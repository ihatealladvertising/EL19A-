/begin PROJECT X12C_KH3DT_DI_NAM_R/C ""
/begin HEADER "" /* key HEADER ++ "comment" に Par.scomment */ PROJECT_NO X12C_KH3DT_DI_NAM_R/C /* key PROJECT_NO ++ project number に car_eng_desti_lot */ VERSION "0KHDCFDZ7" /* key VERSION ++ version number に mProgver */ /end HEADER
/begin MODULE DIM ""
/begin MOD_COMMON "" ALIGNMENT_BYTE 1 ALIGNMENT_WORD 2 ALIGNMENT_LONG 4 ALIGNMENT_FLOAT32_IEEE 4 ALIGNMENT_FLOAT64_IEEE 4 DEPOSIT ABSOLUTE BYTE_ORDER MSB_FIRST /* ﾊﾞｲﾄｵｰﾀﾞｰがﾘﾌﾟﾚｰｽされる */ /end MOD_COMMON
/begin MEASUREMENT vPHOSA "RAM value vPHOSA" UWORD COMP_0489 1 100 -7.995392 7.995148 ECU_ADDRESS 0xFFFF2A4C READ_WRITE /end MEASUREMENT
/begin MEASUREMENT vPHOSAOKf "RAM value vPHOSAOKf" UBYTE COMP_0004 1 100 0 255 ECU_ADDRESS 0xFFFF0DA5 READ_WRITE /end MEASUREMENT
/begin MEASUREMENT vPIADV "RAM value vPIADV" UBYTE COMP_0009 1 100 0 199.21875 ECU_ADDRESS 0xFFFF1B36 READ_WRITE /end MEASUREMENT
/begin MEASUREMENT vPIADVGO "RAM value vPIADVGO" UBYTE COMP_0009 1 100 0 199.21875 ECU_ADDRESS 0xFFFF16F4 READ_WRITE /end MEASUREMENT
/begin MEASUREMENT vPIADVGRS "RAM value vPIADVGRS" UWORD COMP_0009 1 100 0 51199.21875 ECU_ADDRESS 0xFFFF2A50 READ_WRITE /end MEASUREMENT
/begin MEASUREMENT vPIADVGWN "RAM value vPIADVGWN" UBYTE COMP_0045 1 100 0 1.9921875 ECU_ADDRESS 0xFFFF2A52 READ_WRITE /end MEASUREMENT
/begin MEASUREMENT vPICTNG "RAM value vPICTNG" UWORD COMP_0164 1 100 0 19.988175 ECU_ADDRESS 0xFFFF4C66 READ_WRITE /end MEASUREMENT
/begin MEASUREMENT vPICTNG2 "RAM value vPICTNG2" UWORD COMP_0164 1 100 0 19.988175 ECU_ADDRESS 0xFFFF4C68 READ_WRITE /end MEASUREMENT
/begin MEASUREMENT vPIDDTY "RAM value vPIDDTY" ULONG COMP_0490 1 100 -50.00004632576 25550.0236665029 ECU_ADDRESS 0xFFFF0DA8 READ_WRITE /end MEASUREMENT
/begin MEASUREMENT vPIDDTYE "RAM value vPIDDTYE" ULONG COMP_0590_S 1 100 -49.99996243968 25549.980800716 ECU_ADDRESS 0xFFFF0DB0 READ_WRITE /end MEASUREMENT
/begin MEASUREMENT vPIGLMT "RAM value vPIGLMT" UWORD COMP_0146 1 100 0 99.998480265 ECU_ADDRESS 0xFFFF2A54 READ_WRITE /end MEASUREMENT
/begin MEASUREMENT vPIGQH0LM "RAM value vPIGQH0LM" UWORD COMP_0146 1 100 0 99.998480265 ECU_ADDRESS 0xFFFF2A56 READ_WRITE /end MEASUREMENT
/begin MEASUREMENT vPIISCMR "RAM value vPIISCMR" UBYTE COMP_0009 1 100 0 199.21875 ECU_ADDRESS 0xFFFF1B37 READ_WRITE /end MEASUREMENT
/begin MEASUREMENT vPILOCK "RAM value vPILOCK" UBYTE COMP_0009 1 100 0 199.21875 ECU_ADDRESS 0xFFFF1B38 READ_WRITE /end MEASUREMENT
/begin MEASUREMENT vPIPER "RAM value vPIPER" UBYTE COMP_0009 1 100 0 199.21875 ECU_ADDRESS 0xFFFF3A39 READ_WRITE /end MEASUREMENT
/begin MEASUREMENT vPIPERAD "RAM value vPIPERAD" UBYTE COMP_0009 1 100 0 199.21875 ECU_ADDRESS 0xFFFF197A READ_WRITE /end MEASUREMENT
/begin MEASUREMENT vPIPERMR "RAM value vPIPERMR" UBYTE COMP_0009 1 100 0 199.21875 ECU_ADDRESS 0xFFFF197B READ_WRITE /end MEASUREMENT
/begin MEASUREMENT vPIPERZ "RAM value vPIPERZ" UBYTE COMP_0009 1 100 0 199.21875 ECU_ADDRESS 0xFFFF0DB8 READ_WRITE /end MEASUREMENT
/begin MEASUREMENT vPIPHI "RAM value vPIPHI" UWORD COMP_0447 1 100 0 6399.90234375 ECU_ADDRESS 0xFFFF2A58 READ_WRITE /end MEASUREMENT
/begin MEASUREMENT vPMANI "RAM value vPMANI" UWORD COMP_0034_S 1 100 0 255.99609375 ECU_ADDRESS 0xFFFF1E14 READ_WRITE /end MEASUREMENT
/begin MEASUREMENT vPMANIAV "RAM value vPMANIAV" UWORD COMP_0034_S 1 100 0 255.99609375 ECU_ADDRESS 0xFFFF37E6 READ_WRITE /end MEASUREMENT
/begin MEASUREMENT vPMANIAV1 "RAM value vPMANIAV1" UWORD COMP_0034_S 1 100 0 255.99609375 ECU_ADDRESS 0xFFFF37E8 READ_WRITE /end MEASUREMENT
/begin MEASUREMENT vPMANIAV2 "RAM value vPMANIAV2" UWORD COMP_0034_S 1 100 0 255.99609375 ECU_ADDRESS 0xFFFF37EA READ_WRITE /end MEASUREMENT
/begin MEASUREMENT vPMANIAV3 "RAM value vPMANIAV3" UWORD COMP_0034_S 1 100 0 255.99609375 ECU_ADDRESS 0xFFFF37EC READ_WRITE /end MEASUREMENT
/begin MEASUREMENT vPMANIAV4 "RAM value vPMANIAV4" UWORD COMP_0034_S 1 100 0 255.99609375 ECU_ADDRESS 0xFFFF37EE READ_WRITE /end MEASUREMENT
/begin MEASUREMENT vPMANIAV5 "RAM value vPMANIAV5" UWORD COMP_0034_S 1 100 0 255.99609375 ECU_ADDRESS 0xFFFF37F0 READ_WRITE /end MEASUREMENT
/begin MEASUREMENT vPMANI_F "RAM value vPMANI_F" UWORD COMP_0034_S 1 100 0 255.99609375 ECU_ADDRESS 0xFFFF31FE READ_WRITE /end MEASUREMENT
/begin MEASUREMENT vPMANI_N "RAM value vPMANI_N" UWORD COMP_0034_S 1 100 0 255.99609375 ECU_ADDRESS 0xFFFF1E16 READ_WRITE /end MEASUREMENT
/begin MEASUREMENT vPMANVR "RAM value vPMANVR" UWORD COMP_0363_S 1 100 0 327.675 ECU_ADDRESS 0xFFFF2A5A READ_WRITE /end MEASUREMENT
/begin MEASUREMENT vPMAXBST "RAM value vPMAXBST" UWORD COMP_0120_S 1 100 0 16383.75 ECU_ADDRESS 0xFFFF2A5C READ_WRITE /end MEASUREMENT
/begin MEASUREMENT vPMCAFNG1 "RAM value vPMCAFNG1" UBYTE COMP_0016 1 100 0 255 ECU_ADDRESS 0xFFFF4C6A READ_WRITE /end MEASUREMENT
/begin MEASUREMENT vPMCAFNG2 "RAM value vPMCAFNG2" UBYTE COMP_0016 1 100 0 255 ECU_ADDRESS 0xFFFF4C6B READ_WRITE /end MEASUREMENT
/begin MEASUREMENT vPMCAFNG5 "RAM value vPMCAFNG5" UBYTE COMP_0016 1 100 0 255 ECU_ADDRESS 0xFFFF4C6C READ_WRITE /end MEASUREMENT
/begin MEASUREMENT vPMCPRES1 "RAM value vPMCPRES1" UBYTE COMP_0016 1 100 0 255 ECU_ADDRESS 0xFFFF4C6D READ_WRITE /end MEASUREMENT
/begin MEASUREMENT vPMTO2HRL1 "RAM value vPMTO2HRL1" UBYTE COMP_0013 1 100 0 255 ECU_ADDRESS 0xFFFF4C6E READ_WRITE /end MEASUREMENT
/begin MEASUREMENT vPMTO2HRR1 "RAM value vPMTO2HRR1" UBYTE COMP_0013 1 100 0 255 ECU_ADDRESS 0xFFFF4C6F READ_WRITE /end MEASUREMENT
/begin MEASUREMENT vPMTRO2L1 "RAM value vPMTRO2L1" UBYTE COMP_0013 1 100 0 255 ECU_ADDRESS 0xFFFF4C70 READ_WRITE /end MEASUREMENT
/begin MEASUREMENT vPMTRO2R1 "RAM value vPMTRO2R1" UBYTE COMP_0013 1 100 0 255 ECU_ADDRESS 0xFFFF4C71 READ_WRITE /end MEASUREMENT
/begin MEASUREMENT vPMVAB "RAM value vPMVAB" UWORD COMP_0591_S 1 100 0 6553.5 ECU_ADDRESS 0xFFFF37F2 READ_WRITE /end MEASUREMENT
/begin MEASUREMENT vPMVPRES "RAM value vPMVPRES" UWORD COMP_0486 1 100 0 5119.921875 ECU_ADDRESS 0xFFFF4C72 READ_WRITE /end MEASUREMENT
/begin MEASUREMENT vPORTM1 "RAM value vPORTM1" ULONG COMP_0004 1 100 0 4294967295 ECU_ADDRESS 0xFFFF3200 READ_WRITE /end MEASUREMENT
/begin MEASUREMENT vPOSCNTE "RAM value vPOSCNTE" UBYTE COMP_0068 1 100 0 255 ECU_ADDRESS 0xFFFF0DBC READ_WRITE /end MEASUREMENT
/begin MEASUREMENT vPOSIN "RAM value vPOSIN" UBYTE COMP_0068 1 100 0 255 ECU_ADDRESS 0xFFFF3A3A READ_WRITE /end MEASUREMENT
/begin MEASUREMENT vPOSINST "RAM value vPOSINST" UBYTE COMP_0068 1 100 0 255 ECU_ADDRESS 0xFFFF197C READ_WRITE /end MEASUREMENT
/begin MEASUREMENT vPOSPAC "RAM value vPOSPAC" UBYTE COMP_0592_S 1 100 0 255 ECU_ADDRESS 0xFFFF197D READ_WRITE /end MEASUREMENT
/begin MEASUREMENT vPOSTIME "RAM value vPOSTIME" UWORD COMP_0189 1 100 0 209712 ECU_ADDRESS 0xFFFF197E READ_WRITE /end MEASUREMENT
/begin MEASUREMENT vPPAMB "RAM value vPPAMB" UWORD COMP_0215_S 1 100 0 127.99837455 ECU_ADDRESS 0xFFFF522C READ_WRITE /end MEASUREMENT
/begin MEASUREMENT vPPBAV_B "RAM value vPPBAV_B" UWORD COMP_0120_S 1 100 0 16383.75 ECU_ADDRESS 0xFFFF082E READ_WRITE /end MEASUREMENT
/begin MEASUREMENT vPPSV "RAM value vPPSV" UBYTE COMP_0054 1 100 0 5100 ECU_ADDRESS 0xFFFF0DBD READ_WRITE /end MEASUREMENT
/begin MEASUREMENT vPRATIOHD "RAM value vPRATIOHD" UWORD COMP_0217 1 100 0 3.999941832 ECU_ADDRESS 0xFFFF4C74 READ_WRITE /end MEASUREMENT
/begin MEASUREMENT vPRATIO_B "RAM value vPRATIO_B" UWORD COMP_0217 1 100 0 3.999941832 ECU_ADDRESS 0xFFFF0DBE READ_WRITE /end MEASUREMENT
/begin MEASUREMENT vPRATIO_F "RAM value vPRATIO_F" UWORD COMP_0313_S 1 100 0 7.99985745 ECU_ADDRESS 0xFFFF2A5E READ_WRITE /end MEASUREMENT
/begin MEASUREMENT vPRATIO_N "RAM value vPRATIO_N" UWORD COMP_0313_S 1 100 0 7.99985745 ECU_ADDRESS 0xFFFF2A60 READ_WRITE /end MEASUREMENT
/begin MEASUREMENT vPREDSID "RAM value vPREDSID" UBYTE COMP_0068 1 100 0 255 ECU_ADDRESS 0xFFFF37F4 READ_WRITE /end MEASUREMENT
/begin MEASUREMENT vPRENSET0 "RAM value vPRENSET0" UBYTE COMP_0006 1 100 0 3187.5 ECU_ADDRESS 0xFFFF0DC2 READ_WRITE /end MEASUREMENT
/begin MEASUREMENT vPRESS "RAM value vPRESS" UWORD COMP_0050 1 100 0 5119.921875 ECU_ADDRESS 0xFFFF08F4 READ_WRITE /end MEASUREMENT
/begin MEASUREMENT vPRMAX_B "RAM value vPRMAX_B" UWORD COMP_0217 1 100 0 3.999941832 ECU_ADDRESS 0xFFFF4C76 READ_WRITE /end MEASUREMENT
/begin MEASUREMENT vPRSKON "RAM value vPRSKON" UBYTE COMP_0054 1 100 0 5100 ECU_ADDRESS 0xFFFF4C7A READ_WRITE /end MEASUREMENT
/begin MEASUREMENT vPRSOKP "RAM value vPRSOKP" UWORD COMP_0039_S 1 100 60000 125535 ECU_ADDRESS 0xFFFF37F6 READ_WRITE /end MEASUREMENT
/begin MEASUREMENT vPRVO4 "RAM value vPRVO4" UBYTE COMP_0104 1 100 0 2550 ECU_ADDRESS 0xFFFF3316 READ_WRITE /end MEASUREMENT
/begin MEASUREMENT vPSFDCT "RAM value vPSFDCT" UBYTE COMP_0016 1 100 0 255 ECU_ADDRESS 0xFFFF2A62 READ_WRITE /end MEASUREMENT
/begin MEASUREMENT vPSFT "RAM value vPSFT" UWORD COMP_0265 1 100 -8.000012288 7.999768147 ECU_ADDRESS 0xFFFF0DC4 READ_WRITE /end MEASUREMENT
/begin MEASUREMENT vPSRIMN "RAM value vPSRIMN" UBYTE COMP_0091 1 100 0 255 ECU_ADDRESS 0xFFFF0DC8 READ_WRITE /end MEASUREMENT
/begin MEASUREMENT vPSSEQN "RAM value vPSSEQN" UBYTE COMP_0016 1 100 0 255 ECU_ADDRESS 0xFFFF2A63 READ_WRITE /end MEASUREMENT
/begin MEASUREMENT vPSSEQN_S "RAM value vPSSEQN_S" UBYTE COMP_0016 1 100 0 255 ECU_ADDRESS 0xFFFF3052 READ_WRITE /end MEASUREMENT
/begin MEASUREMENT vPST21FN "RAM value vPST21FN" UBYTE COMP_0371 1 100 0 510 ECU_ADDRESS 0xFFFF4C7B READ_WRITE /end MEASUREMENT
/begin MEASUREMENT vPST21PN "RAM value vPST21PN" SWORD COMP_0491 1 100 -2560 2559.921875 ECU_ADDRESS 0xFFFF4C7C READ_WRITE /end MEASUREMENT
/begin MEASUREMENT vPST21PX "RAM value vPST21PX" SWORD COMP_0491 1 100 -2560 2559.921875 ECU_ADDRESS 0xFFFF4C7E READ_WRITE /end MEASUREMENT
/begin MEASUREMENT vPST21TN "RAM value vPST21TN" UBYTE COMP_0096 1 100 0 2550 ECU_ADDRESS 0xFFFF4C80 READ_WRITE /end MEASUREMENT
/begin MEASUREMENT vPST22FN "RAM value vPST22FN" UBYTE COMP_0371 1 100 0 510 ECU_ADDRESS 0xFFFF4C81 READ_WRITE /end MEASUREMENT
/begin MEASUREMENT vPST22PN "RAM value vPST22PN" SWORD COMP_0491 1 100 -2560 2559.921875 ECU_ADDRESS 0xFFFF4C82 READ_WRITE /end MEASUREMENT
/begin MEASUREMENT vPST22PX "RAM value vPST22PX" SWORD COMP_0491 1 100 -2560 2559.921875 ECU_ADDRESS 0xFFFF4C84 READ_WRITE /end MEASUREMENT
/begin MEASUREMENT vPST22TN "RAM value vPST22TN" UBYTE COMP_0096 1 100 0 2550 ECU_ADDRESS 0xFFFF4C86 READ_WRITE /end MEASUREMENT
/begin MEASUREMENT vPST23DN "RAM value vPST23DN" UWORD COMP_0050 1 100 0 5119.921875 ECU_ADDRESS 0xFFFF4C88 READ_WRITE /end MEASUREMENT
/begin MEASUREMENT vPST23JN "RAM value vPST23JN" UWORD COMP_0050 1 100 0 5119.921875 ECU_ADDRESS 0xFFFF4C8A READ_WRITE /end MEASUREMENT
/begin MEASUREMENT vPST23PN "RAM value vPST23PN" SWORD COMP_0491 1 100 -2560 2559.921875 ECU_ADDRESS 0xFFFF4C8C READ_WRITE /end MEASUREMENT
/begin MEASUREMENT vPST23PX "RAM value vPST23PX" SWORD COMP_0491 1 100 -2560 2559.921875 ECU_ADDRESS 0xFFFF4C8E READ_WRITE /end MEASUREMENT
/begin MEASUREMENT vPSTSWTRP "RAM value vPSTSWTRP" UWORD COMP_0049 1 100 0 65535 ECU_ADDRESS 0xFFFF2A64 READ_WRITE /end MEASUREMENT
/begin MEASUREMENT vPSYSCN "RAM value vPSYSCN" UBYTE COMP_0016 1 100 0 255 ECU_ADDRESS 0xFFFF2A66 READ_WRITE /end MEASUREMENT
/begin MEASUREMENT vPSYSCNT "RAM value vPSYSCNT" UWORD COMP_0016 1 100 0 65535 ECU_ADDRESS 0xFFFF4C90 READ_WRITE /end MEASUREMENT
/begin MEASUREMENT vPSYSCNV "RAM value vPSYSCNV" UBYTE COMP_0016 1 100 0 255 ECU_ADDRESS 0xFFFF2A67 READ_WRITE /end MEASUREMENT
/begin MEASUREMENT vPTDAPO "RAM value vPTDAPO" UWORD COMP_0005 1 100 0 7208.85 ECU_ADDRESS 0xFFFF1664 READ_WRITE /end MEASUREMENT
/begin MEASUREMENT vPTDAPOSL "RAM value vPTDAPOSL" UWORD COMP_0032_S 1 100 0 8191.875 ECU_ADDRESS 0xFFFF207A READ_WRITE /end MEASUREMENT
/begin MEASUREMENT vPTDNE "RAM value vPTDNE" UWORD COMP_0065 1 100 0 204796.875 ECU_ADDRESS 0xFFFF098A READ_WRITE /end MEASUREMENT
/begin MEASUREMENT vPTDNE_S "RAM value vPTDNE_S" UWORD COMP_0065 1 100 0 204796.875 ECU_ADDRESS 0xFFFF16D0 READ_WRITE /end MEASUREMENT
/begin MEASUREMENT vPTDPWTSP "RAM value vPTDPWTSP" UWORD COMP_0032_S 1 100 0 8191.875 ECU_ADDRESS 0xFFFF207C READ_WRITE /end MEASUREMENT
/begin MEASUREMENT vPTNHI "RAM value vPTNHI" UBYTE COMP_0020 1 100 0 12750 ECU_ADDRESS 0xFFFF2A68 READ_WRITE /end MEASUREMENT
/begin MEASUREMENT vPTNHIC "RAM value vPTNHIC" UBYTE COMP_0020 1 100 0 12750 ECU_ADDRESS 0xFFFF207E READ_WRITE /end MEASUREMENT
/begin MEASUREMENT vPTYHDTMP "RAM value vPTYHDTMP" ULONG COMP_0068 1 100 0 4294967295 ECU_ADDRESS 0xFFFF2A6C READ_WRITE /end MEASUREMENT
/begin MEASUREMENT vPTYTMP "RAM value vPTYTMP" ULONG COMP_0068 1 100 0 4294967295 ECU_ADDRESS 0xFFFF2A70 READ_WRITE /end MEASUREMENT
/begin MEASUREMENT vPUMDTY "RAM value vPUMDTY" UWORD COMP_0209_S 1 100 0 199.996894995 ECU_ADDRESS 0xFFFF1B3A READ_WRITE /end MEASUREMENT
/begin MEASUREMENT vPUMDTYN "RAM value vPUMDTYN" UBYTE COMP_0047 1 100 0 127.5 ECU_ADDRESS 0xFFFF1666 READ_WRITE /end MEASUREMENT
/begin MEASUREMENT vPUMPMD "RAM value vPUMPMD" UBYTE COMP_0068 1 100 0 255 ECU_ADDRESS 0xFFFF098C READ_WRITE /end MEASUREMENT
/begin MEASUREMENT vPUMPMDBF "RAM value vPUMPMDBF" UBYTE COMP_0068 1 100 0 255 ECU_ADDRESS 0xFFFF0DC9 READ_WRITE /end MEASUREMENT
/begin MEASUREMENT vPUMPPOS "RAM value vPUMPPOS" UBYTE COMP_0068 1 100 0 255 ECU_ADDRESS 0xFFFF1980 READ_WRITE /end MEASUREMENT
/begin MEASUREMENT vPUMRE "RAM value vPUMRE" UWORD COMP_0057_S 1 100 0 6553.5 ECU_ADDRESS 0xFFFF0DCA READ_WRITE /end MEASUREMENT
/begin MEASUREMENT vPUSDGN2f "RAM value vPUSDGN2f" UBYTE COMP_0004 1 100 0 255 ECU_ADDRESS 0xFFFF2A74 READ_WRITE /end MEASUREMENT
/begin MEASUREMENT vPUSDGNf "RAM value vPUSDGNf" UBYTE COMP_0004 1 100 0 255 ECU_ADDRESS 0xFFFF2A75 READ_WRITE /end MEASUREMENT
/begin MEASUREMENT vPVDLTP "RAM value vPVDLTP" SWORD COMP_0002_S 1 100 -32768 32767 ECU_ADDRESS 0xFFFF2A76 READ_WRITE /end MEASUREMENT
/begin MEASUREMENT vPVDLTPMN "RAM value vPVDLTPMN" SWORD COMP_0002_S 1 100 -32768 32767 ECU_ADDRESS 0xFFFF4C92 READ_WRITE /end MEASUREMENT
/begin MEASUREMENT vPVDLTPMX "RAM value vPVDLTPMX" SWORD COMP_0002_S 1 100 -32768 32767 ECU_ADDRESS 0xFFFF4C94 READ_WRITE /end MEASUREMENT
/begin MEASUREMENT vPVEVPR "RAM value vPVEVPR" UBYTE COMP_0054 1 100 0 5100 ECU_ADDRESS 0xFFFF3A3B READ_WRITE /end MEASUREMENT
/begin MEASUREMENT vPVJDGTM "RAM value vPVJDGTM" UBYTE COMP_0013 1 100 0 255 ECU_ADDRESS 0xFFFF2A78 READ_WRITE /end MEASUREMENT
/begin MEASUREMENT vPVLCNT "RAM value vPVLCNT" UWORD COMP_0016 1 100 0 65535 ECU_ADDRESS 0xFFFF4C96 READ_WRITE /end MEASUREMENT
/begin MEASUREMENT vPVPSTD "RAM value vPVPSTD" UWORD COMP_0039_S 1 100 60000 125535 ECU_ADDRESS 0xFFFF2A7A READ_WRITE /end MEASUREMENT
/begin MEASUREMENT vPVSLIM "RAM value vPVSLIM" UWORD COMP_0523_S 1 100 0 64.001481 ECU_ADDRESS 0xFFFF2A7C READ_WRITE /end MEASUREMENT
/begin MEASUREMENT vPVSPTRP "RAM value vPVSPTRP" UWORD COMP_0049 1 100 0 65535 ECU_ADDRESS 0xFFFF2A7E READ_WRITE /end MEASUREMENT
/begin MEASUREMENT vPVTCTRG "RAM value vPVTCTRG" UBYTE COMP_0048 1 100 0 127.5 ECU_ADDRESS 0xFFFF0DCC READ_WRITE /end MEASUREMENT
/begin MEASUREMENT vPVTCTRG2 "RAM value vPVTCTRG2" UBYTE COMP_0019 1 100 0 255 ECU_ADDRESS 0xFFFF0DCD READ_WRITE /end MEASUREMENT
/begin MEASUREMENT vPVTCTRGE "RAM value vPVTCTRGE" UBYTE COMP_0256 1 100 -64 63.5 ECU_ADDRESS 0xFFFF0DCE READ_WRITE /end MEASUREMENT
/begin MEASUREMENT vPVTM "RAM value vPVTM" UWORD COMP_0049 1 100 0 65535 ECU_ADDRESS 0xFFFF37F8 READ_WRITE /end MEASUREMENT
/begin MEASUREMENT vPVTMR "RAM value vPVTMR" UBYTE COMP_0013 1 100 0 255 ECU_ADDRESS 0xFFFF2A80 READ_WRITE /end MEASUREMENT
/begin MEASUREMENT vPVTMR100 "RAM value vPVTMR100" UBYTE COMP_0014 1 100 0 2550 ECU_ADDRESS 0xFFFF2A81 READ_WRITE /end MEASUREMENT
/begin MEASUREMENT vPVTMR1S "RAM value vPVTMR1S" UBYTE COMP_0008 1 100 0 25500 ECU_ADDRESS 0xFFFF2A82 READ_WRITE /end MEASUREMENT
/begin MEASUREMENT vPVTMRNG "RAM value vPVTMRNG" UBYTE COMP_0013 1 100 0 255 ECU_ADDRESS 0xFFFF4C98 READ_WRITE /end MEASUREMENT
/begin MEASUREMENT vPWLNGMD "RAM value vPWLNGMD" UBYTE COMP_0068 1 100 0 255 ECU_ADDRESS 0xFFFF1981 READ_WRITE /end MEASUREMENT
/begin MEASUREMENT vQ0 "RAM value vQ0" ULONG COMP_0068 1 100 0 4294967295 ECU_ADDRESS 0xFFFF3204 READ_WRITE /end MEASUREMENT
/begin MEASUREMENT vQ0N "RAM value vQ0N" SLONG COMP_0263 1 100 -2147483648 2147483647 ECU_ADDRESS 0xFFFF3208 READ_WRITE /end MEASUREMENT
/begin MEASUREMENT vQ0TRM "RAM value vQ0TRM" UWORD COMP_0092_S 1 100 0 1638.375 ECU_ADDRESS 0xFFFF1E18 READ_WRITE /end MEASUREMENT
/begin MEASUREMENT vQ0TRMDMP "RAM value vQ0TRMDMP" UWORD COMP_0092_S 1 100 0 1638.375 ECU_ADDRESS 0xFFFF2A84 READ_WRITE /end MEASUREMENT
/begin MEASUREMENT vQ0_LLIM "RAM value vQ0_LLIM" ULONG COMP_0068 1 100 0 4294967295 ECU_ADDRESS 0xFFFF37FC READ_WRITE /end MEASUREMENT
/begin MEASUREMENT vQ0_LLIML "RAM value vQ0_LLIML" ULONG COMP_0068 1 100 0 4294967295 ECU_ADDRESS 0xFFFF3800 READ_WRITE /end MEASUREMENT
/begin MEASUREMENT vQ4 "RAM value vQ4" ULONG COMP_0004 1 100 0 4294967295 ECU_ADDRESS 0xFFFF3318 READ_WRITE /end MEASUREMENT
/begin MEASUREMENT vQA4 "RAM value vQA4" UWORD COMP_0004 1 100 0 65535 ECU_ADDRESS 0xFFFF1E40 READ_WRITE /end MEASUREMENT
/begin MEASUREMENT vQA4_2 "RAM value vQA4_2" UWORD COMP_0068 1 100 0 65535 ECU_ADDRESS 0xFFFF320C READ_WRITE /end MEASUREMENT
/begin MEASUREMENT vQAA "RAM value vQAA" UWORD COMP_0004 1 100 0 65535 ECU_ADDRESS 0xFFFF331C READ_WRITE /end MEASUREMENT
/begin MEASUREMENT vQAA2 "RAM value vQAA2" UWORD COMP_0004 1 100 0 65535 ECU_ADDRESS 0xFFFF32E0 READ_WRITE /end MEASUREMENT
/begin MEASUREMENT vQAA2_2 "RAM value vQAA2_2" UWORD COMP_0068 1 100 0 65535 ECU_ADDRESS 0xFFFF30DE READ_WRITE /end MEASUREMENT
/begin MEASUREMENT vQAACV "RAM value vQAACV" UWORD COMP_0051 1 100 0 65535 ECU_ADDRESS 0xFFFF1A70 READ_WRITE /end MEASUREMENT
/begin MEASUREMENT vQAACV0 "RAM value vQAACV0" UWORD COMP_0051 1 100 0 65535 ECU_ADDRESS 0xFFFF0DD0 READ_WRITE /end MEASUREMENT
/begin MEASUREMENT vQAACVAVE "RAM value vQAACVAVE" UWORD COMP_0051 1 100 0 65535 ECU_ADDRESS 0xFFFF4C9A READ_WRITE /end MEASUREMENT
/begin MEASUREMENT vQAACVEND "RAM value vQAACVEND" UWORD COMP_0051 1 100 0 65535 ECU_ADDRESS 0xFFFF4C9C READ_WRITE /end MEASUREMENT
/begin MEASUREMENT vQAACVMAX "RAM value vQAACVMAX" UWORD COMP_0051 1 100 0 65535 ECU_ADDRESS 0xFFFF4C9E READ_WRITE /end MEASUREMENT
/begin MEASUREMENT vQAACVMIN "RAM value vQAACVMIN" UWORD COMP_0051 1 100 0 65535 ECU_ADDRESS 0xFFFF4CA0 READ_WRITE /end MEASUREMENT
/begin MEASUREMENT vQAA_2 "RAM value vQAA_2" UWORD COMP_0068 1 100 0 65535 ECU_ADDRESS 0xFFFF320E READ_WRITE /end MEASUREMENT
/begin MEASUREMENT vQABFC "RAM value vQABFC" SWORD COMP_0277 1 100 -32768 32767 ECU_ADDRESS 0xFFFF0DD2 READ_WRITE /end MEASUREMENT
/begin MEASUREMENT vQAC "RAM value vQAC" UBYTE COMP_0051 1 100 0 255 ECU_ADDRESS 0xFFFF098D READ_WRITE /end MEASUREMENT
/begin MEASUREMENT vQACN "RAM value vQACN" UBYTE COMP_0051 1 100 0 255 ECU_ADDRESS 0xFFFF0DD4 READ_WRITE /end MEASUREMENT
/begin MEASUREMENT vQACROFF "RAM value vQACROFF" UBYTE COMP_0051 1 100 0 255 ECU_ADDRESS 0xFFFF0DD5 READ_WRITE /end MEASUREMENT
/begin MEASUREMENT vQACROFF0 "RAM value vQACROFF0" UBYTE COMP_0051 1 100 0 255 ECU_ADDRESS 0xFFFF2A86 READ_WRITE /end MEASUREMENT
/begin MEASUREMENT vQACROLD "RAM value vQACROLD" UBYTE COMP_0051 1 100 0 255 ECU_ADDRESS 0xFFFF0DD6 READ_WRITE /end MEASUREMENT
/begin MEASUREMENT vQACRON "RAM value vQACRON" UBYTE COMP_0051 1 100 0 255 ECU_ADDRESS 0xFFFF0DD7 READ_WRITE /end MEASUREMENT
/begin MEASUREMENT vQACRON0 "RAM value vQACRON0" UBYTE COMP_0051 1 100 0 255 ECU_ADDRESS 0xFFFF2A87 READ_WRITE /end MEASUREMENT
/begin MEASUREMENT vQACYL "RAM value vQACYL" UWORD COMP_0068 1 100 0 65535 ECU_ADDRESS 0xFFFF3210 READ_WRITE /end MEASUREMENT
/begin MEASUREMENT vQADVFB "RAM value vQADVFB" SBYTE COMP_0277 1 100 -128 127 ECU_ADDRESS 0xFFFF1982 READ_WRITE /end MEASUREMENT
/begin MEASUREMENT vQADVFBI "RAM value vQADVFBI" SBYTE COMP_0277 1 100 -128 127 ECU_ADDRESS 0xFFFF1983 READ_WRITE /end MEASUREMENT
/begin MEASUREMENT vQADVFBP "RAM value vQADVFBP" SBYTE COMP_0277 1 100 -128 127 ECU_ADDRESS 0xFFFF1984 READ_WRITE /end MEASUREMENT
/begin MEASUREMENT vQADVFBTP "RAM value vQADVFBTP" SLONG COMP_0277 1 100 -2147483648 2147483647 ECU_ADDRESS 0xFFFF1988 READ_WRITE /end MEASUREMENT
/begin MEASUREMENT vQADVFF "RAM value vQADVFF" SBYTE COMP_0277 1 100 -128 127 ECU_ADDRESS 0xFFFF0DD8 READ_WRITE /end MEASUREMENT
/begin MEASUREMENT vQADVISC2 "RAM value vQADVISC2" SWORD COMP_0277 1 100 -32768 32767 ECU_ADDRESS 0xFFFF198C READ_WRITE /end MEASUREMENT
/begin MEASUREMENT vQAE "RAM value vQAE" UWORD COMP_0068 1 100 0 65535 ECU_ADDRESS 0xFFFF2A88 READ_WRITE /end MEASUREMENT
/begin MEASUREMENT vQAESUML "RAM value vQAESUML" ULONG COMP_0068 1 100 0 4294967295 ECU_ADDRESS 0xFFFF2A8C READ_WRITE /end MEASUREMENT
/begin MEASUREMENT vQAESUMR "RAM value vQAESUMR" ULONG COMP_0068 1 100 0 4294967295 ECU_ADDRESS 0xFFFF2A94 READ_WRITE /end MEASUREMENT
/begin MEASUREMENT vQAFCI "RAM value vQAFCI" SWORD COMP_0277 1 100 -32768 32767 ECU_ADDRESS 0xFFFF0DDA READ_WRITE /end MEASUREMENT
/begin MEASUREMENT vQAI "RAM value vQAI" UWORD COMP_0004 1 100 0 65535 ECU_ADDRESS 0xFFFF3212 READ_WRITE /end MEASUREMENT
/begin MEASUREMENT vQAIG "RAM value vQAIG" UBYTE COMP_0388 1 100 0 25.5 ECU_ADDRESS 0xFFFF0DDC READ_WRITE /end MEASUREMENT
/begin MEASUREMENT vQALTMX "RAM value vQALTMX" UBYTE COMP_0051 1 100 0 255 ECU_ADDRESS 0xFFFF0DDE READ_WRITE /end MEASUREMENT
/begin MEASUREMENT vQAPHYS "RAM value vQAPHYS" UWORD COMP_0220 1 100 0 65535 ECU_ADDRESS 0xFFFF1B3C READ_WRITE /end MEASUREMENT
/begin MEASUREMENT vQAPSUM "RAM value vQAPSUM" UWORD COMP_0156 1 100 0 65535 ECU_ADDRESS 0xFFFF2A9C READ_WRITE /end MEASUREMENT
/begin MEASUREMENT vQAVFBPS "RAM value vQAVFBPS" SBYTE COMP_0277 1 100 -128 127 ECU_ADDRESS 0xFFFF198E READ_WRITE /end MEASUREMENT
/begin MEASUREMENT vQAVFBS "RAM value vQAVFBS" SWORD COMP_0277 1 100 -32768 32767 ECU_ADDRESS 0xFFFF1990 READ_WRITE /end MEASUREMENT
/begin MEASUREMENT vQAVFPS "RAM value vQAVFPS" SWORD COMP_0593_S 1 100 -32768 32767 ECU_ADDRESS 0xFFFF1992 READ_WRITE /end MEASUREMENT
/begin MEASUREMENT vQAVISC "RAM value vQAVISC" SWORD COMP_0277 1 100 -32768 32767 ECU_ADDRESS 0xFFFF1994 READ_WRITE /end MEASUREMENT
/begin MEASUREMENT vQBC "RAM value vQBC" UWORD COMP_0324 1 100 0 511.9921875 ECU_ADDRESS 0xFFFF0DE0 READ_WRITE /end MEASUREMENT
/begin MEASUREMENT vQBCV "RAM value vQBCV" UBYTE COMP_0276 1 100 0 1020 ECU_ADDRESS 0xFFFF0DE2 READ_WRITE /end MEASUREMENT
/begin MEASUREMENT vQCIMAX "RAM value vQCIMAX" UBYTE COMP_0051 1 100 0 255 ECU_ADDRESS 0xFFFF0DE3 READ_WRITE /end MEASUREMENT
/begin MEASUREMENT vQCIMIN "RAM value vQCIMIN" UBYTE COMP_0051 1 100 0 255 ECU_ADDRESS 0xFFFF0DE4 READ_WRITE /end MEASUREMENT
/begin MEASUREMENT vQCINDHL "RAM value vQCINDHL" UBYTE COMP_0051 1 100 0 255 ECU_ADDRESS 0xFFFF0DE5 READ_WRITE /end MEASUREMENT
/begin MEASUREMENT vQCISTS "RAM value vQCISTS" UBYTE COMP_0004 1 100 0 255 ECU_ADDRESS 0xFFFF0DE6 READ_WRITE /end MEASUREMENT
/begin MEASUREMENT vQCK "RAM value vQCK" UBYTE COMP_0220 1 100 0 255 ECU_ADDRESS 0xFFFF1667 READ_WRITE /end MEASUREMENT
/begin MEASUREMENT vQCK0 "RAM value vQCK0" UBYTE COMP_0220 1 100 0 255 ECU_ADDRESS 0xFFFF1668 READ_WRITE /end MEASUREMENT
/begin MEASUREMENT vQCK0N "RAM value vQCK0N" UBYTE COMP_0220 1 100 0 255 ECU_ADDRESS 0xFFFF1669 READ_WRITE /end MEASUREMENT
/begin MEASUREMENT vQCK0NN "RAM value vQCK0NN" UBYTE COMP_0220 1 100 0 255 ECU_ADDRESS 0xFFFF166A READ_WRITE /end MEASUREMENT
/begin MEASUREMENT vQCK0NZ "RAM value vQCK0NZ" UBYTE COMP_0220 1 100 0 255 ECU_ADDRESS 0xFFFF166B READ_WRITE /end MEASUREMENT
/begin MEASUREMENT vQCK1 "RAM value vQCK1" UBYTE COMP_0220 1 100 0 255 ECU_ADDRESS 0xFFFF166C READ_WRITE /end MEASUREMENT
/begin MEASUREMENT vQCK2 "RAM value vQCK2" UBYTE COMP_0220 1 100 0 255 ECU_ADDRESS 0xFFFF166D READ_WRITE /end MEASUREMENT
/begin MEASUREMENT vQCM "RAM value vQCM" UWORD COMP_0068 1 100 0 65535 ECU_ADDRESS 0xFFFF154A READ_WRITE /end MEASUREMENT
/begin MEASUREMENT vQCYL "RAM value vQCYL" UWORD COMP_0092_S 1 100 0 1638.375 ECU_ADDRESS 0xFFFF3214 READ_WRITE /end MEASUREMENT
/begin MEASUREMENT vQCYLAP "RAM value vQCYLAP" UWORD COMP_0594_S 1 100 0 1638.375 ECU_ADDRESS 0xFFFF321A READ_WRITE /end MEASUREMENT
/begin MEASUREMENT vQCYLAPZ "RAM value vQCYLAPZ" UWORD COMP_0594_S 1 100 0 1638.375 ECU_ADDRESS 0xFFFF321C READ_WRITE /end MEASUREMENT
/begin MEASUREMENT vQCYL_PM "RAM value vQCYL_PM" UWORD COMP_0092_S 1 100 0 1638.375 ECU_ADDRESS 0xFFFF3216 READ_WRITE /end MEASUREMENT
/begin MEASUREMENT vQCYL_PMF "RAM value vQCYL_PMF" UWORD COMP_0092_S 1 100 0 1638.375 ECU_ADDRESS 0xFFFF3218 READ_WRITE /end MEASUREMENT
/begin MEASUREMENT vQDSPT "RAM value vQDSPT" UWORD COMP_0324 1 100 0 511.9921875 ECU_ADDRESS 0xFFFF098E READ_WRITE /end MEASUREMENT
/begin MEASUREMENT vQDSPTM "RAM value vQDSPTM" UWORD COMP_0324 1 100 0 511.9921875 ECU_ADDRESS 0xFFFF0DE8 READ_WRITE /end MEASUREMENT
/begin MEASUREMENT vQEGRVA "RAM value vQEGRVA" UWORD COMP_0092_S 1 100 0 1638.375 ECU_ADDRESS 0xFFFF3B7A READ_WRITE /end MEASUREMENT
/begin MEASUREMENT vQEGRVE "RAM value vQEGRVE" UWORD COMP_0092_S 1 100 0 1638.375 ECU_ADDRESS 0xFFFF3B7C READ_WRITE /end MEASUREMENT
/begin MEASUREMENT vQENST "RAM value vQENST" UBYTE COMP_0051 1 100 0 255 ECU_ADDRESS 0xFFFF0DEA READ_WRITE /end MEASUREMENT
/begin MEASUREMENT vQETBN "RAM value vQETBN" UWORD COMP_0304_S 1 100 0 1.04856 ECU_ADDRESS 0xFFFF2AA0 READ_WRITE /end MEASUREMENT
/begin MEASUREMENT vQEXSTM "RAM value vQEXSTM" UWORD COMP_0019_S 1 100 0 257.000024415 ECU_ADDRESS 0xFFFF3A3C READ_WRITE /end MEASUREMENT
/begin MEASUREMENT vQEXSTPM "RAM value vQEXSTPM" ULONG COMP_0019_S 1 100 0 16843010.6000859 ECU_ADDRESS 0xFFFF20F4 READ_WRITE /end MEASUREMENT
/begin MEASUREMENT vQEXSTPU2 "RAM value vQEXSTPU2" UWORD COMP_0068 1 100 0 65535 ECU_ADDRESS 0xFFFF3A3E READ_WRITE /end MEASUREMENT
/begin MEASUREMENT vQEXSTU "RAM value vQEXSTU" UWORD COMP_0019_S 1 100 0 257.000024415 ECU_ADDRESS 0xFFFF3A40 READ_WRITE /end MEASUREMENT
/begin MEASUREMENT vQFBI "RAM value vQFBI" SWORD COMP_0277 1 100 -32768 32767 ECU_ADDRESS 0xFFFF0990 READ_WRITE /end MEASUREMENT
/begin MEASUREMENT vQFBIADD "RAM value vQFBIADD" SLONG COMP_0277 1 100 -2147483648 2147483647 ECU_ADDRESS 0xFFFF0DEC READ_WRITE /end MEASUREMENT
/begin MEASUREMENT vQFBIAVE "RAM value vQFBIAVE" SLONG COMP_0277 1 100 -2147483648 2147483647 ECU_ADDRESS 0xFFFF0DF0 READ_WRITE /end MEASUREMENT
/begin MEASUREMENT vQFBIBAK "RAM value vQFBIBAK" SWORD COMP_0277 1 100 -32768 32767 ECU_ADDRESS 0xFFFF0DF4 READ_WRITE /end MEASUREMENT
/begin MEASUREMENT vQFBIBAS "RAM value vQFBIBAS" UBYTE COMP_0051 1 100 0 255 ECU_ADDRESS 0xFFFF0DF6 READ_WRITE /end MEASUREMENT
/begin MEASUREMENT vQFBIMAX "RAM value vQFBIMAX" UBYTE COMP_0051 1 100 0 255 ECU_ADDRESS 0xFFFF0DF7 READ_WRITE /end MEASUREMENT
/begin MEASUREMENT vQFBIMAXH "RAM value vQFBIMAXH" UBYTE COMP_0051 1 100 0 255 ECU_ADDRESS 0xFFFF0DF8 READ_WRITE /end MEASUREMENT
/begin MEASUREMENT vQFBIMAXS "RAM value vQFBIMAXS" UBYTE COMP_0051 1 100 0 255 ECU_ADDRESS 0xFFFF0DF9 READ_WRITE /end MEASUREMENT
/begin MEASUREMENT vQFBIMIN "RAM value vQFBIMIN" SBYTE COMP_0277 1 100 -128 127 ECU_ADDRESS 0xFFFF0DFA READ_WRITE /end MEASUREMENT
/begin MEASUREMENT vQFBIMINH "RAM value vQFBIMINH" SBYTE COMP_0277 1 100 -128 127 ECU_ADDRESS 0xFFFF0DFB READ_WRITE /end MEASUREMENT
/begin MEASUREMENT vQFBIMINS "RAM value vQFBIMINS" SBYTE COMP_0277 1 100 -128 127 ECU_ADDRESS 0xFFFF0DFC READ_WRITE /end MEASUREMENT
/begin MEASUREMENT vQFUN "RAM value vQFUN" UWORD COMP_0469_S 1 100 0 20479.6875 ECU_ADDRESS 0xFFFF0DFE READ_WRITE /end MEASUREMENT
/begin MEASUREMENT vQH0 "RAM value vQH0" UBYTE COMP_0032 1 100 0 0.99609375 ECU_ADDRESS 0xFFFF207F READ_WRITE /end MEASUREMENT
/begin MEASUREMENT vQH0LMT "RAM value vQH0LMT" UWORD COMP_0146 1 100 0 99.998480265 ECU_ADDRESS 0xFFFF0E00 READ_WRITE /end MEASUREMENT
/begin MEASUREMENT vQH0QL "RAM value vQH0QL" UWORD COMP_0146 1 100 0 99.998480265 ECU_ADDRESS 0xFFFF2080 READ_WRITE /end MEASUREMENT
/begin MEASUREMENT vQH0TD "RAM value vQH0TD" UWORD COMP_0410 1 100 0 99.9985458 ECU_ADDRESS 0xFFFF2AA2 READ_WRITE /end MEASUREMENT
/begin MEASUREMENT vQH0TR "RAM value vQH0TR" UWORD COMP_0063 1 100 0 255.99609375 ECU_ADDRESS 0xFFFF2AA4 READ_WRITE /end MEASUREMENT
/begin MEASUREMENT vQHITAC "RAM value vQHITAC" UBYTE COMP_0045 1 100 0 1.9921875 ECU_ADDRESS 0xFFFF3804 READ_WRITE /end MEASUREMENT
/begin MEASUREMENT vQISC "RAM value vQISC" UWORD COMP_0051 1 100 0 65535 ECU_ADDRESS 0xFFFF0E02 READ_WRITE /end MEASUREMENT
/begin MEASUREMENT vQLD0N "RAM value vQLD0N" UWORD COMP_0051 1 100 0 65535 ECU_ADDRESS 0xFFFF0E04 READ_WRITE /end MEASUREMENT
/begin MEASUREMENT vQLD1N "RAM value vQLD1N" UWORD COMP_0051 1 100 0 65535 ECU_ADDRESS 0xFFFF0E06 READ_WRITE /end MEASUREMENT
/begin MEASUREMENT vQLD1NS "RAM value vQLD1NS" SWORD COMP_0277 1 100 -32768 32767 ECU_ADDRESS 0xFFFF0E08 READ_WRITE /end MEASUREMENT
/begin MEASUREMENT vQLD2 "RAM value vQLD2" UBYTE COMP_0051 1 100 0 255 ECU_ADDRESS 0xFFFF2AA6 READ_WRITE /end MEASUREMENT
/begin MEASUREMENT vQLDAC "RAM value vQLDAC" UBYTE COMP_0051 1 100 0 255 ECU_ADDRESS 0xFFFF0E0A READ_WRITE /end MEASUREMENT
/begin MEASUREMENT vQLDALT "RAM value vQLDALT" UBYTE COMP_0051 1 100 0 255 ECU_ADDRESS 0xFFFF0E0B READ_WRITE /end MEASUREMENT
/begin MEASUREMENT vQLDALTS "RAM value vQLDALTS" SWORD COMP_0277 1 100 -32768 32767 ECU_ADDRESS 0xFFFF0E0C READ_WRITE /end MEASUREMENT
/begin MEASUREMENT vQLDBAT "RAM value vQLDBAT" UBYTE COMP_0051 1 100 0 255 ECU_ADDRESS 0xFFFF0E0E READ_WRITE /end MEASUREMENT
/begin MEASUREMENT vQLDBATN "RAM value vQLDBATN" UBYTE COMP_0051 1 100 0 255 ECU_ADDRESS 0xFFFF0E0F READ_WRITE /end MEASUREMENT
/begin MEASUREMENT vQLDBATS "RAM value vQLDBATS" SBYTE COMP_0277 1 100 -128 127 ECU_ADDRESS 0xFFFF0E10 READ_WRITE /end MEASUREMENT
/begin MEASUREMENT vQLDBATSN "RAM value vQLDBATSN" SBYTE COMP_0277 1 100 -128 127 ECU_ADDRESS 0xFFFF0E11 READ_WRITE /end MEASUREMENT
/begin MEASUREMENT vQLDBFN "RAM value vQLDBFN" UBYTE COMP_0051 1 100 0 255 ECU_ADDRESS 0xFFFF0E12 READ_WRITE /end MEASUREMENT
/begin MEASUREMENT vQLDFOG "RAM value vQLDFOG" UBYTE COMP_0051 1 100 0 255 ECU_ADDRESS 0xFFFF0E13 READ_WRITE /end MEASUREMENT
/begin MEASUREMENT vQLDHLH "RAM value vQLDHLH" UBYTE COMP_0051 1 100 0 255 ECU_ADDRESS 0xFFFF0E14 READ_WRITE /end MEASUREMENT
/begin MEASUREMENT vQLDHLL "RAM value vQLDHLL" UBYTE COMP_0051 1 100 0 255 ECU_ADDRESS 0xFFFF0E15 READ_WRITE /end MEASUREMENT
/begin MEASUREMENT vQLDN "RAM value vQLDN" UWORD COMP_0051 1 100 0 65535 ECU_ADDRESS 0xFFFF0E16 READ_WRITE /end MEASUREMENT
/begin MEASUREMENT vQLDNS "RAM value vQLDNS" SWORD COMP_0277 1 100 -32768 32767 ECU_ADDRESS 0xFFFF0E18 READ_WRITE /end MEASUREMENT
/begin MEASUREMENT vQLDPOS "RAM value vQLDPOS" UBYTE COMP_0051 1 100 0 255 ECU_ADDRESS 0xFFFF0E1A READ_WRITE /end MEASUREMENT
/begin MEASUREMENT vQLDPS2 "RAM value vQLDPS2" UWORD COMP_0051 1 100 0 65535 ECU_ADDRESS 0xFFFF0E1C READ_WRITE /end MEASUREMENT
/begin MEASUREMENT vQLDPSD "RAM value vQLDPSD" UBYTE COMP_0051 1 100 0 255 ECU_ADDRESS 0xFFFF0E1E READ_WRITE /end MEASUREMENT
/begin MEASUREMENT vQLDRED "RAM value vQLDRED" UBYTE COMP_0051 1 100 0 255 ECU_ADDRESS 0xFFFF0E1F READ_WRITE /end MEASUREMENT
/begin MEASUREMENT vQLDRFN "RAM value vQLDRFN" UBYTE COMP_0051 1 100 0 255 ECU_ADDRESS 0xFFFF0E20 READ_WRITE /end MEASUREMENT
/begin MEASUREMENT vQLEAN "RAM value vQLEAN" SWORD COMP_0277 1 100 -32768 32767 ECU_ADDRESS 0xFFFF0E22 READ_WRITE /end MEASUREMENT
/begin MEASUREMENT vQLEARNR "RAM value vQLEARNR" UBYTE COMP_0373 1 100 0 2.55 ECU_ADDRESS 0xFFFF4F38 READ_WRITE /end MEASUREMENT
/begin MEASUREMENT vQLEARNR1 "RAM value vQLEARNR1" SBYTE COMP_0538_S 1 100 -1.28 1.27 ECU_ADDRESS 0xFFFF4F39 READ_WRITE /end MEASUREMENT
/begin MEASUREMENT vQLEARNR2 "RAM value vQLEARNR2" SBYTE COMP_0538_S 1 100 -1.28 1.27 ECU_ADDRESS 0xFFFF4F3A READ_WRITE /end MEASUREMENT
/begin MEASUREMENT vQLEARNR3 "RAM value vQLEARNR3" SBYTE COMP_0538_S 1 100 -1.28 1.27 ECU_ADDRESS 0xFFFF4F3B READ_WRITE /end MEASUREMENT
/begin MEASUREMENT vQM "RAM value vQM" UWORD COMP_0004 1 100 0 65535 ECU_ADDRESS 0xFFFF0832 READ_WRITE /end MEASUREMENT
/begin MEASUREMENT vQM0 "RAM value vQM0" UWORD COMP_0004 1 100 0 65535 ECU_ADDRESS 0xFFFF1580 READ_WRITE /end MEASUREMENT
/begin MEASUREMENT vQNE "RAM value vQNE" UWORD COMP_0051 1 100 0 65535 ECU_ADDRESS 0xFFFF0E24 READ_WRITE /end MEASUREMENT
/begin MEASUREMENT vQNEDN "RAM value vQNEDN" UWORD COMP_0051 1 100 0 65535 ECU_ADDRESS 0xFFFF0E26 READ_WRITE /end MEASUREMENT
/begin MEASUREMENT vQPCYL "RAM value vQPCYL" UWORD COMP_0092_S 1 100 0 1638.375 ECU_ADDRESS 0xFFFF3806 READ_WRITE /end MEASUREMENT
/begin MEASUREMENT vQPS "RAM value vQPS" UBYTE COMP_0051 1 100 0 255 ECU_ADDRESS 0xFFFF0E28 READ_WRITE /end MEASUREMENT
/begin MEASUREMENT vQPSD2 "RAM value vQPSD2" UWORD COMP_0220 1 100 0 65535 ECU_ADDRESS 0xFFFF0E2A READ_WRITE /end MEASUREMENT
/begin MEASUREMENT vQPSN "RAM value vQPSN" UBYTE COMP_0220 1 100 0 255 ECU_ADDRESS 0xFFFF0E2C READ_WRITE /end MEASUREMENT
/begin MEASUREMENT vQS "RAM value vQS" ULONG COMP_0004 1 100 0 4294967295 ECU_ADDRESS 0xFFFF32E4 READ_WRITE /end MEASUREMENT
/begin MEASUREMENT vQSE "RAM value vQSE" UWORD COMP_0004 1 100 0 65535 ECU_ADDRESS 0xFFFF2082 READ_WRITE /end MEASUREMENT
/begin MEASUREMENT vQSISAV "RAM value vQSISAV" SWORD COMP_0277 1 100 -32768 32767 ECU_ADDRESS 0xFFFF1B3E READ_WRITE /end MEASUREMENT
/begin MEASUREMENT vQSISC "RAM value vQSISC" UWORD COMP_0051 1 100 0 65535 ECU_ADDRESS 0xFFFF1B40 READ_WRITE /end MEASUREMENT
/begin MEASUREMENT vQSS "RAM value vQSS" UWORD COMP_0004 1 100 0 65535 ECU_ADDRESS 0xFFFF32E8 READ_WRITE /end MEASUREMENT
/begin MEASUREMENT vQSS_2 "RAM value vQSS_2" UWORD COMP_0068 1 100 0 65535 ECU_ADDRESS 0xFFFF30E4 READ_WRITE /end MEASUREMENT
/begin MEASUREMENT vQS_2 "RAM value vQS_2" ULONG COMP_0068 1 100 0 4294967295 ECU_ADDRESS 0xFFFF30E0 READ_WRITE /end MEASUREMENT
/begin MEASUREMENT vQS_B "RAM value vQS_B" ULONG COMP_0004 1 100 0 4294967295 ECU_ADDRESS 0xFFFF0834 READ_WRITE /end MEASUREMENT
/begin MEASUREMENT vQTASEEP1 "RAM value vQTASEEP1" SWORD COMP_0277 1 100 -32768 32767 ECU_ADDRESS 0xFFFF522E READ_WRITE /end MEASUREMENT
/begin MEASUREMENT vQTHDMPBT "RAM value vQTHDMPBT" UWORD COMP_0092_S 1 100 0 1638.375 ECU_ADDRESS 0xFFFF3808 READ_WRITE /end MEASUREMENT
/begin MEASUREMENT vQTHDMPT "RAM value vQTHDMPT" UWORD COMP_0092_S 1 100 0 1638.375 ECU_ADDRESS 0xFFFF380A READ_WRITE /end MEASUREMENT
/begin MEASUREMENT vQTHLEARN "RAM value vQTHLEARN" UWORD COMP_0092_S 1 100 0 1638.375 ECU_ADDRESS 0xFFFF3222 READ_WRITE /end MEASUREMENT
/begin MEASUREMENT vQTH_PM "RAM value vQTH_PM" UWORD COMP_0092_S 1 100 0 1638.375 ECU_ADDRESS 0xFFFF321E READ_WRITE /end MEASUREMENT
/begin MEASUREMENT vQTH_PMF "RAM value vQTH_PMF" UWORD COMP_0092_S 1 100 0 1638.375 ECU_ADDRESS 0xFFFF3220 READ_WRITE /end MEASUREMENT
/begin MEASUREMENT vQTO "RAM value vQTO" UBYTE COMP_0051 1 100 0 255 ECU_ADDRESS 0xFFFF0E2D READ_WRITE /end MEASUREMENT
/begin MEASUREMENT vQTOAT "RAM value vQTOAT" UBYTE COMP_0051 1 100 0 255 ECU_ADDRESS 0xFFFF0E2E READ_WRITE /end MEASUREMENT
/begin MEASUREMENT vQTR "RAM value vQTR" UWORD COMP_0324 1 100 0 511.9921875 ECU_ADDRESS 0xFFFF0E30 READ_WRITE /end MEASUREMENT
/begin MEASUREMENT vQTRM "RAM value vQTRM" UWORD COMP_0092_S 1 100 0 1638.375 ECU_ADDRESS 0xFFFF3224 READ_WRITE /end MEASUREMENT
/begin MEASUREMENT vQTRMDMPT "RAM value vQTRMDMPT" UWORD COMP_0092_S 1 100 0 1638.375 ECU_ADDRESS 0xFFFF380C READ_WRITE /end MEASUREMENT
/begin MEASUREMENT vQTRMMD "RAM value vQTRMMD" UBYTE COMP_0068 1 100 0 255 ECU_ADDRESS 0xFFFF380E READ_WRITE /end MEASUREMENT
/begin MEASUREMENT vQTRMS "RAM value vQTRMS" UWORD COMP_0092_S 1 100 0 1638.375 ECU_ADDRESS 0xFFFF3226 READ_WRITE /end MEASUREMENT
/begin MEASUREMENT vQTRQ "RAM value vQTRQ" ULONG COMP_0595_S 1 100 0 6871947.672 ECU_ADDRESS 0xFFFF2AA8 READ_WRITE /end MEASUREMENT
/begin MEASUREMENT vQTRQAC "RAM value vQTRQAC" UBYTE COMP_0051 1 100 0 255 ECU_ADDRESS 0xFFFF0E32 READ_WRITE /end MEASUREMENT
/begin MEASUREMENT vQTRQALT "RAM value vQTRQALT" UBYTE COMP_0051 1 100 0 255 ECU_ADDRESS 0xFFFF0E33 READ_WRITE /end MEASUREMENT
/begin MEASUREMENT vQTRQEST "RAM value vQTRQEST" UBYTE COMP_0051 1 100 0 255 ECU_ADDRESS 0xFFFF0E34 READ_WRITE /end MEASUREMENT
/begin MEASUREMENT vQTRQP "RAM value vQTRQP" ULONG COMP_0595_S 1 100 0 6871947.672 ECU_ADDRESS 0xFFFF2AAC READ_WRITE /end MEASUREMENT
/begin MEASUREMENT vQTRQPAVE "RAM value vQTRQPAVE" ULONG COMP_0595_S 1 100 0 6871947.672 ECU_ADDRESS 0xFFFF4CA4 READ_WRITE /end MEASUREMENT
/begin MEASUREMENT vQTRQPEND "RAM value vQTRQPEND" ULONG COMP_0595_S 1 100 0 6871947.672 ECU_ADDRESS 0xFFFF4CA8 READ_WRITE /end MEASUREMENT
/begin MEASUREMENT vQTRQPMAX "RAM value vQTRQPMAX" ULONG COMP_0595_S 1 100 0 6871947.672 ECU_ADDRESS 0xFFFF4CAC READ_WRITE /end MEASUREMENT
/begin MEASUREMENT vQTRQPMIN "RAM value vQTRQPMIN" ULONG COMP_0595_S 1 100 0 6871947.672 ECU_ADDRESS 0xFFFF4CB0 READ_WRITE /end MEASUREMENT
/begin MEASUREMENT vQTRQQLD "RAM value vQTRQQLD" UBYTE COMP_0051 1 100 0 255 ECU_ADDRESS 0xFFFF0E35 READ_WRITE /end MEASUREMENT
/begin MEASUREMENT vQTRQQLD0 "RAM value vQTRQQLD0" UBYTE COMP_0051 1 100 0 255 ECU_ADDRESS 0xFFFF0992 READ_WRITE /end MEASUREMENT
/begin MEASUREMENT vQTRQQLD1 "RAM value vQTRQQLD1" UBYTE COMP_0051 1 100 0 255 ECU_ADDRESS 0xFFFF0E36 READ_WRITE /end MEASUREMENT
/begin MEASUREMENT vQTRQSL "RAM value vQTRQSL" UWORD COMP_0068 1 100 0 65535 ECU_ADDRESS 0xFFFF2AB0 READ_WRITE /end MEASUREMENT
/begin MEASUREMENT vQTW "RAM value vQTW" UBYTE COMP_0276 1 100 0 1020 ECU_ADDRESS 0xFFFF0E37 READ_WRITE /end MEASUREMENT
/begin MEASUREMENT vQTWCK "RAM value vQTWCK" UBYTE COMP_0493 1 100 0 1020 ECU_ADDRESS 0xFFFF0E38 READ_WRITE /end MEASUREMENT
/begin MEASUREMENT vQTWLEN "RAM value vQTWLEN" UBYTE COMP_0027 1 100 0 255 ECU_ADDRESS 0xFFFF0E39 READ_WRITE /end MEASUREMENT
/begin MEASUREMENT vQUST8 "RAM value vQUST8" UBYTE COMP_0068 1 100 0 255 ECU_ADDRESS 0xFFFF2AB2 READ_WRITE /end MEASUREMENT
/begin MEASUREMENT vQUST8BF "RAM value vQUST8BF" UBYTE COMP_0068 1 100 0 255 ECU_ADDRESS 0xFFFF2AB3 READ_WRITE /end MEASUREMENT
/begin MEASUREMENT vQVTC "RAM value vQVTC" UBYTE COMP_0051 1 100 0 255 ECU_ADDRESS 0xFFFF0E3A READ_WRITE /end MEASUREMENT
/begin MEASUREMENT vQVTCOL "RAM value vQVTCOL" UBYTE COMP_0051 1 100 0 255 ECU_ADDRESS 0xFFFF0E3B READ_WRITE /end MEASUREMENT
/begin MEASUREMENT vQZIKKI "RAM value vQZIKKI" UWORD COMP_0004 1 100 0 65535 ECU_ADDRESS 0xFFFF2AB4 READ_WRITE /end MEASUREMENT
/begin MEASUREMENT vR1STPDTC "RAM value vR1STPDTC" UWORD COMP_0068 1 100 0 65535 ECU_ADDRESS 0xFFFF2AB6 READ_WRITE /end MEASUREMENT
/begin MEASUREMENT vR2NDPDTC "RAM value vR2NDPDTC" UWORD COMP_0068 1 100 0 65535 ECU_ADDRESS 0xFFFF2AB8 READ_WRITE /end MEASUREMENT
/begin MEASUREMENT vR3RDPDTC "RAM value vR3RDPDTC" UWORD COMP_0068 1 100 0 65535 ECU_ADDRESS 0xFFFF2ABA READ_WRITE /end MEASUREMENT
/begin MEASUREMENT vR4THPDTC "RAM value vR4THPDTC" UWORD COMP_0068 1 100 0 65535 ECU_ADDRESS 0xFFFF2ABC READ_WRITE /end MEASUREMENT
/begin MEASUREMENT vRAC "RAM value vRAC" UWORD COMP_0139_S 1 100 0 4095.9375 ECU_ADDRESS 0xFFFF3078 READ_WRITE /end MEASUREMENT
/begin MEASUREMENT vRAFP "RAM value vRAFP" UWORD COMP_0093 1 100 0 163837.5 ECU_ADDRESS 0xFFFF2ABE READ_WRITE /end MEASUREMENT
/begin MEASUREMENT vRAMHOS "RAM value vRAMHOS" UBYTE COMP_0365_S 1 100 0 63.75 ECU_ADDRESS 0xFFFF0E3C READ_WRITE /end MEASUREMENT
/begin MEASUREMENT vRANGDDLY "RAM value vRANGDDLY" UBYTE COMP_0014 1 100 0 2550 ECU_ADDRESS 0xFFFF2AC2 READ_WRITE /end MEASUREMENT
/begin MEASUREMENT vRANGUDLY "RAM value vRANGUDLY" UBYTE COMP_0014 1 100 0 2550 ECU_ADDRESS 0xFFFF2AC3 READ_WRITE /end MEASUREMENT
/begin MEASUREMENT vRAPDLTA "RAM value vRAPDLTA" UBYTE COMP_0082_S 1 100 0 255 ECU_ADDRESS 0xFFFF0E3D READ_WRITE /end MEASUREMENT
/begin MEASUREMENT vRATECNT "RAM value vRATECNT" UWORD COMP_0016 1 100 0 65535 ECU_ADDRESS 0xFFFF4CB4 READ_WRITE /end MEASUREMENT
/begin MEASUREMENT vRATECNT1 "RAM value vRATECNT1" UWORD COMP_0016 1 100 0 65535 ECU_ADDRESS 0xFFFF5230 READ_WRITE /end MEASUREMENT
/begin MEASUREMENT vRATECNT2 "RAM value vRATECNT2" UWORD COMP_0016 1 100 0 65535 ECU_ADDRESS 0xFFFF5232 READ_WRITE /end MEASUREMENT
/begin MEASUREMENT vRATEFLGf "RAM value vRATEFLGf" UBYTE COMP_0004 1 100 0 255 ECU_ADDRESS 0xFFFF2AC4 READ_WRITE /end MEASUREMENT
/begin MEASUREMENT vRATEWCNT "RAM value vRATEWCNT" UBYTE COMP_0030 1 100 0 255 ECU_ADDRESS 0xFFFF2AC5 READ_WRITE /end MEASUREMENT
/begin MEASUREMENT vRATILM_S "RAM value vRATILM_S" UWORD COMP_0450 1 100 0 63.999056205 ECU_ADDRESS 0xFFFF14B2 READ_WRITE /end MEASUREMENT
/begin MEASUREMENT vRATIO "RAM value vRATIO" UWORD COMP_0450 1 100 0 63.999056205 ECU_ADDRESS 0xFFFF1A72 READ_WRITE /end MEASUREMENT
/begin MEASUREMENT vRATIO0 "RAM value vRATIO0" UWORD COMP_0028 1 100 0 2.5599609375 ECU_ADDRESS 0xFFFF084C READ_WRITE /end MEASUREMENT
/begin MEASUREMENT vRATIO50Z "RAM value vRATIO50Z" UWORD COMP_0028 1 100 0 2.5599609375 ECU_ADDRESS 0xFFFF166E READ_WRITE /end MEASUREMENT
/begin MEASUREMENT vRATIOBF "RAM value vRATIOBF" UWORD COMP_0450 1 100 0 63.999056205 ECU_ADDRESS 0xFFFF0E3E READ_WRITE /end MEASUREMENT
/begin MEASUREMENT vRATIOCT "RAM value vRATIOCT" UBYTE COMP_0045 1 100 0 1.9921875 ECU_ADDRESS 0xFFFF0E40 READ_WRITE /end MEASUREMENT
/begin MEASUREMENT vRATIOCU "RAM value vRATIOCU" UWORD COMP_0450 1 100 0 63.999056205 ECU_ADDRESS 0xFFFF0E42 READ_WRITE /end MEASUREMENT
/begin MEASUREMENT vRATIOC_S "RAM value vRATIOC_S" UWORD COMP_0450 1 100 0 63.999056205 ECU_ADDRESS 0xFFFF14B6 READ_WRITE /end MEASUREMENT
/begin MEASUREMENT vRATIOLMT "RAM value vRATIOLMT" UWORD COMP_0450 1 100 0 63.999056205 ECU_ADDRESS 0xFFFF0E44 READ_WRITE /end MEASUREMENT
/begin MEASUREMENT vRATIOMT "RAM value vRATIOMT" UWORD COMP_0450 1 100 0 63.999056205 ECU_ADDRESS 0xFFFF2084 READ_WRITE /end MEASUREMENT
/begin MEASUREMENT vRATIONE "RAM value vRATIONE" UWORD COMP_0450 1 100 0 63.999056205 ECU_ADDRESS 0xFFFF0E46 READ_WRITE /end MEASUREMENT
/begin MEASUREMENT vRATION_S "RAM value vRATION_S" UWORD COMP_0450 1 100 0 63.999056205 ECU_ADDRESS 0xFFFF14B8 READ_WRITE /end MEASUREMENT
/begin MEASUREMENT vRATIOPR "RAM value vRATIOPR" UWORD COMP_0450 1 100 0 63.999056205 ECU_ADDRESS 0xFFFF2AC6 READ_WRITE /end MEASUREMENT
/begin MEASUREMENT vRATIOP_S "RAM value vRATIOP_S" UWORD COMP_0450 1 100 0 63.999056205 ECU_ADDRESS 0xFFFF14BA READ_WRITE /end MEASUREMENT
/begin MEASUREMENT vRATIOSL "RAM value vRATIOSL" UWORD COMP_0450 1 100 0 63.999056205 ECU_ADDRESS 0xFFFF2AC8 READ_WRITE /end MEASUREMENT
/begin MEASUREMENT vRATIOTR "RAM value vRATIOTR" UWORD COMP_0450 1 100 0 63.999056205 ECU_ADDRESS 0xFFFF0E48 READ_WRITE /end MEASUREMENT
/begin MEASUREMENT vRATIO_S "RAM value vRATIO_S" UWORD COMP_0450 1 100 0 63.999056205 ECU_ADDRESS 0xFFFF14B4 READ_WRITE /end MEASUREMENT
/begin MEASUREMENT vRCIDHB "RAM value vRCIDHB" UBYTE COMP_0004 1 100 0 255 ECU_ADDRESS 0xFFFF2ACA READ_WRITE /end MEASUREMENT
/begin MEASUREMENT vRCIDLB "RAM value vRCIDLB" UBYTE COMP_0004 1 100 0 255 ECU_ADDRESS 0xFFFF2ACB READ_WRITE /end MEASUREMENT
/begin MEASUREMENT vRCNTRIP "RAM value vRCNTRIP" ULONG COMP_0389 1 100 0 1685624.33943218 ECU_ADDRESS 0xFFFF4410 READ_WRITE /end MEASUREMENT
/begin MEASUREMENT vRCOUNT "RAM value vRCOUNT" UBYTE COMP_0016 1 100 0 255 ECU_ADDRESS 0xFFFF2ACC READ_WRITE /end MEASUREMENT
/begin MEASUREMENT vRCRSETf "RAM value vRCRSETf" UBYTE COMP_0004 1 100 0 255 ECU_ADDRESS 0xFFFF2ACE READ_WRITE /end MEASUREMENT
/begin MEASUREMENT vRCRSETzf "RAM value vRCRSETzf" UBYTE COMP_0004 1 100 0 255 ECU_ADDRESS 0xFFFF2ACF READ_WRITE /end MEASUREMENT
/begin MEASUREMENT vRDTYOUT "RAM value vRDTYOUT" UBYTE COMP_0030 1 100 0 255 ECU_ADDRESS 0xFFFF2AD0 READ_WRITE /end MEASUREMENT
/begin MEASUREMENT vRDTYOUTf "RAM value vRDTYOUTf" UBYTE COMP_0004 1 100 0 255 ECU_ADDRESS 0xFFFF3228 READ_WRITE /end MEASUREMENT
/begin MEASUREMENT vREALTP "RAM value vREALTP" UWORD COMP_0144 1 100 0 31.999495335 ECU_ADDRESS 0xFFFF083C READ_WRITE /end MEASUREMENT
/begin MEASUREMENT vREALTPL "RAM value vREALTPL" ULONG COMP_0144 1 100 0 2097150.9257699 ECU_ADDRESS 0xFFFF0840 READ_WRITE /end MEASUREMENT
/begin MEASUREMENT vREC "RAM value vREC" UBYTE COMP_0000 1 100 0 6375 ECU_ADDRESS 0xFFFF0E4A READ_WRITE /end MEASUREMENT
/begin MEASUREMENT vRECAMID "RAM value vRECAMID" UBYTE COMP_0004 1 100 0 255 ECU_ADDRESS 0xFFFF3828 READ_WRITE /end MEASUREMENT
/begin MEASUREMENT vRECDRCK "RAM value vRECDRCK" UBYTE COMP_0373 1 100 0 2.55 ECU_ADDRESS 0xFFFF1996 READ_WRITE /end MEASUREMENT
/begin MEASUREMENT vRECLID "RAM value vRECLID" UBYTE COMP_0068 1 100 0 255 ECU_ADDRESS 0xFFFF3829 READ_WRITE /end MEASUREMENT
/begin MEASUREMENT vRECNR "RAM value vRECNR" UBYTE COMP_0000 1 100 0 6375 ECU_ADDRESS 0xFFFF0E4B READ_WRITE /end MEASUREMENT
/begin MEASUREMENT vRECONTM "RAM value vRECONTM" UWORD COMP_0015_S 1 100 0 6553.5 ECU_ADDRESS 0xFFFF2AD2 READ_WRITE /end MEASUREMENT
/begin MEASUREMENT vRECVAL "RAM value vRECVAL" UBYTE COMP_0068 1 100 0 255 ECU_ADDRESS 0xFFFF382A READ_WRITE /end MEASUREMENT
/begin MEASUREMENT vRECVAL2 "RAM value vRECVAL2" UWORD COMP_0068 1 100 0 65535 ECU_ADDRESS 0xFFFF382C READ_WRITE /end MEASUREMENT
/begin MEASUREMENT vRECVOPN "RAM value vRECVOPN" UWORD COMP_0450_S 1 100 -1023.96875 1024 ECU_ADDRESS 0xFFFF331E READ_WRITE /end MEASUREMENT
/begin MEASUREMENT vRECVSTR "RAM value vRECVSTR" UWORD COMP_0450_S 1 100 -1023.96875 1024 ECU_ADDRESS 0xFFFF3320 READ_WRITE /end MEASUREMENT
/begin MEASUREMENT vREEVC "RAM value vREEVC" UWORD COMP_0549_S 1 100 0 511.9921875 ECU_ADDRESS 0xFFFF2AD4 READ_WRITE /end MEASUREMENT
/begin MEASUREMENT vREFANG "RAM value vREFANG" UWORD COMP_0057_S 1 100 0 6553.5 ECU_ADDRESS 0xFFFF0E4C READ_WRITE /end MEASUREMENT
/begin MEASUREMENT vREFAPP "RAM value vREFAPP" UBYTE COMP_0004 1 100 0 255 ECU_ADDRESS 0xFFFF0968 READ_WRITE /end MEASUREMENT
/begin MEASUREMENT vREFCNT "RAM value vREFCNT" UBYTE COMP_0030 1 100 0 255 ECU_ADDRESS 0xFFFF1997 READ_WRITE /end MEASUREMENT
/begin MEASUREMENT vREFCNTS "RAM value vREFCNTS" UBYTE COMP_0030 1 100 0 255 ECU_ADDRESS 0xFFFF4421 READ_WRITE /end MEASUREMENT
/begin MEASUREMENT vREFCT "RAM value vREFCT" UWORD COMP_0191 1 100 0 65535 ECU_ADDRESS 0xFFFF3A5E READ_WRITE /end MEASUREMENT
/begin MEASUREMENT vREFEM "RAM value vREFEM" UWORD COMP_0191 1 100 0 65535 ECU_ADDRESS 0xFFFF3A60 READ_WRITE /end MEASUREMENT
/begin MEASUREMENT vREFIA "RAM value vREFIA" UWORD COMP_0191 1 100 0 65535 ECU_ADDRESS 0xFFFF3A62 READ_WRITE /end MEASUREMENT
/begin MEASUREMENT vREFIN "RAM value vREFIN" UBYTE COMP_0068 1 100 0 255 ECU_ADDRESS 0xFFFF3A42 READ_WRITE /end MEASUREMENT
/begin MEASUREMENT vREFINEC "RAM value vREFINEC" UBYTE COMP_0068 1 100 0 255 ECU_ADDRESS 0xFFFF1998 READ_WRITE /end MEASUREMENT
/begin MEASUREMENT vREGEND "RAM value vREGEND" UBYTE COMP_0007 1 100 0 510 ECU_ADDRESS 0xFFFF2AD6 READ_WRITE /end MEASUREMENT
/begin MEASUREMENT vREGENDB "RAM value vREGENDB" UBYTE COMP_0007 1 100 0 510 ECU_ADDRESS 0xFFFF2AD7 READ_WRITE /end MEASUREMENT
/begin MEASUREMENT vREGGSCNT "RAM value vREGGSCNT" UBYTE COMP_0229_S 1 100 0 255 ECU_ADDRESS 0xFFFF2AD8 READ_WRITE /end MEASUREMENT
/begin MEASUREMENT vREGNO "RAM value vREGNO" UBYTE COMP_0068 1 100 0 255 ECU_ADDRESS 0xFFFF0E4E READ_WRITE /end MEASUREMENT
/begin MEASUREMENT vRELNICT "RAM value vRELNICT" UWORD COMP_0545_S 1 100 0 65535 ECU_ADDRESS 0xFFFF4CB8 READ_WRITE /end MEASUREMENT
/begin MEASUREMENT vRELNPCT "RAM value vRELNPCT" UWORD COMP_0545_S 1 100 0 65535 ECU_ADDRESS 0xFFFF4CBC READ_WRITE /end MEASUREMENT
/begin MEASUREMENT vRENSTAT1 "RAM value vRENSTAT1" UBYTE COMP_0004 1 100 0 255 ECU_ADDRESS 0xFFFF382E READ_WRITE /end MEASUREMENT
/begin MEASUREMENT vRENTOPT1 "RAM value vRENTOPT1" UBYTE COMP_0004 1 100 0 255 ECU_ADDRESS 0xFFFF382F READ_WRITE /end MEASUREMENT
/begin MEASUREMENT vRENTOPT2 "RAM value vRENTOPT2" UBYTE COMP_0004 1 100 0 255 ECU_ADDRESS 0xFFFF3830 READ_WRITE /end MEASUREMENT
/begin MEASUREMENT vRENTOPT3 "RAM value vRENTOPT3" UBYTE COMP_0004 1 100 0 255 ECU_ADDRESS 0xFFFF3831 READ_WRITE /end MEASUREMENT
/begin MEASUREMENT vRESCNT1 "RAM value vRESCNT1" UWORD COMP_0016 1 100 0 65535 ECU_ADDRESS 0xFFFF5234 READ_WRITE /end MEASUREMENT
/begin MEASUREMENT vRESCNT2 "RAM value vRESCNT2" UWORD COMP_0016 1 100 0 65535 ECU_ADDRESS 0xFFFF5236 READ_WRITE /end MEASUREMENT
/begin MEASUREMENT vRESCNTL1 "RAM value vRESCNTL1" UWORD COMP_0016 1 100 0 65535 ECU_ADDRESS 0xFFFF4CC0 READ_WRITE /end MEASUREMENT
/begin MEASUREMENT vRESCNTL2 "RAM value vRESCNTL2" UWORD COMP_0016 1 100 0 65535 ECU_ADDRESS 0xFFFF4CC2 READ_WRITE /end MEASUREMENT
/begin MEASUREMENT vRESCNTL2f "RAM value vRESCNTL2f" UBYTE COMP_0004 1 100 0 255 ECU_ADDRESS 0xFFFF2AD9 READ_WRITE /end MEASUREMENT
/begin MEASUREMENT vRESCNTLEN "RAM value vRESCNTLEN" UBYTE COMP_0004 1 100 0 255 ECU_ADDRESS 0xFFFF2ADA READ_WRITE /end MEASUREMENT
/begin MEASUREMENT vRESCNTLOK "RAM value vRESCNTLOK" UBYTE COMP_0004 1 100 0 255 ECU_ADDRESS 0xFFFF2ADB READ_WRITE /end MEASUREMENT
/begin MEASUREMENT vRESCNTR1 "RAM value vRESCNTR1" UWORD COMP_0016 1 100 0 65535 ECU_ADDRESS 0xFFFF4CC4 READ_WRITE /end MEASUREMENT
/begin MEASUREMENT vRESCNTR2 "RAM value vRESCNTR2" UWORD COMP_0016 1 100 0 65535 ECU_ADDRESS 0xFFFF4CC6 READ_WRITE /end MEASUREMENT
/begin MEASUREMENT vRESCNTR2f "RAM value vRESCNTR2f" UBYTE COMP_0004 1 100 0 255 ECU_ADDRESS 0xFFFF2ADC READ_WRITE /end MEASUREMENT
/begin MEASUREMENT vRESCNTREN "RAM value vRESCNTREN" UBYTE COMP_0004 1 100 0 255 ECU_ADDRESS 0xFFFF2ADD READ_WRITE /end MEASUREMENT
/begin MEASUREMENT vRESCNTROK "RAM value vRESCNTROK" UBYTE COMP_0004 1 100 0 255 ECU_ADDRESS 0xFFFF2ADE READ_WRITE /end MEASUREMENT
/begin MEASUREMENT vRESFD "RAM value vRESFD" UWORD COMP_0064_S 1 100 0 65535 ECU_ADDRESS 0xFFFF0E50 READ_WRITE /end MEASUREMENT
/begin MEASUREMENT vRESFD0 "RAM value vRESFD0" UWORD COMP_0315_S 1 100 -32768 32767 ECU_ADDRESS 0xFFFF0E52 READ_WRITE /end MEASUREMENT
/begin MEASUREMENT vRESLGCTf "RAM value vRESLGCTf" UBYTE COMP_0004 1 100 0 255 ECU_ADDRESS 0xFFFF2ADF READ_WRITE /end MEASUREMENT
/begin MEASUREMENT vRESTADV "RAM value vRESTADV" SBYTE COMP_0018 1 100 -128 127 ECU_ADDRESS 0xFFFF2AE0 READ_WRITE /end MEASUREMENT
/begin MEASUREMENT vRESTRP "RAM value vRESTRP" UWORD COMP_0016 1 100 0 65535 ECU_ADDRESS 0xFFFF5238 READ_WRITE /end MEASUREMENT
/begin MEASUREMENT vRESTRP2 "RAM value vRESTRP2" UWORD COMP_0016 1 100 0 65535 ECU_ADDRESS 0xFFFF523A READ_WRITE /end MEASUREMENT
/begin MEASUREMENT vRESTRP4 "RAM value vRESTRP4" UWORD COMP_0016 1 100 0 65535 ECU_ADDRESS 0xFFFF4CC8 READ_WRITE /end MEASUREMENT
/begin MEASUREMENT vRETCYL "RAM value vRETCYL" UBYTE COMP_0017 1 100 0 255 ECU_ADDRESS 0xFFFF0E54 READ_WRITE /end MEASUREMENT
/begin MEASUREMENT vRETRON "RAM value vRETRON" UBYTE COMP_0372_S 1 100 0 24.9023565 ECU_ADDRESS 0xFFFF0E55 READ_WRITE /end MEASUREMENT
/begin MEASUREMENT vREVRATIO "RAM value vREVRATIO" UWORD COMP_0450 1 100 0 63.999056205 ECU_ADDRESS 0xFFFF0E56 READ_WRITE /end MEASUREMENT
/begin MEASUREMENT vREVRAT_S "RAM value vREVRAT_S" UWORD COMP_0450 1 100 0 63.999056205 ECU_ADDRESS 0xFFFF14BC READ_WRITE /end MEASUREMENT
/begin MEASUREMENT vREVSL "RAM value vREVSL" UWORD COMP_0403_S 1 100 0 3276750 ECU_ADDRESS 0xFFFF2AE2 READ_WRITE /end MEASUREMENT
/begin MEASUREMENT vREVSMX2 "RAM value vREVSMX2" UWORD COMP_0116_S 1 100 0 1.999931595 ECU_ADDRESS 0xFFFF0E58 READ_WRITE /end MEASUREMENT
/begin MEASUREMENT vREVX "RAM value vREVX" UWORD COMP_0443 1 100 0 65535 ECU_ADDRESS 0xFFFF1670 READ_WRITE /end MEASUREMENT
/begin MEASUREMENT vREVXFL "RAM value vREVXFL" UWORD COMP_0443 1 100 0 65535 ECU_ADDRESS 0xFFFF08F6 READ_WRITE /end MEASUREMENT
/begin MEASUREMENT vRFBCNT "RAM value vRFBCNT" UBYTE COMP_0016 1 100 0 255 ECU_ADDRESS 0xFFFF2AE4 READ_WRITE /end MEASUREMENT
/begin MEASUREMENT vRFBRO2 "RAM value vRFBRO2" UWORD COMP_0475 1 100 0 2559.9609375 ECU_ADDRESS 0xFFFF2AE6 READ_WRITE /end MEASUREMENT
/begin MEASUREMENT vRFBSL "RAM value vRFBSL" UBYTE COMP_0104 1 100 0 2550 ECU_ADDRESS 0xFFFF2AEA READ_WRITE /end MEASUREMENT
/begin MEASUREMENT vRFBSTf "RAM value vRFBSTf" UBYTE COMP_0004 1 100 0 255 ECU_ADDRESS 0xFFFF2AEC READ_WRITE /end MEASUREMENT
/begin MEASUREMENT vRFLCNT "RAM value vRFLCNT" UBYTE COMP_0016 1 100 0 255 ECU_ADDRESS 0xFFFF4CCA READ_WRITE /end MEASUREMENT
/begin MEASUREMENT vRFNCHG "RAM value vRFNCHG" UBYTE COMP_0004 1 100 0 255 ECU_ADDRESS 0xFFFF0E5A READ_WRITE /end MEASUREMENT
/begin MEASUREMENT vRFNDMD "RAM value vRFNDMD" UBYTE COMP_0004 1 100 0 255 ECU_ADDRESS 0xFFFF2AED READ_WRITE /end MEASUREMENT
/begin MEASUREMENT vRFNOUT "RAM value vRFNOUT" UBYTE COMP_0004 1 100 0 255 ECU_ADDRESS 0xFFFF3B7E READ_WRITE /end MEASUREMENT
/begin MEASUREMENT vRFNOUT0 "RAM value vRFNOUT0" UBYTE COMP_0004 1 100 0 255 ECU_ADDRESS 0xFFFF2AEE READ_WRITE /end MEASUREMENT
/begin MEASUREMENT vRFNRLY "RAM value vRFNRLY" UBYTE COMP_0004 1 100 0 255 ECU_ADDRESS 0xFFFF211C READ_WRITE /end MEASUREMENT
/begin MEASUREMENT vRFNSTS "RAM value vRFNSTS" UBYTE COMP_0004 1 100 0 255 ECU_ADDRESS 0xFFFF2AEF READ_WRITE /end MEASUREMENT
/begin MEASUREMENT vRFNSW "RAM value vRFNSW" UBYTE COMP_0004 1 100 0 255 ECU_ADDRESS 0xFFFF2AF0 READ_WRITE /end MEASUREMENT
/begin MEASUREMENT vRFNSW1 "RAM value vRFNSW1" UBYTE COMP_0004 1 100 0 255 ECU_ADDRESS 0xFFFF2AF1 READ_WRITE /end MEASUREMENT
/begin MEASUREMENT vRFNSW2 "RAM value vRFNSW2" UBYTE COMP_0004 1 100 0 255 ECU_ADDRESS 0xFFFF2AF2 READ_WRITE /end MEASUREMENT
/begin MEASUREMENT vRFO2TM "RAM value vRFO2TM" UBYTE COMP_0013 1 100 0 255 ECU_ADDRESS 0xFFFF2AF3 READ_WRITE /end MEASUREMENT
/begin MEASUREMENT vRFO2TMV "RAM value vRFO2TMV" UBYTE COMP_0013 1 100 0 255 ECU_ADDRESS 0xFFFF2AF4 READ_WRITE /end MEASUREMENT
/begin MEASUREMENT vRFOEVPf "RAM value vRFOEVPf" UBYTE COMP_0004 1 100 0 255 ECU_ADDRESS 0xFFFF2AF5 READ_WRITE /end MEASUREMENT
/begin MEASUREMENT vRGSTR1 "RAM value vRGSTR1" SBYTE COMP_0495 1 100 -128 127 ECU_ADDRESS 0xFFFF4F68 READ_WRITE /end MEASUREMENT
/begin MEASUREMENT vRGSTR2 "RAM value vRGSTR2" SBYTE COMP_0495 1 100 -128 127 ECU_ADDRESS 0xFFFF4F69 READ_WRITE /end MEASUREMENT
/begin MEASUREMENT vRHBAH1 "RAM value vRHBAH1" UBYTE COMP_0054 1 100 0 5100 ECU_ADDRESS 0xFFFF4CCB READ_WRITE /end MEASUREMENT
/begin MEASUREMENT vRHBCNT1 "RAM value vRHBCNT1" UBYTE COMP_0016 1 100 0 255 ECU_ADDRESS 0xFFFF4CD6 READ_WRITE /end MEASUREMENT
/begin MEASUREMENT vRHBDY1 "RAM value vRHBDY1" UWORD COMP_0187_S 1 100 0 2559.9609375 ECU_ADDRESS 0xFFFF4CD8 READ_WRITE /end MEASUREMENT
/begin MEASUREMENT vRHBMN "RAM value vRHBMN" UBYTE COMP_0000 1 100 0 6375 ECU_ADDRESS 0xFFFF4CEE READ_WRITE /end MEASUREMENT
/begin MEASUREMENT vRHBTP "RAM value vRHBTP" UWORD COMP_0144 1 100 0 31.999495335 ECU_ADDRESS 0xFFFF4CFA READ_WRITE /end MEASUREMENT
/begin MEASUREMENT vRHBVB "RAM value vRHBVB" UBYTE COMP_0033 1 100 0 20400 ECU_ADDRESS 0xFFFF4D10 READ_WRITE /end MEASUREMENT
/begin MEASUREMENT vRHBVSP "RAM value vRHBVSP" UBYTE COMP_0007 1 100 0 510 ECU_ADDRESS 0xFFFF4D1B READ_WRITE /end MEASUREMENT
/begin MEASUREMENT vRHOLD "RAM value vRHOLD" UWORD COMP_0453 1 100 0 131.07 ECU_ADDRESS 0xFFFF2AF6 READ_WRITE /end MEASUREMENT
/begin MEASUREMENT vRICTNG "RAM value vRICTNG" UBYTE COMP_0020 1 100 0 12750 ECU_ADDRESS 0xFFFF4D26 READ_WRITE /end MEASUREMENT
/begin MEASUREMENT vRICTNG2 "RAM value vRICTNG2" UBYTE COMP_0020 1 100 0 12750 ECU_ADDRESS 0xFFFF4D27 READ_WRITE /end MEASUREMENT
/begin MEASUREMENT vRINTVL "RAM value vRINTVL" UWORD COMP_0017_S 1 100 0 655.35 ECU_ADDRESS 0xFFFF2AFA READ_WRITE /end MEASUREMENT
/begin MEASUREMENT vRJUDGEf "RAM value vRJUDGEf" UBYTE COMP_0004 1 100 0 255 ECU_ADDRESS 0xFFFF2AFE READ_WRITE /end MEASUREMENT
/begin MEASUREMENT vRJUONEf "RAM value vRJUONEf" UBYTE COMP_0004 1 100 0 255 ECU_ADDRESS 0xFFFF2AFF READ_WRITE /end MEASUREMENT
/begin MEASUREMENT vRJUONHf "RAM value vRJUONHf" UBYTE COMP_0004 1 100 0 255 ECU_ADDRESS 0xFFFF2B00 READ_WRITE /end MEASUREMENT
/begin MEASUREMENT vRKS "RAM value vRKS" SLONG COMP_0415 1 100 -8388608 8388607.99609375 ECU_ADDRESS 0xFFFF199C READ_WRITE /end MEASUREMENT
/begin MEASUREMENT vRKTI "RAM value vRKTI" UWORD COMP_0456 1 100 0 1.999970916 ECU_ADDRESS 0xFFFF4E42 READ_WRITE /end MEASUREMENT
/begin MEASUREMENT vRLDFD "RAM value vRLDFD" SWORD COMP_0514_S 1 100 -32768 32767 ECU_ADDRESS 0xFFFF0E5C READ_WRITE /end MEASUREMENT
/begin MEASUREMENT vRLDGCNT "RAM value vRLDGCNT" UBYTE COMP_0068 1 100 0 255 ECU_ADDRESS 0xFFFF3832 READ_WRITE /end MEASUREMENT
/begin MEASUREMENT vRLDIFF "RAM value vRLDIFF" UWORD COMP_0453 1 100 0 131.07 ECU_ADDRESS 0xFFFF2B02 READ_WRITE /end MEASUREMENT
/begin MEASUREMENT vRLDNGZf "RAM value vRLDNGZf" UBYTE COMP_0004 1 100 0 255 ECU_ADDRESS 0xFFFF2B06 READ_WRITE /end MEASUREMENT
/begin MEASUREMENT vRLDOKZf "RAM value vRLDOKZf" UBYTE COMP_0004 1 100 0 255 ECU_ADDRESS 0xFFFF2B07 READ_WRITE /end MEASUREMENT
/begin MEASUREMENT vRLDSUM "RAM value vRLDSUM" ULONG COMP_0453 1 100 0 8589934.59 ECU_ADDRESS 0xFFFF2B08 READ_WRITE /end MEASUREMENT
/begin MEASUREMENT vRLFLTNE "RAM value vRLFLTNE" UWORD COMP_0162_S 1 100 0 51199.21875 ECU_ADDRESS 0xFFFF0E5E READ_WRITE /end MEASUREMENT
/begin MEASUREMENT vRLFO2f "RAM value vRLFO2f" UBYTE COMP_0004 1 100 0 255 ECU_ADDRESS 0xFFFF2B10 READ_WRITE /end MEASUREMENT
/begin MEASUREMENT vRLIDPRCS "RAM value vRLIDPRCS" UBYTE COMP_0004 1 100 0 255 ECU_ADDRESS 0xFFFF3833 READ_WRITE /end MEASUREMENT
/begin MEASUREMENT vRLNOKf "RAM value vRLNOKf" UBYTE COMP_0004 1 100 0 255 ECU_ADDRESS 0xFFFF2B11 READ_WRITE /end MEASUREMENT
/begin MEASUREMENT vRLOCID "RAM value vRLOCID" UBYTE COMP_0004 1 100 0 255 ECU_ADDRESS 0xFFFF2B12 READ_WRITE /end MEASUREMENT
/begin MEASUREMENT vRLOCIDM "RAM value vRLOCIDM" UBYTE COMP_0004 1 100 0 255 ECU_ADDRESS 0xFFFF3834 READ_WRITE /end MEASUREMENT
/begin MEASUREMENT vRLPEAK "RAM value vRLPEAK" UWORD COMP_0023 1 100 0 327675 ECU_ADDRESS 0xFFFF2B14 READ_WRITE /end MEASUREMENT
/begin MEASUREMENT vRLRPM "RAM value vRLRPM" UWORD COMP_0162_S 1 100 0 51199.21875 ECU_ADDRESS 0xFFFF0E60 READ_WRITE /end MEASUREMENT
/begin MEASUREMENT vRLTENG2 "RAM value vRLTENG2" SWORD COMP_0228 1 100 -3276.8 3276.7 ECU_ADDRESS 0xFFFF1B42 READ_WRITE /end MEASUREMENT
/begin MEASUREMENT vRLTGTRPM "RAM value vRLTGTRPM" UWORD COMP_0162_S 1 100 0 51199.21875 ECU_ADDRESS 0xFFFF0E62 READ_WRITE /end MEASUREMENT
/begin MEASUREMENT vRLTGTf "RAM value vRLTGTf" UBYTE COMP_0004 1 100 0 255 ECU_ADDRESS 0xFFFF2B18 READ_WRITE /end MEASUREMENT
/begin MEASUREMENT vRLVAPO "RAM value vRLVAPO" UWORD COMP_0005 1 100 0 7208.85 ECU_ADDRESS 0xFFFF3B80 READ_WRITE /end MEASUREMENT
/begin MEASUREMENT vRMBAADDR "RAM value vRMBAADDR" UWORD COMP_0004 1 100 0 65535 ECU_ADDRESS 0xFFFF3836 READ_WRITE /end MEASUREMENT
/begin MEASUREMENT vRMBAARRY "RAM value vRMBAARRY" UBYTE COMP_0004 1 100 0 255 ECU_ADDRESS 0xFFFF3838 READ_WRITE /end MEASUREMENT
/begin MEASUREMENT vRMBACNT "RAM value vRMBACNT" UWORD COMP_0004 1 100 0 65535 ECU_ADDRESS 0xFFFF3878 READ_WRITE /end MEASUREMENT
/begin MEASUREMENT vRMBAKEY "RAM value vRMBAKEY" UWORD COMP_0004 1 100 0 65535 ECU_ADDRESS 0xFFFF387A READ_WRITE /end MEASUREMENT
/begin MEASUREMENT vRMBAPRCS "RAM value vRMBAPRCS" UBYTE COMP_0004 1 100 0 255 ECU_ADDRESS 0xFFFF387C READ_WRITE /end MEASUREMENT
/begin MEASUREMENT vRMDHOS "RAM value vRMDHOS" UBYTE COMP_0009 1 100 0 199.21875 ECU_ADDRESS 0xFFFF0E64 READ_WRITE /end MEASUREMENT
/begin MEASUREMENT vRNA "RAM value vRNA" ULONG COMP_0596_S 1 100 0 429496729.5 ECU_ADDRESS 0xFFFF4D28 READ_WRITE /end MEASUREMENT
/begin MEASUREMENT vRNB11 "RAM value vRNB11" ULONG COMP_0597_S 1 100 0 4294967.295 ECU_ADDRESS 0xFFFF4D2C READ_WRITE /end MEASUREMENT
/begin MEASUREMENT vRNB12 "RAM value vRNB12" ULONG COMP_0597_S 1 100 0 4294967.295 ECU_ADDRESS 0xFFFF4D30 READ_WRITE /end MEASUREMENT
/begin MEASUREMENT vRNB13 "RAM value vRNB13" ULONG COMP_0597_S 1 100 0 4294967.295 ECU_ADDRESS 0xFFFF4D34 READ_WRITE /end MEASUREMENT
/begin MEASUREMENT vRNB14 "RAM value vRNB14" ULONG COMP_0597_S 1 100 0 4294967.295 ECU_ADDRESS 0xFFFF4D38 READ_WRITE /end MEASUREMENT
/begin MEASUREMENT vRNB21 "RAM value vRNB21" ULONG COMP_0597_S 1 100 0 4294967.295 ECU_ADDRESS 0xFFFF4D3C READ_WRITE /end MEASUREMENT
/begin MEASUREMENT vRNB22 "RAM value vRNB22" ULONG COMP_0597_S 1 100 0 4294967.295 ECU_ADDRESS 0xFFFF4D40 READ_WRITE /end MEASUREMENT
/begin MEASUREMENT vRNB23 "RAM value vRNB23" ULONG COMP_0597_S 1 100 0 4294967.295 ECU_ADDRESS 0xFFFF4D44 READ_WRITE /end MEASUREMENT
/begin MEASUREMENT vRNB24 "RAM value vRNB24" ULONG COMP_0597_S 1 100 0 4294967.295 ECU_ADDRESS 0xFFFF4D48 READ_WRITE /end MEASUREMENT
/begin MEASUREMENT vRO2CNT "RAM value vRO2CNT" UBYTE COMP_0030 1 100 0 255 ECU_ADDRESS 0xFFFF2B19 READ_WRITE /end MEASUREMENT
/begin MEASUREMENT vRO2DCNT1 "RAM value vRO2DCNT1" UWORD COMP_0016 1 100 0 65535 ECU_ADDRESS 0xFFFF523C READ_WRITE /end MEASUREMENT
/begin MEASUREMENT vRO2DCNT2 "RAM value vRO2DCNT2" UWORD COMP_0016 1 100 0 65535 ECU_ADDRESS 0xFFFF4D4C READ_WRITE /end MEASUREMENT
/begin MEASUREMENT vRO2DCNTED "RAM value vRO2DCNTED" UBYTE COMP_0004 1 100 0 255 ECU_ADDRESS 0xFFFF2B1A READ_WRITE /end MEASUREMENT
/begin MEASUREMENT vRO2DLYf "RAM value vRO2DLYf" UBYTE COMP_0004 1 100 0 255 ECU_ADDRESS 0xFFFF2B1B READ_WRITE /end MEASUREMENT
/begin MEASUREMENT vRO2DTCLf "RAM value vRO2DTCLf" UBYTE COMP_0004 1 100 0 255 ECU_ADDRESS 0xFFFF2B1C READ_WRITE /end MEASUREMENT
/begin MEASUREMENT vRO2DTRP1 "RAM value vRO2DTRP1" UWORD COMP_0016 1 100 0 65535 ECU_ADDRESS 0xFFFF523E READ_WRITE /end MEASUREMENT
/begin MEASUREMENT vRO2DTRP2 "RAM value vRO2DTRP2" UWORD COMP_0016 1 100 0 65535 ECU_ADDRESS 0xFFFF5240 READ_WRITE /end MEASUREMENT
/begin MEASUREMENT vRO2DTYCHf "RAM value vRO2DTYCHf" UBYTE COMP_0004 1 100 0 255 ECU_ADDRESS 0xFFFF2B1D READ_WRITE /end MEASUREMENT
/begin MEASUREMENT vRO2DYMX2f "RAM value vRO2DYMX2f" UBYTE COMP_0004 1 100 0 255 ECU_ADDRESS 0xFFFF2B1E READ_WRITE /end MEASUREMENT
/begin MEASUREMENT vRO2FBALPf "RAM value vRO2FBALPf" UBYTE COMP_0004 1 100 0 255 ECU_ADDRESS 0xFFFF2B1F READ_WRITE /end MEASUREMENT
/begin MEASUREMENT vRO2FBALZf "RAM value vRO2FBALZf" UBYTE COMP_0004 1 100 0 255 ECU_ADDRESS 0xFFFF2B20 READ_WRITE /end MEASUREMENT
/begin MEASUREMENT vRO2FBCLPf "RAM value vRO2FBCLPf" UBYTE COMP_0004 1 100 0 255 ECU_ADDRESS 0xFFFF2B21 READ_WRITE /end MEASUREMENT
/begin MEASUREMENT vRO2FBRALP "RAM value vRO2FBRALP" UBYTE COMP_0004 1 100 0 255 ECU_ADDRESS 0xFFFF2B23 READ_WRITE /end MEASUREMENT
/begin MEASUREMENT vRO2FBRALZ "RAM value vRO2FBRALZ" UBYTE COMP_0004 1 100 0 255 ECU_ADDRESS 0xFFFF2B24 READ_WRITE /end MEASUREMENT
/begin MEASUREMENT vRO2FBRf "RAM value vRO2FBRf" UBYTE COMP_0004 1 100 0 255 ECU_ADDRESS 0xFFFF2B25 READ_WRITE /end MEASUREMENT
/begin MEASUREMENT vRO2FBf "RAM value vRO2FBf" UBYTE COMP_0004 1 100 0 255 ECU_ADDRESS 0xFFFF2B22 READ_WRITE /end MEASUREMENT
/begin MEASUREMENT vRO2HDCNT "RAM value vRO2HDCNT" UBYTE COMP_0030 1 100 0 255 ECU_ADDRESS 0xFFFF2B26 READ_WRITE /end MEASUREMENT
/begin MEASUREMENT vRO2HDONf "RAM value vRO2HDONf" UBYTE COMP_0004 1 100 0 255 ECU_ADDRESS 0xFFFF2B27 READ_WRITE /end MEASUREMENT
/begin MEASUREMENT vRO2HDTY "RAM value vRO2HDTY" UWORD COMP_0187_S 1 100 0 2559.9609375 ECU_ADDRESS 0xFFFF2B28 READ_WRITE /end MEASUREMENT
/begin MEASUREMENT vRO2HON1f "RAM value vRO2HON1f" UBYTE COMP_0004 1 100 0 255 ECU_ADDRESS 0xFFFF387D READ_WRITE /end MEASUREMENT
/begin MEASUREMENT vRO2HONf "RAM value vRO2HONf" UBYTE COMP_0004 1 100 0 255 ECU_ADDRESS 0xFFFF3B82 READ_WRITE /end MEASUREMENT
/begin MEASUREMENT vRO2HPREND "RAM value vRO2HPREND" UBYTE COMP_0004 1 100 0 255 ECU_ADDRESS 0xFFFF3B83 READ_WRITE /end MEASUREMENT
/begin MEASUREMENT vRO2INTf "RAM value vRO2INTf" UBYTE COMP_0004 1 100 0 255 ECU_ADDRESS 0xFFFF2B2A READ_WRITE /end MEASUREMENT
/begin MEASUREMENT vRO2MLOKf "RAM value vRO2MLOKf" UBYTE COMP_0004 1 100 0 255 ECU_ADDRESS 0xFFFF2B2B READ_WRITE /end MEASUREMENT
/begin MEASUREMENT vRO2OK2f "RAM value vRO2OK2f" UBYTE COMP_0004 1 100 0 255 ECU_ADDRESS 0xFFFF4D4E READ_WRITE /end MEASUREMENT
/begin MEASUREMENT vRO2PHSDf "RAM value vRO2PHSDf" UBYTE COMP_0004 1 100 0 255 ECU_ADDRESS 0xFFFF2B2C READ_WRITE /end MEASUREMENT
/begin MEASUREMENT vRO2PJUGf "RAM value vRO2PJUGf" UBYTE COMP_0004 1 100 0 255 ECU_ADDRESS 0xFFFF2B2D READ_WRITE /end MEASUREMENT
/begin MEASUREMENT vRO2RLf "RAM value vRO2RLf" UBYTE COMP_0004 1 100 0 255 ECU_ADDRESS 0xFFFF211D READ_WRITE /end MEASUREMENT
/begin MEASUREMENT vRO2STG2Ef "RAM value vRO2STG2Ef" UBYTE COMP_0004 1 100 0 255 ECU_ADDRESS 0xFFFF2B2E READ_WRITE /end MEASUREMENT
/begin MEASUREMENT vRO2STG2Jf "RAM value vRO2STG2Jf" UBYTE COMP_0004 1 100 0 255 ECU_ADDRESS 0xFFFF2B30 READ_WRITE /end MEASUREMENT
/begin MEASUREMENT vRO2STG2Vf "RAM value vRO2STG2Vf" UBYTE COMP_0004 1 100 0 255 ECU_ADDRESS 0xFFFF2B31 READ_WRITE /end MEASUREMENT
/begin MEASUREMENT vRO2STG2f "RAM value vRO2STG2f" UBYTE COMP_0004 1 100 0 255 ECU_ADDRESS 0xFFFF2B2F READ_WRITE /end MEASUREMENT
/begin MEASUREMENT vRO2TMHMX "RAM value vRO2TMHMX" UBYTE COMP_0068 1 100 0 255 ECU_ADDRESS 0xFFFF2B32 READ_WRITE /end MEASUREMENT
/begin MEASUREMENT vRO2VBHOS "RAM value vRO2VBHOS" UBYTE COMP_0009 1 100 0 199.21875 ECU_ADDRESS 0xFFFF2B33 READ_WRITE /end MEASUREMENT
/begin MEASUREMENT vROAVCNf "RAM value vROAVCNf" UBYTE COMP_0004 1 100 0 255 ECU_ADDRESS 0xFFFF2B34 READ_WRITE /end MEASUREMENT
/begin MEASUREMENT vROAVNG1f "RAM value vROAVNG1f" UBYTE COMP_0004 1 100 0 255 ECU_ADDRESS 0xFFFF4D4F READ_WRITE /end MEASUREMENT
/begin MEASUREMENT vROAVNG2f "RAM value vROAVNG2f" UBYTE COMP_0004 1 100 0 255 ECU_ADDRESS 0xFFFF4D50 READ_WRITE /end MEASUREMENT
/begin MEASUREMENT vROBH1Z "RAM value vROBH1Z" SWORD COMP_0568_S 1 100 -32.768 32.767 ECU_ADDRESS 0xFFFF322A READ_WRITE /end MEASUREMENT
/begin MEASUREMENT vROBH2Z "RAM value vROBH2Z" SWORD COMP_0568_S 1 100 -32.768 32.767 ECU_ADDRESS 0xFFFF322C READ_WRITE /end MEASUREMENT
/begin MEASUREMENT vRODRCNT1 "RAM value vRODRCNT1" UWORD COMP_0016 1 100 0 65535 ECU_ADDRESS 0xFFFF5242 READ_WRITE /end MEASUREMENT
/begin MEASUREMENT vRODRCNT2 "RAM value vRODRCNT2" UWORD COMP_0016 1 100 0 65535 ECU_ADDRESS 0xFFFF5244 READ_WRITE /end MEASUREMENT
/begin MEASUREMENT vRODRDN "RAM value vRODRDN" UBYTE COMP_0068 1 100 0 255 ECU_ADDRESS 0xFFFF2B35 READ_WRITE /end MEASUREMENT
/begin MEASUREMENT vRODRJVO "RAM value vRODRJVO" UBYTE COMP_0104 1 100 0 2550 ECU_ADDRESS 0xFFFF2B36 READ_WRITE /end MEASUREMENT
/begin MEASUREMENT vRODRSTS "RAM value vRODRSTS" UBYTE COMP_0068 1 100 0 255 ECU_ADDRESS 0xFFFF0E65 READ_WRITE /end MEASUREMENT
/begin MEASUREMENT vRODRTRP1 "RAM value vRODRTRP1" UWORD COMP_0016 1 100 0 65535 ECU_ADDRESS 0xFFFF5246 READ_WRITE /end MEASUREMENT
/begin MEASUREMENT vRODRTRP2 "RAM value vRODRTRP2" UWORD COMP_0016 1 100 0 65535 ECU_ADDRESS 0xFFFF5248 READ_WRITE /end MEASUREMENT
/begin MEASUREMENT vROHCANf "RAM value vROHCANf" UBYTE COMP_0004 1 100 0 255 ECU_ADDRESS 0xFFFF2B37 READ_WRITE /end MEASUREMENT
/begin MEASUREMENT vROHCR "RAM value vROHCR" UBYTE COMP_0054 1 100 0 5100 ECU_ADDRESS 0xFFFF2086 READ_WRITE /end MEASUREMENT
/begin MEASUREMENT vROHCRT "RAM value vROHCRT" UBYTE COMP_0054 1 100 0 5100 ECU_ADDRESS 0xFFFF387E READ_WRITE /end MEASUREMENT
/begin MEASUREMENT vROHMLOKf "RAM value vROHMLOKf" UBYTE COMP_0004 1 100 0 255 ECU_ADDRESS 0xFFFF2B38 READ_WRITE /end MEASUREMENT
/begin MEASUREMENT vROHNG1f "RAM value vROHNG1f" UBYTE COMP_0004 1 100 0 255 ECU_ADDRESS 0xFFFF4D51 READ_WRITE /end MEASUREMENT
/begin MEASUREMENT vROHNG2f "RAM value vROHNG2f" UBYTE COMP_0004 1 100 0 255 ECU_ADDRESS 0xFFFF4D52 READ_WRITE /end MEASUREMENT
/begin MEASUREMENT vROHOK2f "RAM value vROHOK2f" UBYTE COMP_0004 1 100 0 255 ECU_ADDRESS 0xFFFF4D53 READ_WRITE /end MEASUREMENT
/begin MEASUREMENT vROHONTf "RAM value vROHONTf" UBYTE COMP_0004 1 100 0 255 ECU_ADDRESS 0xFFFF2B39 READ_WRITE /end MEASUREMENT
/begin MEASUREMENT vROJFCC "RAM value vROJFCC" UBYTE COMP_0030 1 100 0 255 ECU_ADDRESS 0xFFFF2B3A READ_WRITE /end MEASUREMENT
/begin MEASUREMENT vROJFCTf "RAM value vROJFCTf" UBYTE COMP_0004 1 100 0 255 ECU_ADDRESS 0xFFFF2B3B READ_WRITE /end MEASUREMENT
/begin MEASUREMENT vROMNCNf "RAM value vROMNCNf" UBYTE COMP_0004 1 100 0 255 ECU_ADDRESS 0xFFFF2B3C READ_WRITE /end MEASUREMENT
/begin MEASUREMENT vROMNNG1f "RAM value vROMNNG1f" UBYTE COMP_0004 1 100 0 255 ECU_ADDRESS 0xFFFF4D54 READ_WRITE /end MEASUREMENT
/begin MEASUREMENT vROMNNG2f "RAM value vROMNNG2f" UBYTE COMP_0004 1 100 0 255 ECU_ADDRESS 0xFFFF4D55 READ_WRITE /end MEASUREMENT
/begin MEASUREMENT vROMXCNf "RAM value vROMXCNf" UBYTE COMP_0004 1 100 0 255 ECU_ADDRESS 0xFFFF2B3D READ_WRITE /end MEASUREMENT
/begin MEASUREMENT vROMXNG1f "RAM value vROMXNG1f" UBYTE COMP_0004 1 100 0 255 ECU_ADDRESS 0xFFFF4D56 READ_WRITE /end MEASUREMENT
/begin MEASUREMENT vROMXNG2f "RAM value vROMXNG2f" UBYTE COMP_0004 1 100 0 255 ECU_ADDRESS 0xFFFF4D57 READ_WRITE /end MEASUREMENT
/begin MEASUREMENT vRON "RAM value vRON" ULONG COMP_0366_S 1 100 0 2097150.9257699 ECU_ADDRESS 0xFFFF0E68 READ_WRITE /end MEASUREMENT
/begin MEASUREMENT vROND "RAM value vROND" ULONG COMP_0366_S 1 100 0 2097150.9257699 ECU_ADDRESS 0xFFFF0E6C READ_WRITE /end MEASUREMENT
/begin MEASUREMENT vRONEST "RAM value vRONEST" UBYTE COMP_0201_S 1 100 75 106.875 ECU_ADDRESS 0xFFFF4D58 READ_WRITE /end MEASUREMENT
/begin MEASUREMENT vRONHOS "RAM value vRONHOS" SBYTE COMP_0509_S 1 100 -32 31.75 ECU_ADDRESS 0xFFFF2B3E READ_WRITE /end MEASUREMENT
/begin MEASUREMENT vRONHYS "RAM value vRONHYS" UBYTE COMP_0235_S 1 100 0 31.875 ECU_ADDRESS 0xFFFF0E70 READ_WRITE /end MEASUREMENT
/begin MEASUREMENT vRONJH "RAM value vRONJH" UBYTE COMP_0201_S 1 100 75 106.875 ECU_ADDRESS 0xFFFF0E71 READ_WRITE /end MEASUREMENT
/begin MEASUREMENT vRONLMH "RAM value vRONLMH" UWORD COMP_0235_S 1 100 0 8191.875 ECU_ADDRESS 0xFFFF0E72 READ_WRITE /end MEASUREMENT
/begin MEASUREMENT vRONLML "RAM value vRONLML" UWORD COMP_0235_S 1 100 0 8191.875 ECU_ADDRESS 0xFFFF0E74 READ_WRITE /end MEASUREMENT
/begin MEASUREMENT vRONNEH "RAM value vRONNEH" SLONG COMP_0598_S 1 100 -268435456 268435455.875 ECU_ADDRESS 0xFFFF2B40 READ_WRITE /end MEASUREMENT
/begin MEASUREMENT vRONNEL "RAM value vRONNEL" SLONG COMP_0598_S 1 100 -268435456 268435455.875 ECU_ADDRESS 0xFFFF2B44 READ_WRITE /end MEASUREMENT
/begin MEASUREMENT vRORLTM "RAM value vRORLTM" UBYTE COMP_0295 1 100 0 25500 ECU_ADDRESS 0xFFFF0E76 READ_WRITE /end MEASUREMENT
/begin MEASUREMENT vRORLTMM "RAM value vRORLTMM" UBYTE COMP_0295 1 100 0 25500 ECU_ADDRESS 0xFFFF0E77 READ_WRITE /end MEASUREMENT
/begin MEASUREMENT vRORLTMT "RAM value vRORLTMT" UWORD COMP_0295 1 100 0 6553500 ECU_ADDRESS 0xFFFF2B48 READ_WRITE /end MEASUREMENT
/begin MEASUREMENT vRORSCNf "RAM value vRORSCNf" UBYTE COMP_0004 1 100 0 255 ECU_ADDRESS 0xFFFF2B4A READ_WRITE /end MEASUREMENT
/begin MEASUREMENT vRORSNG1f "RAM value vRORSNG1f" UBYTE COMP_0004 1 100 0 255 ECU_ADDRESS 0xFFFF4D59 READ_WRITE /end MEASUREMENT
/begin MEASUREMENT vRORSNG2f "RAM value vRORSNG2f" UBYTE COMP_0004 1 100 0 255 ECU_ADDRESS 0xFFFF4D5A READ_WRITE /end MEASUREMENT
/begin MEASUREMENT vROU "RAM value vROU" UBYTE COMP_0303 1 100 0 31875 ECU_ADDRESS 0xFFFF0E78 READ_WRITE /end MEASUREMENT
/begin MEASUREMENT vROXMN "RAM value vROXMN" UBYTE COMP_0104 1 100 0 2550 ECU_ADDRESS 0xFFFF2087 READ_WRITE /end MEASUREMENT
/begin MEASUREMENT vROXMX "RAM value vROXMX" UBYTE COMP_0104 1 100 0 2550 ECU_ADDRESS 0xFFFF2088 READ_WRITE /end MEASUREMENT
/begin MEASUREMENT vRPAMB "RAM value vRPAMB" UBYTE COMP_0045 1 100 0 1.9921875 ECU_ADDRESS 0xFFFF2B4B READ_WRITE /end MEASUREMENT
/begin MEASUREMENT vRPEAK "RAM value vRPEAK" UWORD COMP_0453 1 100 0 131.07 ECU_ADDRESS 0xFFFF2B4C READ_WRITE /end MEASUREMENT
/begin MEASUREMENT vRPIPER "RAM value vRPIPER" UBYTE COMP_0009 1 100 0 199.21875 ECU_ADDRESS 0xFFFF19BC READ_WRITE /end MEASUREMENT
/begin MEASUREMENT vRPISET "RAM value vRPISET" UBYTE COMP_0068 1 100 0 255 ECU_ADDRESS 0xFFFF19BD READ_WRITE /end MEASUREMENT
/begin MEASUREMENT vRPMPS1 "RAM value vRPMPS1" UWORD COMP_0006 1 100 0 819187.5 ECU_ADDRESS 0xFFFF1672 READ_WRITE /end MEASUREMENT
/begin MEASUREMENT vRPMPS2 "RAM value vRPMPS2" UWORD COMP_0006 1 100 0 819187.5 ECU_ADDRESS 0xFFFF1674 READ_WRITE /end MEASUREMENT
/begin MEASUREMENT vRPMPS3 "RAM value vRPMPS3" UWORD COMP_0006 1 100 0 819187.5 ECU_ADDRESS 0xFFFF1676 READ_WRITE /end MEASUREMENT
/begin MEASUREMENT vRPMPS4 "RAM value vRPMPS4" UWORD COMP_0006 1 100 0 819187.5 ECU_ADDRESS 0xFFFF1678 READ_WRITE /end MEASUREMENT
/begin MEASUREMENT vRPMPS5 "RAM value vRPMPS5" UWORD COMP_0006 1 100 0 819187.5 ECU_ADDRESS 0xFFFF167A READ_WRITE /end MEASUREMENT
/begin MEASUREMENT vRQAST "RAM value vRQAST" UWORD COMP_0217 1 100 0 3.999941832 ECU_ADDRESS 0xFFFF0994 READ_WRITE /end MEASUREMENT
/begin MEASUREMENT vRQASTB "RAM value vRQASTB" UWORD COMP_0217 1 100 0 3.999941832 ECU_ADDRESS 0xFFFF0E7A READ_WRITE /end MEASUREMENT
/begin MEASUREMENT vRQASTC "RAM value vRQASTC" UWORD COMP_0217 1 100 0 3.999941832 ECU_ADDRESS 0xFFFF0E7C READ_WRITE /end MEASUREMENT
/begin MEASUREMENT vRQASTD "RAM value vRQASTD" UWORD COMP_0217 1 100 0 3.999941832 ECU_ADDRESS 0xFFFF0E7E READ_WRITE /end MEASUREMENT
/begin MEASUREMENT vRRCOKf "RAM value vRRCOKf" UBYTE COMP_0004 1 100 0 255 ECU_ADDRESS 0xFFFF2B50 READ_WRITE /end MEASUREMENT
/begin MEASUREMENT vRRFOEVPf "RAM value vRRFOEVPf" UBYTE COMP_0004 1 100 0 255 ECU_ADDRESS 0xFFFF2B51 READ_WRITE /end MEASUREMENT
/begin MEASUREMENT vRROFMT "RAM value vRROFMT" UBYTE COMP_0049 1 100 0 255 ECU_ADDRESS 0xFFFF2B52 READ_WRITE /end MEASUREMENT
/begin MEASUREMENT vRRPEAK "RAM value vRRPEAK" UWORD COMP_0023 1 100 0 327675 ECU_ADDRESS 0xFFFF2B54 READ_WRITE /end MEASUREMENT
/begin MEASUREMENT vRRPSOKf "RAM value vRRPSOKf" UBYTE COMP_0004 1 100 0 255 ECU_ADDRESS 0xFFFF2B58 READ_WRITE /end MEASUREMENT
/begin MEASUREMENT vRSIDLTM "RAM value vRSIDLTM" UBYTE COMP_0008 1 100 0 25500 ECU_ADDRESS 0xFFFF0E80 READ_WRITE /end MEASUREMENT
/begin MEASUREMENT vRSLICE "RAM value vRSLICE" UWORD COMP_0023 1 100 0 327675 ECU_ADDRESS 0xFFFF2B5A READ_WRITE /end MEASUREMENT
/begin MEASUREMENT vRSLIP "RAM value vRSLIP" UBYTE COMP_0063 1 100 0 0.99609375 ECU_ADDRESS 0xFFFF2B5E READ_WRITE /end MEASUREMENT
/begin MEASUREMENT vRST2ARAVf "RAM value vRST2ARAVf" UBYTE COMP_0004 1 100 0 255 ECU_ADDRESS 0xFFFF2B60 READ_WRITE /end MEASUREMENT
/begin MEASUREMENT vRST2ARAf "RAM value vRST2ARAf" UBYTE COMP_0004 1 100 0 255 ECU_ADDRESS 0xFFFF2B5F READ_WRITE /end MEASUREMENT
/begin MEASUREMENT vRST2GOf "RAM value vRST2GOf" UBYTE COMP_0004 1 100 0 255 ECU_ADDRESS 0xFFFF2B61 READ_WRITE /end MEASUREMENT
/begin MEASUREMENT vRSTCNT "RAM value vRSTCNT" UWORD COMP_0016 1 100 0 65535 ECU_ADDRESS 0xFFFF4F3C READ_WRITE /end MEASUREMENT
/begin MEASUREMENT vRSTINPR "RAM value vRSTINPR" UWORD COMP_0443 1 100 0 65535 ECU_ADDRESS 0xFFFF4F3E READ_WRITE /end MEASUREMENT
/begin MEASUREMENT vRSTNGCNT "RAM value vRSTNGCNT" UBYTE COMP_0016 1 100 0 255 ECU_ADDRESS 0xFFFF4D5B READ_WRITE /end MEASUREMENT
/begin MEASUREMENT vRSTOTMP "RAM value vRSTOTMP" UBYTE COMP_0016 1 100 0 255 ECU_ADDRESS 0xFFFF4F40 READ_WRITE /end MEASUREMENT
/begin MEASUREMENT vRSTRTIO "RAM value vRSTRTIO" UWORD COMP_0450 1 100 0 63.999056205 ECU_ADDRESS 0xFFFF4F42 READ_WRITE /end MEASUREMENT
/begin MEASUREMENT vRSTTRQLM "RAM value vRSTTRQLM" SWORD COMP_0228 1 100 -3276.8 3276.7 ECU_ADDRESS 0xFFFF2B62 READ_WRITE /end MEASUREMENT
/begin MEASUREMENT vRTCLV "RAM value vRTCLV" UBYTE COMP_0425 1 100 0 99.99999981 ECU_ADDRESS 0xFFFF3B84 READ_WRITE /end MEASUREMENT
/begin MEASUREMENT vRTCNT0 "RAM value vRTCNT0" ULONG COMP_0496 1 100 0 6247029930.5775 ECU_ADDRESS 0xFFFF0E84 READ_WRITE /end MEASUREMENT
/begin MEASUREMENT vRTFSS "RAM value vRTFSS" UBYTE COMP_0091 1 100 0 255 ECU_ADDRESS 0xFFFF3B85 READ_WRITE /end MEASUREMENT
/begin MEASUREMENT vRTORATE "RAM value vRTORATE" UBYTE COMP_0425 1 100 0 99.99999981 ECU_ADDRESS 0xFFFF0E94 READ_WRITE /end MEASUREMENT
/begin MEASUREMENT vRTOTMP "RAM value vRTOTMP" UWORD COMP_0313_S 1 100 0 7.99985745 ECU_ADDRESS 0xFFFF0E96 READ_WRITE /end MEASUREMENT
/begin MEASUREMENT vRTOTRN "RAM value vRTOTRN" UWORD COMP_0290 1 100 0 0.999985458 ECU_ADDRESS 0xFFFF0E98 READ_WRITE /end MEASUREMENT
/begin MEASUREMENT vRTOTRN_S "RAM value vRTOTRN_S" UWORD COMP_0290 1 100 0 0.999985458 ECU_ADDRESS 0xFFFF14BE READ_WRITE /end MEASUREMENT
/begin MEASUREMENT vRTPOS10 "RAM value vRTPOS10" UWORD COMP_0599_S 1 100 0 65535 ECU_ADDRESS 0xFFFF19BE READ_WRITE /end MEASUREMENT
/begin MEASUREMENT vRTQAFPRC "RAM value vRTQAFPRC" UBYTE COMP_0497_S 1 100 -100 410 ECU_ADDRESS 0xFFFF387F READ_WRITE /end MEASUREMENT
/begin MEASUREMENT vRTREF10 "RAM value vRTREF10" UWORD COMP_0599_S 1 100 0 65535 ECU_ADDRESS 0xFFFF19C0 READ_WRITE /end MEASUREMENT
/begin MEASUREMENT vRTTBPATM "RAM value vRTTBPATM" UWORD COMP_0217 1 100 0 3.999941832 ECU_ADDRESS 0xFFFF2B64 READ_WRITE /end MEASUREMENT
/begin MEASUREMENT vRUNTIME "RAM value vRUNTIME" UBYTE COMP_0013 1 100 0 255 ECU_ADDRESS 0xFFFF3880 READ_WRITE /end MEASUREMENT
/begin MEASUREMENT vRUNTM "RAM value vRUNTM" UWORD COMP_0013 1 100 0 65535 ECU_ADDRESS 0xFFFF3B88 READ_WRITE /end MEASUREMENT
/begin MEASUREMENT vRVRFAC "RAM value vRVRFAC" UWORD COMP_0209_S 1 100 0 199.996894995 ECU_ADDRESS 0xFFFF2B66 READ_WRITE /end MEASUREMENT
/begin MEASUREMENT vRVRFAC_S "RAM value vRVRFAC_S" UWORD COMP_0209_S 1 100 0 199.996894995 ECU_ADDRESS 0xFFFF3054 READ_WRITE /end MEASUREMENT
/begin MEASUREMENT vR_COM1 "RAM value vR_COM1" UWORD COMP_0068 1 100 0 65535 ECU_ADDRESS 0xFFFF3810 READ_WRITE /end MEASUREMENT
/begin MEASUREMENT vR_COM1OU "RAM value vR_COM1OU" UWORD COMP_0068 1 100 0 65535 ECU_ADDRESS 0xFFFF3812 READ_WRITE /end MEASUREMENT
/begin MEASUREMENT vR_COM2 "RAM value vR_COM2" UWORD COMP_0068 1 100 0 65535 ECU_ADDRESS 0xFFFF3814 READ_WRITE /end MEASUREMENT
/begin MEASUREMENT vR_COM2OU "RAM value vR_COM2OU" UWORD COMP_0068 1 100 0 65535 ECU_ADDRESS 0xFFFF3816 READ_WRITE /end MEASUREMENT
/begin MEASUREMENT vR_COM3 "RAM value vR_COM3" UWORD COMP_0068 1 100 0 65535 ECU_ADDRESS 0xFFFF3818 READ_WRITE /end MEASUREMENT
/begin MEASUREMENT vR_COM3OU "RAM value vR_COM3OU" UWORD COMP_0068 1 100 0 65535 ECU_ADDRESS 0xFFFF381A READ_WRITE /end MEASUREMENT
/begin MEASUREMENT vR_COM4 "RAM value vR_COM4" UWORD COMP_0068 1 100 0 65535 ECU_ADDRESS 0xFFFF381C READ_WRITE /end MEASUREMENT
/begin MEASUREMENT vR_COM4OU "RAM value vR_COM4OU" UWORD COMP_0068 1 100 0 65535 ECU_ADDRESS 0xFFFF381E READ_WRITE /end MEASUREMENT
/begin MEASUREMENT vR_COM5 "RAM value vR_COM5" UWORD COMP_0068 1 100 0 65535 ECU_ADDRESS 0xFFFF3820 READ_WRITE /end MEASUREMENT
/begin MEASUREMENT vR_COM5OU "RAM value vR_COM5OU" UWORD COMP_0068 1 100 0 65535 ECU_ADDRESS 0xFFFF3822 READ_WRITE /end MEASUREMENT
/begin MEASUREMENT vR_COM6 "RAM value vR_COM6" UWORD COMP_0068 1 100 0 65535 ECU_ADDRESS 0xFFFF3824 READ_WRITE /end MEASUREMENT
/begin MEASUREMENT vR_COM6OU "RAM value vR_COM6OU" UWORD COMP_0068 1 100 0 65535 ECU_ADDRESS 0xFFFF3826 READ_WRITE /end MEASUREMENT
/begin MEASUREMENT vSAKAI "RAM value vSAKAI" UWORD COMP_0057_S 1 100 0 6553.5 ECU_ADDRESS 0xFFFF19C2 READ_WRITE /end MEASUREMENT
/begin MEASUREMENT vSCDMP0 "RAM value vSCDMP0" UBYTE COMP_0021 1 100 0 99.609375 ECU_ADDRESS 0xFFFF0E9A READ_WRITE /end MEASUREMENT
/begin MEASUREMENT vSCFEQ "RAM value vSCFEQ" UBYTE COMP_0373 1 100 0 2.55 ECU_ADDRESS 0xFFFF2B68 READ_WRITE /end MEASUREMENT
/begin MEASUREMENT vSCI1MAX "RAM value vSCI1MAX" UBYTE COMP_0030 1 100 0 255 ECU_ADDRESS 0xFFFF4D5C READ_WRITE /end MEASUREMENT
/begin MEASUREMENT vSCI2MAX "RAM value vSCI2MAX" UBYTE COMP_0030 1 100 0 255 ECU_ADDRESS 0xFFFF4D5D READ_WRITE /end MEASUREMENT
/begin MEASUREMENT vSCI3MAX "RAM value vSCI3MAX" UBYTE COMP_0030 1 100 0 255 ECU_ADDRESS 0xFFFF4D5E READ_WRITE /end MEASUREMENT
/begin MEASUREMENT vSCINGC1 "RAM value vSCINGC1" UBYTE COMP_0030 1 100 0 255 ECU_ADDRESS 0xFFFF3881 READ_WRITE /end MEASUREMENT
/begin MEASUREMENT vSCINGC2 "RAM value vSCINGC2" UBYTE COMP_0030 1 100 0 255 ECU_ADDRESS 0xFFFF3882 READ_WRITE /end MEASUREMENT
/begin MEASUREMENT vSCINGC3 "RAM value vSCINGC3" UBYTE COMP_0030 1 100 0 255 ECU_ADDRESS 0xFFFF3883 READ_WRITE /end MEASUREMENT
/begin MEASUREMENT vSCKRET "RAM value vSCKRET" UBYTE COMP_0017 1 100 0 255 ECU_ADDRESS 0xFFFF3B8A READ_WRITE /end MEASUREMENT
/begin MEASUREMENT vSCKRET0 "RAM value vSCKRET0" UWORD COMP_0081 1 100 0 255.99609375 ECU_ADDRESS 0xFFFF2B6A READ_WRITE /end MEASUREMENT
/begin MEASUREMENT vSCVCNT "RAM value vSCVCNT" UWORD COMP_0016 1 100 0 65535 ECU_ADDRESS 0xFFFF4D60 READ_WRITE /end MEASUREMENT
/begin MEASUREMENT vSCVDCV "RAM value vSCVDCV" UWORD COMP_0023 1 100 0 327675 ECU_ADDRESS 0xFFFF3884 READ_WRITE /end MEASUREMENT
/begin MEASUREMENT vSCVTF "RAM value vSCVTF" UBYTE COMP_0095 1 100 0 398.4375 ECU_ADDRESS 0xFFFF0E9B READ_WRITE /end MEASUREMENT
/begin MEASUREMENT vSDCESTCT "RAM value vSDCESTCT" UBYTE COMP_0004_S 1 100 -50 205 ECU_ADDRESS 0xFFFF2B6C READ_WRITE /end MEASUREMENT
/begin MEASUREMENT vSDCRbuf "RAM value vSDCRbuf" UWORD COMP_0004 1 100 0 65535 ECU_ADDRESS 0xFFFF3886 READ_WRITE /end MEASUREMENT
/begin MEASUREMENT vSECID "RAM value vSECID" UWORD COMP_0068 1 100 0 65535 ECU_ADDRESS 0xFFFF4F44 READ_WRITE /end MEASUREMENT
/begin MEASUREMENT vSEED "RAM value vSEED" UWORD COMP_0068 1 100 0 65535 ECU_ADDRESS 0xFFFF4F46 READ_WRITE /end MEASUREMENT
/begin MEASUREMENT vSENNRPM "RAM value vSENNRPM" UWORD COMP_0006 1 100 0 819187.5 ECU_ADDRESS 0xFFFF0E9C READ_WRITE /end MEASUREMENT
/begin MEASUREMENT vSFSTTS "RAM value vSFSTTS" UBYTE COMP_0008 1 100 0 25500 ECU_ADDRESS 0xFFFF167C READ_WRITE /end MEASUREMENT
/begin MEASUREMENT vSFTREQHT "RAM value vSFTREQHT" UBYTE COMP_0068 1 100 0 255 ECU_ADDRESS 0xFFFF1B44 READ_WRITE /end MEASUREMENT
/begin MEASUREMENT vSFTTVOL "RAM value vSFTTVOL" UWORD COMP_0005 1 100 0 7208.85 ECU_ADDRESS 0xFFFF2B6E READ_WRITE /end MEASUREMENT
/begin MEASUREMENT vSFTTVOU "RAM value vSFTTVOU" UWORD COMP_0005 1 100 0 7208.85 ECU_ADDRESS 0xFFFF2B70 READ_WRITE /end MEASUREMENT
/begin MEASUREMENT vSFTVCTR "RAM value vSFTVCTR" UBYTE COMP_0068 1 100 0 255 ECU_ADDRESS 0xFFFF2089 READ_WRITE /end MEASUREMENT
/begin MEASUREMENT vSGADV "RAM value vSGADV" UBYTE COMP_0017 1 100 0 255 ECU_ADDRESS 0xFFFF3A43 READ_WRITE /end MEASUREMENT
/begin MEASUREMENT vSGCOUNT "RAM value vSGCOUNT" UBYTE COMP_0030 1 100 0 255 ECU_ADDRESS 0xFFFF211E READ_WRITE /end MEASUREMENT
/begin MEASUREMENT vSGIGNNUM "RAM value vSGIGNNUM" UBYTE COMP_0030 1 100 0 255 ECU_ADDRESS 0xFFFF3A44 READ_WRITE /end MEASUREMENT
/begin MEASUREMENT vSHAGAILM "RAM value vSHAGAILM" SWORD COMP_0228 1 100 -3276.8 3276.7 ECU_ADDRESS 0xFFFF0E9E READ_WRITE /end MEASUREMENT
/begin MEASUREMENT vSHSOSQ "RAM value vSHSOSQ" ULONG COMP_0498_S 1 100 0 42949672.95 ECU_ADDRESS 0xFFFF2B74 READ_WRITE /end MEASUREMENT
/begin MEASUREMENT vSIGMA "RAM value vSIGMA" SWORD COMP_0020_S 1 100 -65.536 65.534 ECU_ADDRESS 0xFFFF0EA0 READ_WRITE /end MEASUREMENT
/begin MEASUREMENT vSKTNT "RAM value vSKTNT" ULONG COMP_0456 1 100 0 131072.093921892 ECU_ADDRESS 0xFFFF3230 READ_WRITE /end MEASUREMENT
/begin MEASUREMENT vSLAJFLTR "RAM value vSLAJFLTR" SWORD COMP_0228 1 100 -3276.8 3276.7 ECU_ADDRESS 0xFFFF0EA4 READ_WRITE /end MEASUREMENT
/begin MEASUREMENT vSLAJRAMP "RAM value vSLAJRAMP" SWORD COMP_0228 1 100 -3276.8 3276.7 ECU_ADDRESS 0xFFFF0EA6 READ_WRITE /end MEASUREMENT
/begin MEASUREMENT vSLDSHPOD "RAM value vSLDSHPOD" SWORD COMP_0228 1 100 -3276.8 3276.7 ECU_ADDRESS 0xFFFF2B7C READ_WRITE /end MEASUREMENT
/begin MEASUREMENT vSLDTDSP "RAM value vSLDTDSP" SWORD COMP_0600_S 1 100 -327.68 327.67 ECU_ADDRESS 0xFFFF2B7E READ_WRITE /end MEASUREMENT
/begin MEASUREMENT vSLDTHRV "RAM value vSLDTHRV" SWORD COMP_0600_S 1 100 -327.68 327.67 ECU_ADDRESS 0xFFFF2B80 READ_WRITE /end MEASUREMENT
/begin MEASUREMENT vSLFBP "RAM value vSLFBP" SWORD COMP_0553_S 1 100 -163.84 163.835 ECU_ADDRESS 0xFFFF19C4 READ_WRITE /end MEASUREMENT
/begin MEASUREMENT vSLHIGRIH "RAM value vSLHIGRIH" UBYTE COMP_0068 1 100 0 255 ECU_ADDRESS 0xFFFF3B8B READ_WRITE /end MEASUREMENT
/begin MEASUREMENT vSLID "RAM value vSLID" UBYTE COMP_0283 1 100 0 255 ECU_ADDRESS 0xFFFF2B82 READ_WRITE /end MEASUREMENT
/begin MEASUREMENT vSLIGAIN "RAM value vSLIGAIN" UWORD COMP_0241_S 1 100 0 65535 ECU_ADDRESS 0xFFFF2B84 READ_WRITE /end MEASUREMENT
/begin MEASUREMENT vSLINVEL "RAM value vSLINVEL" UWORD COMP_0571_S 1 100 -15.999991808 15.999503527 ECU_ADDRESS 0xFFFF0EA8 READ_WRITE /end MEASUREMENT
/begin MEASUREMENT vSLLEANf "RAM value vSLLEANf" UBYTE COMP_0004 1 100 0 255 ECU_ADDRESS 0xFFFF2B86 READ_WRITE /end MEASUREMENT
/begin MEASUREMENT vSLMNAVTQ "RAM value vSLMNAVTQ" SWORD COMP_0228 1 100 -3276.8 3276.7 ECU_ADDRESS 0xFFFF2B88 READ_WRITE /end MEASUREMENT
/begin MEASUREMENT vSLMON "RAM value vSLMON" UBYTE COMP_0283 1 100 0 255 ECU_ADDRESS 0xFFFF2B8A READ_WRITE /end MEASUREMENT
/begin MEASUREMENT vSLMTOIL "RAM value vSLMTOIL" UWORD COMP_0238_S 1 100 0 655.35 ECU_ADDRESS 0xFFFF2B8C READ_WRITE /end MEASUREMENT
/begin MEASUREMENT vSLMTOIL0 "RAM value vSLMTOIL0" ULONG COMP_0238_S 1 100 0 42949672.95 ECU_ADDRESS 0xFFFF2B90 READ_WRITE /end MEASUREMENT
/begin MEASUREMENT vSLMTOIT0 "RAM value vSLMTOIT0" UWORD COMP_0008 1 100 0 6553500 ECU_ADDRESS 0xFFFF2B94 READ_WRITE /end MEASUREMENT
/begin MEASUREMENT vSLMTOITM "RAM value vSLMTOITM" UWORD COMP_0008 1 100 0 6553500 ECU_ADDRESS 0xFFFF2B96 READ_WRITE /end MEASUREMENT
/begin MEASUREMENT vSLNTHPUN "RAM value vSLNTHPUN" UWORD COMP_0182_S 1 100 0 65.535 ECU_ADDRESS 0xFFFF2B98 READ_WRITE /end MEASUREMENT
/begin MEASUREMENT vSLNTHUL "RAM value vSLNTHUL" UWORD COMP_0182_S 1 100 0 65.535 ECU_ADDRESS 0xFFFF2B9C READ_WRITE /end MEASUREMENT
/begin MEASUREMENT vSLOPE "RAM value vSLOPE" UWORD COMP_0428_S 1 100 -327.68 327.67 ECU_ADDRESS 0xFFFF3888 READ_WRITE /end MEASUREMENT
/begin MEASUREMENT vSLOPEBU "RAM value vSLOPEBU" UWORD COMP_0428_S 1 100 -327.68 327.67 ECU_ADDRESS 0xFFFF4F48 READ_WRITE /end MEASUREMENT
/begin MEASUREMENT vSLOPEOKH "RAM value vSLOPEOKH" SWORD COMP_0601_S 1 100 -327.68 327.67 ECU_ADDRESS 0xFFFF2BA0 READ_WRITE /end MEASUREMENT
/begin MEASUREMENT vSLOPEOKL "RAM value vSLOPEOKL" SWORD COMP_0601_S 1 100 -327.68 327.67 ECU_ADDRESS 0xFFFF2BA2 READ_WRITE /end MEASUREMENT
/begin MEASUREMENT vSLOPERAW "RAM value vSLOPERAW" UWORD COMP_0428_S 1 100 -327.68 327.67 ECU_ADDRESS 0xFFFF388A READ_WRITE /end MEASUREMENT
/begin MEASUREMENT vSLP "RAM value vSLP" UWORD COMP_0456 1 100 0 1.999970916 ECU_ADDRESS 0xFFFF0EAA READ_WRITE /end MEASUREMENT
/begin MEASUREMENT vSLPDEC "RAM value vSLPDEC" SWORD COMP_0277 1 100 -32768 32767 ECU_ADDRESS 0xFFFF0EAC READ_WRITE /end MEASUREMENT
/begin MEASUREMENT vSLPDEC0 "RAM value vSLPDEC0" SWORD COMP_0277 1 100 -32768 32767 ECU_ADDRESS 0xFFFF0EAE READ_WRITE /end MEASUREMENT
/begin MEASUREMENT vSLPGAIN "RAM value vSLPGAIN" UWORD COMP_0400_S 1 100 0 65535 ECU_ADDRESS 0xFFFF2BA4 READ_WRITE /end MEASUREMENT
/begin MEASUREMENT vSLPGAIN0 "RAM value vSLPGAIN0" UWORD COMP_0400_S 1 100 0 65535 ECU_ADDRESS 0xFFFF2BA6 READ_WRITE /end MEASUREMENT
/begin MEASUREMENT vSLPGFCTR "RAM value vSLPGFCTR" UWORD COMP_0447 1 100 0 6399.90234375 ECU_ADDRESS 0xFFFF2BA8 READ_WRITE /end MEASUREMENT
/begin MEASUREMENT vSLPISC0 "RAM value vSLPISC0" SBYTE COMP_0472 1 100 -2 1.984375 ECU_ADDRESS 0xFFFF0996 READ_WRITE /end MEASUREMENT
/begin MEASUREMENT vSLPRTO "RAM value vSLPRTO" UWORD COMP_0585_S 1 100 0 1.06664766 ECU_ADDRESS 0xFFFF0EB0 READ_WRITE /end MEASUREMENT
/begin MEASUREMENT vSLPRTO_S "RAM value vSLPRTO_S" UWORD COMP_0585_S 1 100 0 1.06664766 ECU_ADDRESS 0xFFFF14C0 READ_WRITE /end MEASUREMENT
/begin MEASUREMENT vSLPVTC "RAM value vSLPVTC" UWORD COMP_0571_S 1 100 -15.999991808 15.999503527 ECU_ADDRESS 0xFFFF0EB2 READ_WRITE /end MEASUREMENT
/begin MEASUREMENT vSLPWTSP "RAM value vSLPWTSP" UWORD COMP_0032_S 1 100 0 8191.875 ECU_ADDRESS 0xFFFF3B8C READ_WRITE /end MEASUREMENT
/begin MEASUREMENT vSLRDUP "RAM value vSLRDUP" UWORD COMP_0238_S 1 100 0 655.35 ECU_ADDRESS 0xFFFF2BAA READ_WRITE /end MEASUREMENT
/begin MEASUREMENT vSLRICHf "RAM value vSLRICHf" UBYTE COMP_0004 1 100 0 255 ECU_ADDRESS 0xFFFF2BAC READ_WRITE /end MEASUREMENT
/begin MEASUREMENT vSLRNOKf "RAM value vSLRNOKf" UBYTE COMP_0004 1 100 0 255 ECU_ADDRESS 0xFFFF0EB4 READ_WRITE /end MEASUREMENT
/begin MEASUREMENT vSLSLVEL "RAM value vSLSLVEL" UWORD COMP_0602_S 1 100 -1.0000007168 0.9999701992 ECU_ADDRESS 0xFFFF0EB6 READ_WRITE /end MEASUREMENT
/begin MEASUREMENT vSLTAP1 "RAM value vSLTAP1" UWORD COMP_0238_S 1 100 0 655.35 ECU_ADDRESS 0xFFFF2BAE READ_WRITE /end MEASUREMENT
/begin MEASUREMENT vSLTAP2 "RAM value vSLTAP2" UWORD COMP_0238_S 1 100 0 655.35 ECU_ADDRESS 0xFFFF2BB0 READ_WRITE /end MEASUREMENT
/begin MEASUREMENT vSLTAPTM2 "RAM value vSLTAPTM2" UBYTE COMP_0014 1 100 0 2550 ECU_ADDRESS 0xFFFF2BB2 READ_WRITE /end MEASUREMENT
/begin MEASUREMENT vSLTGTVSP "RAM value vSLTGTVSP" UWORD COMP_0238_S 1 100 0 655.35 ECU_ADDRESS 0xFFFF2BB4 READ_WRITE /end MEASUREMENT
/begin MEASUREMENT vSLTMP "RAM value vSLTMP" UWORD COMP_0238_S 1 100 0 655.35 ECU_ADDRESS 0xFFFF2BB6 READ_WRITE /end MEASUREMENT
/begin MEASUREMENT vSLVAPGAI "RAM value vSLVAPGAI" UWORD COMP_0032_S 1 100 0 8191.875 ECU_ADDRESS 0xFFFF2BB8 READ_WRITE /end MEASUREMENT
/begin MEASUREMENT vSLVAPGUP "RAM value vSLVAPGUP" UWORD COMP_0328 1 100 0 399.99392106 ECU_ADDRESS 0xFFFF2BBA READ_WRITE /end MEASUREMENT
/begin MEASUREMENT vSLVAPLM0 "RAM value vSLVAPLM0" UWORD COMP_0032_S 1 100 0 8191.875 ECU_ADDRESS 0xFFFF2BBC READ_WRITE /end MEASUREMENT
/begin MEASUREMENT vSLVAPLM1 "RAM value vSLVAPLM1" UWORD COMP_0032_S 1 100 0 8191.875 ECU_ADDRESS 0xFFFF2BBE READ_WRITE /end MEASUREMENT
/begin MEASUREMENT vSLVAPLM2 "RAM value vSLVAPLM2" UWORD COMP_0032_S 1 100 0 8191.875 ECU_ADDRESS 0xFFFF2BC0 READ_WRITE /end MEASUREMENT
/begin MEASUREMENT vSLVAPO "RAM value vSLVAPO" UWORD COMP_0032_S 1 100 0 8191.875 ECU_ADDRESS 0xFFFF2BC2 READ_WRITE /end MEASUREMENT
/begin MEASUREMENT vSLVAPO00 "RAM value vSLVAPO00" UWORD COMP_0032_S 1 100 0 8191.875 ECU_ADDRESS 0xFFFF2BC4 READ_WRITE /end MEASUREMENT
/begin MEASUREMENT vSLVAPTLM "RAM value vSLVAPTLM" SWORD COMP_0228 1 100 -3276.8 3276.7 ECU_ADDRESS 0xFFFF2BC6 READ_WRITE /end MEASUREMENT
/begin MEASUREMENT vSLVPLMUP "RAM value vSLVPLMUP" UWORD COMP_0032_S 1 100 0 8191.875 ECU_ADDRESS 0xFFFF2BC8 READ_WRITE /end MEASUREMENT
/begin MEASUREMENT vSLVPSATU "RAM value vSLVPSATU" UBYTE COMP_0014 1 100 0 2550 ECU_ADDRESS 0xFFFF2BCA READ_WRITE /end MEASUREMENT
/begin MEASUREMENT vSLVSP "RAM value vSLVSP" UWORD COMP_0238_S 1 100 0 655.35 ECU_ADDRESS 0xFFFF2BCC READ_WRITE /end MEASUREMENT
/begin MEASUREMENT vSLVSP00 "RAM value vSLVSP00" UWORD COMP_0238_S 1 100 0 655.35 ECU_ADDRESS 0xFFFF2BCE READ_WRITE /end MEASUREMENT
/begin MEASUREMENT vSLVSPCN "RAM value vSLVSPCN" UWORD COMP_0238_S 1 100 0 655.35 ECU_ADDRESS 0xFFFF2BD0 READ_WRITE /end MEASUREMENT
/begin MEASUREMENT vSLVSPDLT "RAM value vSLVSPDLT" SWORD COMP_0239_S 1 100 -327.68 327.67 ECU_ADDRESS 0xFFFF2BD2 READ_WRITE /end MEASUREMENT
/begin MEASUREMENT vSLVSPH "RAM value vSLVSPH" UWORD COMP_0238_S 1 100 0 655.35 ECU_ADDRESS 0xFFFF2BD4 READ_WRITE /end MEASUREMENT
/begin MEASUREMENT vSLVSPHOG "RAM value vSLVSPHOG" UWORD COMP_0238_S 1 100 0 655.35 ECU_ADDRESS 0xFFFF2BD6 READ_WRITE /end MEASUREMENT
/begin MEASUREMENT vSLVSPL "RAM value vSLVSPL" UWORD COMP_0238_S 1 100 0 655.35 ECU_ADDRESS 0xFFFF2BD8 READ_WRITE /end MEASUREMENT
/begin MEASUREMENT vSLVSPOLD "RAM value vSLVSPOLD" UWORD COMP_0238_S 1 100 0 655.35 ECU_ADDRESS 0xFFFF2BDA READ_WRITE /end MEASUREMENT
/begin MEASUREMENT vSLVSPRM "RAM value vSLVSPRM" UWORD COMP_0238_S 1 100 0 655.35 ECU_ADDRESS 0xFFFF2BDC READ_WRITE /end MEASUREMENT
/begin MEASUREMENT vSLVSPRMZ "RAM value vSLVSPRMZ" UWORD COMP_0238_S 1 100 0 655.35 ECU_ADDRESS 0xFFFF2BDE READ_WRITE /end MEASUREMENT
/begin MEASUREMENT vSMATH1 "RAM value vSMATH1" UBYTE COMP_0580_S 1 100 -128 127 ECU_ADDRESS 0xFFFF2BE0 READ_WRITE /end MEASUREMENT
/begin MEASUREMENT vSMDLTPI2 "RAM value vSMDLTPI2" ULONG COMP_0050 1 100 0 335544319.921875 ECU_ADDRESS 0xFFFF2BE4 READ_WRITE /end MEASUREMENT
/begin MEASUREMENT vSMDLY "RAM value vSMDLY" UBYTE COMP_0008 1 100 0 25500 ECU_ADDRESS 0xFFFF0EB8 READ_WRITE /end MEASUREMENT
/begin MEASUREMENT vSMILI2 "RAM value vSMILI2" ULONG COMP_0050 1 100 0 335544319.921875 ECU_ADDRESS 0xFFFF4D64 READ_WRITE /end MEASUREMENT
/begin MEASUREMENT vSMISA "RAM value vSMISA" UBYTE COMP_0580_S 1 100 -128 127 ECU_ADDRESS 0xFFFF323C READ_WRITE /end MEASUREMENT
/begin MEASUREMENT vSNRPM "RAM value vSNRPM" UBYTE COMP_0480 1 100 0 1593.75 ECU_ADDRESS 0xFFFF19C6 READ_WRITE /end MEASUREMENT
/begin MEASUREMENT vSOLDGNf "RAM value vSOLDGNf" UBYTE COMP_0004 1 100 0 255 ECU_ADDRESS 0xFFFF2BE8 READ_WRITE /end MEASUREMENT
/begin MEASUREMENT vSONITC "RAM value vSONITC" UBYTE COMP_0009 1 100 0 199.21875 ECU_ADDRESS 0xFFFF0EB9 READ_WRITE /end MEASUREMENT
/begin MEASUREMENT vSPCEND "RAM value vSPCEND" UWORD COMP_0312 1 100 0 127.998046875 ECU_ADDRESS 0xFFFF4414 READ_WRITE /end MEASUREMENT
/begin MEASUREMENT vSPCENDB "RAM value vSPCENDB" UWORD COMP_0078_S 1 100 0 255.99609375 ECU_ADDRESS 0xFFFF4416 READ_WRITE /end MEASUREMENT
/begin MEASUREMENT vSPCINT "RAM value vSPCINT" UWORD COMP_0312 1 100 0 127.998046875 ECU_ADDRESS 0xFFFF208A READ_WRITE /end MEASUREMENT
/begin MEASUREMENT vSPCINTB "RAM value vSPCINTB" UWORD COMP_0078_S 1 100 0 255.99609375 ECU_ADDRESS 0xFFFF208C READ_WRITE /end MEASUREMENT
/begin MEASUREMENT vSPCV "RAM value vSPCV" UWORD COMP_0312 1 100 0 127.998046875 ECU_ADDRESS 0xFFFF208E READ_WRITE /end MEASUREMENT
/begin MEASUREMENT vSPCVB "RAM value vSPCVB" UWORD COMP_0078_S 1 100 0 255.99609375 ECU_ADDRESS 0xFFFF2090 READ_WRITE /end MEASUREMENT
/begin MEASUREMENT vSPCVNG "RAM value vSPCVNG" UBYTE COMP_0156 1 100 0 255 ECU_ADDRESS 0xFFFF4D68 READ_WRITE /end MEASUREMENT
/begin MEASUREMENT vSPDBATQF "RAM value vSPDBATQF" SWORD COMP_0228 1 100 -3276.8 3276.7 ECU_ADDRESS 0xFFFF2BEA READ_WRITE /end MEASUREMENT
/begin MEASUREMENT vSPDBATQS "RAM value vSPDBATQS" SWORD COMP_0228 1 100 -3276.8 3276.7 ECU_ADDRESS 0xFFFF2BEC READ_WRITE /end MEASUREMENT
/begin MEASUREMENT vSPDGCNT "RAM value vSPDGCNT" UWORD COMP_0016 1 100 0 65535 ECU_ADDRESS 0xFFFF4D6A READ_WRITE /end MEASUREMENT
/begin MEASUREMENT vSPDIDLTM "RAM value vSPDIDLTM" UBYTE COMP_0014 1 100 0 2550 ECU_ADDRESS 0xFFFF2BEE READ_WRITE /end MEASUREMENT
/begin MEASUREMENT vSPDNEDIF "RAM value vSPDNEDIF" SWORD COMP_0603_S 1 100 -25600 25599.21875 ECU_ADDRESS 0xFFFF2BF0 READ_WRITE /end MEASUREMENT
/begin MEASUREMENT vSPDNEFLT "RAM value vSPDNEFLT" UWORD COMP_0162_S 1 100 0 51199.21875 ECU_ADDRESS 0xFFFF2120 READ_WRITE /end MEASUREMENT
/begin MEASUREMENT vSPDPGAIN "RAM value vSPDPGAIN" UWORD COMP_0231_S 1 100 0 65.535 ECU_ADDRESS 0xFFFF2BF2 READ_WRITE /end MEASUREMENT
/begin MEASUREMENT vSPDTGREV "RAM value vSPDTGREV" UWORD COMP_0162_S 1 100 0 51199.21875 ECU_ADDRESS 0xFFFF2BF4 READ_WRITE /end MEASUREMENT
/begin MEASUREMENT vSPINGCT "RAM value vSPINGCT" UBYTE COMP_0030 1 100 0 255 ECU_ADDRESS 0xFFFF2092 READ_WRITE /end MEASUREMENT
/begin MEASUREMENT vSPINGCTP "RAM value vSPINGCTP" UBYTE COMP_0030 1 100 0 255 ECU_ADDRESS 0xFFFF388C READ_WRITE /end MEASUREMENT
/begin MEASUREMENT vSPINGP "RAM value vSPINGP" UBYTE COMP_0068 1 100 0 255 ECU_ADDRESS 0xFFFF2093 READ_WRITE /end MEASUREMENT
/begin MEASUREMENT vSQASL "RAM value vSQASL" UWORD COMP_0497 1 100 0 2621.4 ECU_ADDRESS 0xFFFF2BF6 READ_WRITE /end MEASUREMENT
/begin MEASUREMENT vSQKVC "RAM value vSQKVC" UBYTE COMP_0341 1 100 0 0.99705 ECU_ADDRESS 0xFFFF0EBA READ_WRITE /end MEASUREMENT
/begin MEASUREMENT vSRFCCLY "RAM value vSRFCCLY" UBYTE COMP_0030 1 100 0 255 ECU_ADDRESS 0xFFFF0EBB READ_WRITE /end MEASUREMENT
/begin MEASUREMENT vSRTEND "RAM value vSRTEND" UBYTE COMP_0004 1 100 0 255 ECU_ADDRESS 0xFFFF3B8E READ_WRITE /end MEASUREMENT
/begin MEASUREMENT vSRTEND2 "RAM value vSRTEND2" UBYTE COMP_0068 1 100 0 255 ECU_ADDRESS 0xFFFF388D READ_WRITE /end MEASUREMENT
/begin MEASUREMENT vSRTM "RAM value vSRTM" UWORD COMP_0040_S 1 100 0 655.35 ECU_ADDRESS 0xFFFF2122 READ_WRITE /end MEASUREMENT
/begin MEASUREMENT vSRTOPT2 "RAM value vSRTOPT2" UBYTE COMP_0004 1 100 0 255 ECU_ADDRESS 0xFFFF388E READ_WRITE /end MEASUREMENT
/begin MEASUREMENT vSRTOPT3 "RAM value vSRTOPT3" UBYTE COMP_0004 1 100 0 255 ECU_ADDRESS 0xFFFF388F READ_WRITE /end MEASUREMENT
/begin MEASUREMENT vSRTRSL "RAM value vSRTRSL" UBYTE COMP_0004 1 100 0 255 ECU_ADDRESS 0xFFFF3B94 READ_WRITE /end MEASUREMENT
/begin MEASUREMENT vSRTRSL2 "RAM value vSRTRSL2" UBYTE COMP_0068 1 100 0 255 ECU_ADDRESS 0xFFFF3890 READ_WRITE /end MEASUREMENT
/begin MEASUREMENT vSRTTST "RAM value vSRTTST" UBYTE COMP_0004 1 100 0 255 ECU_ADDRESS 0xFFFF3B9A READ_WRITE /end MEASUREMENT
/begin MEASUREMENT vSRTTST2 "RAM value vSRTTST2" UBYTE COMP_0068 1 100 0 255 ECU_ADDRESS 0xFFFF3891 READ_WRITE /end MEASUREMENT
/begin MEASUREMENT vSSFCNT "RAM value vSSFCNT" UBYTE COMP_0016 1 100 0 255 ECU_ADDRESS 0xFFFF4D6C READ_WRITE /end MEASUREMENT
/begin MEASUREMENT vSSFMAX "RAM value vSSFMAX" UBYTE COMP_0016 1 100 0 255 ECU_ADDRESS 0xFFFF4D6D READ_WRITE /end MEASUREMENT
/begin MEASUREMENT vSSGCRLMT "RAM value vSSGCRLMT" UBYTE COMP_0249_S 1 100 0 25.5 ECU_ADDRESS 0xFFFF3892 READ_WRITE /end MEASUREMENT
/begin MEASUREMENT vSSGEXCA "RAM value vSSGEXCA" UBYTE COMP_0604_S 1 100 0 25.5 ECU_ADDRESS 0xFFFF3893 READ_WRITE /end MEASUREMENT
/begin MEASUREMENT vSSGEXCDT "RAM value vSSGEXCDT" UBYTE COMP_0605_S 1 100 0 823.65 ECU_ADDRESS 0xFFFF3894 READ_WRITE /end MEASUREMENT
/begin MEASUREMENT vSSGEXCMX "RAM value vSSGEXCMX" UBYTE COMP_0249_S 1 100 0 25.5 ECU_ADDRESS 0xFFFF3895 READ_WRITE /end MEASUREMENT
/begin MEASUREMENT vSSGLRCOF "RAM value vSSGLRCOF" UBYTE COMP_0606_S 1 100 0 89250 ECU_ADDRESS 0xFFFF3896 READ_WRITE /end MEASUREMENT
/begin MEASUREMENT vSSGMDREQ "RAM value vSSGMDREQ" UBYTE COMP_0068 1 100 0 255 ECU_ADDRESS 0xFFFF1E66 READ_WRITE /end MEASUREMENT
/begin MEASUREMENT vSSGMODE "RAM value vSSGMODE" UBYTE COMP_0068 1 100 0 255 ECU_ADDRESS 0xFFFF3897 READ_WRITE /end MEASUREMENT
/begin MEASUREMENT vSSGRAMPT "RAM value vSSGRAMPT" UBYTE COMP_0013 1 100 0 255 ECU_ADDRESS 0xFFFF3898 READ_WRITE /end MEASUREMENT
/begin MEASUREMENT vSSGRPM "RAM value vSSGRPM" UBYTE COMP_0607_S 1 100 0 19125 ECU_ADDRESS 0xFFFF2094 READ_WRITE /end MEASUREMENT
/begin MEASUREMENT vSSGTMPIC "RAM value vSSGTMPIC" UBYTE COMP_0608_S 1 100 -42 978 ECU_ADDRESS 0xFFFF3899 READ_WRITE /end MEASUREMENT
/begin MEASUREMENT vSSGVACT "RAM value vSSGVACT" UBYTE COMP_0609_S 1 100 10.6 16.975 ECU_ADDRESS 0xFFFF389A READ_WRITE /end MEASUREMENT
/begin MEASUREMENT vSSOFFTIM "RAM value vSSOFFTIM" ULONG COMP_0521_S 1 100 0 429496729.5 ECU_ADDRESS 0xFFFF30CC READ_WRITE /end MEASUREMENT
/begin MEASUREMENT vSSOFT1 "RAM value vSSOFT1" UBYTE COMP_0250 1 100 0 1020 ECU_ADDRESS 0xFFFF3322 READ_WRITE /end MEASUREMENT
/begin MEASUREMENT vSSOFT1B "RAM value vSSOFT1B" UBYTE COMP_0250 1 100 0 1020 ECU_ADDRESS 0xFFFF3323 READ_WRITE /end MEASUREMENT
/begin MEASUREMENT vSSOFTM "RAM value vSSOFTM" UWORD COMP_0176 1 100 0 1023.984375 ECU_ADDRESS 0xFFFF3324 READ_WRITE /end MEASUREMENT
/begin MEASUREMENT vSSTM "RAM value vSSTM" UWORD COMP_0040_S 1 100 0 655.35 ECU_ADDRESS 0xFFFF2124 READ_WRITE /end MEASUREMENT
/begin MEASUREMENT vSSTMD "RAM value vSSTMD" UBYTE COMP_0068 1 100 0 255 ECU_ADDRESS 0xFFFF1A74 READ_WRITE /end MEASUREMENT
/begin MEASUREMENT vST1VAP "RAM value vST1VAP" SWORD COMP_0002_S 1 100 -32768 32767 ECU_ADDRESS 0xFFFF389C READ_WRITE /end MEASUREMENT
/begin MEASUREMENT vST2ARAVf "RAM value vST2ARAVf" UBYTE COMP_0004 1 100 0 255 ECU_ADDRESS 0xFFFF2BF9 READ_WRITE /end MEASUREMENT
/begin MEASUREMENT vST2ARAf "RAM value vST2ARAf" UBYTE COMP_0004 1 100 0 255 ECU_ADDRESS 0xFFFF2BF8 READ_WRITE /end MEASUREMENT
/begin MEASUREMENT vST2GOVf "RAM value vST2GOVf" UBYTE COMP_0004 1 100 0 255 ECU_ADDRESS 0xFFFF2BFB READ_WRITE /end MEASUREMENT
/begin MEASUREMENT vST2GOWf "RAM value vST2GOWf" UBYTE COMP_0004 1 100 0 255 ECU_ADDRESS 0xFFFF2BFC READ_WRITE /end MEASUREMENT
/begin MEASUREMENT vST2GOf "RAM value vST2GOf" UBYTE COMP_0004 1 100 0 255 ECU_ADDRESS 0xFFFF2BFA READ_WRITE /end MEASUREMENT
/begin MEASUREMENT vST2JDGOKf "RAM value vST2JDGOKf" UBYTE COMP_0004 1 100 0 255 ECU_ADDRESS 0xFFFF2BFE READ_WRITE /end MEASUREMENT
/begin MEASUREMENT vST2JDGf "RAM value vST2JDGf" UBYTE COMP_0004 1 100 0 255 ECU_ADDRESS 0xFFFF2BFD READ_WRITE /end MEASUREMENT
/begin MEASUREMENT vSTACKMON "RAM value vSTACKMON" ULONG COMP_0068 1 100 0 4294967295 ECU_ADDRESS 0xFFFF2C00 READ_WRITE /end MEASUREMENT
/begin MEASUREMENT vSTAEGR "RAM value vSTAEGR" UWORD COMP_0385 1 100 0 105380.28 ECU_ADDRESS 0xFFFF4D6E READ_WRITE /end MEASUREMENT
/begin MEASUREMENT vSTAERCNT "RAM value vSTAERCNT" UBYTE COMP_0068 1 100 0 255 ECU_ADDRESS 0xFFFF4D70 READ_WRITE /end MEASUREMENT
/begin MEASUREMENT vSTAETIM "RAM value vSTAETIM" UWORD COMP_0494 1 100 0 6553500 ECU_ADDRESS 0xFFFF2C04 READ_WRITE /end MEASUREMENT
/begin MEASUREMENT vSTAGCT "RAM value vSTAGCT" UBYTE COMP_0390 1 100 0 2550 ECU_ADDRESS 0xFFFF19C7 READ_WRITE /end MEASUREMENT
/begin MEASUREMENT vSTAGE "RAM value vSTAGE" UBYTE COMP_0004 1 100 0 255 ECU_ADDRESS 0xFFFF2C06 READ_WRITE /end MEASUREMENT
/begin MEASUREMENT vSTAGOFS "RAM value vSTAGOFS" UBYTE COMP_0068 1 100 0 255 ECU_ADDRESS 0xFFFF0EBC READ_WRITE /end MEASUREMENT
/begin MEASUREMENT vSTAGOFSB "RAM value vSTAGOFSB" UBYTE COMP_0068 1 100 0 255 ECU_ADDRESS 0xFFFF0EBD READ_WRITE /end MEASUREMENT
/begin MEASUREMENT vSTAGOFSZ "RAM value vSTAGOFSZ" UBYTE COMP_0068 1 100 0 255 ECU_ADDRESS 0xFFFF19C8 READ_WRITE /end MEASUREMENT
/begin MEASUREMENT vSTAGRST "RAM value vSTAGRST" UWORD COMP_0057_S 1 100 0 6553.5 ECU_ADDRESS 0xFFFF0EBE READ_WRITE /end MEASUREMENT
/begin MEASUREMENT vSTAGRSTB "RAM value vSTAGRSTB" UWORD COMP_0057_S 1 100 0 6553.5 ECU_ADDRESS 0xFFFF0EC0 READ_WRITE /end MEASUREMENT
/begin MEASUREMENT vSTAGTM "RAM value vSTAGTM" UWORD COMP_0057_S 1 100 0 6553.5 ECU_ADDRESS 0xFFFF19CA READ_WRITE /end MEASUREMENT
/begin MEASUREMENT vSTANG "RAM value vSTANG" UWORD COMP_0057_S 1 100 0 6553.5 ECU_ADDRESS 0xFFFF0EC2 READ_WRITE /end MEASUREMENT
/begin MEASUREMENT vSTANHOS "RAM value vSTANHOS" UBYTE COMP_0337_S 1 100 0 0.99609375 ECU_ADDRESS 0xFFFF2C07 READ_WRITE /end MEASUREMENT
/begin MEASUREMENT vSTAO2S "RAM value vSTAO2S" UWORD COMP_0385 1 100 0 105380.28 ECU_ADDRESS 0xFFFF4D72 READ_WRITE /end MEASUREMENT
/begin MEASUREMENT vSTAPHCT "RAM value vSTAPHCT" UBYTE COMP_0068 1 100 0 255 ECU_ADDRESS 0xFFFF19CC READ_WRITE /end MEASUREMENT
/begin MEASUREMENT vSTAPHTM "RAM value vSTAPHTM" UWORD COMP_0057_S 1 100 0 6553.5 ECU_ADDRESS 0xFFFF19CE READ_WRITE /end MEASUREMENT
/begin MEASUREMENT vSTARTSID "RAM value vSTARTSID" UBYTE COMP_0004 1 100 0 255 ECU_ADDRESS 0xFFFF389E READ_WRITE /end MEASUREMENT
/begin MEASUREMENT vSTARTSTS "RAM value vSTARTSTS" UBYTE COMP_0004 1 100 0 255 ECU_ADDRESS 0xFFFF389F READ_WRITE /end MEASUREMENT
/begin MEASUREMENT vSTATE "RAM value vSTATE" UBYTE COMP_0068 1 100 0 255 ECU_ADDRESS 0xFFFF38A0 READ_WRITE /end MEASUREMENT
/begin MEASUREMENT vSTATUDEM "RAM value vSTATUDEM" UBYTE COMP_0068 1 100 0 255 ECU_ADDRESS 0xFFFF38A1 READ_WRITE /end MEASUREMENT
/begin MEASUREMENT vSTBICN "RAM value vSTBICN" UBYTE COMP_0181 1 100 0 7.96875 ECU_ADDRESS 0xFFFF0EC4 READ_WRITE /end MEASUREMENT
/begin MEASUREMENT vSTDVTC "RAM value vSTDVTC" UBYTE COMP_0008 1 100 0 25500 ECU_ADDRESS 0xFFFF0EC5 READ_WRITE /end MEASUREMENT
/begin MEASUREMENT vSTGPDTC "RAM value vSTGPDTC" UBYTE COMP_0068 1 100 0 255 ECU_ADDRESS 0xFFFF38A2 READ_WRITE /end MEASUREMENT
/begin MEASUREMENT vSTHOS "RAM value vSTHOS" UWORD COMP_0217 1 100 0 3.999941832 ECU_ADDRESS 0xFFFF0EC6 READ_WRITE /end MEASUREMENT
/begin MEASUREMENT vSTHOSTW "RAM value vSTHOSTW" UBYTE COMP_0045 1 100 0 1.9921875 ECU_ADDRESS 0xFFFF2C08 READ_WRITE /end MEASUREMENT
/begin MEASUREMENT vSTICMX "RAM value vSTICMX" UWORD COMP_0394 1 100 0 838848 ECU_ADDRESS 0xFFFF2C0A READ_WRITE /end MEASUREMENT
/begin MEASUREMENT vSTIMAX "RAM value vSTIMAX" UWORD COMP_0394 1 100 0 838848 ECU_ADDRESS 0xFFFF2C0C READ_WRITE /end MEASUREMENT
/begin MEASUREMENT vSTLRPMz1 "RAM value vSTLRPMz1" UBYTE COMP_0006 1 100 0 3187.5 ECU_ADDRESS 0xFFFF19D0 READ_WRITE /end MEASUREMENT
/begin MEASUREMENT vSTLRPMz2 "RAM value vSTLRPMz2" UBYTE COMP_0006 1 100 0 3187.5 ECU_ADDRESS 0xFFFF19D1 READ_WRITE /end MEASUREMENT
/begin MEASUREMENT vSTNGTIM "RAM value vSTNGTIM" UBYTE COMP_0008 1 100 0 25500 ECU_ADDRESS 0xFFFF2C0E READ_WRITE /end MEASUREMENT
/begin MEASUREMENT vSTONVB "RAM value vSTONVB" UBYTE COMP_0033 1 100 0 20400 ECU_ADDRESS 0xFFFF0EC8 READ_WRITE /end MEASUREMENT
/begin MEASUREMENT vSTONVBKC "RAM value vSTONVBKC" UBYTE COMP_0033 1 100 0 20400 ECU_ADDRESS 0xFFFF38A3 READ_WRITE /end MEASUREMENT
/begin MEASUREMENT vSTOPUCHX "RAM value vSTOPUCHX" UBYTE COMP_0068 1 100 0 255 ECU_ADDRESS 0xFFFF38A4 READ_WRITE /end MEASUREMENT
/begin MEASUREMENT vSTPCYL "RAM value vSTPCYL" UBYTE COMP_0004 1 100 0 255 ECU_ADDRESS 0xFFFF19D2 READ_WRITE /end MEASUREMENT
/begin MEASUREMENT vSTPFLG2f "RAM value vSTPFLG2f" UBYTE COMP_0004 1 100 0 255 ECU_ADDRESS 0xFFFF2C0F READ_WRITE /end MEASUREMENT
/begin MEASUREMENT vSTPOINT "RAM value vSTPOINT" ULONG COMP_0068 1 100 0 4294967295 ECU_ADDRESS 0xFFFF0ECC READ_WRITE /end MEASUREMENT
/begin MEASUREMENT vSTRAG "RAM value vSTRAG" UBYTE COMP_0062_S 1 100 0 255 ECU_ADDRESS 0xFFFF2C10 READ_WRITE /end MEASUREMENT
/begin MEASUREMENT vSTRKIVC "RAM value vSTRKIVC" UWORD COMP_0374_S 1 100 0 655.35 ECU_ADDRESS 0xFFFF2C12 READ_WRITE /end MEASUREMENT
/begin MEASUREMENT vSTRKJUDG "RAM value vSTRKJUDG" UWORD COMP_0552_S 1 100 0 1310.7 ECU_ADDRESS 0xFFFF2C14 READ_WRITE /end MEASUREMENT
/begin MEASUREMENT vSTRTTIME "RAM value vSTRTTIME" ULONG COMP_0053 1 100 0 4294967295 ECU_ADDRESS 0xFFFF1680 READ_WRITE /end MEASUREMENT
/begin MEASUREMENT vSTSTATE "RAM value vSTSTATE" UBYTE COMP_0068 1 100 0 255 ECU_ADDRESS 0xFFFF0997 READ_WRITE /end MEASUREMENT
/begin MEASUREMENT vSTSWTR2 "RAM value vSTSWTR2" UWORD COMP_0049 1 100 0 65535 ECU_ADDRESS 0xFFFF2C16 READ_WRITE /end MEASUREMENT
/begin MEASUREMENT vSTSWTRP "RAM value vSTSWTRP" UWORD COMP_0049 1 100 0 65535 ECU_ADDRESS 0xFFFF2C18 READ_WRITE /end MEASUREMENT
/begin MEASUREMENT vSTSYSCNT "RAM value vSTSYSCNT" UBYTE COMP_0016 1 100 0 255 ECU_ADDRESS 0xFFFF38A5 READ_WRITE /end MEASUREMENT
/begin MEASUREMENT vSTSYSOK "RAM value vSTSYSOK" UBYTE COMP_0068 1 100 0 255 ECU_ADDRESS 0xFFFF38A6 READ_WRITE /end MEASUREMENT
/begin MEASUREMENT vSTTCNT "RAM value vSTTCNT" UWORD COMP_0016 1 100 0 65535 ECU_ADDRESS 0xFFFF524A READ_WRITE /end MEASUREMENT
/begin MEASUREMENT vSTTMINSG "RAM value vSTTMINSG" UBYTE COMP_0008 1 100 0 25500 ECU_ADDRESS 0xFFFF1684 READ_WRITE /end MEASUREMENT
/begin MEASUREMENT vSTVOOV "RAM value vSTVOOV" UWORD COMP_0296 1 100 0 72.0885 ECU_ADDRESS 0xFFFF2C1A READ_WRITE /end MEASUREMENT
/begin MEASUREMENT vSTVOOV2 "RAM value vSTVOOV2" UWORD COMP_0296 1 100 0 72.0885 ECU_ADDRESS 0xFFFF2C1C READ_WRITE /end MEASUREMENT
/begin MEASUREMENT vSTWGLOD "RAM value vSTWGLOD" UWORD COMP_0071_S 1 100 0 0.040959375 ECU_ADDRESS 0xFFFF2C1E READ_WRITE /end MEASUREMENT
/begin MEASUREMENT vSTWGVL "RAM value vSTWGVL" UWORD COMP_0377_S 1 100 0 0.0204796875 ECU_ADDRESS 0xFFFF2C20 READ_WRITE /end MEASUREMENT
/begin MEASUREMENT vSTWNHOS "RAM value vSTWNHOS" UBYTE COMP_0337_S 1 100 0 0.99609375 ECU_ADDRESS 0xFFFF2C22 READ_WRITE /end MEASUREMENT
/begin MEASUREMENT vSUMALP "RAM value vSUMALP" SLONG COMP_0438 1 100 -8388608 8388607.99609375 ECU_ADDRESS 0xFFFF2C24 READ_WRITE /end MEASUREMENT
/begin MEASUREMENT vSUMALPA "RAM value vSUMALPA" ULONG COMP_0031 1 100 0 16777215.9960938 ECU_ADDRESS 0xFFFF2C2C READ_WRITE /end MEASUREMENT
/begin MEASUREMENT vSUMCNT "RAM value vSUMCNT" UWORD COMP_0030 1 100 0 65535 ECU_ADDRESS 0xFFFF2C34 READ_WRITE /end MEASUREMENT
/begin MEASUREMENT vSUMHDTMP "RAM value vSUMHDTMP" ULONG COMP_0068 1 100 0 4294967295 ECU_ADDRESS 0xFFFF2C38 READ_WRITE /end MEASUREMENT
/begin MEASUREMENT vSUMOSC "RAM value vSUMOSC" ULONG COMP_0498_S 1 100 0 42949672.95 ECU_ADDRESS 0xFFFF2C3C READ_WRITE /end MEASUREMENT
/begin MEASUREMENT vSUMOSLf "RAM value vSUMOSLf" UBYTE COMP_0004 1 100 0 255 ECU_ADDRESS 0xFFFF2C44 READ_WRITE /end MEASUREMENT
/begin MEASUREMENT vSUMOSRf "RAM value vSUMOSRf" UBYTE COMP_0004 1 100 0 255 ECU_ADDRESS 0xFFFF2C45 READ_WRITE /end MEASUREMENT
/begin MEASUREMENT vSUMOXY "RAM value vSUMOXY" ULONG COMP_0068 1 100 0 4294967295 ECU_ADDRESS 0xFFFF2C48 READ_WRITE /end MEASUREMENT
/begin MEASUREMENT vSUMQI "RAM value vSUMQI" UWORD COMP_0497 1 100 0 2621.4 ECU_ADDRESS 0xFFFF2C50 READ_WRITE /end MEASUREMENT
/begin MEASUREMENT vSUMQM20 "RAM value vSUMQM20" ULONG COMP_0068 1 100 0 4294967295 ECU_ADDRESS 0xFFFF0ED0 READ_WRITE /end MEASUREMENT
/begin MEASUREMENT vSUMQM20Z "RAM value vSUMQM20Z" ULONG COMP_0068 1 100 0 4294967295 ECU_ADDRESS 0xFFFF0ED4 READ_WRITE /end MEASUREMENT
/begin MEASUREMENT vSUMQM40 "RAM value vSUMQM40" ULONG COMP_0068 1 100 0 4294967295 ECU_ADDRESS 0xFFFF0ED8 READ_WRITE /end MEASUREMENT
/begin MEASUREMENT vSUMSTG "RAM value vSUMSTG" UWORD COMP_0062_S 1 100 0 65535 ECU_ADDRESS 0xFFFF2C52 READ_WRITE /end MEASUREMENT
/begin MEASUREMENT vSUMTMP "RAM value vSUMTMP" ULONG COMP_0068 1 100 0 4294967295 ECU_ADDRESS 0xFFFF2C58 READ_WRITE /end MEASUREMENT
/begin MEASUREMENT vSUMVSP "RAM value vSUMVSP" ULONG COMP_0389 1 100 0 1685624.33943218 ECU_ADDRESS 0xFFFF4418 READ_WRITE /end MEASUREMENT
/begin MEASUREMENT vSWINF "RAM value vSWINF" UBYTE COMP_0068 1 100 0 255 ECU_ADDRESS 0xFFFF4D74 READ_WRITE /end MEASUREMENT
/begin MEASUREMENT vSWMNTEND "RAM value vSWMNTEND" UBYTE COMP_0068 1 100 0 255 ECU_ADDRESS 0xFFFF4D75 READ_WRITE /end MEASUREMENT
/begin MEASUREMENT vSWMNTMAX "RAM value vSWMNTMAX" UBYTE COMP_0068 1 100 0 255 ECU_ADDRESS 0xFFFF4D7A READ_WRITE /end MEASUREMENT
/begin MEASUREMENT vSWMNTMIN "RAM value vSWMNTMIN" UBYTE COMP_0068 1 100 0 255 ECU_ADDRESS 0xFFFF4D7F READ_WRITE /end MEASUREMENT
/begin MEASUREMENT vSWMONT "RAM value vSWMONT" UBYTE COMP_0004 1 100 0 255 ECU_ADDRESS 0xFFFF2C5C READ_WRITE /end MEASUREMENT
/begin MEASUREMENT vSWSTADV "RAM value vSWSTADV" UWORD COMP_0375_S 1 100 -30 33.99899067 ECU_ADDRESS 0xFFFF2C62 READ_WRITE /end MEASUREMENT
/begin MEASUREMENT vSWSTRET "RAM value vSWSTRET" UWORD COMP_0375_S 1 100 -30 33.99899067 ECU_ADDRESS 0xFFFF2C64 READ_WRITE /end MEASUREMENT
/begin MEASUREMENT vT12M "RAM value vT12M" UBYTE COMP_0014 1 100 0 2550 ECU_ADDRESS 0xFFFF1685 READ_WRITE /end MEASUREMENT
/begin MEASUREMENT vT14M "RAM value vT14M" UBYTE COMP_0014 1 100 0 2550 ECU_ADDRESS 0xFFFF1686 READ_WRITE /end MEASUREMENT
/begin MEASUREMENT vT1DLYT "RAM value vT1DLYT" UBYTE COMP_0068 1 100 0 255 ECU_ADDRESS 0xFFFF323D READ_WRITE /end MEASUREMENT
/begin MEASUREMENT vT1STPDTC "RAM value vT1STPDTC" UWORD COMP_0068 1 100 0 65535 ECU_ADDRESS 0xFFFF524C READ_WRITE /end MEASUREMENT
/begin MEASUREMENT vT210MB "RAM value vT210MB" UBYTE COMP_0030 1 100 0 255 ECU_ADDRESS 0xFFFF0EDC READ_WRITE /end MEASUREMENT
/begin MEASUREMENT vT210MJ "RAM value vT210MJ" UBYTE COMP_0030 1 100 0 255 ECU_ADDRESS 0xFFFF1687 READ_WRITE /end MEASUREMENT
/begin MEASUREMENT vT22M "RAM value vT22M" UBYTE COMP_0030 1 100 0 255 ECU_ADDRESS 0xFFFF154C READ_WRITE /end MEASUREMENT
/begin MEASUREMENT vT24M "RAM value vT24M" UBYTE COMP_0030 1 100 0 255 ECU_ADDRESS 0xFFFF159A READ_WRITE /end MEASUREMENT
/begin MEASUREMENT vT2MJOB "RAM value vT2MJOB" UBYTE COMP_0030 1 100 0 255 ECU_ADDRESS 0xFFFF154D READ_WRITE /end MEASUREMENT
/begin MEASUREMENT vT2NDPDTC "RAM value vT2NDPDTC" UWORD COMP_0068 1 100 0 65535 ECU_ADDRESS 0xFFFF524E READ_WRITE /end MEASUREMENT
/begin MEASUREMENT vT3RDPDTC "RAM value vT3RDPDTC" UWORD COMP_0068 1 100 0 65535 ECU_ADDRESS 0xFFFF5250 READ_WRITE /end MEASUREMENT
/begin MEASUREMENT vT4MJOB "RAM value vT4MJOB" UBYTE COMP_0030 1 100 0 255 ECU_ADDRESS 0xFFFF159B READ_WRITE /end MEASUREMENT
/begin MEASUREMENT vT4THPDTC "RAM value vT4THPDTC" UWORD COMP_0068 1 100 0 65535 ECU_ADDRESS 0xFFFF5252 READ_WRITE /end MEASUREMENT
/begin MEASUREMENT vT5THPDTC "RAM value vT5THPDTC" UWORD COMP_0068 1 100 0 65535 ECU_ADDRESS 0xFFFF5254 READ_WRITE /end MEASUREMENT
/begin MEASUREMENT vT6THPDTC "RAM value vT6THPDTC" UWORD COMP_0068 1 100 0 65535 ECU_ADDRESS 0xFFFF5256 READ_WRITE /end MEASUREMENT
/begin MEASUREMENT vT7THPDTC "RAM value vT7THPDTC" UWORD COMP_0068 1 100 0 65535 ECU_ADDRESS 0xFFFF5258 READ_WRITE /end MEASUREMENT
/begin MEASUREMENT vT8THPDTC "RAM value vT8THPDTC" UWORD COMP_0068 1 100 0 65535 ECU_ADDRESS 0xFFFF525A READ_WRITE /end MEASUREMENT
/begin MEASUREMENT vTA "RAM value vTA" UWORD COMP_0023 1 100 0 327675 ECU_ADDRESS 0xFFFF2096 READ_WRITE /end MEASUREMENT
/begin MEASUREMENT vTAAIR "RAM value vTAAIR" UWORD COMP_0041 1 100 0 52.428 ECU_ADDRESS 0xFFFF1B46 READ_WRITE /end MEASUREMENT
/begin MEASUREMENT vTAAIRZ "RAM value vTAAIRZ" UWORD COMP_0041 1 100 0 52.428 ECU_ADDRESS 0xFFFF0EDE READ_WRITE /end MEASUREMENT
/begin MEASUREMENT vTAAIR_S "RAM value vTAAIR_S" UWORD COMP_0041 1 100 0 52.428 ECU_ADDRESS 0xFFFF14C2 READ_WRITE /end MEASUREMENT
/begin MEASUREMENT vTAB "RAM value vTAB" UBYTE COMP_0054 1 100 0 5100 ECU_ADDRESS 0xFFFF38A7 READ_WRITE /end MEASUREMENT
/begin MEASUREMENT vTABFCPLf "RAM value vTABFCPLf" UBYTE COMP_0004 1 100 0 255 ECU_ADDRESS 0xFFFF2C66 READ_WRITE /end MEASUREMENT
/begin MEASUREMENT vTABFCPRf "RAM value vTABFCPRf" UBYTE COMP_0004 1 100 0 255 ECU_ADDRESS 0xFFFF2C67 READ_WRITE /end MEASUREMENT
/begin MEASUREMENT vTACTRQ "RAM value vTACTRQ" UWORD COMP_0196 1 100 0 6553.5 ECU_ADDRESS 0xFFFF0EE0 READ_WRITE /end MEASUREMENT
/begin MEASUREMENT vTADNV "RAM value vTADNV" ULONG COMP_0610_S 1 100 0 0.167772159960938 ECU_ADDRESS 0xFFFF0EE4 READ_WRITE /end MEASUREMENT
/begin MEASUREMENT vTADNVCK "RAM value vTADNVCK" ULONG COMP_0611_S 1 100 0 0.1679332212345 ECU_ADDRESS 0xFFFF0EE8 READ_WRITE /end MEASUREMENT
/begin MEASUREMENT vTADNVTE "RAM value vTADNVTE" ULONG COMP_0028_S 1 100 0 0.167772159960938 ECU_ADDRESS 0xFFFF0EEC READ_WRITE /end MEASUREMENT
/begin MEASUREMENT vTADNVTSL "RAM value vTADNVTSL" ULONG COMP_0028_S 1 100 0 0.167772159960938 ECU_ADDRESS 0xFFFF0EF0 READ_WRITE /end MEASUREMENT
/begin MEASUREMENT vTADNVT_S "RAM value vTADNVT_S" ULONG COMP_0612_S 1 100 0 0.1679332212345 ECU_ADDRESS 0xFFFF14C8 READ_WRITE /end MEASUREMENT
/begin MEASUREMENT vTADNV_S "RAM value vTADNV_S" ULONG COMP_0612_S 1 100 0 0.1679332212345 ECU_ADDRESS 0xFFFF14C4 READ_WRITE /end MEASUREMENT
/begin MEASUREMENT vTADVM "RAM value vTADVM" SBYTE COMP_0018 1 100 -128 127 ECU_ADDRESS 0xFFFF1B48 READ_WRITE /end MEASUREMENT
/begin MEASUREMENT vTADVMK "RAM value vTADVMK" SBYTE COMP_0018 1 100 -128 127 ECU_ADDRESS 0xFFFF19D3 READ_WRITE /end MEASUREMENT
/begin MEASUREMENT vTADVMTQ "RAM value vTADVMTQ" SBYTE COMP_0018 1 100 -128 127 ECU_ADDRESS 0xFFFF1B4A READ_WRITE /end MEASUREMENT
/begin MEASUREMENT vTADVMTQn "RAM value vTADVMTQn" SBYTE COMP_0018 1 100 -128 127 ECU_ADDRESS 0xFFFF0EF5 READ_WRITE /end MEASUREMENT
/begin MEASUREMENT vTADVMnm "RAM value vTADVMnm" SBYTE COMP_0018 1 100 -128 127 ECU_ADDRESS 0xFFFF0EF4 READ_WRITE /end MEASUREMENT
/begin MEASUREMENT vTADVMst "RAM value vTADVMst" SBYTE COMP_0018 1 100 -128 127 ECU_ADDRESS 0xFFFF1B49 READ_WRITE /end MEASUREMENT
/begin MEASUREMENT vTADVOV "RAM value vTADVOV" UWORD COMP_0613_S 1 100 0 2097120 ECU_ADDRESS 0xFFFF0EF6 READ_WRITE /end MEASUREMENT
/begin MEASUREMENT vTAEGR "RAM value vTAEGR" UBYTE COMP_0147 1 100 0 0.816 ECU_ADDRESS 0xFFFF0EF8 READ_WRITE /end MEASUREMENT
/begin MEASUREMENT vTAEND "RAM value vTAEND" UBYTE COMP_0035 1 100 -50 205 ECU_ADDRESS 0xFFFF441C READ_WRITE /end MEASUREMENT
/begin MEASUREMENT vTAG "RAM value vTAG" UBYTE COMP_0428 1 100 -40 215 ECU_ADDRESS 0xFFFF2098 READ_WRITE /end MEASUREMENT
/begin MEASUREMENT vTAGAS "RAM value vTAGAS" UWORD COMP_0041 1 100 0 52.428 ECU_ADDRESS 0xFFFF0EFA READ_WRITE /end MEASUREMENT
/begin MEASUREMENT vTAGAS0 "RAM value vTAGAS0" UWORD COMP_0041 1 100 0 52.428 ECU_ADDRESS 0xFFFF0EFC READ_WRITE /end MEASUREMENT
/begin MEASUREMENT vTAGAS0_S "RAM value vTAGAS0_S" UWORD COMP_0041 1 100 0 52.428 ECU_ADDRESS 0xFFFF14CE READ_WRITE /end MEASUREMENT
/begin MEASUREMENT vTAGAS_S "RAM value vTAGAS_S" UWORD COMP_0041 1 100 0 52.428 ECU_ADDRESS 0xFFFF14CC READ_WRITE /end MEASUREMENT
/begin MEASUREMENT vTAICTNG "RAM value vTAICTNG" UBYTE COMP_0035 1 100 -50 205 ECU_ADDRESS 0xFFFF4D84 READ_WRITE /end MEASUREMENT
/begin MEASUREMENT vTAICTNG2 "RAM value vTAICTNG2" UBYTE COMP_0035 1 100 -50 205 ECU_ADDRESS 0xFFFF4D85 READ_WRITE /end MEASUREMENT
/begin MEASUREMENT vTAINT "RAM value vTAINT" UBYTE COMP_0035 1 100 -50 205 ECU_ADDRESS 0xFFFF441D READ_WRITE /end MEASUREMENT
/begin MEASUREMENT vTAINTEO "RAM value vTAINTEO" UBYTE COMP_0035 1 100 -50 205 ECU_ADDRESS 0xFFFF38A8 READ_WRITE /end MEASUREMENT
/begin MEASUREMENT vTAINTTS "RAM value vTAINTTS" UBYTE COMP_0004_S 1 100 -50 205 ECU_ADDRESS 0xFFFF2C68 READ_WRITE /end MEASUREMENT
/begin MEASUREMENT vTAK "RAM value vTAK" UBYTE COMP_0356 1 100 -40 119.375 ECU_ADDRESS 0xFFFF08F8 READ_WRITE /end MEASUREMENT
/begin MEASUREMENT vTALTRQ "RAM value vTALTRQ" UWORD COMP_0196 1 100 0 6553.5 ECU_ADDRESS 0xFFFF0EFE READ_WRITE /end MEASUREMENT
/begin MEASUREMENT vTALTRQS "RAM value vTALTRQS" SWORD COMP_0228 1 100 -3276.8 3276.7 ECU_ADDRESS 0xFFFF0F00 READ_WRITE /end MEASUREMENT
/begin MEASUREMENT vTAMNBU "RAM value vTAMNBU" UBYTE COMP_0035 1 100 -50 205 ECU_ADDRESS 0xFFFF4F4A READ_WRITE /end MEASUREMENT
/begin MEASUREMENT vTAN "RAM value vTAN" UBYTE COMP_0035 1 100 -50 205 ECU_ADDRESS 0xFFFF2099 READ_WRITE /end MEASUREMENT
/begin MEASUREMENT vTAN1 "RAM value vTAN1" UBYTE COMP_0035 1 100 -50 205 ECU_ADDRESS 0xFFFF38A9 READ_WRITE /end MEASUREMENT
/begin MEASUREMENT vTAN2 "RAM value vTAN2" UBYTE COMP_0035 1 100 -50 205 ECU_ADDRESS 0xFFFF38AA READ_WRITE /end MEASUREMENT
/begin MEASUREMENT vTAN3 "RAM value vTAN3" UBYTE COMP_0035 1 100 -50 205 ECU_ADDRESS 0xFFFF38AB READ_WRITE /end MEASUREMENT
/begin MEASUREMENT vTAN4 "RAM value vTAN4" UBYTE COMP_0035 1 100 -50 205 ECU_ADDRESS 0xFFFF38AC READ_WRITE /end MEASUREMENT
/begin MEASUREMENT vTAN5 "RAM value vTAN5" UBYTE COMP_0035 1 100 -50 205 ECU_ADDRESS 0xFFFF38AD READ_WRITE /end MEASUREMENT
/begin MEASUREMENT vTAN6 "RAM value vTAN6" UBYTE COMP_0035 1 100 -50 205 ECU_ADDRESS 0xFFFF38AE READ_WRITE /end MEASUREMENT
/begin MEASUREMENT vTAN7 "RAM value vTAN7" UBYTE COMP_0035 1 100 -50 205 ECU_ADDRESS 0xFFFF38AF READ_WRITE /end MEASUREMENT
/begin MEASUREMENT vTANAIR "RAM value vTANAIR" UWORD COMP_0383 1 100 -50 205.99609375 ECU_ADDRESS 0xFFFF2C6A READ_WRITE /end MEASUREMENT
/begin MEASUREMENT vTANAIR0 "RAM value vTANAIR0" UWORD COMP_0383 1 100 -50 205.99609375 ECU_ADDRESS 0xFFFF2C6C READ_WRITE /end MEASUREMENT
/begin MEASUREMENT vTANAVE "RAM value vTANAVE" UBYTE COMP_0035 1 100 -50 205 ECU_ADDRESS 0xFFFF4D86 READ_WRITE /end MEASUREMENT
/begin MEASUREMENT vTANBMN "RAM value vTANBMN" UBYTE COMP_0035 1 100 -50 205 ECU_ADDRESS 0xFFFF209A READ_WRITE /end MEASUREMENT
/begin MEASUREMENT vTANBMNEO "RAM value vTANBMNEO" UBYTE COMP_0035 1 100 -50 205 ECU_ADDRESS 0xFFFF38B0 READ_WRITE /end MEASUREMENT
/begin MEASUREMENT vTANBMNG "RAM value vTANBMNG" UBYTE COMP_0035 1 100 -50 205 ECU_ADDRESS 0xFFFF4D87 READ_WRITE /end MEASUREMENT
/begin MEASUREMENT vTANBMNST "RAM value vTANBMNST" UBYTE COMP_0035 1 100 -50 205 ECU_ADDRESS 0xFFFF38B1 READ_WRITE /end MEASUREMENT
/begin MEASUREMENT vTANCNT "RAM value vTANCNT" UWORD COMP_0016 1 100 0 65535 ECU_ADDRESS 0xFFFF4D88 READ_WRITE /end MEASUREMENT
/begin MEASUREMENT vTANEND "RAM value vTANEND" UBYTE COMP_0035 1 100 -50 205 ECU_ADDRESS 0xFFFF4D8A READ_WRITE /end MEASUREMENT
/begin MEASUREMENT vTANESTHD "RAM value vTANESTHD" UWORD COMP_0383 1 100 -50 205.99609375 ECU_ADDRESS 0xFFFF4D8C READ_WRITE /end MEASUREMENT
/begin MEASUREMENT vTANFAC "RAM value vTANFAC" UWORD COMP_0334_S 1 100 0 1599.9780435 ECU_ADDRESS 0xFFFF2C6E READ_WRITE /end MEASUREMENT
/begin MEASUREMENT vTANFS "RAM value vTANFS" UBYTE COMP_0035 1 100 -50 205 ECU_ADDRESS 0xFFFF38B2 READ_WRITE /end MEASUREMENT
/begin MEASUREMENT vTANHOS "RAM value vTANHOS" UBYTE COMP_0124_S 1 100 -48 15.75 ECU_ADDRESS 0xFFFF0F02 READ_WRITE /end MEASUREMENT
/begin MEASUREMENT vTANMAX "RAM value vTANMAX" UBYTE COMP_0035 1 100 -50 205 ECU_ADDRESS 0xFFFF4D8E READ_WRITE /end MEASUREMENT
/begin MEASUREMENT vTANMIN "RAM value vTANMIN" UBYTE COMP_0035 1 100 -50 205 ECU_ADDRESS 0xFFFF209B READ_WRITE /end MEASUREMENT
/begin MEASUREMENT vTANMINBU "RAM value vTANMINBU" UBYTE COMP_0035 1 100 -50 205 ECU_ADDRESS 0xFFFF4D8F READ_WRITE /end MEASUREMENT
/begin MEASUREMENT vTANMLV "RAM value vTANMLV" SWORD COMP_0255_S 1 100 -3276.8 3276.7 ECU_ADDRESS 0xFFFF2C70 READ_WRITE /end MEASUREMENT
/begin MEASUREMENT vTANMNAIR "RAM value vTANMNAIR" UWORD COMP_0383 1 100 -50 205.99609375 ECU_ADDRESS 0xFFFF2C72 READ_WRITE /end MEASUREMENT
/begin MEASUREMENT vTANMNFS "RAM value vTANMNFS" UBYTE COMP_0035 1 100 -50 205 ECU_ADDRESS 0xFFFF209C READ_WRITE /end MEASUREMENT
/begin MEASUREMENT vTANPGHT "RAM value vTANPGHT" UBYTE COMP_0035 1 100 -50 205 ECU_ADDRESS 0xFFFF2C74 READ_WRITE /end MEASUREMENT
/begin MEASUREMENT vTANPIST2 "RAM value vTANPIST2" UBYTE COMP_0035 1 100 -50 205 ECU_ADDRESS 0xFFFF2C75 READ_WRITE /end MEASUREMENT
/begin MEASUREMENT vTANRHDIF "RAM value vTANRHDIF" SWORD COMP_0614_S 1 100 -128 127.99609375 ECU_ADDRESS 0xFFFF2C76 READ_WRITE /end MEASUREMENT
/begin MEASUREMENT vTANRHDMX "RAM value vTANRHDMX" SWORD COMP_0614_S 1 100 -128 127.99609375 ECU_ADDRESS 0xFFFF4D90 READ_WRITE /end MEASUREMENT
/begin MEASUREMENT vTANRLDIF "RAM value vTANRLDIF" SWORD COMP_0308 1 100 -32768 32767 ECU_ADDRESS 0xFFFF2C78 READ_WRITE /end MEASUREMENT
/begin MEASUREMENT vTANRLDMX "RAM value vTANRLDMX" SWORD COMP_0308 1 100 -32768 32767 ECU_ADDRESS 0xFFFF4D92 READ_WRITE /end MEASUREMENT
/begin MEASUREMENT vTANRLHD "RAM value vTANRLHD" UBYTE COMP_0035 1 100 -50 205 ECU_ADDRESS 0xFFFF4D94 READ_WRITE /end MEASUREMENT
/begin MEASUREMENT vTANST "RAM value vTANST" UBYTE COMP_0035 1 100 -50 205 ECU_ADDRESS 0xFFFF209D READ_WRITE /end MEASUREMENT
/begin MEASUREMENT vTANST4 "RAM value vTANST4" UWORD COMP_0504 1 100 0 1023.984375 ECU_ADDRESS 0xFFFF2C7A READ_WRITE /end MEASUREMENT
/begin MEASUREMENT vTANTH "RAM value vTANTH" UBYTE COMP_0035 1 100 -50 205 ECU_ADDRESS 0xFFFF209E READ_WRITE /end MEASUREMENT
/begin MEASUREMENT vTANTHEST "RAM value vTANTHEST" UWORD COMP_0383 1 100 -50 205.99609375 ECU_ADDRESS 0xFFFF2C7C READ_WRITE /end MEASUREMENT
/begin MEASUREMENT vTANTHG "RAM value vTANTHG" UBYTE COMP_0428 1 100 -40 215 ECU_ADDRESS 0xFFFF209F READ_WRITE /end MEASUREMENT
/begin MEASUREMENT vTAOUT "RAM value vTAOUT" UBYTE COMP_0035 1 100 -50 205 ECU_ADDRESS 0xFFFF20A0 READ_WRITE /end MEASUREMENT
/begin MEASUREMENT vTAOUT0 "RAM value vTAOUT0" UWORD COMP_0615_S 1 100 -50 605.35 ECU_ADDRESS 0xFFFF38B4 READ_WRITE /end MEASUREMENT
/begin MEASUREMENT vTAPDATA "RAM value vTAPDATA" SLONG COMP_0144_S 1 100 -1843.20024746394 1843.20024660563 ECU_ADDRESS 0xFFFF2C80 READ_WRITE /end MEASUREMENT
/begin MEASUREMENT vTAPGHOS "RAM value vTAPGHOS" UBYTE COMP_0019_S 1 100 0 1.000000095 ECU_ADDRESS 0xFFFF2C84 READ_WRITE /end MEASUREMENT
/begin MEASUREMENT vTARCNTE "RAM value vTARCNTE" UBYTE COMP_0016 1 100 0 255 ECU_ADDRESS 0xFFFF3A45 READ_WRITE /end MEASUREMENT
/begin MEASUREMENT vTASISCQ "RAM value vTASISCQ" UBYTE COMP_0068 1 100 0 255 ECU_ADDRESS 0xFFFF0F03 READ_WRITE /end MEASUREMENT
/begin MEASUREMENT vTASKNG "RAM value vTASKNG" UBYTE COMP_0004 1 100 0 255 ECU_ADDRESS 0xFFFF154E READ_WRITE /end MEASUREMENT
/begin MEASUREMENT vTASLRCQ "RAM value vTASLRCQ" UBYTE COMP_0068 1 100 0 255 ECU_ADDRESS 0xFFFF0F04 READ_WRITE /end MEASUREMENT
/begin MEASUREMENT vTATE "RAM value vTATE" UWORD COMP_0042 1 100 0 52.428 ECU_ADDRESS 0xFFFF0F06 READ_WRITE /end MEASUREMENT
/begin MEASUREMENT vTATESLIM "RAM value vTATESLIM" UWORD COMP_0042 1 100 0 52.428 ECU_ADDRESS 0xFFFF0F08 READ_WRITE /end MEASUREMENT
/begin MEASUREMENT vTATE_S "RAM value vTATE_S" UWORD COMP_0042 1 100 0 52.428 ECU_ADDRESS 0xFFFF14D0 READ_WRITE /end MEASUREMENT
/begin MEASUREMENT vTATH "RAM value vTATH" UWORD COMP_0023 1 100 0 327675 ECU_ADDRESS 0xFFFF20A2 READ_WRITE /end MEASUREMENT
/begin MEASUREMENT vTATHDGCT "RAM value vTATHDGCT" UBYTE COMP_0014 1 100 0 2550 ECU_ADDRESS 0xFFFF2C85 READ_WRITE /end MEASUREMENT
/begin MEASUREMENT vTATHINT "RAM value vTATHINT" UBYTE COMP_0004_S 1 100 -50 205 ECU_ADDRESS 0xFFFF2C86 READ_WRITE /end MEASUREMENT
/begin MEASUREMENT vTATM "RAM value vTATM" UBYTE COMP_0384 1 100 0 1.992315 ECU_ADDRESS 0xFFFF0F0A READ_WRITE /end MEASUREMENT
/begin MEASUREMENT vTAUEXG "RAM value vTAUEXG" UWORD COMP_0290 1 100 0 0.999985458 ECU_ADDRESS 0xFFFF2C88 READ_WRITE /end MEASUREMENT
/begin MEASUREMENT vTAVTFD "RAM value vTAVTFD" UBYTE COMP_0017 1 100 0 255 ECU_ADDRESS 0xFFFF0F0B READ_WRITE /end MEASUREMENT
/begin MEASUREMENT vTAVTFN "RAM value vTAVTFN" UBYTE COMP_0017 1 100 0 255 ECU_ADDRESS 0xFFFF0F0C READ_WRITE /end MEASUREMENT
/begin MEASUREMENT vTBCDG1_Sf "RAM value vTBCDG1_Sf" UBYTE COMP_0004 1 100 0 255 ECU_ADDRESS 0xFFFF3056 READ_WRITE /end MEASUREMENT
/begin MEASUREMENT vTBCDG2_Sf "RAM value vTBCDG2_Sf" UBYTE COMP_0004 1 100 0 255 ECU_ADDRESS 0xFFFF3057 READ_WRITE /end MEASUREMENT
/begin MEASUREMENT vTBCDG3_Sf "RAM value vTBCDG3_Sf" UBYTE COMP_0004 1 100 0 255 ECU_ADDRESS 0xFFFF3058 READ_WRITE /end MEASUREMENT
/begin MEASUREMENT vTBCDGN1f "RAM value vTBCDGN1f" UBYTE COMP_0004 1 100 0 255 ECU_ADDRESS 0xFFFF2126 READ_WRITE /end MEASUREMENT
/begin MEASUREMENT vTBCDGN2f "RAM value vTBCDGN2f" UBYTE COMP_0004 1 100 0 255 ECU_ADDRESS 0xFFFF2127 READ_WRITE /end MEASUREMENT
/begin MEASUREMENT vTBCDGN3f "RAM value vTBCDGN3f" UBYTE COMP_0004 1 100 0 255 ECU_ADDRESS 0xFFFF2128 READ_WRITE /end MEASUREMENT
/begin MEASUREMENT vTBCGDSH "RAM value vTBCGDSH" UBYTE COMP_0030 1 100 0 255 ECU_ADDRESS 0xFFFF2C8A READ_WRITE /end MEASUREMENT
/begin MEASUREMENT vTBCOPEN "RAM value vTBCOPEN" UBYTE COMP_0030 1 100 0 255 ECU_ADDRESS 0xFFFF2C8C READ_WRITE /end MEASUREMENT
/begin MEASUREMENT vTBCVBSH "RAM value vTBCVBSH" UBYTE COMP_0030 1 100 0 255 ECU_ADDRESS 0xFFFF2C8E READ_WRITE /end MEASUREMENT
/begin MEASUREMENT vTBLDFST "RAM value vTBLDFST" UBYTE COMP_0006 1 100 0 3187.5 ECU_ADDRESS 0xFFFF0F0D READ_WRITE /end MEASUREMENT
/begin MEASUREMENT vTBPERR "RAM value vTBPERR" SWORD COMP_0616_S 1 100 -8192 8191.75 ECU_ADDRESS 0xFFFF2C90 READ_WRITE /end MEASUREMENT
/begin MEASUREMENT vTBPREGLM "RAM value vTBPREGLM" UWORD COMP_0120_S 1 100 0 16383.75 ECU_ADDRESS 0xFFFF2C92 READ_WRITE /end MEASUREMENT
/begin MEASUREMENT vTBTWNHS "RAM value vTBTWNHS" UBYTE COMP_0373 1 100 0 2.55 ECU_ADDRESS 0xFFFF2C94 READ_WRITE /end MEASUREMENT
/begin MEASUREMENT vTBUDGET "RAM value vTBUDGET" SLONG COMP_0115_S 1 100 -214748.3648 214748.3647 ECU_ADDRESS 0xFFFF2C98 READ_WRITE /end MEASUREMENT
/begin MEASUREMENT vTCAJA2 "RAM value vTCAJA2" UBYTE COMP_0013 1 100 0 255 ECU_ADDRESS 0xFFFF2C9C READ_WRITE /end MEASUREMENT
/begin MEASUREMENT vTCAJA2V "RAM value vTCAJA2V" UBYTE COMP_0013 1 100 0 255 ECU_ADDRESS 0xFFFF2C9E READ_WRITE /end MEASUREMENT
/begin MEASUREMENT vTCAM "RAM value vTCAM" ULONG COMP_0189 1 100 0 13743895344 ECU_ADDRESS 0xFFFF19D4 READ_WRITE /end MEASUREMENT
/begin MEASUREMENT vTCAM1 "RAM value vTCAM1" ULONG COMP_0189 1 100 0 13743895344 ECU_ADDRESS 0xFFFF19D8 READ_WRITE /end MEASUREMENT
/begin MEASUREMENT vTCAM2 "RAM value vTCAM2" ULONG COMP_0189 1 100 0 13743895344 ECU_ADDRESS 0xFFFF19DC READ_WRITE /end MEASUREMENT
/begin MEASUREMENT vTCAMCNT "RAM value vTCAMCNT" UBYTE COMP_0068 1 100 0 255 ECU_ADDRESS 0xFFFF19E0 READ_WRITE /end MEASUREMENT
/begin MEASUREMENT vTCANDYT "RAM value vTCANDYT" UBYTE COMP_0049 1 100 0 255 ECU_ADDRESS 0xFFFF0F0E READ_WRITE /end MEASUREMENT
/begin MEASUREMENT vTCATKO "RAM value vTCATKO" UBYTE COMP_0062 1 100 0 1020 ECU_ADDRESS 0xFFFF4D95 READ_WRITE /end MEASUREMENT
/begin MEASUREMENT vTCATKOS "RAM value vTCATKOS" UBYTE COMP_0062 1 100 0 1020 ECU_ADDRESS 0xFFFF4D96 READ_WRITE /end MEASUREMENT
/begin MEASUREMENT vTCATL "RAM value vTCATL" UBYTE COMP_0062 1 100 0 1020 ECU_ADDRESS 0xFFFF0F0F READ_WRITE /end MEASUREMENT
/begin MEASUREMENT vTCDRQ "RAM value vTCDRQ" ULONG COMP_0489_S 1 100 0 429496.7295 ECU_ADDRESS 0xFFFF2CA0 READ_WRITE /end MEASUREMENT
/begin MEASUREMENT vTCKBL "RAM value vTCKBL" SWORD COMP_0228 1 100 -3276.8 3276.7 ECU_ADDRESS 0xFFFF0F14 READ_WRITE /end MEASUREMENT
/begin MEASUREMENT vTCKBLC "RAM value vTCKBLC" SWORD COMP_0228 1 100 -3276.8 3276.7 ECU_ADDRESS 0xFFFF0F16 READ_WRITE /end MEASUREMENT
/begin MEASUREMENT vTCKBLCC "RAM value vTCKBLCC" UBYTE COMP_0349 1 100 0 408 ECU_ADDRESS 0xFFFF1688 READ_WRITE /end MEASUREMENT
/begin MEASUREMENT vTCKBLCL "RAM value vTCKBLCL" SWORD COMP_0228 1 100 -3276.8 3276.7 ECU_ADDRESS 0xFFFF0F18 READ_WRITE /end MEASUREMENT
/begin MEASUREMENT vTCKBLCLM "RAM value vTCKBLCLM" SWORD COMP_0228 1 100 -3276.8 3276.7 ECU_ADDRESS 0xFFFF0F1A READ_WRITE /end MEASUREMENT
/begin MEASUREMENT vTCKLM "RAM value vTCKLM" SWORD COMP_0228 1 100 -3276.8 3276.7 ECU_ADDRESS 0xFFFF0F1C READ_WRITE /end MEASUREMENT
/begin MEASUREMENT vTCKTD "RAM value vTCKTD" SWORD COMP_0228 1 100 -3276.8 3276.7 ECU_ADDRESS 0xFFFF0F1E READ_WRITE /end MEASUREMENT
/begin MEASUREMENT vTCLK "RAM value vTCLK" UWORD COMP_0617_S 1 100 0 209712 ECU_ADDRESS 0xFFFF3A48 READ_WRITE /end MEASUREMENT
/begin MEASUREMENT vTCLK1 "RAM value vTCLK1" UWORD COMP_0617_S 1 100 0 209712 ECU_ADDRESS 0xFFFF38B6 READ_WRITE /end MEASUREMENT
/begin MEASUREMENT vTCLK2 "RAM value vTCLK2" UWORD COMP_0617_S 1 100 0 209712 ECU_ADDRESS 0xFFFF38B8 READ_WRITE /end MEASUREMENT
/begin MEASUREMENT vTCLMAX "RAM value vTCLMAX" UWORD COMP_0617_S 1 100 0 209712 ECU_ADDRESS 0xFFFF4F4C READ_WRITE /end MEASUREMENT
/begin MEASUREMENT vTCLMIN "RAM value vTCLMIN" UWORD COMP_0617_S 1 100 0 209712 ECU_ADDRESS 0xFFFF4F4E READ_WRITE /end MEASUREMENT
/begin MEASUREMENT vTCNT0 "RAM value vTCNT0" ULONG COMP_0494 1 100 0 429496729500 ECU_ADDRESS 0xFFFF0F20 READ_WRITE /end MEASUREMENT
/begin MEASUREMENT vTCOLD "RAM value vTCOLD" UBYTE COMP_0497_S 1 100 -100 410 ECU_ADDRESS 0xFFFF1689 READ_WRITE /end MEASUREMENT
/begin MEASUREMENT vTCSMDD1 "RAM value vTCSMDD1" UBYTE COMP_0189_S 1 100 0 84.999999915 ECU_ADDRESS 0xFFFF2CB4 READ_WRITE /end MEASUREMENT
/begin MEASUREMENT vTCSMDD15 "RAM value vTCSMDD15" UBYTE COMP_0189_S 1 100 0 84.999999915 ECU_ADDRESS 0xFFFF2CB5 READ_WRITE /end MEASUREMENT
/begin MEASUREMENT vTCSMDD2 "RAM value vTCSMDD2" UBYTE COMP_0189_S 1 100 0 84.999999915 ECU_ADDRESS 0xFFFF2CB6 READ_WRITE /end MEASUREMENT
/begin MEASUREMENT vTCSMOD "RAM value vTCSMOD" UBYTE COMP_0189_S 1 100 0 84.999999915 ECU_ADDRESS 0xFFFF2CB7 READ_WRITE /end MEASUREMENT
/begin MEASUREMENT vTCVDUTY "RAM value vTCVDUTY" UBYTE COMP_0027 1 100 0 255 ECU_ADDRESS 0xFFFF2CB8 READ_WRITE /end MEASUREMENT
/begin MEASUREMENT vTCVHOS "RAM value vTCVHOS" UBYTE COMP_0017 1 100 0 255 ECU_ADDRESS 0xFFFF0F24 READ_WRITE /end MEASUREMENT
/begin MEASUREMENT vTCVOEGR "RAM value vTCVOEGR" UBYTE COMP_0141 1 100 0 49.8046875 ECU_ADDRESS 0xFFFF0F25 READ_WRITE /end MEASUREMENT
/begin MEASUREMENT vTCVSTS "RAM value vTCVSTS" UBYTE COMP_0068 1 100 0 255 ECU_ADDRESS 0xFFFF2129 READ_WRITE /end MEASUREMENT
/begin MEASUREMENT vTCVV "RAM value vTCVV" UBYTE COMP_0023 1 100 0 1275 ECU_ADDRESS 0xFFFF20A4 READ_WRITE /end MEASUREMENT
/begin MEASUREMENT vTDABF50 "RAM value vTDABF50" UBYTE COMP_0014 1 100 0 2550 ECU_ADDRESS 0xFFFF2CB9 READ_WRITE /end MEASUREMENT
/begin MEASUREMENT vTDADNV "RAM value vTDADNV" ULONG COMP_0028_S 1 100 0 0.167772159960938 ECU_ADDRESS 0xFFFF0F28 READ_WRITE /end MEASUREMENT
/begin MEASUREMENT vTDADNV_S "RAM value vTDADNV_S" ULONG COMP_0610_S 1 100 0 0.167772159960938 ECU_ADDRESS 0xFFFF14D4 READ_WRITE /end MEASUREMENT
/begin MEASUREMENT vTDATDGP "RAM value vTDATDGP" UBYTE COMP_0068 1 100 0 255 ECU_ADDRESS 0xFFFF0F2C READ_WRITE /end MEASUREMENT
/begin MEASUREMENT vTDCVC2 "RAM value vTDCVC2" UBYTE COMP_0049 1 100 0 255 ECU_ADDRESS 0xFFFF2CBA READ_WRITE /end MEASUREMENT
/begin MEASUREMENT vTDCVCL "RAM value vTDCVCL" UBYTE COMP_0049 1 100 0 255 ECU_ADDRESS 0xFFFF2CBB READ_WRITE /end MEASUREMENT
/begin MEASUREMENT vTDEPRS "RAM value vTDEPRS" UBYTE COMP_0014 1 100 0 2550 ECU_ADDRESS 0xFFFF2CBC READ_WRITE /end MEASUREMENT
/begin MEASUREMENT vTDEPRS10 "RAM value vTDEPRS10" UBYTE COMP_0014 1 100 0 2550 ECU_ADDRESS 0xFFFF2CBD READ_WRITE /end MEASUREMENT
/begin MEASUREMENT vTDEPRS5 "RAM value vTDEPRS5" UBYTE COMP_0014 1 100 0 2550 ECU_ADDRESS 0xFFFF2CBE READ_WRITE /end MEASUREMENT
/begin MEASUREMENT vTDGMIN "RAM value vTDGMIN" UBYTE COMP_0014 1 100 0 2550 ECU_ADDRESS 0xFFFF4D97 READ_WRITE /end MEASUREMENT
/begin MEASUREMENT vTDICTNG "RAM value vTDICTNG" SWORD COMP_0228 1 100 -3276.8 3276.7 ECU_ADDRESS 0xFFFF4D98 READ_WRITE /end MEASUREMENT
/begin MEASUREMENT vTDICTNG2 "RAM value vTDICTNG2" SWORD COMP_0228 1 100 -3276.8 3276.7 ECU_ADDRESS 0xFFFF4D9A READ_WRITE /end MEASUREMENT
/begin MEASUREMENT vTDLIMPI "RAM value vTDLIMPI" UBYTE COMP_0618_S 1 100 0 0.99705 ECU_ADDRESS 0xFFFF0F2D READ_WRITE /end MEASUREMENT
/begin MEASUREMENT vTDQCI "RAM value vTDQCI" UBYTE COMP_0004 1 100 0 255 ECU_ADDRESS 0xFFFF0F2E READ_WRITE /end MEASUREMENT
/begin MEASUREMENT vTDRASRPI "RAM value vTDRASRPI" UBYTE COMP_0063 1 100 0 0.99609375 ECU_ADDRESS 0xFFFF0F2F READ_WRITE /end MEASUREMENT
/begin MEASUREMENT vTDRAT "RAM value vTDRAT" UWORD COMP_0101 1 100 0 0.999985458 ECU_ADDRESS 0xFFFF0F30 READ_WRITE /end MEASUREMENT
/begin MEASUREMENT vTDRATBF "RAM value vTDRATBF" UWORD COMP_0290 1 100 0 0.999985458 ECU_ADDRESS 0xFFFF0F32 READ_WRITE /end MEASUREMENT
/begin MEASUREMENT vTDRATPI "RAM value vTDRATPI" UBYTE COMP_0618_S 1 100 0 0.99705 ECU_ADDRESS 0xFFFF0F34 READ_WRITE /end MEASUREMENT
/begin MEASUREMENT vTDRATPIH "RAM value vTDRATPIH" UBYTE COMP_0618_S 1 100 0 0.99705 ECU_ADDRESS 0xFFFF0F35 READ_WRITE /end MEASUREMENT
/begin MEASUREMENT vTDRCOMPI "RAM value vTDRCOMPI" UBYTE COMP_0063 1 100 0 0.99609375 ECU_ADDRESS 0xFFFF0F36 READ_WRITE /end MEASUREMENT
/begin MEASUREMENT vTDRDYN "RAM value vTDRDYN" UWORD COMP_0290 1 100 0 0.999985458 ECU_ADDRESS 0xFFFF0F38 READ_WRITE /end MEASUREMENT
/begin MEASUREMENT vTDRFIN "RAM value vTDRFIN" UWORD COMP_0290 1 100 0 0.999985458 ECU_ADDRESS 0xFFFF0F3A READ_WRITE /end MEASUREMENT
/begin MEASUREMENT vTDRFINPI "RAM value vTDRFINPI" UBYTE COMP_0063 1 100 0 0.99609375 ECU_ADDRESS 0xFFFF0F3C READ_WRITE /end MEASUREMENT
/begin MEASUREMENT vTDRONC "RAM value vTDRONC" UBYTE COMP_0618_S 1 100 0 0.99705 ECU_ADDRESS 0xFFFF0F3D READ_WRITE /end MEASUREMENT
/begin MEASUREMENT vTDRTACAN "RAM value vTDRTACAN" UBYTE COMP_0063 1 100 0 0.99609375 ECU_ADDRESS 0xFFFF20A5 READ_WRITE /end MEASUREMENT
/begin MEASUREMENT vTDRTARG "RAM value vTDRTARG" UBYTE COMP_0063 1 100 0 0.99609375 ECU_ADDRESS 0xFFFF2CBF READ_WRITE /end MEASUREMENT
/begin MEASUREMENT vTDRYTIME "RAM value vTDRYTIME" UBYTE COMP_0013 1 100 0 255 ECU_ADDRESS 0xFFFF38BA READ_WRITE /end MEASUREMENT
/begin MEASUREMENT vTDRYTIMEf "RAM value vTDRYTIMEf" UBYTE COMP_0004 1 100 0 255 ECU_ADDRESS 0xFFFF38BB READ_WRITE /end MEASUREMENT
/begin MEASUREMENT vTDTVO "RAM value vTDTVO" UWORD COMP_0130 1 100 0 1802.2125 ECU_ADDRESS 0xFFFF2CC0 READ_WRITE /end MEASUREMENT
/begin MEASUREMENT vTDTVO_S "RAM value vTDTVO_S" UWORD COMP_0130 1 100 0 1802.2125 ECU_ADDRESS 0xFFFF14D8 READ_WRITE /end MEASUREMENT
/begin MEASUREMENT vTDVPIL "RAM value vTDVPIL" UBYTE COMP_0008 1 100 0 25500 ECU_ADDRESS 0xFFFF2CC2 READ_WRITE /end MEASUREMENT
/begin MEASUREMENT vTDVPIL10 "RAM value vTDVPIL10" UBYTE COMP_0008 1 100 0 25500 ECU_ADDRESS 0xFFFF2CC3 READ_WRITE /end MEASUREMENT
/begin MEASUREMENT vTDVPIL3 "RAM value vTDVPIL3" UBYTE COMP_0024 1 100 0 12750 ECU_ADDRESS 0xFFFF2CC4 READ_WRITE /end MEASUREMENT
/begin MEASUREMENT vTDWLL "RAM value vTDWLL" UBYTE COMP_0017 1 100 0 255 ECU_ADDRESS 0xFFFF1B4B READ_WRITE /end MEASUREMENT
/begin MEASUREMENT vTDWLLB "RAM value vTDWLLB" UBYTE COMP_0017 1 100 0 255 ECU_ADDRESS 0xFFFF0F3E READ_WRITE /end MEASUREMENT
/begin MEASUREMENT vTDWLLH "RAM value vTDWLLH" UBYTE COMP_0017 1 100 0 255 ECU_ADDRESS 0xFFFF0F3F READ_WRITE /end MEASUREMENT
/begin MEASUREMENT vTE1INV "RAM value vTE1INV" ULONG COMP_0619_S 1 100 0 512.007346204245 ECU_ADDRESS 0xFFFF0F44 READ_WRITE /end MEASUREMENT
/begin MEASUREMENT vTE1INVS "RAM value vTE1INVS" UBYTE COMP_0004 1 100 0 255 ECU_ADDRESS 0xFFFF0F48 READ_WRITE /end MEASUREMENT
/begin MEASUREMENT vTE1INVSz2 "RAM value vTE1INVSz2" UBYTE COMP_0004 1 100 0 255 ECU_ADDRESS 0xFFFF0F4A READ_WRITE /end MEASUREMENT
/begin MEASUREMENT vTE1INVz2 "RAM value vTE1INVz2" ULONG COMP_0619_S 1 100 0 512.007346204245 ECU_ADDRESS 0xFFFF0F50 READ_WRITE /end MEASUREMENT
/begin MEASUREMENT vTE1_W "RAM value vTE1_W" UWORD COMP_0502 1 100 0 1.0000051185 ECU_ADDRESS 0xFFFF0F40 READ_WRITE /end MEASUREMENT
/begin MEASUREMENT vTE2INV "RAM value vTE2INV" ULONG COMP_0619_S 1 100 0 512.007346204245 ECU_ADDRESS 0xFFFF0F58 READ_WRITE /end MEASUREMENT
/begin MEASUREMENT vTE2INVS "RAM value vTE2INVS" UBYTE COMP_0004 1 100 0 255 ECU_ADDRESS 0xFFFF0F7C READ_WRITE /end MEASUREMENT
/begin MEASUREMENT vTE2INVSz2 "RAM value vTE2INVSz2" UBYTE COMP_0004 1 100 0 255 ECU_ADDRESS 0xFFFF0F7E READ_WRITE /end MEASUREMENT
/begin MEASUREMENT vTE2INV_1 "RAM value vTE2INV_1" ULONG COMP_0501 1 100 0 8388758.3219022 ECU_ADDRESS 0xFFFF0F5C READ_WRITE /end MEASUREMENT
/begin MEASUREMENT vTE2INV_2 "RAM value vTE2INV_2" ULONG COMP_0501 1 100 0 8388758.3219022 ECU_ADDRESS 0xFFFF0F60 READ_WRITE /end MEASUREMENT
/begin MEASUREMENT vTE2INV_3 "RAM value vTE2INV_3" ULONG COMP_0501 1 100 0 8388758.3219022 ECU_ADDRESS 0xFFFF0F64 READ_WRITE /end MEASUREMENT
/begin MEASUREMENT vTE2INV_4 "RAM value vTE2INV_4" ULONG COMP_0501 1 100 0 8388758.3219022 ECU_ADDRESS 0xFFFF0F68 READ_WRITE /end MEASUREMENT
/begin MEASUREMENT vTE2INV_5 "RAM value vTE2INV_5" ULONG COMP_0501 1 100 0 8388758.3219022 ECU_ADDRESS 0xFFFF0F6C READ_WRITE /end MEASUREMENT
/begin MEASUREMENT vTE2INV_6 "RAM value vTE2INV_6" ULONG COMP_0501 1 100 0 8388758.3219022 ECU_ADDRESS 0xFFFF0F70 READ_WRITE /end MEASUREMENT
/begin MEASUREMENT vTE2INV_7 "RAM value vTE2INV_7" ULONG COMP_0501 1 100 0 8388758.3219022 ECU_ADDRESS 0xFFFF0F74 READ_WRITE /end MEASUREMENT
/begin MEASUREMENT vTE2INV_8 "RAM value vTE2INV_8" ULONG COMP_0501 1 100 0 8388758.3219022 ECU_ADDRESS 0xFFFF0F78 READ_WRITE /end MEASUREMENT
/begin MEASUREMENT vTE2INV_S__3 "RAM value vTE2INV_S_" UBYTE COMP_0004 1 100 0 255 ECU_ADDRESS 0xFFFF14DA READ_WRITE /end MEASUREMENT
/begin MEASUREMENT vTE2INV_S__4 "RAM value vTE2INV_S_" UBYTE COMP_0004 1 100 0 255 ECU_ADDRESS 0xFFFF14DB READ_WRITE /end MEASUREMENT
/begin MEASUREMENT vTE2INV_S__1 "RAM value vTE2INV_S_" UBYTE COMP_0004 1 100 0 255 ECU_ADDRESS 0xFFFF14DC READ_WRITE /end MEASUREMENT
/begin MEASUREMENT vTE2INV_S__2 "RAM value vTE2INV_S_" UBYTE COMP_0004 1 100 0 255 ECU_ADDRESS 0xFFFF14DD READ_WRITE /end MEASUREMENT
/begin MEASUREMENT vTE2INV_S__5 "RAM value vTE2INV_S_" UBYTE COMP_0004 1 100 0 255 ECU_ADDRESS 0xFFFF14DE READ_WRITE /end MEASUREMENT
/begin MEASUREMENT vTE2INV_S__6 "RAM value vTE2INV_S_" UBYTE COMP_0004 1 100 0 255 ECU_ADDRESS 0xFFFF14DF READ_WRITE /end MEASUREMENT
/begin MEASUREMENT vTE2INV_S__7 "RAM value vTE2INV_S_" UBYTE COMP_0004 1 100 0 255 ECU_ADDRESS 0xFFFF14E0 READ_WRITE /end MEASUREMENT
/begin MEASUREMENT vTE2INV_S_ "RAM value vTE2INV_S_" UBYTE COMP_0004 1 100 0 255 ECU_ADDRESS 0xFFFF14E1 READ_WRITE /end MEASUREMENT
/begin MEASUREMENT vTE2INVz2 "RAM value vTE2INVz2" ULONG COMP_0619_S 1 100 0 512.007346204245 ECU_ADDRESS 0xFFFF0F84 READ_WRITE /end MEASUREMENT
/begin MEASUREMENT vTE2_W "RAM value vTE2_W" UWORD COMP_0502 1 100 0 1.0000051185 ECU_ADDRESS 0xFFFF0F54 READ_WRITE /end MEASUREMENT
/begin MEASUREMENT vTECLPf "RAM value vTECLPf" UBYTE COMP_0004 1 100 0 255 ECU_ADDRESS 0xFFFF2CC5 READ_WRITE /end MEASUREMENT
/begin MEASUREMENT vTECOM "RAM value vTECOM" SWORD COMP_0228 1 100 -3276.8 3276.7 ECU_ADDRESS 0xFFFF3BA0 READ_WRITE /end MEASUREMENT
/begin MEASUREMENT vTEFRIC "RAM value vTEFRIC" UWORD COMP_0196 1 100 0 6553.5 ECU_ADDRESS 0xFFFF1B4C READ_WRITE /end MEASUREMENT
/begin MEASUREMENT vTEFRIC0 "RAM value vTEFRIC0" UWORD COMP_0196 1 100 0 6553.5 ECU_ADDRESS 0xFFFF0F8A READ_WRITE /end MEASUREMENT
/begin MEASUREMENT vTEFRICS "RAM value vTEFRICS" UWORD COMP_0196 1 100 0 6553.5 ECU_ADDRESS 0xFFFF0F8C READ_WRITE /end MEASUREMENT
/begin MEASUREMENT vTEGR "RAM value vTEGR" UBYTE COMP_0035 1 100 -50 205 ECU_ADDRESS 0xFFFF20A6 READ_WRITE /end MEASUREMENT
/begin MEASUREMENT vTEGRMX "RAM value vTEGRMX" UBYTE COMP_0035 1 100 -50 205 ECU_ADDRESS 0xFFFF2CC6 READ_WRITE /end MEASUREMENT
/begin MEASUREMENT vTEHOSAPO "RAM value vTEHOSAPO" UWORD COMP_0483_S 1 100 0 199.9970916 ECU_ADDRESS 0xFFFF0F8E READ_WRITE /end MEASUREMENT
/begin MEASUREMENT vTEMHOS "RAM value vTEMHOS" UWORD COMP_0057 1 100 0 3.999941832 ECU_ADDRESS 0xFFFF1B4E READ_WRITE /end MEASUREMENT
/begin MEASUREMENT vTEMINLIM "RAM value vTEMINLIM" UWORD COMP_0620_S 1 100 0 255.97971 ECU_ADDRESS 0xFFFF2CC8 READ_WRITE /end MEASUREMENT
/begin MEASUREMENT vTENG "RAM value vTENG" SWORD COMP_0228 1 100 -3276.8 3276.7 ECU_ADDRESS 0xFFFF1B50 READ_WRITE /end MEASUREMENT
/begin MEASUREMENT vTENG10 "RAM value vTENG10" SWORD COMP_0228 1 100 -3276.8 3276.7 ECU_ADDRESS 0xFFFF0F90 READ_WRITE /end MEASUREMENT
/begin MEASUREMENT vTENG11 "RAM value vTENG11" SWORD COMP_0228 1 100 -3276.8 3276.7 ECU_ADDRESS 0xFFFF0F92 READ_WRITE /end MEASUREMENT
/begin MEASUREMENT vTENG12 "RAM value vTENG12" SWORD COMP_0228 1 100 -3276.8 3276.7 ECU_ADDRESS 0xFFFF0F94 READ_WRITE /end MEASUREMENT
/begin MEASUREMENT vTENG13 "RAM value vTENG13" SWORD COMP_0228 1 100 -3276.8 3276.7 ECU_ADDRESS 0xFFFF0F96 READ_WRITE /end MEASUREMENT
/begin MEASUREMENT vTENG14 "RAM value vTENG14" SWORD COMP_0228 1 100 -3276.8 3276.7 ECU_ADDRESS 0xFFFF0F98 READ_WRITE /end MEASUREMENT
/begin MEASUREMENT vTENG2 "RAM value vTENG2" SWORD COMP_0228 1 100 -3276.8 3276.7 ECU_ADDRESS 0xFFFF1B52 READ_WRITE /end MEASUREMENT
/begin MEASUREMENT vTENG22 "RAM value vTENG22" SWORD COMP_0228 1 100 -3276.8 3276.7 ECU_ADDRESS 0xFFFF0F9A READ_WRITE /end MEASUREMENT
/begin MEASUREMENT vTENG23 "RAM value vTENG23" SWORD COMP_0228 1 100 -3276.8 3276.7 ECU_ADDRESS 0xFFFF0F9C READ_WRITE /end MEASUREMENT
/begin MEASUREMENT vTENG24 "RAM value vTENG24" SWORD COMP_0228 1 100 -3276.8 3276.7 ECU_ADDRESS 0xFFFF0F9E READ_WRITE /end MEASUREMENT
/begin MEASUREMENT vTENG24S "RAM value vTENG24S" SWORD COMP_0228 1 100 -3276.8 3276.7 ECU_ADDRESS 0xFFFF0FA0 READ_WRITE /end MEASUREMENT
/begin MEASUREMENT vTENG4 "RAM value vTENG4" SWORD COMP_0228 1 100 -3276.8 3276.7 ECU_ADDRESS 0xFFFF0FA2 READ_WRITE /end MEASUREMENT
/begin MEASUREMENT vTENGAFS "RAM value vTENGAFS" UWORD COMP_0328 1 100 0 399.99392106 ECU_ADDRESS 0xFFFF38BC READ_WRITE /end MEASUREMENT
/begin MEASUREMENT vTENGOF1 "RAM value vTENGOF1" SWORD COMP_0228 1 100 -3276.8 3276.7 ECU_ADDRESS 0xFFFF168A READ_WRITE /end MEASUREMENT
/begin MEASUREMENT vTENGOF2 "RAM value vTENGOF2" SWORD COMP_0228 1 100 -3276.8 3276.7 ECU_ADDRESS 0xFFFF168C READ_WRITE /end MEASUREMENT
/begin MEASUREMENT vTENGOFT "RAM value vTENGOFT" UWORD COMP_0328 1 100 0 399.99392106 ECU_ADDRESS 0xFFFF38BE READ_WRITE /end MEASUREMENT
/begin MEASUREMENT vTENGOFT2 "RAM value vTENGOFT2" SWORD COMP_0228 1 100 -3276.8 3276.7 ECU_ADDRESS 0xFFFF168E READ_WRITE /end MEASUREMENT
/begin MEASUREMENT vTENGOFTR "RAM value vTENGOFTR" SWORD COMP_0228 1 100 -3276.8 3276.7 ECU_ADDRESS 0xFFFF1690 READ_WRITE /end MEASUREMENT
/begin MEASUREMENT vTEPD11_S "RAM value vTEPD11_S" SWORD COMP_0228 1 100 -3276.8 3276.7 ECU_ADDRESS 0xFFFF305A READ_WRITE /end MEASUREMENT
/begin MEASUREMENT vTEPD12_S "RAM value vTEPD12_S" SWORD COMP_0228 1 100 -3276.8 3276.7 ECU_ADDRESS 0xFFFF305C READ_WRITE /end MEASUREMENT
/begin MEASUREMENT vTEPDID_S "RAM value vTEPDID_S" SWORD COMP_0228 1 100 -3276.8 3276.7 ECU_ADDRESS 0xFFFF14E2 READ_WRITE /end MEASUREMENT
/begin MEASUREMENT vTEPUMP "RAM value vTEPUMP" UWORD COMP_0196 1 100 0 6553.5 ECU_ADDRESS 0xFFFF0FA4 READ_WRITE /end MEASUREMENT
/begin MEASUREMENT vTEQ "RAM value vTEQ" ULONG COMP_0489_S 1 100 0 429496.7295 ECU_ADDRESS 0xFFFF2CCC READ_WRITE /end MEASUREMENT
/begin MEASUREMENT vTESMO2 "RAM value vTESMO2" UBYTE COMP_0062 1 100 0 1020 ECU_ADDRESS 0xFFFF2CD0 READ_WRITE /end MEASUREMENT
/begin MEASUREMENT vTEXB "RAM value vTEXB" UWORD COMP_0504 1 100 0 1023.984375 ECU_ADDRESS 0xFFFF2CD2 READ_WRITE /end MEASUREMENT
/begin MEASUREMENT vTEXB1 "RAM value vTEXB1" UWORD COMP_0504 1 100 0 1023.984375 ECU_ADDRESS 0xFFFF2CD4 READ_WRITE /end MEASUREMENT
/begin MEASUREMENT vTEXB2 "RAM value vTEXB2" UWORD COMP_0504 1 100 0 1023.984375 ECU_ADDRESS 0xFFFF2CD6 READ_WRITE /end MEASUREMENT
/begin MEASUREMENT vTEXST "RAM value vTEXST" UBYTE COMP_0062 1 100 0 1020 ECU_ADDRESS 0xFFFF2CD8 READ_WRITE /end MEASUREMENT
/begin MEASUREMENT vTEd "RAM value vTEd" UWORD COMP_0320 1 100 0 104856 ECU_ADDRESS 0xFFFF0F88 READ_WRITE /end MEASUREMENT
/begin MEASUREMENT vTF "RAM value vTF" UBYTE COMP_0054 1 100 0 5100 ECU_ADDRESS 0xFFFF20A7 READ_WRITE /end MEASUREMENT
/begin MEASUREMENT vTFA "RAM value vTFA" UBYTE COMP_0035 1 100 -50 205 ECU_ADDRESS 0xFFFF08F9 READ_WRITE /end MEASUREMENT
/begin MEASUREMENT vTFANG "RAM value vTFANG" UBYTE COMP_0035 1 100 -50 205 ECU_ADDRESS 0xFFFF4D9C READ_WRITE /end MEASUREMENT
/begin MEASUREMENT vTFATP "RAM value vTFATP" UBYTE COMP_0035 1 100 -50 205 ECU_ADDRESS 0xFFFF2CD9 READ_WRITE /end MEASUREMENT
/begin MEASUREMENT vTFBAKRTW "RAM value vTFBAKRTW" UBYTE COMP_0045 1 100 0 1.9921875 ECU_ADDRESS 0xFFFF2CDA READ_WRITE /end MEASUREMENT
/begin MEASUREMENT vTFBINTN "RAM value vTFBINTN" UWORD COMP_0013 1 100 0 65535 ECU_ADDRESS 0xFFFF0FA6 READ_WRITE /end MEASUREMENT
/begin MEASUREMENT vTFBYA00 "RAM value vTFBYA00" UWORD COMP_0057 1 100 0 3.999941832 ECU_ADDRESS 0xFFFF0FAA READ_WRITE /end MEASUREMENT
/begin MEASUREMENT vTFBYA03 "RAM value vTFBYA03" UWORD COMP_0217 1 100 0 3.999941832 ECU_ADDRESS 0xFFFF0998 READ_WRITE /end MEASUREMENT
/begin MEASUREMENT vTFBYA04 "RAM value vTFBYA04" UWORD COMP_0217 1 100 0 3.999941832 ECU_ADDRESS 0xFFFF099A READ_WRITE /end MEASUREMENT
/begin MEASUREMENT vTFBYA1 "RAM value vTFBYA1" UWORD COMP_0057 1 100 0 3.999941832 ECU_ADDRESS 0xFFFF0FAC READ_WRITE /end MEASUREMENT
/begin MEASUREMENT vTFBYA2 "RAM value vTFBYA2" UWORD COMP_0057 1 100 0 3.999941832 ECU_ADDRESS 0xFFFF0FAE READ_WRITE /end MEASUREMENT
/begin MEASUREMENT vTFBYA2N "RAM value vTFBYA2N" UWORD COMP_0057 1 100 0 3.999941832 ECU_ADDRESS 0xFFFF0FB0 READ_WRITE /end MEASUREMENT
/begin MEASUREMENT vTFBYA3 "RAM value vTFBYA3" UWORD COMP_0057 1 100 0 3.999941832 ECU_ADDRESS 0xFFFF099C READ_WRITE /end MEASUREMENT
/begin MEASUREMENT vTFBYA4 "RAM value vTFBYA4" UWORD COMP_0057 1 100 0 3.999941832 ECU_ADDRESS 0xFFFF099E READ_WRITE /end MEASUREMENT
/begin MEASUREMENT vTFBYAADV "RAM value vTFBYAADV" UWORD COMP_0217 1 100 0 3.999941832 ECU_ADDRESS 0xFFFF0FC4 READ_WRITE /end MEASUREMENT
/begin MEASUREMENT vTFBYAC "RAM value vTFBYAC" UWORD COMP_0057 1 100 0 3.999941832 ECU_ADDRESS 0xFFFF0FC6 READ_WRITE /end MEASUREMENT
/begin MEASUREMENT vTFBYAD "RAM value vTFBYAD" UWORD COMP_0057 1 100 0 3.999941832 ECU_ADDRESS 0xFFFF0FC8 READ_WRITE /end MEASUREMENT
/begin MEASUREMENT vTFBYADH "RAM value vTFBYADH" UWORD COMP_0057 1 100 0 3.999941832 ECU_ADDRESS 0xFFFF0FCA READ_WRITE /end MEASUREMENT
/begin MEASUREMENT vTFBYADR "RAM value vTFBYADR" UWORD COMP_0057 1 100 0 3.999941832 ECU_ADDRESS 0xFFFF0FCC READ_WRITE /end MEASUREMENT
/begin MEASUREMENT vTFBYAMK "RAM value vTFBYAMK" UWORD COMP_0217 1 100 0 3.999941832 ECU_ADDRESS 0xFFFF0FCE READ_WRITE /end MEASUREMENT
/begin MEASUREMENT vTFBYASTL "RAM value vTFBYASTL" UWORD COMP_0217 1 100 0 3.999941832 ECU_ADDRESS 0xFFFF0FF0 READ_WRITE /end MEASUREMENT
/begin MEASUREMENT vTFBYAX "RAM value vTFBYAX" UWORD COMP_0217 1 100 0 3.999941832 ECU_ADDRESS 0xFFFF0FF2 READ_WRITE /end MEASUREMENT
/begin MEASUREMENT vTFCDMAPZ "RAM value vTFCDMAPZ" UBYTE COMP_0014 1 100 0 2550 ECU_ADDRESS 0xFFFF0FF4 READ_WRITE /end MEASUREMENT
/begin MEASUREMENT vTFCNT "RAM value vTFCNT" UWORD COMP_0016 1 100 0 65535 ECU_ADDRESS 0xFFFF4D9E READ_WRITE /end MEASUREMENT
/begin MEASUREMENT vTFDACC "RAM value vTFDACC" SWORD COMP_0514_S 1 100 -32768 32767 ECU_ADDRESS 0xFFFF2CDC READ_WRITE /end MEASUREMENT
/begin MEASUREMENT vTFDCAN "RAM value vTFDCAN" SWORD COMP_0514_S 1 100 -32768 32767 ECU_ADDRESS 0xFFFF0FF6 READ_WRITE /end MEASUREMENT
/begin MEASUREMENT vTFDCAN_S "RAM value vTFDCAN_S" SWORD COMP_0621_S 1 100 -32768 32767 ECU_ADDRESS 0xFFFF14E4 READ_WRITE /end MEASUREMENT
/begin MEASUREMENT vTFDCC "RAM value vTFDCC" SWORD COMP_0514_S 1 100 -32768 32767 ECU_ADDRESS 0xFFFF2CDE READ_WRITE /end MEASUREMENT
/begin MEASUREMENT vTFDCOM "RAM value vTFDCOM" SWORD COMP_0514_S 1 100 -32768 32767 ECU_ADDRESS 0xFFFF2CE0 READ_WRITE /end MEASUREMENT
/begin MEASUREMENT vTFDCOMB "RAM value vTFDCOMB" SWORD COMP_0514_S 1 100 -32768 32767 ECU_ADDRESS 0xFFFF2CE2 READ_WRITE /end MEASUREMENT
/begin MEASUREMENT vTFDCOMF "RAM value vTFDCOMF" SWORD COMP_0514_S 1 100 -32768 32767 ECU_ADDRESS 0xFFFF2CE4 READ_WRITE /end MEASUREMENT
/begin MEASUREMENT vTFDCOMSL "RAM value vTFDCOMSL" SWORD COMP_0514_S 1 100 -32768 32767 ECU_ADDRESS 0xFFFF38C0 READ_WRITE /end MEASUREMENT
/begin MEASUREMENT vTFDPTD "RAM value vTFDPTD" SWORD COMP_0514_S 1 100 -32768 32767 ECU_ADDRESS 0xFFFF0FF8 READ_WRITE /end MEASUREMENT
/begin MEASUREMENT vTFDSL "RAM value vTFDSL" SWORD COMP_0514_S 1 100 -32768 32767 ECU_ADDRESS 0xFFFF2CE6 READ_WRITE /end MEASUREMENT
/begin MEASUREMENT vTFEND "RAM value vTFEND" UBYTE COMP_0035 1 100 -50 205 ECU_ADDRESS 0xFFFF441E READ_WRITE /end MEASUREMENT
/begin MEASUREMENT vTFEX "RAM value vTFEX" UBYTE COMP_0004 1 100 0 255 ECU_ADDRESS 0xFFFF38C2 READ_WRITE /end MEASUREMENT
/begin MEASUREMENT vTFHR "RAM value vTFHR" UWORD COMP_0023 1 100 0 327675 ECU_ADDRESS 0xFFFF38C4 READ_WRITE /end MEASUREMENT
/begin MEASUREMENT vTFHREX "RAM value vTFHREX" UBYTE COMP_0068 1 100 0 255 ECU_ADDRESS 0xFFFF38C6 READ_WRITE /end MEASUREMENT
/begin MEASUREMENT vTFINT "RAM value vTFINT" UBYTE COMP_0035 1 100 -50 205 ECU_ADDRESS 0xFFFF0858 READ_WRITE /end MEASUREMENT
/begin MEASUREMENT vTFINTD "RAM value vTFINTD" UBYTE COMP_0035 1 100 -50 205 ECU_ADDRESS 0xFFFF20A8 READ_WRITE /end MEASUREMENT
/begin MEASUREMENT vTFINTHR "RAM value vTFINTHR" UWORD COMP_0259_S 1 100 -50 13057 ECU_ADDRESS 0xFFFF3358 READ_WRITE /end MEASUREMENT
/begin MEASUREMENT vTFINTTS "RAM value vTFINTTS" UBYTE COMP_0004_S 1 100 -50 205 ECU_ADDRESS 0xFFFF2CE8 READ_WRITE /end MEASUREMENT
/begin MEASUREMENT vTFK "RAM value vTFK" UBYTE COMP_0356 1 100 -40 119.375 ECU_ADDRESS 0xFFFF08FA READ_WRITE /end MEASUREMENT
/begin MEASUREMENT vTFKINT "RAM value vTFKINT" UBYTE COMP_0356 1 100 -40 119.375 ECU_ADDRESS 0xFFFF1692 READ_WRITE /end MEASUREMENT
/begin MEASUREMENT vTFKK "RAM value vTFKK" UWORD COMP_0259_S 1 100 -50 13057 ECU_ADDRESS 0xFFFF20AA READ_WRITE /end MEASUREMENT
/begin MEASUREMENT vTFLST2 "RAM value vTFLST2" UWORD COMP_0259_S 1 100 -50 13057 ECU_ADDRESS 0xFFFF38C8 READ_WRITE /end MEASUREMENT
/begin MEASUREMENT vTFN "RAM value vTFN" UBYTE COMP_0035 1 100 -50 205 ECU_ADDRESS 0xFFFF1E67 READ_WRITE /end MEASUREMENT
/begin MEASUREMENT vTFNNEW "RAM value vTFNNEW" UBYTE COMP_0035 1 100 -50 205 ECU_ADDRESS 0xFFFF38CA READ_WRITE /end MEASUREMENT
/begin MEASUREMENT vTFOFI "RAM value vTFOFI" UWORD COMP_0259_S 1 100 -50 13057 ECU_ADDRESS 0xFFFF38CC READ_WRITE /end MEASUREMENT
/begin MEASUREMENT vTFSETH "RAM value vTFSETH" ULONG COMP_0320 1 100 0 6871947672 ECU_ADDRESS 0xFFFF0FFC READ_WRITE /end MEASUREMENT
/begin MEASUREMENT vTFSETH2 "RAM value vTFSETH2" ULONG COMP_0157_S 1 100 0 6871947672 ECU_ADDRESS 0xFFFF100C READ_WRITE /end MEASUREMENT
/begin MEASUREMENT vTFSETMIN "RAM value vTFSETMIN" UWORD COMP_0152_S 1 100 0 419424 ECU_ADDRESS 0xFFFF101C READ_WRITE /end MEASUREMENT
/begin MEASUREMENT vTFSETS "RAM value vTFSETS" ULONG COMP_0320 1 100 0 6871947672 ECU_ADDRESS 0xFFFF1020 READ_WRITE /end MEASUREMENT
/begin MEASUREMENT vTFSETS2 "RAM value vTFSETS2" ULONG COMP_0157_S 1 100 0 6871947672 ECU_ADDRESS 0xFFFF1030 READ_WRITE /end MEASUREMENT
/begin MEASUREMENT vTFST1 "RAM value vTFST1" UBYTE COMP_0003 1 100 0 255 ECU_ADDRESS 0xFFFF1040 READ_WRITE /end MEASUREMENT
/begin MEASUREMENT vTGABFE "RAM value vTGABFE" UWORD COMP_0453 1 100 0 131.07 ECU_ADDRESS 0xFFFF3BA2 READ_WRITE /end MEASUREMENT
/begin MEASUREMENT vTGABFEJG "RAM value vTGABFEJG" UWORD COMP_0453 1 100 0 131.07 ECU_ADDRESS 0xFFFF2CEA READ_WRITE /end MEASUREMENT
/begin MEASUREMENT vTGABFEMX "RAM value vTGABFEMX" UWORD COMP_0453 1 100 0 131.07 ECU_ADDRESS 0xFFFF2CEC READ_WRITE /end MEASUREMENT
/begin MEASUREMENT vTGADNV "RAM value vTGADNV" ULONG COMP_0028_S 1 100 0 0.167772159960938 ECU_ADDRESS 0xFFFF1044 READ_WRITE /end MEASUREMENT
/begin MEASUREMENT vTGADNVCM "RAM value vTGADNVCM" UWORD COMP_0028_S 1 100 0 2.5599609375E-06 ECU_ADDRESS 0xFFFF2CEE READ_WRITE /end MEASUREMENT
/begin MEASUREMENT vTGADNV_S "RAM value vTGADNV_S" ULONG COMP_0028_S 1 100 0 0.167772159960938 ECU_ADDRESS 0xFFFF14E8 READ_WRITE /end MEASUREMENT
/begin MEASUREMENT vTGAFCL "RAM value vTGAFCL" UWORD COMP_0453 1 100 0 131.07 ECU_ADDRESS 0xFFFF2CF0 READ_WRITE /end MEASUREMENT
/begin MEASUREMENT vTGAFCL0 "RAM value vTGAFCL0" UWORD COMP_0453 1 100 0 131.07 ECU_ADDRESS 0xFFFF2CF4 READ_WRITE /end MEASUREMENT
/begin MEASUREMENT vTGAFCMPf "RAM value vTGAFCMPf" UBYTE COMP_0004 1 100 0 255 ECU_ADDRESS 0xFFFF2CF6 READ_WRITE /end MEASUREMENT
/begin MEASUREMENT vTGAFTMP "RAM value vTGAFTMP" ULONG COMP_0346_S 1 100 0 2097.15092576989 ECU_ADDRESS 0xFFFF2CF8 READ_WRITE /end MEASUREMENT
/begin MEASUREMENT vTGALPRR "RAM value vTGALPRR" UBYTE COMP_0015 1 100 0 31.875 ECU_ADDRESS 0xFFFF4DA0 READ_WRITE /end MEASUREMENT
/begin MEASUREMENT vTGALTCUR "RAM value vTGALTCUR" UBYTE COMP_0045_S 1 100 0 255 ECU_ADDRESS 0xFFFF2CFC READ_WRITE /end MEASUREMENT
/begin MEASUREMENT vTGALTV "RAM value vTGALTV" UBYTE COMP_0033 1 100 0 20400 ECU_ADDRESS 0xFFFF2CFD READ_WRITE /end MEASUREMENT
/begin MEASUREMENT vTGALTV0 "RAM value vTGALTV0" UBYTE COMP_0033 1 100 0 20400 ECU_ADDRESS 0xFFFF2CFE READ_WRITE /end MEASUREMENT
/begin MEASUREMENT vTGALTV0K "RAM value vTGALTV0K" UWORD COMP_0054 1 100 0 1310700 ECU_ADDRESS 0xFFFF2D00 READ_WRITE /end MEASUREMENT
/begin MEASUREMENT vTGALTV2 "RAM value vTGALTV2" ULONG COMP_0622_S 1 100 0 858993459 ECU_ADDRESS 0xFFFF2D04 READ_WRITE /end MEASUREMENT
/begin MEASUREMENT vTGALTV20 "RAM value vTGALTV20" UWORD COMP_0054 1 100 0 1310700 ECU_ADDRESS 0xFFFF2D08 READ_WRITE /end MEASUREMENT
/begin MEASUREMENT vTGALTVZ "RAM value vTGALTVZ" UBYTE COMP_0033 1 100 0 20400 ECU_ADDRESS 0xFFFF2D0A READ_WRITE /end MEASUREMENT
/begin MEASUREMENT vTGAWGVL "RAM value vTGAWGVL" UWORD COMP_0378_S 1 100 0 0.0013107 ECU_ADDRESS 0xFFFF2D0C READ_WRITE /end MEASUREMENT
/begin MEASUREMENT vTGITACDF "RAM value vTGITACDF" UWORD COMP_0271 1 100 0 199.99696053 ECU_ADDRESS 0xFFFF2D0E READ_WRITE /end MEASUREMENT
/begin MEASUREMENT vTGITCFUL "RAM value vTGITCFUL" UBYTE COMP_0009 1 100 0 199.21875 ECU_ADDRESS 0xFFFF2D10 READ_WRITE /end MEASUREMENT
/begin MEASUREMENT vTGKUBTW "RAM value vTGKUBTW" UBYTE COMP_0045 1 100 0 1.9921875 ECU_ADDRESS 0xFFFF1048 READ_WRITE /end MEASUREMENT
/begin MEASUREMENT vTGM8E "RAM value vTGM8E" UBYTE COMP_0096 1 100 0 2550 ECU_ADDRESS 0xFFFF2D11 READ_WRITE /end MEASUREMENT
/begin MEASUREMENT vTGMFTBNB "RAM value vTGMFTBNB" UWORD COMP_0308_S 1 100 0 0.52428 ECU_ADDRESS 0xFFFF2D12 READ_WRITE /end MEASUREMENT
/begin MEASUREMENT vTGMFWG "RAM value vTGMFWG" UWORD COMP_0304_S 1 100 0 1.04856 ECU_ADDRESS 0xFFFF2D14 READ_WRITE /end MEASUREMENT
/begin MEASUREMENT vTGPACT "RAM value vTGPACT" UWORD COMP_0317_S 1 100 0 2047.96875 ECU_ADDRESS 0xFFFF2D16 READ_WRITE /end MEASUREMENT
/begin MEASUREMENT vTGPC0 "RAM value vTGPC0" UWORD COMP_0034_S 1 100 0 255.99609375 ECU_ADDRESS 0xFFFF2D18 READ_WRITE /end MEASUREMENT
/begin MEASUREMENT vTGPC1 "RAM value vTGPC1" UWORD COMP_0034_S 1 100 0 255.99609375 ECU_ADDRESS 0xFFFF2D1A READ_WRITE /end MEASUREMENT
/begin MEASUREMENT vTGPPART "RAM value vTGPPART" SWORD COMP_0623_S 1 100 -1.99999488 1.999933845 ECU_ADDRESS 0xFFFF2D1C READ_WRITE /end MEASUREMENT
/begin MEASUREMENT vTGQH0 "RAM value vTGQH0" UWORD COMP_0146 1 100 0 99.998480265 ECU_ADDRESS 0xFFFF104A READ_WRITE /end MEASUREMENT
/begin MEASUREMENT vTGQH0L "RAM value vTGQH0L" UWORD COMP_0624_S 1 100 0 100.26855 ECU_ADDRESS 0xFFFF104C READ_WRITE /end MEASUREMENT
/begin MEASUREMENT vTGQH0L_S "RAM value vTGQH0L_S" UWORD COMP_0146 1 100 0 99.998480265 ECU_ADDRESS 0xFFFF14EE READ_WRITE /end MEASUREMENT
/begin MEASUREMENT vTGQH0_S "RAM value vTGQH0_S" UWORD COMP_0146 1 100 0 99.998480265 ECU_ADDRESS 0xFFFF14EC READ_WRITE /end MEASUREMENT
/begin MEASUREMENT vTGRTO1 "RAM value vTGRTO1" UWORD COMP_0450 1 100 0 63.999056205 ECU_ADDRESS 0xFFFF104E READ_WRITE /end MEASUREMENT
/begin MEASUREMENT vTGRTO2 "RAM value vTGRTO2" UWORD COMP_0450 1 100 0 63.999056205 ECU_ADDRESS 0xFFFF1050 READ_WRITE /end MEASUREMENT
/begin MEASUREMENT vTGTCLP "RAM value vTGTCLP" UWORD COMP_0453 1 100 0 131.07 ECU_ADDRESS 0xFFFF2D20 READ_WRITE /end MEASUREMENT
/begin MEASUREMENT vTGTSW "RAM value vTGTSW" UWORD COMP_0453 1 100 0 131.07 ECU_ADDRESS 0xFFFF2D24 READ_WRITE /end MEASUREMENT
/begin MEASUREMENT vTGTVG1 "RAM value vTGTVG1" UBYTE COMP_0315 1 100 0 24.90075 ECU_ADDRESS 0xFFFF2D28 READ_WRITE /end MEASUREMENT
/begin MEASUREMENT vTGTVO "RAM value vTGTVO" UWORD COMP_0130 1 100 0 1802.2125 ECU_ADDRESS 0xFFFF3A84 READ_WRITE /end MEASUREMENT
/begin MEASUREMENT vTGTVODG "RAM value vTGTVODG" UWORD COMP_0130 1 100 0 1802.2125 ECU_ADDRESS 0xFFFF2D2E READ_WRITE /end MEASUREMENT
/begin MEASUREMENT vTGTVOGK "RAM value vTGTVOGK" UWORD COMP_0625_S 1 100 -14.08205 98.55623125 ECU_ADDRESS 0xFFFF323E READ_WRITE /end MEASUREMENT
/begin MEASUREMENT vTGTVOLM "RAM value vTGTVOLM" UWORD COMP_0625_S 1 100 -14.08205 98.55623125 ECU_ADDRESS 0xFFFF3240 READ_WRITE /end MEASUREMENT
/begin MEASUREMENT vTGTVOSPR "RAM value vTGTVOSPR" UWORD COMP_0005 1 100 0 7208.85 ECU_ADDRESS 0xFFFF38CE READ_WRITE /end MEASUREMENT
/begin MEASUREMENT vTGTVOZ "RAM value vTGTVOZ" UWORD COMP_0130 1 100 0 1802.2125 ECU_ADDRESS 0xFFFF2D30 READ_WRITE /end MEASUREMENT
/begin MEASUREMENT vTGTVO_B "RAM value vTGTVO_B" UWORD COMP_0130 1 100 0 1802.2125 ECU_ADDRESS 0xFFFF2D2A READ_WRITE /end MEASUREMENT
/begin MEASUREMENT vTGTVO_S "RAM value vTGTVO_S" UWORD COMP_0130 1 100 0 1802.2125 ECU_ADDRESS 0xFFFF3060 READ_WRITE /end MEASUREMENT
/begin MEASUREMENT vTGTV_S "RAM value vTGTV_S" UWORD COMP_0130 1 100 0 1802.2125 ECU_ADDRESS 0xFFFF305E READ_WRITE /end MEASUREMENT
/begin MEASUREMENT vTGX1 "RAM value vTGX1" SWORD COMP_0626_S 1 100 -1966.08 1966.02 ECU_ADDRESS 0xFFFF1052 READ_WRITE /end MEASUREMENT
/begin MEASUREMENT vTHCHGCNT "RAM value vTHCHGCNT" UBYTE COMP_0016 1 100 0 255 ECU_ADDRESS 0xFFFF0809 READ_WRITE /end MEASUREMENT
/begin MEASUREMENT vTHCNT "RAM value vTHCNT" UBYTE COMP_0016 1 100 0 255 ECU_ADDRESS 0xFFFF2D46 READ_WRITE /end MEASUREMENT
/begin MEASUREMENT vTHMOCNT "RAM value vTHMOCNT" UWORD COMP_0016 1 100 0 65535 ECU_ADDRESS 0xFFFF4DA8 READ_WRITE /end MEASUREMENT
/begin MEASUREMENT vTHOKI "RAM value vTHOKI" UWORD COMP_0196 1 100 0 6553.5 ECU_ADDRESS 0xFFFF1B54 READ_WRITE /end MEASUREMENT
/begin MEASUREMENT vTHOKIS "RAM value vTHOKIS" SWORD COMP_0228 1 100 -3276.8 3276.7 ECU_ADDRESS 0xFFFF1B56 READ_WRITE /end MEASUREMENT
/begin MEASUREMENT vTHRTO "RAM value vTHRTO" UWORD COMP_0410 1 100 0 99.9985458 ECU_ADDRESS 0xFFFF1056 READ_WRITE /end MEASUREMENT
/begin MEASUREMENT vTHTIMER "RAM value vTHTIMER" UWORD COMP_0040_S 1 100 0 655.35 ECU_ADDRESS 0xFFFF2D48 READ_WRITE /end MEASUREMENT
/begin MEASUREMENT vTHTWLMT "RAM value vTHTWLMT" UWORD COMP_0226 1 100 -3276.8 3276.7 ECU_ADDRESS 0xFFFF1058 READ_WRITE /end MEASUREMENT
/begin MEASUREMENT vTICFLIM "RAM value vTICFLIM" UWORD COMP_0271 1 100 0 199.99696053 ECU_ADDRESS 0xFFFF2D4A READ_WRITE /end MEASUREMENT
/begin MEASUREMENT vTICFULM "RAM value vTICFULM" UWORD COMP_0271 1 100 0 199.99696053 ECU_ADDRESS 0xFFFF2D4C READ_WRITE /end MEASUREMENT
/begin MEASUREMENT vTICHG "RAM value vTICHG" UWORD COMP_0320 1 100 0 104856 ECU_ADDRESS 0xFFFF105A READ_WRITE /end MEASUREMENT
/begin MEASUREMENT vTICTNG1 "RAM value vTICTNG1" UWORD COMP_0158_S 1 100 -50 8141.875 ECU_ADDRESS 0xFFFF4DAA READ_WRITE /end MEASUREMENT
/begin MEASUREMENT vTICTNG12 "RAM value vTICTNG12" UWORD COMP_0158_S 1 100 -50 8141.875 ECU_ADDRESS 0xFFFF4DAC READ_WRITE /end MEASUREMENT
/begin MEASUREMENT vTICTNG2 "RAM value vTICTNG2" UWORD COMP_0158_S 1 100 -50 8141.875 ECU_ADDRESS 0xFFFF4DAE READ_WRITE /end MEASUREMENT
/begin MEASUREMENT vTICTNG22 "RAM value vTICTNG22" UWORD COMP_0158_S 1 100 -50 8141.875 ECU_ADDRESS 0xFFFF4DB0 READ_WRITE /end MEASUREMENT
/begin MEASUREMENT vTIM "RAM value vTIM" UWORD COMP_0098 1 100 0 104856 ECU_ADDRESS 0xFFFF105C READ_WRITE /end MEASUREMENT
/begin MEASUREMENT vTIM40MS "RAM value vTIM40MS" UBYTE COMP_0016 1 100 0 255 ECU_ADDRESS 0xFFFF2D4E READ_WRITE /end MEASUREMENT
/begin MEASUREMENT vTIMCLK "RAM value vTIMCLK" UBYTE COMP_0068 1 100 0 255 ECU_ADDRESS 0xFFFF38D0 READ_WRITE /end MEASUREMENT
/begin MEASUREMENT vTIMDOS "RAM value vTIMDOS" UBYTE COMP_0013 1 100 0 255 ECU_ADDRESS 0xFFFF2D4F READ_WRITE /end MEASUREMENT
/begin MEASUREMENT vTIMEIC "RAM value vTIMEIC" UWORD COMP_0395_S 1 100 0 5.2428 ECU_ADDRESS 0xFFFF2D50 READ_WRITE /end MEASUREMENT
/begin MEASUREMENT vTIMERH "RAM value vTIMERH" UWORD COMP_0040_S 1 100 0 655.35 ECU_ADDRESS 0xFFFF2D52 READ_WRITE /end MEASUREMENT
/begin MEASUREMENT vTIMERL "RAM value vTIMERL" UWORD COMP_0040_S 1 100 0 655.35 ECU_ADDRESS 0xFFFF2D54 READ_WRITE /end MEASUREMENT
/begin MEASUREMENT vTIMES "RAM value vTIMES" UBYTE COMP_0096 1 100 0 2550 ECU_ADDRESS 0xFFFF105E READ_WRITE /end MEASUREMENT
/begin MEASUREMENT vTIMHPRA "RAM value vTIMHPRA" UBYTE COMP_0190 1 100 0 510 ECU_ADDRESS 0xFFFF2D56 READ_WRITE /end MEASUREMENT
/begin MEASUREMENT vTIMHPRB "RAM value vTIMHPRB" UBYTE COMP_0190 1 100 0 510 ECU_ADDRESS 0xFFFF2D57 READ_WRITE /end MEASUREMENT
/begin MEASUREMENT vTIMING "RAM value vTIMING" UBYTE COMP_0053 1 100 0 255 ECU_ADDRESS 0xFFFF38D1 READ_WRITE /end MEASUREMENT
/begin MEASUREMENT vTIMINT "RAM value vTIMINT" UBYTE COMP_0096 1 100 0 2550 ECU_ADDRESS 0xFFFF2D58 READ_WRITE /end MEASUREMENT
/begin MEASUREMENT vTIMON "RAM value vTIMON" ULONG COMP_0320 1 100 0 6871947672 ECU_ADDRESS 0xFFFF1060 READ_WRITE /end MEASUREMENT
/begin MEASUREMENT vTIMONIS "RAM value vTIMONIS" ULONG COMP_0157_S 1 100 0 6871947672 ECU_ADDRESS 0xFFFF19E4 READ_WRITE /end MEASUREMENT
/begin MEASUREMENT vTIN3 "RAM value vTIN3" ULONG COMP_0068 1 100 0 4294967295 ECU_ADDRESS 0xFFFF3244 READ_WRITE /end MEASUREMENT
/begin MEASUREMENT vTINFLIM "RAM value vTINFLIM" UWORD COMP_0271 1 100 0 199.99696053 ECU_ADDRESS 0xFFFF2D5A READ_WRITE /end MEASUREMENT
/begin MEASUREMENT vTINFULMT "RAM value vTINFULMT" UWORD COMP_0271 1 100 0 199.99696053 ECU_ADDRESS 0xFFFF2D5C READ_WRITE /end MEASUREMENT
/begin MEASUREMENT vTINT "RAM value vTINT" ULONG COMP_0376 1 100 0 429496729.5 ECU_ADDRESS 0xFFFF1550 READ_WRITE /end MEASUREMENT
/begin MEASUREMENT vTIP0 "RAM value vTIP0" UWORD COMP_0320 1 100 0 104856 ECU_ADDRESS 0xFFFF1064 READ_WRITE /end MEASUREMENT
/begin MEASUREMENT vTIPSd "RAM value vTIPSd" UWORD COMP_0320 1 100 0 104856 ECU_ADDRESS 0xFFFF1066 READ_WRITE /end MEASUREMENT
/begin MEASUREMENT vTISETH "RAM value vTISETH" ULONG COMP_0320 1 100 0 6871947672 ECU_ADDRESS 0xFFFF106C READ_WRITE /end MEASUREMENT
/begin MEASUREMENT vTISETH2 "RAM value vTISETH2" ULONG COMP_0157_S 1 100 0 6871947672 ECU_ADDRESS 0xFFFF107C READ_WRITE /end MEASUREMENT
/begin MEASUREMENT vTISETS "RAM value vTISETS" ULONG COMP_0320 1 100 0 6871947672 ECU_ADDRESS 0xFFFF108C READ_WRITE /end MEASUREMENT
/begin MEASUREMENT vTISTd "RAM value vTISTd" ULONG COMP_0320 1 100 0 6871947672 ECU_ADDRESS 0xFFFF1B58 READ_WRITE /end MEASUREMENT
/begin MEASUREMENT vTISTdS "RAM value vTISTdS" ULONG COMP_0320 1 100 0 6871947672 ECU_ADDRESS 0xFFFF1B5C READ_WRITE /end MEASUREMENT
/begin MEASUREMENT vTITM "RAM value vTITM" UWORD COMP_0190 1 100 0 131070 ECU_ADDRESS 0xFFFF109C READ_WRITE /end MEASUREMENT
/begin MEASUREMENT vTITMH "RAM value vTITMH" UBYTE COMP_0190 1 100 0 510 ECU_ADDRESS 0xFFFF109E READ_WRITE /end MEASUREMENT
/begin MEASUREMENT vTITMHF "RAM value vTITMHF" UWORD COMP_0627_S 1 100 0 511.9921875 ECU_ADDRESS 0xFFFF10A0 READ_WRITE /end MEASUREMENT
/begin MEASUREMENT vTITMHFC "RAM value vTITMHFC" UWORD COMP_0627_S 1 100 0 511.9921875 ECU_ADDRESS 0xFFFF10A2 READ_WRITE /end MEASUREMENT
/begin MEASUREMENT vTITMHFZ "RAM value vTITMHFZ" UWORD COMP_0627_S 1 100 0 511.9921875 ECU_ADDRESS 0xFFFF10A4 READ_WRITE /end MEASUREMENT
/begin MEASUREMENT vTITMS "RAM value vTITMS" UBYTE COMP_0190 1 100 0 510 ECU_ADDRESS 0xFFFF10A6 READ_WRITE /end MEASUREMENT
/begin MEASUREMENT vTITMSF "RAM value vTITMSF" UWORD COMP_0627_S 1 100 0 511.9921875 ECU_ADDRESS 0xFFFF10A8 READ_WRITE /end MEASUREMENT
/begin MEASUREMENT vTITMSF0 "RAM value vTITMSF0" UWORD COMP_0627_S 1 100 0 511.9921875 ECU_ADDRESS 0xFFFF10AA READ_WRITE /end MEASUREMENT
/begin MEASUREMENT vTITMSFC "RAM value vTITMSFC" UWORD COMP_0627_S 1 100 0 511.9921875 ECU_ADDRESS 0xFFFF10AC READ_WRITE /end MEASUREMENT
/begin MEASUREMENT vTITMSFZ "RAM value vTITMSFZ" UWORD COMP_0627_S 1 100 0 511.9921875 ECU_ADDRESS 0xFFFF10AE READ_WRITE /end MEASUREMENT
/begin MEASUREMENT vTIVTDTW "RAM value vTIVTDTW" UBYTE COMP_0003 1 100 0 255 ECU_ADDRESS 0xFFFF2D5E READ_WRITE /end MEASUREMENT
/begin MEASUREMENT vTK1J2MX "RAM value vTK1J2MX" UBYTE COMP_0014 1 100 0 2550 ECU_ADDRESS 0xFFFF4F50 READ_WRITE /end MEASUREMENT
/begin MEASUREMENT vTK1J4MX "RAM value vTK1J4MX" UBYTE COMP_0014 1 100 0 2550 ECU_ADDRESS 0xFFFF4F51 READ_WRITE /end MEASUREMENT
/begin MEASUREMENT vTK2B10X "RAM value vTK2B10X" UBYTE COMP_0030 1 100 0 255 ECU_ADDRESS 0xFFFF4E48 READ_WRITE /end MEASUREMENT
/begin MEASUREMENT vTK2J10X "RAM value vTK2J10X" UBYTE COMP_0030 1 100 0 255 ECU_ADDRESS 0xFFFF4E49 READ_WRITE /end MEASUREMENT
/begin MEASUREMENT vTK2J2MX "RAM value vTK2J2MX" UBYTE COMP_0030 1 100 0 255 ECU_ADDRESS 0xFFFF4E4A READ_WRITE /end MEASUREMENT
/begin MEASUREMENT vTK2J4MX "RAM value vTK2J4MX" UBYTE COMP_0030 1 100 0 255 ECU_ADDRESS 0xFFFF4E4B READ_WRITE /end MEASUREMENT
/begin MEASUREMENT vTKTEXD "RAM value vTKTEXD" UBYTE COMP_0096 1 100 0 2550 ECU_ADDRESS 0xFFFF2D62 READ_WRITE /end MEASUREMENT
/begin MEASUREMENT vTLAMBDA "RAM value vTLAMBDA" UWORD COMP_0217 1 100 0 3.999941832 ECU_ADDRESS 0xFFFF2D64 READ_WRITE /end MEASUREMENT
/begin MEASUREMENT vTLAMBDA_S "RAM value vTLAMBDA_S" UWORD COMP_0217 1 100 0 3.999941832 ECU_ADDRESS 0xFFFF3062 READ_WRITE /end MEASUREMENT
/begin MEASUREMENT vTLRCNT "RAM value vTLRCNT" UBYTE COMP_0016 1 100 0 255 ECU_ADDRESS 0xFFFF2D66 READ_WRITE /end MEASUREMENT
/begin MEASUREMENT vTM2CONT "RAM value vTM2CONT" UBYTE COMP_0014 1 100 0 2550 ECU_ADDRESS 0xFFFF38D2 READ_WRITE /end MEASUREMENT
/begin MEASUREMENT vTM500ms "RAM value vTM500ms" UBYTE COMP_0008 1 100 0 25500 ECU_ADDRESS 0xFFFF38D3 READ_WRITE /end MEASUREMENT
/* COMPU_METHOD --------------------------------------------------------- */
/begin COMPU_METHOD COMP_0017 "1deg" RAT_FUNC "%8.2" "deg" COEFFS 0 1 0 0 0 1 /end COMPU_METHOD
/begin COMPU_METHOD COMP_0004 "1－" RAT_FUNC "%8.2" "－" COEFFS 0 1 0 0 0 1 /end COMPU_METHOD
/begin COMPU_METHOD COMP_0068 "1-" RAT_FUNC "%8.2" "-" COEFFS 0 1 0 0 0 1 /end COMPU_METHOD
/begin COMPU_METHOD COMP_0002_S "1Pa" RAT_FUNC "%8.2" "Pa" COEFFS 0 1 0 0 0 1 /end COMPU_METHOD
/begin COMPU_METHOD COMP_0013 "1s" RAT_FUNC "%8.2" "s" COEFFS 0 1 0 0 0 1 /end COMPU_METHOD
/begin COMPU_METHOD COMP_0014 "10ms" RAT_FUNC "%8.2" "ms" COEFFS 0 1 0 0 0 10 /end COMPU_METHOD
/begin COMPU_METHOD COMP_0045 "1/128-" RAT_FUNC "%8.4" "-" COEFFS 0 1 0 0 0 0.0078125 /end COMPU_METHOD
/begin COMPU_METHOD COMP_0009 "100/128%" RAT_FUNC "%8.2" "%" COEFFS 0 1 0 0 0 0.78125 /end COMPU_METHOD
/begin COMPU_METHOD COMP_0000 "25rpm" RAT_FUNC "%8.2" "rpm" COEFFS 0 1 0 0 0 25 /end COMPU_METHOD
/begin COMPU_METHOD COMP_0020 "50rpm" RAT_FUNC "%8.2" "rpm" COEFFS 0 1 0 0 0 50 /end COMPU_METHOD
/begin COMPU_METHOD COMP_0004_S "X-50degC" RAT_FUNC "%8.2" "degC" COEFFS 0 1 50 0 0 1 /end COMPU_METHOD
/begin COMPU_METHOD COMP_0388 "0.1-" RAT_FUNC "%8.2" "-" COEFFS 0 1 0 0 0 0.1 /end COMPU_METHOD
/begin COMPU_METHOD COMP_0373 "1/100-" RAT_FUNC "%8.3" "-" COEFFS 0 1 0 0 0 0.01 /end COMPU_METHOD
/begin COMPU_METHOD COMP_0003 "1℃" RAT_FUNC "%8.2" "℃" COEFFS 0 1 0 0 0 1 /end COMPU_METHOD
/begin COMPU_METHOD COMP_0035 "X-50℃" RAT_FUNC "%8.2" "℃" COEFFS 0 1 50 0 0 1 /end COMPU_METHOD
/begin COMPU_METHOD COMP_0453 "0.002-" RAT_FUNC "%8.4" "-" COEFFS 0 1 0 0 0 0.002 /end COMPU_METHOD
/begin COMPU_METHOD COMP_0005 "0.11deg" RAT_FUNC "%8.2" "deg" COEFFS 0 1 0 0 0 0.11 /end COMPU_METHOD
/begin COMPU_METHOD COMP_0006 "12.5rpm" RAT_FUNC "%8.2" "rpm" COEFFS 0 1 0 0 0 12.5 /end COMPU_METHOD
/begin COMPU_METHOD COMP_0008 "100ms" RAT_FUNC "%8.2" "ms" COEFFS 0 1 0 0 0 100 /end COMPU_METHOD
/begin COMPU_METHOD COMP_0007 "2km/h" RAT_FUNC "%8.2" "km/h" COEFFS 0 1 0 0 0 2 /end COMPU_METHOD
/begin COMPU_METHOD COMP_0047 "0.5%" RAT_FUNC "%8.2" "%" COEFFS 0 1 0 0 0 0.5 /end COMPU_METHOD
/begin COMPU_METHOD COMP_0486 "20/256mv" RAT_FUNC "%8.3" "mv" COEFFS 0 1 0 0 0 0.078125 /end COMPU_METHOD
/begin COMPU_METHOD COMP_0018 "1deg" RAT_FUNC "%8.2" "deg" COEFFS 0 1 0 0 0 1 /end COMPU_METHOD
/begin COMPU_METHOD COMP_0019 "1degCA" RAT_FUNC "%8.2" "degCA" COEFFS 0 1 0 0 0 1 /end COMPU_METHOD
/begin COMPU_METHOD COMP_0081 "1/256deg" RAT_FUNC "%8.4" "deg" COEFFS 0 1 0 0 0 0.00390625 /end COMPU_METHOD
/begin COMPU_METHOD COMP_0217 "1/16384-" RAT_FUNC "%8.6" "-" COEFFS 0 1 0 0 0 0.0000610352 /end COMPU_METHOD
/begin COMPU_METHOD COMP_0023 "5mV" RAT_FUNC "%8.2" "mV" COEFFS 0 1 0 0 0 5 /end COMPU_METHOD
/begin COMPU_METHOD COMP_0250 "4ms" RAT_FUNC "%8.2" "ms" COEFFS 0 1 0 0 0 4 /end COMPU_METHOD
/begin COMPU_METHOD COMP_0033 "80mV" RAT_FUNC "%8.2" "mV" COEFFS 0 1 0 0 0 80 /end COMPU_METHOD
/begin COMPU_METHOD COMP_0027 "1%" RAT_FUNC "%8.2" "%" COEFFS 0 1 0 0 0 1 /end COMPU_METHOD
/begin COMPU_METHOD COMP_0015_S "0.1sec" RAT_FUNC "%8.2" "sec" COEFFS 0 1 0 0 0 0.1 /end COMPU_METHOD
/begin COMPU_METHOD COMP_0017_S "0.01sec" RAT_FUNC "%8.3" "sec" COEFFS 0 1 0 0 0 0.01 /end COMPU_METHOD
/begin COMPU_METHOD COMP_0049 "1sec" RAT_FUNC "%8.2" "sec" COEFFS 0 1 0 0 0 1 /end COMPU_METHOD
/begin COMPU_METHOD COMP_0032 "1/256－" RAT_FUNC "%8.4" "－" COEFFS 0 1 0 0 0 0.00390625 /end COMPU_METHOD
/begin COMPU_METHOD COMP_0063 "1/256-" RAT_FUNC "%8.4" "-" COEFFS 0 1 0 0 0 0.00390625 /end COMPU_METHOD
/begin COMPU_METHOD COMP_0015 "0.125－" RAT_FUNC "%8.2" "－" COEFFS 0 1 0 0 0 0.125 /end COMPU_METHOD
/begin COMPU_METHOD COMP_0093 "2.5mV" RAT_FUNC "%8.2" "mV" COEFFS 0 1 0 0 0 2.5 /end COMPU_METHOD
/begin COMPU_METHOD COMP_0019_S "1/255-" RAT_FUNC "%8.4" "-" COEFFS 0 1 0 0 0 0.003921569 /end COMPU_METHOD
/begin COMPU_METHOD COMP_0030 "1回" RAT_FUNC "%8.2" "回" COEFFS 0 1 0 0 0 1 /end COMPU_METHOD
/begin COMPU_METHOD COMP_0020_S "0.002-" RAT_FUNC "%8.4" "-" COEFFS 0 1 0 0 0 0.002 /end COMPU_METHOD
/begin COMPU_METHOD COMP_0016 "1count" RAT_FUNC "%8.2" "count" COEFFS 0 1 0 0 0 1 /end COMPU_METHOD
/begin COMPU_METHOD COMP_0443 "1rpm" RAT_FUNC "%8.2" "rpm" COEFFS 0 1 0 0 0 1 /end COMPU_METHOD
/begin COMPU_METHOD COMP_0228 "0.1Nm" RAT_FUNC "%8.2" "Nm" COEFFS 0 1 0 0 0 0.1 /end COMPU_METHOD
/begin COMPU_METHOD COMP_0263 "1-" RAT_FUNC "%8.2" "-" COEFFS 0 1 0 0 0 1 /end COMPU_METHOD
/begin COMPU_METHOD COMP_0256 "64/128degCA" RAT_FUNC "%8.2" "degCA" COEFFS 0 1 64 0 0 0.5 /end COMPU_METHOD
/begin COMPU_METHOD COMP_0031 "1/256%" RAT_FUNC "%8.4" "%" COEFFS 0 1 0 0 0 0.00390625 /end COMPU_METHOD
/begin COMPU_METHOD COMP_0028_S "3.90625E-11cm**2/rp" RAT_FUNC "%8.6" "cm**2/rp" COEFFS 0 1 0 0 0 3.90625E-11 /end COMPU_METHOD
/begin COMPU_METHOD COMP_0065 "3.125rpm" RAT_FUNC "%8.2" "rpm" COEFFS 0 1 0 0 0 3.125 /end COMPU_METHOD
/begin COMPU_METHOD COMP_0048 "64/128degCA" RAT_FUNC "%8.2" "degCA" COEFFS 0 1 0 0 0 0.5 /end COMPU_METHOD
/begin COMPU_METHOD COMP_0032_S "0.125%" RAT_FUNC "%8.2" "%" COEFFS 0 1 0 0 0 0.125 /end COMPU_METHOD
/begin COMPU_METHOD COMP_0034_S "2^-8kPa" RAT_FUNC "%8.4" "kPa" COEFFS 0 1 0 0 0 0.00390625 /end COMPU_METHOD
/begin COMPU_METHOD COMP_0220 "1l/min" RAT_FUNC "%8.2" "l/min" COEFFS 0 1 0 0 0 1 /end COMPU_METHOD
/begin COMPU_METHOD COMP_0039_S "1Pa" RAT_FUNC "%8.2" "Pa" COEFFS 0 1 -60000 0 0 1 /end COMPU_METHOD
/begin COMPU_METHOD COMP_0040_S "0.01s" RAT_FUNC "%8.3" "s" COEFFS 0 1 0 0 0 0.01 /end COMPU_METHOD
/begin COMPU_METHOD COMP_0041 "0.0008cm^2" RAT_FUNC "%8.5" "cm^2" COEFFS 0 1 0 0 0 0.0008 /end COMPU_METHOD
/begin COMPU_METHOD COMP_0042 "0.0008cm**2" RAT_FUNC "%8.5" "cm**2" COEFFS 0 1 0 0 0 0.0008 /end COMPU_METHOD
/begin COMPU_METHOD COMP_0045_S "1A" RAT_FUNC "%8.2" "A" COEFFS 0 1 0 0 0 1 /end COMPU_METHOD
/begin COMPU_METHOD COMP_0054 "20mV" RAT_FUNC "%8.2" "mV" COEFFS 0 1 0 0 0 20 /end COMPU_METHOD
/begin COMPU_METHOD COMP_0450 "1/1024-" RAT_FUNC "%8.5" "-" COEFFS 0 1 0 0 0 0.000976563 /end COMPU_METHOD
/begin COMPU_METHOD COMP_0057_S "0.1deg" RAT_FUNC "%8.2" "deg" COEFFS 0 1 0 0 0 0.1 /end COMPU_METHOD
/begin COMPU_METHOD COMP_0290 "1/65536-" RAT_FUNC "%8.6" "-" COEFFS 0 1 0 0 0 0.0000152588 /end COMPU_METHOD
/begin COMPU_METHOD COMP_0144 "1/2048ms" RAT_FUNC "%8.5" "ms" COEFFS 0 1 0 0 0 0.000488281 /end COMPU_METHOD
/begin COMPU_METHOD COMP_0062_S "1ms/2^(ST" RAT_FUNC "%8.2" "ms/2^(ST" COEFFS 0 1 0 0 0 1 /end COMPU_METHOD
/begin COMPU_METHOD COMP_0064_S "1N" RAT_FUNC "%8.2" "N" COEFFS 0 1 0 0 0 1 /end COMPU_METHOD
/begin COMPU_METHOD COMP_0071_S "0.000000625m" RAT_FUNC "%8.6" "m" COEFFS 0 1 0 0 0 0.000000625 /end COMPU_METHOD
/begin COMPU_METHOD COMP_0021 "100/256%" RAT_FUNC "%8.2" "%" COEFFS 0 1 0 0 0 0.390625 /end COMPU_METHOD
/begin COMPU_METHOD COMP_0078_S "1/256L" RAT_FUNC "%8.4" "L" COEFFS 0 1 0 0 0 0.00390625 /end COMPU_METHOD
/begin COMPU_METHOD COMP_0091 "ﾌﾗｸﾞﾌﾗｸﾞ" RAT_FUNC "%8.2" "ﾌﾗｸﾞ" COEFFS 0 1 0 0 0 1 /end COMPU_METHOD
/begin COMPU_METHOD COMP_0095 "400/256%" RAT_FUNC "%8.2" "%" COEFFS 0 1 0 0 0 1.5625 /end COMPU_METHOD
/begin COMPU_METHOD COMP_0082_S "1rpm/50ms" RAT_FUNC "%8.2" "rpm/50ms" COEFFS 0 1 0 0 0 1 /end COMPU_METHOD
/begin COMPU_METHOD COMP_0096 "10s" RAT_FUNC "%8.2" "s" COEFFS 0 1 0 0 0 10 /end COMPU_METHOD
/begin COMPU_METHOD COMP_0051 "1L/min" RAT_FUNC "%8.2" "L/min" COEFFS 0 1 0 0 0 1 /end COMPU_METHOD
/begin COMPU_METHOD COMP_0456 "1/(256×128)-" RAT_FUNC "%8.6" "-" COEFFS 0 1 0 0 0 0.0000305176 /end COMPU_METHOD
/begin COMPU_METHOD COMP_0101 "1/65536－" RAT_FUNC "%8.6" "－" COEFFS 0 1 0 0 0 0.0000152588 /end COMPU_METHOD
/begin COMPU_METHOD COMP_0092_S "0.025kg/h" RAT_FUNC "%8.3" "kg/h" COEFFS 0 1 0 0 0 0.025 /end COMPU_METHOD
/begin COMPU_METHOD COMP_0156 "1L" RAT_FUNC "%8.2" "L" COEFFS 0 1 0 0 0 1 /end COMPU_METHOD
/begin COMPU_METHOD COMP_0308 "1℃" RAT_FUNC "%8.2" "℃" COEFFS 0 1 0 0 0 1 /end COMPU_METHOD
/begin COMPU_METHOD COMP_0050 "5/64mV" RAT_FUNC "%8.3" "mV" COEFFS 0 1 0 0 0 0.078125 /end COMPU_METHOD
/begin COMPU_METHOD COMP_0283 "1flag" RAT_FUNC "%8.2" "flag" COEFFS 0 1 0 0 0 1 /end COMPU_METHOD
/begin COMPU_METHOD COMP_0196 "0.1Nm" RAT_FUNC "%8.2" "Nm" COEFFS 0 1 0 0 0 0.1 /end COMPU_METHOD
/begin COMPU_METHOD COMP_0057 "1/16384－" RAT_FUNC "%8.6" "－" COEFFS 0 1 0 0 0 0.0000610352 /end COMPU_METHOD
/begin COMPU_METHOD COMP_0104 "10mV" RAT_FUNC "%8.2" "mV" COEFFS 0 1 0 0 0 10 /end COMPU_METHOD
/begin COMPU_METHOD COMP_0190 "2deg" RAT_FUNC "%8.2" "deg" COEFFS 0 1 0 0 0 2 /end COMPU_METHOD
/begin COMPU_METHOD COMP_0141 "50/256%" RAT_FUNC "%8.2" "%" COEFFS 0 1 0 0 0 0.1953125 /end COMPU_METHOD
/begin COMPU_METHOD COMP_0115_S "0.0001degC" RAT_FUNC "%8.5" "degC" COEFFS 0 1 0 0 0 0.0001 /end COMPU_METHOD
/begin COMPU_METHOD COMP_0295 "100msec" RAT_FUNC "%8.2" "msec" COEFFS 0 1 0 0 0 100 /end COMPU_METHOD
/begin COMPU_METHOD COMP_0116_S "1/128*256-" RAT_FUNC "%8.6" "-" COEFFS 0 1 0 0 0 0.000030517 /end COMPU_METHOD
/begin COMPU_METHOD COMP_0120_S "0.25kPa" RAT_FUNC "%8.2" "kPa" COEFFS 0 1 0 0 0 0.25 /end COMPU_METHOD
/begin COMPU_METHOD COMP_0277 "1L/min" RAT_FUNC "%8.2" "L/min" COEFFS 0 1 0 0 0 1 /end COMPU_METHOD
/begin COMPU_METHOD COMP_0164 "0.000305MPa" RAT_FUNC "%8.5" "MPa" COEFFS 0 1 0 0 0 0.000305 /end COMPU_METHOD
/begin COMPU_METHOD COMP_0124_S "0.25X-48deg" RAT_FUNC "%8.2" "deg" COEFFS 0 1 48 0 0 0.25 /end COMPU_METHOD
/begin COMPU_METHOD COMP_0312 "0.5/256L" RAT_FUNC "%8.4" "L" COEFFS 0 1 0 0 0 0.001953125 /end COMPU_METHOD
/begin COMPU_METHOD COMP_0146 "100/256/256%" RAT_FUNC "%8.4" "%" COEFFS 0 1 0 0 0 0.001525879 /end COMPU_METHOD
/begin COMPU_METHOD COMP_0139_S "1/16Ω" RAT_FUNC "%8.3" "Ω" COEFFS 0 1 0 0 0 0.0625 /end COMPU_METHOD
/begin COMPU_METHOD COMP_0144_S "3.6_*_2^-22km/h" RAT_FUNC "%8.6" "km/h" COEFFS 0 1 0 0 0 0.000000858307 /end COMPU_METHOD
/begin COMPU_METHOD COMP_0328 "100/(64*256)%" RAT_FUNC "%8.4" "%" COEFFS 0 1 0 0 0 0.006103516 /end COMPU_METHOD
/begin COMPU_METHOD COMP_0152_S "6.4μs" RAT_FUNC "%8.2" "μs" COEFFS 0 1 0 0 0 6.4 /end COMPU_METHOD
/begin COMPU_METHOD COMP_0157_S "1.6μs" RAT_FUNC "%8.2" "μs" COEFFS 0 1 0 0 0 1.6 /end COMPU_METHOD
/begin COMPU_METHOD COMP_0158_S "0.125X-50℃" RAT_FUNC "%8.2" "℃" COEFFS 0 1 50 0 0 0.125 /end COMPU_METHOD
/begin COMPU_METHOD COMP_0162_S "0.78125rpm" RAT_FUNC "%8.2" "rpm" COEFFS 0 1 0 0 0 0.78125 /end COMPU_METHOD
/begin COMPU_METHOD COMP_0189 "3.2μS" RAT_FUNC "%8.2" "μS" COEFFS 0 1 0 0 0 3.2 /end COMPU_METHOD
/begin COMPU_METHOD COMP_0191 "1REV" RAT_FUNC "%8.2" "REV" COEFFS 0 1 0 0 0 1 /end COMPU_METHOD
/begin COMPU_METHOD COMP_0028 "1/(100*256)-" RAT_FUNC "%8.6" "-" COEFFS 0 1 0 0 0 0.0000390625 /end COMPU_METHOD
/begin COMPU_METHOD COMP_0447 "100/1024%" RAT_FUNC "%8.3" "%" COEFFS 0 1 0 0 0 0.09765625 /end COMPU_METHOD
/begin COMPU_METHOD COMP_0062 "4℃" RAT_FUNC "%8.2" "℃" COEFFS 0 1 0 0 0 4 /end COMPU_METHOD
/begin COMPU_METHOD COMP_0130 "0.0275deg" RAT_FUNC "%8.3" "deg" COEFFS 0 1 0 0 0 0.0275 /end COMPU_METHOD
/begin COMPU_METHOD COMP_0182_S "0.001-" RAT_FUNC "%8.4" "-" COEFFS 0 1 0 0 0 0.001 /end COMPU_METHOD
/begin COMPU_METHOD COMP_0187_S "10/256%" RAT_FUNC "%8.3" "%" COEFFS 0 1 0 0 0 0.0390625 /end COMPU_METHOD
/begin COMPU_METHOD COMP_0472 "1/64-" RAT_FUNC "%8.3" "-" COEFFS 0 1 0 0 0 0.015625 /end COMPU_METHOD
/begin COMPU_METHOD COMP_0189_S "1/3cyl" RAT_FUNC "%8.2" "cyl" COEFFS 0 1 0 0 0 0.333333333 /end COMPU_METHOD
/begin COMPU_METHOD COMP_0389 "1/2548km" RAT_FUNC "%8.5" "km" COEFFS 0 1 0 0 0 0.000392465 /end COMPU_METHOD
/begin COMPU_METHOD COMP_0201_S "0.125oct" RAT_FUNC "%8.2" "oct" COEFFS 0 1 -75 0 0 0.125 /end COMPU_METHOD
/begin COMPU_METHOD COMP_0024 "50ms" RAT_FUNC "%8.2" "ms" COEFFS 0 1 0 0 0 50 /end COMPU_METHOD
/begin COMPU_METHOD COMP_0209_S "100/32768%" RAT_FUNC "%8.4" "%" COEFFS 0 1 0 0 0 0.003051757 /end COMPU_METHOD
/begin COMPU_METHOD COMP_0215_S "1/512kPa" RAT_FUNC "%8.4" "kPa" COEFFS 0 1 0 0 0 0.00195313 /end COMPU_METHOD
/begin COMPU_METHOD COMP_0276 "4L/min" RAT_FUNC "%8.2" "L/min" COEFFS 0 1 0 0 0 4 /end COMPU_METHOD
/begin COMPU_METHOD COMP_0229_S "1ｶｳﾝﾀ" RAT_FUNC "%8.2" "ｶｳﾝﾀ" COEFFS 0 1 0 0 0 1 /end COMPU_METHOD
/begin COMPU_METHOD COMP_0231_S "0.001Nm/rpm" RAT_FUNC "%8.4" "Nm/rpm" COEFFS 0 1 0 0 0 0.001 /end COMPU_METHOD
/begin COMPU_METHOD COMP_0235_S "32/256oct" RAT_FUNC "%8.2" "oct" COEFFS 0 1 0 0 0 0.125 /end COMPU_METHOD
/begin COMPU_METHOD COMP_0425 "100/255%" RAT_FUNC "%8.2" "%" COEFFS 0 1 0 0 0 0.392156862 /end COMPU_METHOD
/begin COMPU_METHOD COMP_0238_S "0.01km/h" RAT_FUNC "%8.3" "km/h" COEFFS 0 1 0 0 0 0.01 /end COMPU_METHOD
/begin COMPU_METHOD COMP_0239_S "0.01km/h" RAT_FUNC "%8.3" "km/h" COEFFS 0 1 0 0 0 0.01 /end COMPU_METHOD
/begin COMPU_METHOD COMP_0241_S "1Nm/km_h/" RAT_FUNC "%8.2" "Nm/km_h/" COEFFS 0 1 0 0 0 1 /end COMPU_METHOD
/begin COMPU_METHOD COMP_0249_S "0.1A" RAT_FUNC "%8.2" "A" COEFFS 0 1 0 0 0 0.1 /end COMPU_METHOD
/begin COMPU_METHOD COMP_0255_S "0.1degC" RAT_FUNC "%8.2" "degC" COEFFS 0 1 0 0 0 0.1 /end COMPU_METHOD
/begin COMPU_METHOD COMP_0259_S "0.2℃" RAT_FUNC "%8.2" "℃" COEFFS 0 1 50 0 0 0.2 /end COMPU_METHOD
/begin COMPU_METHOD COMP_0315 "0.09765%/ms" RAT_FUNC "%8.3" "%/ms" COEFFS 0 1 0 0 0 0.09765 /end COMPU_METHOD
/begin COMPU_METHOD COMP_0356 "0.625X-40℃" RAT_FUNC "%8.2" "℃" COEFFS 0 1 40 0 0 0.625 /end COMPU_METHOD
/begin COMPU_METHOD COMP_0320 "1.6μS" RAT_FUNC "%8.2" "μS" COEFFS 0 1 0 0 0 1.6 /end COMPU_METHOD
/begin COMPU_METHOD COMP_0410 "100/256/256%" RAT_FUNC "%8.4" "%" COEFFS 0 1 0 0 0 0.00152588 /end COMPU_METHOD
/begin COMPU_METHOD COMP_0053 "1ms" RAT_FUNC "%8.2" "ms" COEFFS 0 1 0 0 0 1 /end COMPU_METHOD
/begin COMPU_METHOD COMP_0304_S "0.000016kg/s" RAT_FUNC "%8.6" "kg/s" COEFFS 0 1 0 0 0 0.000016 /end COMPU_METHOD
/begin COMPU_METHOD COMP_0226 "0.1Nm" RAT_FUNC "%8.2" "Nm" COEFFS 0 1 3276.8 0 0 0.1 /end COMPU_METHOD
/begin COMPU_METHOD COMP_0308_S "8E-006kg/s" RAT_FUNC "%8.6" "kg/s" COEFFS 0 1 0 0 0 0.000008 /end COMPU_METHOD
/begin COMPU_METHOD COMP_0313_S "2^-13-" RAT_FUNC "%8.5" "-" COEFFS 0 1 0 0 0 0.00012207 /end COMPU_METHOD
/begin COMPU_METHOD COMP_0315_S "1N" RAT_FUNC "%8.2" "N" COEFFS 0 1 32768 0 0 1 /end COMPU_METHOD
/begin COMPU_METHOD COMP_0317_S "2^-5kPa" RAT_FUNC "%8.3" "kPa" COEFFS 0 1 0 0 0 0.03125 /end COMPU_METHOD
/begin COMPU_METHOD COMP_0181 "1/32－" RAT_FUNC "%8.3" "－" COEFFS 0 1 0 0 0 0.03125 /end COMPU_METHOD
/begin COMPU_METHOD COMP_0334_S "100/4096%" RAT_FUNC "%8.3" "%" COEFFS 0 1 0 0 0 0.0244141 /end COMPU_METHOD
/begin COMPU_METHOD COMP_0337_S "1/256deg/℃" RAT_FUNC "%8.4" "deg/℃" COEFFS 0 1 0 0 0 0.00390625 /end COMPU_METHOD
/begin COMPU_METHOD COMP_0271 "100/128/256%" RAT_FUNC "%8.4" "%" COEFFS 0 1 0 0 0 0.003051758 /end COMPU_METHOD
/begin COMPU_METHOD COMP_0346_S "0.002/4096-" RAT_FUNC "%8.6" "-" COEFFS 0 1 0 0 0 0.000000488281 /end COMPU_METHOD
/begin COMPU_METHOD COMP_0341 "1/256-" RAT_FUNC "%8.4" "-" COEFFS 0 1 0 0 0 0.00391 /end COMPU_METHOD
/begin COMPU_METHOD COMP_0363_S "0.005kPa" RAT_FUNC "%8.4" "kPa" COEFFS 0 1 0 0 0 0.005 /end COMPU_METHOD
/begin COMPU_METHOD COMP_0365_S "64/256deg" RAT_FUNC "%8.2" "deg" COEFFS 0 1 0 0 0 0.25 /end COMPU_METHOD
/begin COMPU_METHOD COMP_0366_S "1/2048oct" RAT_FUNC "%8.5" "oct" COEFFS 0 1 0 0 0 0.000488281 /end COMPU_METHOD
/begin COMPU_METHOD COMP_0372_S "200/2048oct" RAT_FUNC "%8.3" "oct" COEFFS 0 1 0 0 0 0.0976563 /end COMPU_METHOD
/begin COMPU_METHOD COMP_0374_S "0.01mm" RAT_FUNC "%8.3" "mm" COEFFS 0 1 0 0 0 0.01 /end COMPU_METHOD
/begin COMPU_METHOD COMP_0375_S "2^-10deg" RAT_FUNC "%8.5" "deg" COEFFS 0 1 30 0 0 0.000976562 /end COMPU_METHOD
/begin COMPU_METHOD COMP_0377_S "0.0000003125m" RAT_FUNC "%8.6" "m" COEFFS 0 1 0 0 0 0.0000003125 /end COMPU_METHOD
/begin COMPU_METHOD COMP_0378_S "0.00000002m**2" RAT_FUNC "%8.6" "m**2" COEFFS 0 1 0 0 0 0.00000002 /end COMPU_METHOD
/begin COMPU_METHOD COMP_0395_S "0.00008s" RAT_FUNC "%8.6" "s" COEFFS 0 1 0 0 0 0.00008 /end COMPU_METHOD
/begin COMPU_METHOD COMP_0400_S "1Nm/km_h" RAT_FUNC "%8.2" "Nm/km_h" COEFFS 0 1 0 0 0 1 /end COMPU_METHOD
/begin COMPU_METHOD COMP_0403_S "50-" RAT_FUNC "%8.2" "-" COEFFS 0 1 0 0 0 50 /end COMPU_METHOD
/begin COMPU_METHOD COMP_0303 "32/256X10^3g/m^3" RAT_FUNC "%8.2" "g/m^3" COEFFS 0 1 0 0 0 125 /end COMPU_METHOD
/begin COMPU_METHOD COMP_0428_S "0.01%" RAT_FUNC "%8.3" "%" COEFFS 0 1 327.68 0 0 0.01 /end COMPU_METHOD
/begin COMPU_METHOD COMP_0383 "X/256-50℃" RAT_FUNC "%8.4" "℃" COEFFS 0 1 50 0 0 0.00390625 /end COMPU_METHOD
/begin COMPU_METHOD COMP_0450_S "1/32mm" RAT_FUNC "%8.3" "mm" COEFFS 0 1 1023.96875 0 0 0.03125 /end COMPU_METHOD
/begin COMPU_METHOD COMP_0324 "2/256L/min" RAT_FUNC "%8.4" "L/min" COEFFS 0 1 0 0 0 0.0078125 /end COMPU_METHOD
/begin COMPU_METHOD COMP_0469_S "mm^3mm^3" RAT_FUNC "%8.2" "mm^3" COEFFS 0 1 0 0 0 0.3125 /end COMPU_METHOD
/begin COMPU_METHOD COMP_0428 "X-40℃" RAT_FUNC "%8.2" "℃" COEFFS 0 1 40 0 0 1 /end COMPU_METHOD
/begin COMPU_METHOD COMP_0483_S "%%" RAT_FUNC "%8.4" "%" COEFFS 0 1 0 0 0 0.00305176 /end COMPU_METHOD
/begin COMPU_METHOD COMP_0489_S "kjkj" RAT_FUNC "%8.5" "kj" COEFFS 0 1 0 0 0 0.0001 /end COMPU_METHOD
/begin COMPU_METHOD COMP_0376 "0.1μS" RAT_FUNC "%8.2" "μS" COEFFS 0 1 0 0 0 0.1 /end COMPU_METHOD
/begin COMPU_METHOD COMP_0497_S "NmNm" RAT_FUNC "%8.2" "Nm" COEFFS 0 1 100 0 0 2 /end COMPU_METHOD
/begin COMPU_METHOD COMP_0498_S "mgmg" RAT_FUNC "%8.3" "mg" COEFFS 0 1 0 0 0 0.01 /end COMPU_METHOD
/begin COMPU_METHOD COMP_0509_S "degdeg" RAT_FUNC "%8.2" "deg" COEFFS 0 1 0 0 0 0.25 /end COMPU_METHOD
/begin COMPU_METHOD COMP_0384 "1/128-" RAT_FUNC "%8.4" "-" COEFFS 0 1 0 0 0 0.007813 /end COMPU_METHOD
/begin COMPU_METHOD COMP_0514_S "NN" RAT_FUNC "%8.2" "N" COEFFS 0 1 0 0 0 1 /end COMPU_METHOD
/begin COMPU_METHOD COMP_0390 "10deg" RAT_FUNC "%8.2" "deg" COEFFS 0 1 0 0 0 10 /end COMPU_METHOD
/begin COMPU_METHOD COMP_0521_S "μsμs" RAT_FUNC "%8.2" "μs" COEFFS 0 1 0 0 0 0.1 /end COMPU_METHOD
/begin COMPU_METHOD COMP_0523_S "%%" RAT_FUNC "%8.5" "%" COEFFS 0 1 0 0 0 0.0009766 /end COMPU_METHOD
/begin COMPU_METHOD COMP_0394 "12.8μS" RAT_FUNC "%8.2" "μS" COEFFS 0 1 0 0 0 12.8 /end COMPU_METHOD
/begin COMPU_METHOD COMP_0438 "1/256%" RAT_FUNC "%8.4" "%" COEFFS 0 1 0 0 0 0.00390625 /end COMPU_METHOD
/begin COMPU_METHOD COMP_0538_S "--" RAT_FUNC "%8.3" "-" COEFFS 0 1 0 0 0 0.01 /end COMPU_METHOD
/begin COMPU_METHOD COMP_0545_S "timestimes" RAT_FUNC "%8.2" "times" COEFFS 0 1 0 0 0 1 /end COMPU_METHOD
/begin COMPU_METHOD COMP_0415 "1/256－" RAT_FUNC "%8.4" "－" COEFFS 0 1 0 0 0 0.00390625 /end COMPU_METHOD
/begin COMPU_METHOD COMP_0549_S "degCAdegCA" RAT_FUNC "%8.4" "degCA" COEFFS 0 1 0 0 0 0.0078125 /end COMPU_METHOD
/begin COMPU_METHOD COMP_0552_S "NN" RAT_FUNC "%8.3" "N" COEFFS 0 1 0 0 0 0.02 /end COMPU_METHOD
/begin COMPU_METHOD COMP_0553_S "L/min/rpmL/min/rp" RAT_FUNC "%8.4" "L/min/rp" COEFFS 0 1 0 0 0 0.005 /end COMPU_METHOD
/begin COMPU_METHOD COMP_0568_S "AA" RAT_FUNC "%8.4" "A" COEFFS 0 1 0 0 0 0.001 /end COMPU_METHOD
/begin COMPU_METHOD COMP_0571_S "--" RAT_FUNC "%8.5" "-" COEFFS 0 1 15.999991808 0 0 0.000488281 /end COMPU_METHOD
/begin COMPU_METHOD COMP_0580_S "(μS)^-2(ms)^-1(μS)^-2" RAT_FUNC "%8.2" "(μS)^-2" COEFFS 0 1 128 0 0 1 /end COMPU_METHOD
/begin COMPU_METHOD COMP_0176 "1/64ms" RAT_FUNC "%8.3" "ms" COEFFS 0 1 0 0 0 0.015625 /end COMPU_METHOD
/begin COMPU_METHOD COMP_0480 "6.25rpm" RAT_FUNC "%8.2" "rpm" COEFFS 0 1 0 0 0 6.25 /end COMPU_METHOD
/begin COMPU_METHOD COMP_0585_S "--" RAT_FUNC "%8.6" "-" COEFFS 0 1 0 0 0 0.000016276 /end COMPU_METHOD
/begin COMPU_METHOD COMP_0385 "1.608km" RAT_FUNC "%8.2" "km" COEFFS 0 1 0 0 0 1.608 /end COMPU_METHOD
/begin COMPU_METHOD COMP_0265 "1/4096%" RAT_FUNC "%8.5" "%" COEFFS 0 1 8.000012288 0 0 0.000244141 /end COMPU_METHOD
/begin COMPU_METHOD COMP_0489 "1/4096%" RAT_FUNC "%8.5" "%" COEFFS 0 1 7.995392 0 0 0.000244 /end COMPU_METHOD
/begin COMPU_METHOD COMP_0490 "50/(128*256*256)%" RAT_FUNC "%8.6" "%" COEFFS 0 1 50.00004632576 0 0 0.00000596047 /end COMPU_METHOD
/begin COMPU_METHOD COMP_0590_S "%%" RAT_FUNC "%8.6" "%" COEFFS 0 1 49.99996243968 0 0 0.00000596046 /end COMPU_METHOD
/begin COMPU_METHOD COMP_0591_S "kPakPa" RAT_FUNC "%8.2" "kPa" COEFFS 0 1 0 0 0 0.1 /end COMPU_METHOD
/begin COMPU_METHOD COMP_0592_S "ﾊﾟﾙｽﾊﾟﾙｽ" RAT_FUNC "%8.2" "ﾊﾟﾙｽ" COEFFS 0 1 0 0 0 1 /end COMPU_METHOD
/begin COMPU_METHOD COMP_0371 "2cc" RAT_FUNC "%8.2" "cc" COEFFS 0 1 0 0 0 2 /end COMPU_METHOD
/begin COMPU_METHOD COMP_0491 "20/256mV" RAT_FUNC "%8.3" "mV" COEFFS 0 1 0 0 0 0.078125 /end COMPU_METHOD
/begin COMPU_METHOD COMP_0593_S "_L/min_L/min" RAT_FUNC "%8.2" "_L/min" COEFFS 0 1 0 0 0 1 /end COMPU_METHOD
/begin COMPU_METHOD COMP_0594_S "Kg/hKg/h" RAT_FUNC "%8.3" "Kg/h" COEFFS 0 1 0 0 0 0.025 /end COMPU_METHOD
/begin COMPU_METHOD COMP_0595_S "--" RAT_FUNC "%8.4" "-" COEFFS 0 1 0 0 0 0.0016 /end COMPU_METHOD
/begin COMPU_METHOD COMP_0493 "4l/min" RAT_FUNC "%8.2" "l/min" COEFFS 0 1 0 0 0 4 /end COMPU_METHOD
/begin COMPU_METHOD COMP_0475 "10/256mV" RAT_FUNC "%8.3" "mV" COEFFS 0 1 0 0 0 0.0390625 /end COMPU_METHOD
/begin COMPU_METHOD COMP_0495 "1歯" RAT_FUNC "%8.2" "歯" COEFFS 0 1 0 0 0 1 /end COMPU_METHOD
/begin COMPU_METHOD COMP_0596_S "回転回転" RAT_FUNC "%8.2" "回転" COEFFS 0 1 0 0 0 0.1 /end COMPU_METHOD
/begin COMPU_METHOD COMP_0597_S "回転回転" RAT_FUNC "%8.4" "回転" COEFFS 0 1 0 0 0 0.001 /end COMPU_METHOD
/begin COMPU_METHOD COMP_0598_S "octoct" RAT_FUNC "%8.2" "oct" COEFFS 0 1 0 0 0 0.125 /end COMPU_METHOD
/begin COMPU_METHOD COMP_0496 "1.4545μS" RAT_FUNC "%8.2" "μS" COEFFS 0 1 0 0 0 1.4545 /end COMPU_METHOD
/begin COMPU_METHOD COMP_0599_S "μSμS" RAT_FUNC "%8.2" "μS" COEFFS 0 1 0 0 0 1 /end COMPU_METHOD
/begin COMPU_METHOD COMP_0600_S "Km/h/sKm/h/s" RAT_FUNC "%8.3" "Km/h/s" COEFFS 0 1 0 0 0 0.01 /end COMPU_METHOD
/begin COMPU_METHOD COMP_0601_S "%%" RAT_FUNC "%8.3" "%" COEFFS 0 1 0 0 0 0.01 /end COMPU_METHOD
/begin COMPU_METHOD COMP_0602_S "1/deg1/deg" RAT_FUNC "%8.6" "1/deg" COEFFS 0 1 1.0000007168 0 0 0.0000305176 /end COMPU_METHOD
/begin COMPU_METHOD COMP_0603_S "rpmrpm" RAT_FUNC "%8.2" "rpm" COEFFS 0 1 0 0 0 0.78125 /end COMPU_METHOD
/begin COMPU_METHOD COMP_0497 "0.04g℃" RAT_FUNC "%8.3" "g℃" COEFFS 0 1 0 0 0 0.04 /end COMPU_METHOD
/begin COMPU_METHOD COMP_0604_S "mAmA" RAT_FUNC "%8.2" "mA" COEFFS 0 1 0 0 0 0.1 /end COMPU_METHOD
/begin COMPU_METHOD COMP_0605_S "%%" RAT_FUNC "%8.2" "%" COEFFS 0 1 0 0 0 3.23 /end COMPU_METHOD
/begin COMPU_METHOD COMP_0606_S "rpmrpm" RAT_FUNC "%8.2" "rpm" COEFFS 0 1 0 0 0 350 /end COMPU_METHOD
/begin COMPU_METHOD COMP_0607_S "rpmrpm" RAT_FUNC "%8.2" "rpm" COEFFS 0 1 0 0 0 75 /end COMPU_METHOD
/begin COMPU_METHOD COMP_0608_S "℃℃" RAT_FUNC "%8.2" "℃" COEFFS 0 1 42 0 0 4 /end COMPU_METHOD
/begin COMPU_METHOD COMP_0609_S "VV" RAT_FUNC "%8.3" "V" COEFFS 0 1 -10.6 0 0 0.025 /end COMPU_METHOD
/begin COMPU_METHOD COMP_0494 "100ns" RAT_FUNC "%8.2" "ns" COEFFS 0 1 0 0 0 100 /end COMPU_METHOD
/begin COMPU_METHOD COMP_0296 "0.0011deg･s" RAT_FUNC "%8.4" "deg･s" COEFFS 0 1 0 0 0 0.0011 /end COMPU_METHOD
/begin COMPU_METHOD COMP_0610_S "cm^2/rpm/cccm^2/rpm" RAT_FUNC "%8.6" "cm^2/rpm" COEFFS 0 1 0 0 0 3.90625E-11 /end COMPU_METHOD
/begin COMPU_METHOD COMP_0611_S "cm**2/rpm/cccm**2/rp" RAT_FUNC "%8.6" "cm**2/rp" COEFFS 0 1 0 0 0 0.0000000000391 /end COMPU_METHOD
/begin COMPU_METHOD COMP_0612_S "cm^2/rpm/cccm^2/rpm" RAT_FUNC "%8.6" "cm^2/rpm" COEFFS 0 1 0 0 0 0.0000000000391 /end COMPU_METHOD
/begin COMPU_METHOD COMP_0613_S "μSμS" RAT_FUNC "%8.2" "μS" COEFFS 0 1 0 0 0 32 /end COMPU_METHOD
/begin COMPU_METHOD COMP_0147 "0.0032cm^2" RAT_FUNC "%8.4" "cm^2" COEFFS 0 1 0 0 0 0.0032 /end COMPU_METHOD
/begin COMPU_METHOD COMP_0614_S "℃℃" RAT_FUNC "%8.4" "℃" COEFFS 0 1 0 0 0 0.00390625 /end COMPU_METHOD
/begin COMPU_METHOD COMP_0504 "1/64℃" RAT_FUNC "%8.3" "℃" COEFFS 0 1 0 0 0 0.015625 /end COMPU_METHOD
/begin COMPU_METHOD COMP_0615_S "℃℃" RAT_FUNC "%8.3" "℃" COEFFS 0 1 50 0 0 0.01 /end COMPU_METHOD
/begin COMPU_METHOD COMP_0616_S "kPakPa" RAT_FUNC "%8.2" "kPa" COEFFS 0 1 0 0 0 0.25 /end COMPU_METHOD
/begin COMPU_METHOD COMP_0349 "1.6Nm" RAT_FUNC "%8.2" "Nm" COEFFS 0 1 0 0 0 1.6 /end COMPU_METHOD
/begin COMPU_METHOD COMP_0617_S "μsecμsec" RAT_FUNC "%8.2" "μsec" COEFFS 0 1 0 0 0 3.2 /end COMPU_METHOD
/begin COMPU_METHOD COMP_0618_S "－－" RAT_FUNC "%8.4" "－" COEFFS 0 1 0 0 0 0.00391 /end COMPU_METHOD
/begin COMPU_METHOD COMP_0619_S "－－" RAT_FUNC "%8.6" "－" COEFFS 0 1 0 0 0 0.000000119211 /end COMPU_METHOD
/begin COMPU_METHOD COMP_0502 "1/65535－" RAT_FUNC "%8.6" "－" COEFFS 0 1 0 0 0 0.0000152591 /end COMPU_METHOD
/begin COMPU_METHOD COMP_0501 "1/65535*128－" RAT_FUNC "%8.4" "－" COEFFS 0 1 0 0 0 0.00195316 /end COMPU_METHOD
/begin COMPU_METHOD COMP_0620_S "%%" RAT_FUNC "%8.4" "%" COEFFS 0 1 0 0 0 0.003906 /end COMPU_METHOD
/begin COMPU_METHOD COMP_0621_S "N_N_" RAT_FUNC "%8.2" "N_" COEFFS 0 1 0 0 0 1 /end COMPU_METHOD
/begin COMPU_METHOD COMP_0622_S "mVmV" RAT_FUNC "%8.2" "mV" COEFFS 0 1 0 0 0 0.2 /end COMPU_METHOD
/begin COMPU_METHOD COMP_0623_S "--" RAT_FUNC "%8.6" "-" COEFFS 0 1 0 0 0 0.000061035 /end COMPU_METHOD
/begin COMPU_METHOD COMP_0624_S "--" RAT_FUNC "%8.4" "-" COEFFS 0 1 0 0 0 0.00153 /end COMPU_METHOD
/begin COMPU_METHOD COMP_0625_S "degdeg" RAT_FUNC "%8.4" "deg" COEFFS 0 1 14.08205 0 0 0.00171875 /end COMPU_METHOD
/begin COMPU_METHOD COMP_0626_S "--" RAT_FUNC "%8.3" "-" COEFFS 0 1 0 0 0 0.06 /end COMPU_METHOD
/begin COMPU_METHOD COMP_0098 "1.6us" RAT_FUNC "%8.2" "us" COEFFS 0 1 0 0 0 1.6 /end COMPU_METHOD
/begin COMPU_METHOD COMP_0627_S "degdeg" RAT_FUNC "%8.4" "deg" COEFFS 0 1 0 0 0 0.0078125 /end COMPU_METHOD
/end MODULE
/end PROJECT
