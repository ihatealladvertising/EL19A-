/begin PROJECT X12C_KH3DT_DI_NAM_R/C ""
/begin HEADER "" /* key HEADER ++ "comment" に Par.scomment */ PROJECT_NO X12C_KH3DT_DI_NAM_R/C /* key PROJECT_NO ++ project number に car_eng_desti_lot */ VERSION "0KHDCFDZ7" /* key VERSION ++ version number に mProgver */ /end HEADER
/begin MODULE DIM ""
/begin MOD_COMMON "" ALIGNMENT_BYTE 1 ALIGNMENT_WORD 2 ALIGNMENT_LONG 4 ALIGNMENT_FLOAT32_IEEE 4 ALIGNMENT_FLOAT64_IEEE 4 DEPOSIT ABSOLUTE BYTE_ORDER MSB_FIRST /* ﾊﾞｲﾄｵｰﾀﾞｰがﾘﾌﾟﾚｰｽされる */ /end MOD_COMMON
/begin CHARACTERISTIC mTTITMSF0 "多段噴射開始時噴射ﾀｲﾐﾝｸﾞ(膨張行程)" CURVE 0x000128FA REC_UBYTE_C 0 COMP_0190 0 510
 /begin AXIS_DESCR COM_AXIS NO_INPUT_QUANTITY COMP_0006 8 0 3187.5 AXIS_PTS_REF mLPINJNE /end AXIS_DESCR
/end CHARACTERISTIC
/begin CHARACTERISTIC mTTMDECHI "ﾊｲｾﾚｸﾄ減速判定条件OFF後ﾃﾞｨﾚｲ時間ﾃｰﾌﾞﾙ" CURVE 0x00012902 REC_UBYTE_C 0 COMP_0008 0 25500
 /begin AXIS_DESCR FIX_AXIS NO_INPUT_QUANTITY COMP_0329_S 8 0 5600 FIX_AXIS_PAR_DIST 0 1 8 /end AXIS_DESCR
/end CHARACTERISTIC
/begin CHARACTERISTIC mTTMDECLO "ﾛｰｾﾚｸﾄ減速判定条件OFF後ﾃﾞｨﾚｲ時間ﾃｰﾌﾞﾙ" CURVE 0x0001290A REC_UBYTE_C 0 COMP_0008 0 25500
 /begin AXIS_DESCR FIX_AXIS NO_INPUT_QUANTITY COMP_0329_S 8 0 5600 FIX_AXIS_PAR_DIST 0 1 8 /end AXIS_DESCR
/end CHARACTERISTIC
/begin CHARACTERISTIC mTTMHOS "ｴﾚﾒﾝﾄ・ﾘｰﾄﾞ初期温度補正値ﾃｰﾌﾞﾙ" CURVE 0x00012922 REC_UBYTE_C 0 COMP_0021 0 99.609375
 /begin AXIS_DESCR COM_AXIS NO_INPUT_QUANTITY COMP_0250 8 0 1020 AXIS_PTS_REF mLTMHOS /end AXIS_DESCR
/end CHARACTERISTIC
/begin CHARACTERISTIC mTTPADHD2 "熱量診断ADV/TP補正項(Dﾚﾝｼﾞ)" CURVE 0x00015250 REC_UWORD_C 0 COMP_0135_S 0 256.99995888
 /begin AXIS_DESCR COM_AXIS NO_INPUT_QUANTITY COMP_0455_S 8 -32768 32767 AXIS_PTS_REF mLTPADHD2 /end AXIS_DESCR
/end CHARACTERISTIC
/begin CHARACTERISTIC mTTPADHN2 "熱量診断ADV/TP補正項(Nﾚﾝｼﾞ)" CURVE 0x00015260 REC_UWORD_C 0 COMP_0135_S 0 256.99995888
 /begin AXIS_DESCR COM_AXIS NO_INPUT_QUANTITY COMP_0455_S 8 -32768 32767 AXIS_PTS_REF mLTPADHN2 /end AXIS_DESCR
/end CHARACTERISTIC
/begin CHARACTERISTIC mTTPADHNB "熱量診断ADV/TP補正項(Nﾚﾝｼﾞ)（DIG/エリアB）" CURVE 0x00015270 REC_UWORD_C 0 COMP_0019_S 0 257.000024415
 /begin AXIS_DESCR COM_AXIS NO_INPUT_QUANTITY COMP_0456_S 8 -32768 32767 AXIS_PTS_REF mLTPADHNB /end AXIS_DESCR
/end CHARACTERISTIC
/begin CHARACTERISTIC mTTPADHNC "熱量診断ADV/TP補正項(Nﾚﾝｼﾞ)（DIG/エリアC）" CURVE 0x00015280 REC_UWORD_C 0 COMP_0019_S 0 257.000024415
 /begin AXIS_DESCR COM_AXIS NO_INPUT_QUANTITY COMP_0456_S 8 -32768 32767 AXIS_PTS_REF mLTPADHNC /end AXIS_DESCR
/end CHARACTERISTIC
/begin CHARACTERISTIC mTTPFUELL "低水温時目標燃圧テーブル" CURVE 0x0001296E REC_UBYTE_C 0 COMP_0087_S 0 19.9104
 /begin AXIS_DESCR COM_AXIS NO_INPUT_QUANTITY COMP_0001 8 0 31.875 AXIS_PTS_REF mLTPFTPNL /end AXIS_DESCR
/end CHARACTERISTIC
/begin CHARACTERISTIC mTTPH "個別診断TP補正項" CURVE 0x00015290 REC_UWORD_C 0 COMP_0019_S 0 257.000024415
 /begin AXIS_DESCR COM_AXIS NO_INPUT_QUANTITY COMP_0144 8 0 31.999495335 AXIS_PTS_REF mLTTPH /end AXIS_DESCR
/end CHARACTERISTIC
/begin CHARACTERISTIC mTTPHB "個別診断TP補正項（DIG/エリアB）" CURVE 0x000152A0 REC_UWORD_C 0 COMP_0019_S 0 257.000024415
 /begin AXIS_DESCR COM_AXIS NO_INPUT_QUANTITY COMP_0144 8 0 31.999495335 AXIS_PTS_REF mLTTPHB /end AXIS_DESCR
/end CHARACTERISTIC
/begin CHARACTERISTIC mTTPHC "個別診断TP補正項（DIG/エリアC）" CURVE 0x000152B0 REC_UWORD_C 0 COMP_0019_S 0 257.000024415
 /begin AXIS_DESCR COM_AXIS NO_INPUT_QUANTITY COMP_0144 8 0 31.999495335 AXIS_PTS_REF mLTTPHC /end AXIS_DESCR
/end CHARACTERISTIC
/begin CHARACTERISTIC mTTPINT "TP初期値テーブル" CURVE 0x000152C0 REC_UWORD_C 0 COMP_0052 0 31.99956087
 /begin AXIS_DESCR FIX_AXIS NO_INPUT_QUANTITY COMP_0333_S 8 -40 100 FIX_AXIS_PAR_DIST 0 1 8 /end AXIS_DESCR
/end CHARACTERISTIC
/begin CHARACTERISTIC mTTPSSTH "成層始動用目標基本ｼﾘﾝﾀﾞ吸気量上限値ﾃｰﾌﾞﾙ" CURVE 0x000152F0 REC_UWORD_C 0 COMP_0144 0 31.999495335
 /begin AXIS_DESCR COM_AXIS NO_INPUT_QUANTITY COMP_0050 8 0 5119.921875 AXIS_PTS_REF mTPMBTRTP /end AXIS_DESCR
/end CHARACTERISTIC
/begin CHARACTERISTIC mTTPSTNGT "負荷異常NG判定テーブル" CURVE 0x00015300 REC_UWORD_C 0 COMP_0144 0 31.999495335
 /begin AXIS_DESCR COM_AXIS NO_INPUT_QUANTITY COMP_0050 8 0 5119.921875 AXIS_PTS_REF mTPMBTRTP /end AXIS_DESCR
/end CHARACTERISTIC
/begin CHARACTERISTIC mTTRAIDXF "トラノック制御終了指標閾値テーブル" CURVE 0x000153B0 REC_UWORD_C 0 COMP_0182_S 0 65.535
 /begin AXIS_DESCR COM_AXIS NO_INPUT_QUANTITY COMP_0006 8 0 819187.5 AXIS_PTS_REF mTTRIDXNE /end AXIS_DESCR
/end CHARACTERISTIC
/begin CHARACTERISTIC mTTRIDXST "トラノック制御開始許可条件指標閾値テーブル" CURVE 0x000153F0 REC_UWORD_C 0 COMP_0182_S 0 65.535
 /begin AXIS_DESCR COM_AXIS NO_INPUT_QUANTITY COMP_0006 8 0 819187.5 AXIS_PTS_REF mTTRIDXNE /end AXIS_DESCR
/end CHARACTERISTIC
/begin CHARACTERISTIC mTTRITLMT "トラノック制御開始条件充填効率閾値テーブル" CURVE 0x00015400 REC_UWORD_C 0 COMP_0009 0 51199.21875
 /begin AXIS_DESCR COM_AXIS NO_INPUT_QUANTITY COMP_0006 8 0 819187.5 AXIS_PTS_REF mTTRIDXNE /end AXIS_DESCR
/end CHARACTERISTIC
/begin CHARACTERISTIC mTTRQPF "低圧故障時上限トルク燃圧補正ﾃｰﾌﾞﾙ(Limit_torque_fuel_pressure_correction_table_when_low_pressure_breaks_down)" CURVE 0x000129B2 REC_UBYTE_C 0 COMP_0186 0 3.984375
 /begin AXIS_DESCR COM_AXIS NO_INPUT_QUANTITY COMP_0087_S 8 0 19.9104 AXIS_PTS_REF mTRQPFLT /end AXIS_DESCR
/end CHARACTERISTIC
/begin CHARACTERISTIC mTTRQPIGF "TRQPIG参照テーブル(TRQPIG_reference_table)" CURVE 0x00015410 REC_UWORD_C 0 COMP_0196 0 6553.5
 /begin AXIS_DESCR COM_AXIS NO_INPUT_QUANTITY COMP_0006 8 0 819187.5 AXIS_PTS_REF mTPIGNE /end AXIS_DESCR
/end CHARACTERISTIC
/begin CHARACTERISTIC mTTRSLP "トルコン負荷減量補正空気量過渡補正量ﾃｰﾌﾞﾙ" CURVE 0x000129BA REC_UBYTE_C 0 COMP_0293 0 510
 /begin AXIS_DESCR COM_AXIS NO_INPUT_QUANTITY COMP_0006 8 0 3187.5 AXIS_PTS_REF mNSLP /end AXIS_DESCR
/end CHARACTERISTIC
/begin CHARACTERISTIC mTTVBHOS "USはりつき時間に対するVB補正値ﾃｰﾌﾞﾙ" CURVE 0x000129F2 REC_UBYTE_C 0 COMP_0021 0 99.609375
 /begin AXIS_DESCR COM_AXIS NO_INPUT_QUANTITY COMP_0457_S 8 0 326400000 AXIS_PTS_REF mLVBHOS /end AXIS_DESCR
/end CHARACTERISTIC
/begin CHARACTERISTIC mTTVGUSED "VTCｷﾞﾛﾁﾝ発生判定時間油温テーブル" CURVE 0x000129FA REC_UBYTE_C 0 COMP_0008 0 25500
 /begin AXIS_DESCR COM_AXIS NO_INPUT_QUANTITY COMP_0035 8 -50 205 AXIS_PTS_REF mLTVGUSED /end AXIS_DESCR
/end CHARACTERISTIC
/begin CHARACTERISTIC mTTVOULM "吸気脈動対策用スロットル開度上限回転数テーブル(主演算部)" CURVE 0x00012A22 REC_UBYTE_C 0 COMP_0458_S 0 91.1625
 /begin AXIS_DESCR COM_AXIS NO_INPUT_QUANTITY COMP_0000 8 0 6375 AXIS_PTS_REF mTTVONBP /end AXIS_DESCR
/end CHARACTERISTIC
/begin CHARACTERISTIC mTTVOULMS "吸気脈動対策用スロットル開度上限回転数テーブル(副演算部)" CURVE 0x00012A2A REC_UBYTE_C 0 COMP_0458_S 0 91.1625
 /begin AXIS_DESCR COM_AXIS NO_INPUT_QUANTITY COMP_0000 8 0 6375 AXIS_PTS_REF mTTVONBPS /end AXIS_DESCR
/end CHARACTERISTIC
/begin CHARACTERISTIC mTTWHOS "水温テーブル2" CURVE 0x00012A32 REC_UBYTE_C 0 COMP_0009 0 199.21875
 /begin AXIS_DESCR FIX_AXIS NO_INPUT_QUANTITY COMP_0333_S 8 -40 100 FIX_AXIS_PAR_DIST 0 1 8 /end AXIS_DESCR
/end CHARACTERISTIC
/begin CHARACTERISTIC mTTWMF1 "TWFM1参照ﾃｰﾌﾞﾙ" CURVE 0x00012A4A REC_UBYTE_C 0 COMP_0035 -50 205
 /begin AXIS_DESCR FIX_AXIS NO_INPUT_QUANTITY COMP_0348_S 8 -40 30 FIX_AXIS_PAR_DIST 0 1 8 /end AXIS_DESCR
/end CHARACTERISTIC
/begin CHARACTERISTIC mTTWNH "個別診断水温補正項" CURVE 0x00015460 REC_UWORD_C 0 COMP_0019_S 0 257.000024415
 /begin AXIS_DESCR COM_AXIS NO_INPUT_QUANTITY COMP_0035 8 -50 65485 AXIS_PTS_REF mLTWNH /end AXIS_DESCR
/end CHARACTERISTIC
/begin CHARACTERISTIC mTTWNHB "個別診断水温補正項（DIG/エリアB）" CURVE 0x00015470 REC_UWORD_C 0 COMP_0019_S 0 257.000024415
 /begin AXIS_DESCR COM_AXIS NO_INPUT_QUANTITY COMP_0035 8 -50 65485 AXIS_PTS_REF mLTWNHB /end AXIS_DESCR
/end CHARACTERISTIC
/begin CHARACTERISTIC mTTWNHC "個別診断水温補正項（DIG/エリアC）" CURVE 0x00015480 REC_UWORD_C 0 COMP_0019_S 0 257.000024415
 /begin AXIS_DESCR COM_AXIS NO_INPUT_QUANTITY COMP_0035 8 -50 65485 AXIS_PTS_REF mLTWNHC /end AXIS_DESCR
/end CHARACTERISTIC
/begin CHARACTERISTIC mTTWNHD "熱量診断水温補正項(Dﾚﾝｼﾞ)" CURVE 0x00015490 REC_UWORD_C 0 COMP_0019_S 0 257.000024415
 /begin AXIS_DESCR COM_AXIS NO_INPUT_QUANTITY COMP_0035 8 -50 65485 AXIS_PTS_REF mLTWNHD /end AXIS_DESCR
/end CHARACTERISTIC
/begin CHARACTERISTIC mTTWNHN "熱量診断水温補正項(Nﾚﾝｼﾞ)" CURVE 0x000154A0 REC_UWORD_C 0 COMP_0019_S 0 257.000024415
 /begin AXIS_DESCR COM_AXIS NO_INPUT_QUANTITY COMP_0035 8 -50 65485 AXIS_PTS_REF mLTWNHN /end AXIS_DESCR
/end CHARACTERISTIC
/begin CHARACTERISTIC mTTWNHNB "熱量診断水温補正項(Nﾚﾝｼﾞ)（DIG/エリアB）" CURVE 0x000154B0 REC_UWORD_C 0 COMP_0019_S 0 257.000024415
 /begin AXIS_DESCR COM_AXIS NO_INPUT_QUANTITY COMP_0035 8 -50 65485 AXIS_PTS_REF mLTWNHNB /end AXIS_DESCR
/end CHARACTERISTIC
/begin CHARACTERISTIC mTTWNHNC "熱量診断水温補正項(Nﾚﾝｼﾞ)（DIG/エリアC）" CURVE 0x000154C0 REC_UWORD_C 0 COMP_0019_S 0 257.000024415
 /begin AXIS_DESCR COM_AXIS NO_INPUT_QUANTITY COMP_0035 8 -50 65485 AXIS_PTS_REF mLTWNHNC /end AXIS_DESCR
/end CHARACTERISTIC
/begin CHARACTERISTIC mTTWPGHSR "低回転ﾌﾟﾚｲｸﾞ回避QH0ｶｯﾄ量水温補正(ﾚｷﾞｭﾗｰ時)(Pre-ignition_evasion_control_QH0_cutting_amount_water_temperature_correction(" CURVE 0x00012A82 REC_UBYTE_C 0 COMP_0019_S 0 1.000000095
 /begin AXIS_DESCR COM_AXIS NO_INPUT_QUANTITY COMP_0035 8 -50 205 AXIS_PTS_REF mTTWNPILN /end AXIS_DESCR
/end CHARACTERISTIC
/begin CHARACTERISTIC mTVGUCOD "VTCｷﾞﾛﾁﾝ解除時間油温ﾃﾞｰﾌﾞﾙ" CURVE 0x00012ABA REC_UBYTE_C 0 COMP_0008 0 25500
 /begin AXIS_DESCR COM_AXIS NO_INPUT_QUANTITY COMP_0035 8 -50 205 AXIS_PTS_REF mLVGUCOD /end AXIS_DESCR
/end CHARACTERISTIC
/begin CHARACTERISTIC mTVGUCWD "VTCｷﾞﾛﾁﾝ解除時間水温ﾃﾞｰﾌﾞﾙ" CURVE 0x00012AC2 REC_UBYTE_C 0 COMP_0008 0 25500
 /begin AXIS_DESCR COM_AXIS NO_INPUT_QUANTITY COMP_0356 8 -40 119.375 AXIS_PTS_REF mLVGUCWD /end AXIS_DESCR
/end CHARACTERISTIC
/begin CHARACTERISTIC mTVPFCON "フィードバック不感帯テーブル" CURVE 0x00015550 REC_UWORD_C 0 COMP_0164 0 19.988175
 /begin AXIS_DESCR FIX_AXIS NO_INPUT_QUANTITY COMP_0459_S 8 0 3150 FIX_AXIS_PAR_DIST 0 1 8 /end AXIS_DESCR
/end CHARACTERISTIC
/begin CHARACTERISTIC mTVSRTOER "車速換算率変化率リミットテーブル" CURVE 0x00015560 REC_UWORD_C 0 COMP_0298_S 0 0.56249149245
 /begin AXIS_DESCR COM_AXIS NO_INPUT_QUANTITY COMP_0436 8 0 6553.5 AXIS_PTS_REF mTRERVSP /end AXIS_DESCR
/end CHARACTERISTIC
/begin CHARACTERISTIC mTVTCDTW "極低水温時VTC駆動許可用水温上昇幅テーブル" CURVE 0x00012AF2 REC_UBYTE_C 0 COMP_0003 0 255
 /begin AXIS_DESCR COM_AXIS NO_INPUT_QUANTITY COMP_0035 8 -50 205 AXIS_PTS_REF mVTCTWIN /end AXIS_DESCR
/end CHARACTERISTIC
/begin CHARACTERISTIC mTVTCKTN "VTC駆動許可用ｴﾝｼﾞﾝ回転下限ﾃｰﾌﾞﾙ" CURVE 0x00012AFA REC_UBYTE_C 0 COMP_0006 0 3187.5
 /begin AXIS_DESCR COM_AXIS NO_INPUT_QUANTITY COMP_0035 8 -50 205 AXIS_PTS_REF mVTCTOIL /end AXIS_DESCR
/end CHARACTERISTIC
/begin CHARACTERISTIC mTVTCKTNE "排気VTC駆動許可用ｴﾝｼﾞﾝ回転下限ﾃｰﾌﾞﾙ" CURVE 0x00012B02 REC_UBYTE_C 0 COMP_0006 0 3187.5
 /begin AXIS_DESCR COM_AXIS NO_INPUT_QUANTITY COMP_0035 8 -50 205 AXIS_PTS_REF mVTCTOILE /end AXIS_DESCR
/end CHARACTERISTIC
/begin CHARACTERISTIC mTVTDPTO "VTC目標値変化率油温ﾃｰﾌﾞﾙ" CURVE 0x00012B22 REC_UBYTE_C 0 COMP_0014 0 2550
 /begin AXIS_DESCR FIX_AXIS NO_INPUT_QUANTITY COMP_0460_S 8 -50 90 FIX_AXIS_PAR_DIST 0 1 8 /end AXIS_DESCR
/end CHARACTERISTIC
/begin CHARACTERISTIC mTVTDPTOE "排気VTC目標値変化率油温ﾃｰﾌﾞﾙ" CURVE 0x00012B2A REC_UBYTE_C 0 COMP_0014 0 2550
 /begin AXIS_DESCR FIX_AXIS NO_INPUT_QUANTITY COMP_0460_S 8 -50 90 FIX_AXIS_PAR_DIST 0 1 8 /end AXIS_DESCR
/end CHARACTERISTIC
/begin CHARACTERISTIC mTVTDPTW "VTC目標値変化率水温ﾃｰﾌﾞﾙ" CURVE 0x00012B32 REC_UBYTE_C 0 COMP_0014 0 2550
 /begin AXIS_DESCR FIX_AXIS NO_INPUT_QUANTITY COMP_0333_S 8 -40 100 FIX_AXIS_PAR_DIST 0 1 8 /end AXIS_DESCR
/end CHARACTERISTIC
/begin CHARACTERISTIC mTVTDPTWE "排気VTC目標値変化率水温ﾃｰﾌﾞﾙ" CURVE 0x00012B3A REC_UBYTE_C 0 COMP_0014 0 2550
 /begin AXIS_DESCR FIX_AXIS NO_INPUT_QUANTITY COMP_0333_S 8 -40 100 FIX_AXIS_PAR_DIST 0 1 8 /end AXIS_DESCR
/end CHARACTERISTIC
/begin CHARACTERISTIC mTVTFIDTW "低水温ｱｲﾄﾞﾙVTC駆動許可用水温上昇幅テーブル" CURVE 0x00012B42 REC_UBYTE_C 0 COMP_0003 0 255
 /begin AXIS_DESCR COM_AXIS NO_INPUT_QUANTITY COMP_0035 8 -50 205 AXIS_PTS_REF mVTFITWIN /end AXIS_DESCR
/end CHARACTERISTIC
/begin CHARACTERISTIC mTVTRGDMD "極低水温時VTC基準位置戻し目標値減速度VTC作動角テーブル" CURVE 0x00012B5A REC_UBYTE_C 0 COMP_0300_S 0 127.5
 /begin AXIS_DESCR COM_AXIS NO_INPUT_QUANTITY COMP_0048 8 0 127.5 AXIS_PTS_REF mVTRGDMD /end AXIS_DESCR
/end CHARACTERISTIC
/begin CHARACTERISTIC mTVTRGDMI "極低水温時VTC目標値回復速度VTC作動角テーブル" CURVE 0x00012B62 REC_UBYTE_C 0 COMP_0300_S 0 127.5
 /begin AXIS_DESCR COM_AXIS NO_INPUT_QUANTITY COMP_0048 8 0 127.5 AXIS_PTS_REF mVTRGDMI /end AXIS_DESCR
/end CHARACTERISTIC
/begin CHARACTERISTIC mTVTTWDMD "極低水温時VTC基準位置戻し目標値減速度水温テーブル" CURVE 0x00012B7A REC_UBYTE_C 0 COMP_0300_S 0 127.5
 /begin AXIS_DESCR COM_AXIS NO_INPUT_QUANTITY COMP_0035 8 -50 205 AXIS_PTS_REF mVTCDMTW /end AXIS_DESCR
/end CHARACTERISTIC
/begin CHARACTERISTIC mTVTTWDMI "極低水温時VTC目標値回復速度水温テーブル" CURVE 0x00012B82 REC_UBYTE_C 0 COMP_0300_S 0 127.5
 /begin AXIS_DESCR COM_AXIS NO_INPUT_QUANTITY COMP_0035 8 -50 205 AXIS_PTS_REF mVTCDMTW /end AXIS_DESCR
/end CHARACTERISTIC
/begin CHARACTERISTIC mTVTWDMDE "極低水温時排気VTC基準位置戻し目標値減速度水温テーブル" CURVE 0x00012B8A REC_UBYTE_C 0 COMP_0300_S 0 127.5
 /begin AXIS_DESCR COM_AXIS NO_INPUT_QUANTITY COMP_0035 8 -50 205 AXIS_PTS_REF mVTCDMTWE /end AXIS_DESCR
/end CHARACTERISTIC
/begin CHARACTERISTIC mTVTWDMIE "極低水温時排気VTC目標値回復速度水温テーブル" CURVE 0x00012B92 REC_UBYTE_C 0 COMP_0300_S 0 127.5
 /begin AXIS_DESCR COM_AXIS NO_INPUT_QUANTITY COMP_0035 8 -50 205 AXIS_PTS_REF mVTCDMTWE /end AXIS_DESCR
/end CHARACTERISTIC
/begin CHARACTERISTIC mTWT2ITH "ｻｰｼﾞ2度噴きITAC下限条件(Multipul_injection_for_surge_control_minimum_ITAC_condition)" CURVE 0x00012BC6 REC_UBYTE_C 0 COMP_0009 0 199.21875
 /begin AXIS_DESCR FIX_AXIS NO_INPUT_QUANTITY COMP_0347_S 8 0 2800 FIX_AXIS_PAR_DIST 0 1 8 /end AXIS_DESCR
/end CHARACTERISTIC
/begin CHARACTERISTIC mTWT2ITL "ｻｰｼﾞ2度噴きITAC上限条件(Multipul_injection_for_surge_control_maximum_ITAC_condition)" CURVE 0x00012BCE REC_UBYTE_C 0 COMP_0009 0 199.21875
 /begin AXIS_DESCR FIX_AXIS NO_INPUT_QUANTITY COMP_0347_S 8 0 2800 FIX_AXIS_PAR_DIST 0 1 8 /end AXIS_DESCR
/end CHARACTERISTIC
/begin CHARACTERISTIC mTWTKOU "最低吸気温高時TWTMRテーブル" CURVE 0x00012BD6 REC_UBYTE_C 0 COMP_0096 0 2550
 /begin AXIS_DESCR FIX_AXIS NO_INPUT_QUANTITY COMP_0348_S 8 -40 30 FIX_AXIS_PAR_DIST 0 1 8 /end AXIS_DESCR
/end CHARACTERISTIC
/begin CHARACTERISTIC mTWTTEI "最低吸気温低時TWTMRテーブル" CURVE 0x00012BDE REC_UBYTE_C 0 COMP_0096 0 2550
 /begin AXIS_DESCR FIX_AXIS NO_INPUT_QUANTITY COMP_0348_S 8 -40 30 FIX_AXIS_PAR_DIST 0 1 8 /end AXIS_DESCR
/end CHARACTERISTIC
/begin CHARACTERISTIC mTZIDL "IDLHOSｹﾞｲﾝ水温ﾃｰﾌﾞﾙ" CURVE 0x00012C26 REC_UBYTE_C 0 COMP_0186 0 3.984375
 /begin AXIS_DESCR FIX_AXIS NO_INPUT_QUANTITY COMP_0333_S 8 -40 100 FIX_AXIS_PAR_DIST 0 1 8 /end AXIS_DESCR
/end CHARACTERISTIC
/begin CHARACTERISTIC mVCFBGE "排気側F/B制御ゲイン低減係数テーブル" CURVE 0x00015720 REC_UWORD_C 0 COMP_0402 0 0.999998565
 /begin AXIS_DESCR COM_AXIS NO_INPUT_QUANTITY COMP_0461_S 8 0 0.209712 AXIS_PTS_REF mVCFBTRFE /end AXIS_DESCR
/end CHARACTERISTIC
/begin CHARACTERISTIC mVCFBGI "F/B制御ゲイン低減係数テーブル" CURVE 0x00015730 REC_UWORD_C 0 COMP_0402 0 0.999998565
 /begin AXIS_DESCR COM_AXIS NO_INPUT_QUANTITY COMP_0461_S 8 0 0.209712 AXIS_PTS_REF mVCFBTRF /end AXIS_DESCR
/end CHARACTERISTIC
/begin CHARACTERISTIC mVSWCFRQ "放熱量_車速風補正係数(vehicle_speed_winds_correction_factor_for_radiation_quantity_)" CURVE 0x00012C3E REC_UBYTE_C 0 COMP_0373 0 2.55
 /begin AXIS_DESCR COM_AXIS NO_INPUT_QUANTITY COMP_0007 8 0 510 AXIS_PTS_REF mLVSWCFRQ /end AXIS_DESCR
/end CHARACTERISTIC
/begin CHARACTERISTIC mAJAPMXMP "ｱﾝﾁｼﾞｬｰｸ全開判定ｱｸｾﾙ開度  X-[D_UNLU] [D_LU] [M_UNLU] [M_LU] " MAP 0x0000C76E REC_UWORD_C 0 COMP_0005 0 7208.85
 /begin AXIS_DESCR FIX_AXIS NO_INPUT_QUANTITY COMP_0000_S 4 0 3 FIX_AXIS_PAR_DIST 0 1 4 /end AXIS_DESCR
 /begin AXIS_DESCR FIX_AXIS NO_INPUT_QUANTITY COMP_0068 4 0 3 FIX_AXIS_PAR_DIST 0 1 4 /end AXIS_DESCR
/end CHARACTERISTIC
/begin CHARACTERISTIC mINV_NDM "M_ﾓｰﾄﾞ用ｲﾝﾊﾞｰｽﾌｨﾙﾀ定数  X-[IN0] [IN1] [IN2] [ID0] [ID1] " MAP 0x0000C80E REC_UWORD_C 0 COMP_0068 0 65535
 /begin AXIS_DESCR FIX_AXIS NO_INPUT_QUANTITY COMP_0000_S 5 0 4 FIX_AXIS_PAR_DIST 0 1 5 /end AXIS_DESCR
 /begin AXIS_DESCR FIX_AXIS NO_INPUT_QUANTITY COMP_0324_S 9 1 9 FIX_AXIS_PAR_DIST 0 1 9 /end AXIS_DESCR
/end CHARACTERISTIC
/begin CHARACTERISTIC mINV_N_D "ｲﾝﾊﾞｰｽﾌｨﾙﾀ定数  X-[IN0] [IN1] [IN2] [ID0] [ID1] " MAP 0x0000C868 REC_UWORD_C 0 COMP_0068 0 65535
 /begin AXIS_DESCR FIX_AXIS NO_INPUT_QUANTITY COMP_0000_S 5 0 4 FIX_AXIS_PAR_DIST 0 1 5 /end AXIS_DESCR
 /begin AXIS_DESCR FIX_AXIS NO_INPUT_QUANTITY COMP_0324_S 9 1 9 FIX_AXIS_PAR_DIST 0 1 9 /end AXIS_DESCR
/end CHARACTERISTIC
/begin CHARACTERISTIC mNINV_NDM "M_ﾓｰﾄﾞ用ｲﾝﾊﾞｰｽﾌｨﾙﾀ定数ｼﾌﾄ数  X-[IN0] [IN1] [IN2] [ID0] [ID1] " MAP 0x00009808 REC_SBYTE_C 0 COMP_0263 -128 127
 /begin AXIS_DESCR FIX_AXIS NO_INPUT_QUANTITY COMP_0000_S 5 0 4 FIX_AXIS_PAR_DIST 0 1 5 /end AXIS_DESCR
 /begin AXIS_DESCR FIX_AXIS NO_INPUT_QUANTITY COMP_0324_S 9 1 9 FIX_AXIS_PAR_DIST 0 1 9 /end AXIS_DESCR
/end CHARACTERISTIC
/begin CHARACTERISTIC mNINV_N_D "ｲﾝﾊﾞｰｽﾌｨﾙﾀ定数ｼﾌﾄ数  X-[IN0] [IN1] [IN2] [ID0] [ID1] " MAP 0x00009835 REC_SBYTE_C 0 COMP_0263 -128 127
 /begin AXIS_DESCR FIX_AXIS NO_INPUT_QUANTITY COMP_0000_S 5 0 4 FIX_AXIS_PAR_DIST 0 1 5 /end AXIS_DESCR
 /begin AXIS_DESCR FIX_AXIS NO_INPUT_QUANTITY COMP_0324_S 9 1 9 FIX_AXIS_PAR_DIST 0 1 9 /end AXIS_DESCR
/end CHARACTERISTIC
/begin CHARACTERISTIC mTSL "SLIテーブル  X-[TSL1] [TSL2] [TSL3] [TSL4] [TSL5] [TSL6] [TSL7] [TSL8] " MAP 0x00010AC2 REC_UWORD_C 0 COMP_0032 0 255.99609375
 /begin AXIS_DESCR FIX_AXIS NO_INPUT_QUANTITY COMP_0000_S 8 0 7 FIX_AXIS_PAR_DIST 0 1 8 /end AXIS_DESCR
 /begin AXIS_DESCR FIX_AXIS NO_INPUT_QUANTITY COMP_0357_S 16 400 6400 FIX_AXIS_PAR_DIST 0 1 16 /end AXIS_DESCR
/end CHARACTERISTIC
/begin CHARACTERISTIC mTSL1 "SLIテーブル1(SLI_table1)  X-[TSL1] [TSL2] [TSL3] [TSL4] [TSL5] [TSL6] [TSL7] [TSL8] " MAP 0x00010BC2 REC_UWORD_C 0 COMP_0032 0 255.99609375
 /begin AXIS_DESCR FIX_AXIS NO_INPUT_QUANTITY COMP_0000_S 8 0 7 FIX_AXIS_PAR_DIST 0 1 8 /end AXIS_DESCR
 /begin AXIS_DESCR FIX_AXIS NO_INPUT_QUANTITY COMP_0357_S 16 400 6400 FIX_AXIS_PAR_DIST 0 1 16 /end AXIS_DESCR
/end CHARACTERISTIC
/begin CHARACTERISTIC mTADVKIRW "燃焼切換え直後均質狙い点火時期水温補正ﾃｰﾌﾞﾙ(アイドル) [軸最終値無効]" CURVE 0x00011B20 REC_UBYTE_C 0 COMP_0245 -64 191
 /begin AXIS_DESCR COM_AXIS NO_INPUT_QUANTITY COMP_0035 4 -50 205 AXIS_PTS_REF mADVKIRLT /end AXIS_DESCR
/end CHARACTERISTIC
/begin CHARACTERISTIC mTDRYDUTY "ﾄﾞﾗｲ判定時DUTY値 [軸最終値無効]  X-[mPREHTWN1] [mPREHTWN2] [mPREHTWN3] " CURVE 0x00011D7C REC_UBYTE_C 0 COMP_0047 0 127.5
 /begin AXIS_DESCR FIX_AXIS NO_INPUT_QUANTITY COMP_0000_S 4 0 3 FIX_AXIS_PAR_DIST 0 1 4 /end AXIS_DESCR
/end CHARACTERISTIC
/begin CHARACTERISTIC mTDRYTIME "ﾄﾞﾗｲ判定時DUTY保持時間 [軸最終値無効]  X-[mPREHTWN1] [mPREHTWN2] [mPREHTWN3] " CURVE 0x00011D80 REC_UBYTE_C 0 COMP_0013 0 255
 /begin AXIS_DESCR FIX_AXIS NO_INPUT_QUANTITY COMP_0000_S 4 0 3 FIX_AXIS_PAR_DIST 0 1 4 /end AXIS_DESCR
/end CHARACTERISTIC
/begin CHARACTERISTIC mTISBCP "減速負荷補正量テーブル [軸最終値無効]" CURVE 0x0001466A REC_UWORD_C 0 COMP_0324 0 511.9921875
 /begin AXIS_DESCR COM_AXIS NO_INPUT_QUANTITY COMP_0006 4 0 3187.5 AXIS_PTS_REF mNEDWN /end AXIS_DESCR
/end CHARACTERISTIC
/begin CHARACTERISTIC mTNISBC "減速負荷補正開始回転数テーブル [軸最終値無効]" CURVE 0x000123D8 REC_UBYTE_C 0 COMP_0006 0 3187.5
 /begin AXIS_DESCR COM_AXIS NO_INPUT_QUANTITY COMP_0006 4 0 3187.5 AXIS_PTS_REF mNEDWN /end AXIS_DESCR
/end CHARACTERISTIC
/begin CHARACTERISTIC mTRECNE "ΔNeﾘｶﾊﾞｰ回転数ﾃｰﾌﾞﾙ [軸最終値無効]" CURVE 0x0001268C REC_UBYTE_C 0 COMP_0000 0 6375
 /begin AXIS_DESCR COM_AXIS NO_INPUT_QUANTITY COMP_0006 4 0 3187.5 AXIS_PTS_REF mNEDWN /end AXIS_DESCR
/end CHARACTERISTIC
/begin CHARACTERISTIC mTRLRC "学習ゲインﾃｰﾌﾞﾙ [軸最終値無効]  X-[mDLMD1] [mDLMD2] [mDLMD3] " CURVE 0x000126BE REC_UBYTE_C 0 COMP_0021 0 99.609375
 /begin AXIS_DESCR FIX_AXIS NO_INPUT_QUANTITY COMP_0000_S 4 0 3 FIX_AXIS_PAR_DIST 0 1 4 /end AXIS_DESCR
/end CHARACTERISTIC
/begin CHARACTERISTIC mTSTHOSTW "STHOS水温補正値ﾃｰﾌﾞﾙ（STHOS_temperature_correction_value_table） [軸最終値無効]" CURVE 0x00012796 REC_UBYTE_C 0 COMP_0045 0 1.9921875
 /begin AXIS_DESCR COM_AXIS NO_INPUT_QUANTITY COMP_0035 4 -50 205 AXIS_PTS_REF mSTHOSLT /end AXIS_DESCR
/end CHARACTERISTIC
/begin CHARACTERISTIC mTTFBAKRT "TFBYAKIR水温補正値ﾃｰﾌﾞﾙ（TFBYAKIR_temperature_correction_value_table） [軸最終値無効]" CURVE 0x000128C2 REC_UBYTE_C 0 COMP_0045 0 1.9921875
 /begin AXIS_DESCR COM_AXIS NO_INPUT_QUANTITY COMP_0035 4 -50 205 AXIS_PTS_REF mSTHOSLT /end AXIS_DESCR
/end CHARACTERISTIC
/begin CHARACTERISTIC mTTMQBC "減速負荷補正開始時間テーブル [軸最終値無効]" CURVE 0x0001292A REC_UBYTE_C 0 COMP_0014 0 2550
 /begin AXIS_DESCR COM_AXIS NO_INPUT_QUANTITY COMP_0006 4 0 3187.5 AXIS_PTS_REF mNEDWN /end AXIS_DESCR
/end CHARACTERISTIC
/begin CHARACTERISTIC mTWETTIME "ｳｪｯﾄ判定時DUTY保持時間(Duty_maintenance_time_at_the_time_of_an_wet_judging) [軸最終値無効]  X-[mPRHWTWN1] [mPRHWTWN2] [mPRHWTWN3] " CURVE 0x00012B9A REC_UBYTE_C 0 COMP_0049 0 255
 /begin AXIS_DESCR FIX_AXIS NO_INPUT_QUANTITY COMP_0000_S 4 0 3 FIX_AXIS_PAR_DIST 0 1 4 /end AXIS_DESCR
/end CHARACTERISTIC
/begin CHARACTERISTIC mACBLTS "Flag mACBLTS" VALUE 0x00008256 REC_UBYTE_C 0 COMP_0283 0 255 /end CHARACTERISTIC
/begin CHARACTERISTIC mfACNGTR "0:故障時OFF制御(従来ｼｽﾃﾑ結線)  1:故障時DUTY制御(ﾍﾞﾙﾄ滑り対応新ｼｽﾃ" VALUE 0x00008256 REC_UBYTE_C 0 COMP_0283 0 1 BIT_MASK 0x0001 /end CHARACTERISTIC
/begin CHARACTERISTIC mALHCFB "Flag mALHCFB" VALUE 0x000082ED REC_UBYTE_C 0 COMP_0283 0 255 /end CHARACTERISTIC
/begin CHARACTERISTIC mfRSACCLIH "0:LimpHome_strategy_cancel  1:LimpHome_strategy_on" VALUE 0x000082ED REC_UBYTE_C 0 COMP_0283 0 1 BIT_MASK 0x0002 /end CHARACTERISTIC
/begin CHARACTERISTIC mALTEL "Flag mALTEL" VALUE 0x000082FD REC_UBYTE_C 0 COMP_0283 0 255 /end CHARACTERISTIC
/begin CHARACTERISTIC mfALTBLMAX "0:ブロアファン_on時回生制御禁止  1:ブロアファン風量MAX時以外は回生" VALUE 0x000082FD REC_UBYTE_C 0 COMP_0283 0 1 BIT_MASK 0x0080 /end CHARACTERISTIC
/begin CHARACTERISTIC mfALTPOS "0:ポジションライト_on時回生制御禁  1:ポジションライト_on時回生制御禁" VALUE 0x000082FD REC_UBYTE_C 0 COMP_0283 0 1 BIT_MASK 0x0040 /end CHARACTERISTIC
/begin CHARACTERISTIC mfALTLL "0:ヘッドライト(Low)_on時回生制御禁  1:ヘッドライト(Low)_on時回生制御禁" VALUE 0x000082FD REC_UBYTE_C 0 COMP_0283 0 1 BIT_MASK 0x0020 /end CHARACTERISTIC
/begin CHARACTERISTIC mfALTLH "0:ヘッドライト(High)_on時回生制御  1:ヘッドライト(High)_on時回生制御" VALUE 0x000082FD REC_UBYTE_C 0 COMP_0283 0 1 BIT_MASK 0x0010 /end CHARACTERISTIC
/begin CHARACTERISTIC mfALTFOG "0:フォグライト_on時回生制御禁止_(T  1:フォグライト_on時回生制御禁止し" VALUE 0x000082FD REC_UBYTE_C 0 COMP_0283 0 1 BIT_MASK 0x0008 /end CHARACTERISTIC
/begin CHARACTERISTIC mfALTRD "0:リアデフ_on時回生制御禁止_(The_t  1:リアデフ_on時回生制御禁止しない_" VALUE 0x000082FD REC_UBYTE_C 0 COMP_0283 0 1 BIT_MASK 0x0004 /end CHARACTERISTIC
/begin CHARACTERISTIC mfALTBL "0:フロアファン_on時回生制御禁止_(T  1:フロアファン_on時回生制御禁止し" VALUE 0x000082FD REC_UBYTE_C 0 COMP_0283 0 1 BIT_MASK 0x0002 /end CHARACTERISTIC
/begin CHARACTERISTIC mfALTM4 "0:M4WD_on時回生制御禁止_(The_time_  1:M4WD_on時回生制御禁止しない_(It_" VALUE 0x000082FD REC_UBYTE_C 0 COMP_0283 0 1 BIT_MASK 0x0001 /end CHARACTERISTIC
/begin CHARACTERISTIC mBYPASS01 "Flag mBYPASS01" VALUE 0x00008346 REC_UBYTE_C 0 COMP_0283 0 255 /end CHARACTERISTIC
/begin CHARACTERISTIC mfBPS008 "0:CHKFREC_set:ﾊﾞｲﾊﾟｽ不許可  1:CHKFREC_set:ﾊﾞｲﾊﾟｽ許可" VALUE 0x00008346 REC_UBYTE_C 0 COMP_0283 0 1 BIT_MASK 0x0080 /end CHARACTERISTIC
/begin CHARACTERISTIC mfBPS007 "0:CHKFCUT_set:ﾊﾞｲﾊﾟｽ不許可  1:CHKFCUT_set:ﾊﾞｲﾊﾟｽ許可" VALUE 0x00008346 REC_UBYTE_C 0 COMP_0283 0 1 BIT_MASK 0x0040 /end CHARACTERISTIC
/begin CHARACTERISTIC mfBPS006 "0:FCUT_cal:ﾊﾞｲﾊﾟｽ不許可  1:FCUT_cal:ﾊﾞｲﾊﾟｽ許可" VALUE 0x00008346 REC_UBYTE_C 0 COMP_0283 0 1 BIT_MASK 0x0020 /end CHARACTERISTIC
/begin CHARACTERISTIC mfBPS005 "0:FLOCK_cal:ﾊﾞｲﾊﾟｽ不許可  1:FLOCK_cal:ﾊﾞｲﾊﾟｽ許可" VALUE 0x00008346 REC_UBYTE_C 0 COMP_0283 0 1 BIT_MASK 0x0010 /end CHARACTERISTIC
/begin CHARACTERISTIC mfBPS004 "0:VVL_cal:ﾊﾞｲﾊﾟｽ不許可  1:VVL_cal:ﾊﾞｲﾊﾟｽ許可" VALUE 0x00008346 REC_UBYTE_C 0 COMP_0283 0 1 BIT_MASK 0x0008 /end CHARACTERISTIC
/begin CHARACTERISTIC mfBPS003 "0:TTETD_cal:ﾊﾞｲﾊﾟｽ不許可  1:TTETD_cal:ﾊﾞｲﾊﾟｽ許可" VALUE 0x00008346 REC_UBYTE_C 0 COMP_0283 0 1 BIT_MASK 0x0004 /end CHARACTERISTIC
/begin CHARACTERISTIC mfBPS002 "0:SRTUPETCcal:ﾊﾞｲﾊﾟｽ不許可  1:SRTUPETCcal:ﾊﾞｲﾊﾟｽ許可" VALUE 0x00008346 REC_UBYTE_C 0 COMP_0283 0 1 BIT_MASK 0x0002 /end CHARACTERISTIC
/begin CHARACTERISTIC mfBPS001 "0:CMNAPOST_cal:ﾊﾞｲﾊﾟｽ不許可  1:CMNAPOST_cal:ﾊﾞｲﾊﾟｽ許可" VALUE 0x00008346 REC_UBYTE_C 0 COMP_0283 0 1 BIT_MASK 0x0001 /end CHARACTERISTIC
/begin CHARACTERISTIC mBYPASS02 "Flag mBYPASS02" VALUE 0x00008347 REC_UBYTE_C 0 COMP_0283 0 255 /end CHARACTERISTIC
/begin CHARACTERISTIC mfBPS016 "0:ITAFSV_cal:ﾊﾞｲﾊﾟｽ不許可  1:ITAFSV_cal:ﾊﾞｲﾊﾟｽ許可" VALUE 0x00008347 REC_UBYTE_C 0 COMP_0283 0 1 BIT_MASK 0x0080 /end CHARACTERISTIC
/begin CHARACTERISTIC mfBPS015 "0:TFBYA_cal:ﾊﾞｲﾊﾟｽ不許可  1:TFBYA_cal:ﾊﾞｲﾊﾟｽ許可" VALUE 0x00008347 REC_UBYTE_C 0 COMP_0283 0 1 BIT_MASK 0x0040 /end CHARACTERISTIC
/begin CHARACTERISTIC mfBPS014 "0:QCK_cal:ﾊﾞｲﾊﾟｽ不許可  1:QCK_cal:ﾊﾞｲﾊﾟｽ許可" VALUE 0x00008347 REC_UBYTE_C 0 COMP_0283 0 1 BIT_MASK 0x0020 /end CHARACTERISTIC
/begin CHARACTERISTIC mfBPS013 "0:ALTDUTY_cal:ﾊﾞｲﾊﾟｽ不許可  1:ALTDUTY_cal:ﾊﾞｲﾊﾟｽ許可" VALUE 0x00008347 REC_UBYTE_C 0 COMP_0283 0 1 BIT_MASK 0x0010 /end CHARACTERISTIC
/begin CHARACTERISTIC mfBPS012 "0:QCKmpi_cal:ﾊﾞｲﾊﾟｽ不許可  1:QCKmpi_cal:ﾊﾞｲﾊﾟｽ許可" VALUE 0x00008347 REC_UBYTE_C 0 COMP_0283 0 1 BIT_MASK 0x0008 /end CHARACTERISTIC
/begin CHARACTERISTIC mfBPS011 "0:ISCcal:ﾊﾞｲﾊﾟｽ不許可  1:ISCcal:ﾊﾞｲﾊﾟｽ許可" VALUE 0x00008347 REC_UBYTE_C 0 COMP_0283 0 1 BIT_MASK 0x0004 /end CHARACTERISTIC
/begin CHARACTERISTIC mfBPS010 "0:RFNcal:ﾊﾞｲﾊﾟｽ不許可  1:RFNcal:ﾊﾞｲﾊﾟｽ許可" VALUE 0x00008347 REC_UBYTE_C 0 COMP_0283 0 1 BIT_MASK 0x0002 /end CHARACTERISTIC
/begin CHARACTERISTIC mfBPS009 "0:ACcal:ﾊﾞｲﾊﾟｽ不許可  1:ACcal:ﾊﾞｲﾊﾟｽ許可" VALUE 0x00008347 REC_UBYTE_C 0 COMP_0283 0 1 BIT_MASK 0x0001 /end CHARACTERISTIC
/begin CHARACTERISTIC mBYPASS03 "Flag mBYPASS03" VALUE 0x00008348 REC_UBYTE_C 0 COMP_0283 0 255 /end CHARACTERISTIC
/begin CHARACTERISTIC mfBPS024 "0:S_TISTcal:ﾊﾞｲﾊﾟｽ不許可  1:S_TISTcal:ﾊﾞｲﾊﾟｽ許可" VALUE 0x00008348 REC_UBYTE_C 0 COMP_0283 0 1 BIT_MASK 0x0080 /end CHARACTERISTIC
/begin CHARACTERISTIC mfBPS023 "0:S_MKINJset:ﾊﾞｲﾊﾟｽ不許可  1:S_MKINJset:ﾊﾞｲﾊﾟｽ許可" VALUE 0x00008348 REC_UBYTE_C 0 COMP_0283 0 1 BIT_MASK 0x0040 /end CHARACTERISTIC
/begin CHARACTERISTIC mfBPS022 "0:TDTVO_cal:ﾊﾞｲﾊﾟｽ不許可  1:TDTVO_cal:ﾊﾞｲﾊﾟｽ許可" VALUE 0x00008348 REC_UBYTE_C 0 COMP_0283 0 1 BIT_MASK 0x0020 /end CHARACTERISTIC
/begin CHARACTERISTIC mfBPS021 "0:KQEGRcal:ﾊﾞｲﾊﾟｽ不許可  1:KQEGRcal:ﾊﾞｲﾊﾟｽ許可" VALUE 0x00008348 REC_UBYTE_C 0 COMP_0283 0 1 BIT_MASK 0x0010 /end CHARACTERISTIC
/begin CHARACTERISTIC mfBPS020 "0:VCYL_cal:ﾊﾞｲﾊﾟｽ不許可  1:VCYL_cal:ﾊﾞｲﾊﾟｽ許可" VALUE 0x00008348 REC_UBYTE_C 0 COMP_0283 0 1 BIT_MASK 0x0008 /end CHARACTERISTIC
/begin CHARACTERISTIC mfBPS019 "0:Targrt_Qcyl:ﾊﾞｲﾊﾟｽ不許可  1:Targrt_Qcyl:ﾊﾞｲﾊﾟｽ許可" VALUE 0x00008348 REC_UBYTE_C 0 COMP_0283 0 1 BIT_MASK 0x0004 /end CHARACTERISTIC
/begin CHARACTERISTIC mfBPS018 "0:ITAFSVT_cal:ﾊﾞｲﾊﾟｽ不許可  1:ITAFSVT_cal:ﾊﾞｲﾊﾟｽ許可" VALUE 0x00008348 REC_UBYTE_C 0 COMP_0283 0 1 BIT_MASK 0x0002 /end CHARACTERISTIC
/begin CHARACTERISTIC mfBPS017 "0:TTP_cal:ﾊﾞｲﾊﾟｽ不許可  1:TTP_cal:ﾊﾞｲﾊﾟｽ許可" VALUE 0x00008348 REC_UBYTE_C 0 COMP_0283 0 1 BIT_MASK 0x0001 /end CHARACTERISTIC
/begin CHARACTERISTIC mBYPASS04 "Flag mBYPASS04" VALUE 0x00008349 REC_UBYTE_C 0 COMP_0283 0 255 /end CHARACTERISTIC
/begin CHARACTERISTIC mfBPS032 "0:VO2SM_cont_load:ﾊﾞｲﾊﾟｽ不許可  1:VO2SM_cont_load:ﾊﾞｲﾊﾟｽ許可" VALUE 0x00008349 REC_UBYTE_C 0 COMP_0283 0 1 BIT_MASK 0x0080 /end CHARACTERISTIC
/begin CHARACTERISTIC mfBPS031 "0:AFSHOS_cont_load:ﾊﾞｲﾊﾟｽ不許可  1:AFSHOS_cont_load:ﾊﾞｲﾊﾟｽ許可" VALUE 0x00008349 REC_UBYTE_C 0 COMP_0283 0 1 BIT_MASK 0x0040 /end CHARACTERISTIC
/begin CHARACTERISTIC mfBPS030 "0:AFSAF_cont_load:ﾊﾞｲﾊﾟｽ不許可  1:AFSAF_cont_load:ﾊﾞｲﾊﾟｽ許可" VALUE 0x00008349 REC_UBYTE_C 0 COMP_0283 0 1 BIT_MASK 0x0020 /end CHARACTERISTIC
/begin CHARACTERISTIC mfBPS029 "0:AFDIAG_cont_load:ﾊﾞｲﾊﾟｽ不許可  1:AFDIAG_cont_load:ﾊﾞｲﾊﾟｽ許可" VALUE 0x00008349 REC_UBYTE_C 0 COMP_0283 0 1 BIT_MASK 0x0010 /end CHARACTERISTIC
/begin CHARACTERISTIC mfBPS028 "0:alpha_smc_cont_load:ﾊﾞｲﾊﾟｽ不許可  1:alpha_smc_cont_load:ﾊﾞｲﾊﾟｽ許可" VALUE 0x00008349 REC_UBYTE_C 0 COMP_0283 0 1 BIT_MASK 0x0008 /end CHARACTERISTIC
/begin CHARACTERISTIC mfBPS027 "0:TGABF_cont_load:ﾊﾞｲﾊﾟｽ不許可  1:TGABF_cont_load:ﾊﾞｲﾊﾟｽ許可" VALUE 0x00008349 REC_UBYTE_C 0 COMP_0283 0 1 BIT_MASK 0x0004 /end CHARACTERISTIC
/begin CHARACTERISTIC mfBPS026 "0:S_TEcal:ﾊﾞｲﾊﾟｽ不許可  1:S_TEcal:ﾊﾞｲﾊﾟｽ許可" VALUE 0x00008349 REC_UBYTE_C 0 COMP_0283 0 1 BIT_MASK 0x0002 /end CHARACTERISTIC
/begin CHARACTERISTIC mfBPS025 "0:S_KATHOScal:ﾊﾞｲﾊﾟｽ不許可  1:S_KATHOScal:ﾊﾞｲﾊﾟｽ許可" VALUE 0x00008349 REC_UBYTE_C 0 COMP_0283 0 1 BIT_MASK 0x0001 /end CHARACTERISTIC
/begin CHARACTERISTIC mBYPASS05 "Flag mBYPASS05" VALUE 0x0000834A REC_UBYTE_C 0 COMP_0283 0 255 /end CHARACTERISTIC
/begin CHARACTERISTIC mfBPS040 "0:SCV_cal:ﾊﾞｲﾊﾟｽ不許可  1:SCV_cal:ﾊﾞｲﾊﾟｽ許可" VALUE 0x0000834A REC_UBYTE_C 0 COMP_0283 0 1 BIT_MASK 0x0080 /end CHARACTERISTIC
/begin CHARACTERISTIC mfBPS039 "0:S_INJTIMcal:ﾊﾞｲﾊﾟｽ不許可  1:S_INJTIMcal:ﾊﾞｲﾊﾟｽ許可" VALUE 0x0000834A REC_UBYTE_C 0 COMP_0283 0 1 BIT_MASK 0x0040 /end CHARACTERISTIC
/begin CHARACTERISTIC mfBPS038 "0:TITM_cal:ﾊﾞｲﾊﾟｽ不許可  1:TITM_cal:ﾊﾞｲﾊﾟｽ許可" VALUE 0x0000834A REC_UBYTE_C 0 COMP_0283 0 1 BIT_MASK 0x0020 /end CHARACTERISTIC
/begin CHARACTERISTIC mfBPS037 "0:S_TISETcal:ﾊﾞｲﾊﾟｽ不許可  1:S_TISETcal:ﾊﾞｲﾊﾟｽ許可" VALUE 0x0000834A REC_UBYTE_C 0 COMP_0283 0 1 BIT_MASK 0x0010 /end CHARACTERISTIC
/begin CHARACTERISTIC mfBPS036 "0:S_CTIncal:ﾊﾞｲﾊﾟｽ不許可  1:S_CTIncal:ﾊﾞｲﾊﾟｽ許可" VALUE 0x0000834A REC_UBYTE_C 0 COMP_0283 0 1 BIT_MASK 0x0008 /end CHARACTERISTIC
/begin CHARACTERISTIC mfBPS035 "0:MRLRN_cal:ﾊﾞｲﾊﾟｽ不許可  1:MRLRN_cal:ﾊﾞｲﾊﾟｽ許可" VALUE 0x0000834A REC_UBYTE_C 0 COMP_0283 0 1 BIT_MASK 0x0004 /end CHARACTERISTIC
/begin CHARACTERISTIC mfBPS034 "0:AFSFTDGN_cal:ﾊﾞｲﾊﾟｽ不許可  1:AFSFTDGN_cal:ﾊﾞｲﾊﾟｽ許可" VALUE 0x0000834A REC_UBYTE_C 0 COMP_0283 0 1 BIT_MASK 0x0002 /end CHARACTERISTIC
/begin CHARACTERISTIC mfBPS033 "0:CLAMP_cont_load:ﾊﾞｲﾊﾟｽ不許可  1:CLAMP_cont_load:ﾊﾞｲﾊﾟｽ許可" VALUE 0x0000834A REC_UBYTE_C 0 COMP_0283 0 1 BIT_MASK 0x0001 /end CHARACTERISTIC
/begin CHARACTERISTIC mBYPASS06 "Flag mBYPASS06" VALUE 0x0000834B REC_UBYTE_C 0 COMP_0283 0 255 /end CHARACTERISTIC
/begin CHARACTERISTIC mfBPS048 "0:TADVMcal:ﾊﾞｲﾊﾟｽ不許可  1:TADVMcal:ﾊﾞｲﾊﾟｽ許可" VALUE 0x0000834B REC_UBYTE_C 0 COMP_0283 0 1 BIT_MASK 0x0080 /end CHARACTERISTIC
/begin CHARACTERISTIC mfBPS047 "0:EGRcal:ﾊﾞｲﾊﾟｽ不許可  1:EGRcal:ﾊﾞｲﾊﾟｽ許可" VALUE 0x0000834B REC_UBYTE_C 0 COMP_0283 0 1 BIT_MASK 0x0040 /end CHARACTERISTIC
/begin CHARACTERISTIC mfBPS046 "0:PIFCcal:ﾊﾞｲﾊﾟｽ不許可  1:PIFCcal:ﾊﾞｲﾊﾟｽ許可" VALUE 0x0000834B REC_UBYTE_C 0 COMP_0283 0 1 BIT_MASK 0x0020 /end CHARACTERISTIC
/begin CHARACTERISTIC mfBPS045 "0:DUETTEcal:ﾊﾞｲﾊﾟｽ不許可  1:DUETTEcal:ﾊﾞｲﾊﾟｽ許可" VALUE 0x0000834B REC_UBYTE_C 0 COMP_0283 0 1 BIT_MASK 0x0010 /end CHARACTERISTIC
/begin CHARACTERISTIC mfBPS044 "0:KNOCKcal:ﾊﾞｲﾊﾟｽ不許可  1:KNOCKcal:ﾊﾞｲﾊﾟｽ許可" VALUE 0x0000834B REC_UBYTE_C 0 COMP_0283 0 1 BIT_MASK 0x0008 /end CHARACTERISTIC
/begin CHARACTERISTIC mfBPS043 "0:LADVTRMcal:ﾊﾞｲﾊﾟｽ不許可  1:LADVTRMcal:ﾊﾞｲﾊﾟｽ許可" VALUE 0x0000834B REC_UBYTE_C 0 COMP_0283 0 1 BIT_MASK 0x0004 /end CHARACTERISTIC
/begin CHARACTERISTIC mfBPS042 "0:ESCV_cal:ﾊﾞｲﾊﾟｽ不許可  1:ESCV_cal:ﾊﾞｲﾊﾟｽ許可" VALUE 0x0000834B REC_UBYTE_C 0 COMP_0283 0 1 BIT_MASK 0x0002 /end CHARACTERISTIC
/begin CHARACTERISTIC mfBPS041 "0:TCV_cal:ﾊﾞｲﾊﾟｽ不許可  1:TCV_cal:ﾊﾞｲﾊﾟｽ許可" VALUE 0x0000834B REC_UBYTE_C 0 COMP_0283 0 1 BIT_MASK 0x0001 /end CHARACTERISTIC
/begin CHARACTERISTIC mBYPASS07 "Flag mBYPASS07" VALUE 0x0000834C REC_UBYTE_C 0 COMP_0283 0 255 /end CHARACTERISTIC
/begin CHARACTERISTIC mfBPS056 "0:VTCCSCA_cal:ﾊﾞｲﾊﾟｽ不許可  1:VTCCSCA_cal:ﾊﾞｲﾊﾟｽ許可" VALUE 0x0000834C REC_UBYTE_C 0 COMP_0283 0 1 BIT_MASK 0x0080 /end CHARACTERISTIC
/begin CHARACTERISTIC mfBPS055 "0:TGIVO_TGIVC_cal:ﾊﾞｲﾊﾟｽ不許可  1:TGIVO_TGIVC_cal:ﾊﾞｲﾊﾟｽ許可" VALUE 0x0000834C REC_UBYTE_C 0 COMP_0283 0 1 BIT_MASK 0x0040 /end CHARACTERISTIC
/begin CHARACTERISTIC mfBPS054 "0:PURGECONT_load:ﾊﾞｲﾊﾟｽ不許可  1:PURGECONT_load:ﾊﾞｲﾊﾟｽ許可" VALUE 0x0000834C REC_UBYTE_C 0 COMP_0283 0 1 BIT_MASK 0x0020 /end CHARACTERISTIC
/begin CHARACTERISTIC mfBPS053 "0:CPC_cal:ﾊﾞｲﾊﾟｽ不許可  1:CPC_cal:ﾊﾞｲﾊﾟｽ許可" VALUE 0x0000834C REC_UBYTE_C 0 COMP_0283 0 1 BIT_MASK 0x0010 /end CHARACTERISTIC
/begin CHARACTERISTIC mfBPS052 "0:RESP_ETD:ﾊﾞｲﾊﾟｽ不許可  1:RESP_ETD:ﾊﾞｲﾊﾟｽ許可" VALUE 0x0000834C REC_UBYTE_C 0 COMP_0283 0 1 BIT_MASK 0x0008 /end CHARACTERISTIC
/begin CHARACTERISTIC mfBPS051 "0:TGTVO_cal:ﾊﾞｲﾊﾟｽ不許可  1:TGTVO_cal:ﾊﾞｲﾊﾟｽ許可" VALUE 0x0000834C REC_UBYTE_C 0 COMP_0283 0 1 BIT_MASK 0x0004 /end CHARACTERISTIC
/begin CHARACTERISTIC mfBPS050 "0:QLRN_cal:ﾊﾞｲﾊﾟｽ不許可  1:QLRN_cal:ﾊﾞｲﾊﾟｽ許可" VALUE 0x0000834C REC_UBYTE_C 0 COMP_0283 0 1 BIT_MASK 0x0002 /end CHARACTERISTIC
/begin CHARACTERISTIC mfBPS049 "0:QTAS_cal:ﾊﾞｲﾊﾟｽ不許可  1:QTAS_cal:ﾊﾞｲﾊﾟｽ許可" VALUE 0x0000834C REC_UBYTE_C 0 COMP_0283 0 1 BIT_MASK 0x0001 /end CHARACTERISTIC
/begin CHARACTERISTIC mBYPASS08 "Flag mBYPASS08" VALUE 0x0000834D REC_UBYTE_C 0 COMP_0283 0 255 /end CHARACTERISTIC
/begin CHARACTERISTIC mfBPS064 "0:AFMDGN_cal:ﾊﾞｲﾊﾟｽ不許可  1:AFMDGN_cal:ﾊﾞｲﾊﾟｽ許可" VALUE 0x0000834D REC_UBYTE_C 0 COMP_0283 0 1 BIT_MASK 0x0080 /end CHARACTERISTIC
/begin CHARACTERISTIC mfBPS063 "0:MFapp_cal:ﾊﾞｲﾊﾟｽ不許可  1:MFapp_cal:ﾊﾞｲﾊﾟｽ許可" VALUE 0x0000834D REC_UBYTE_C 0 COMP_0283 0 1 BIT_MASK 0x0040 /end CHARACTERISTIC
/begin CHARACTERISTIC mfBPS062 "0:RO2FB_cal:ﾊﾞｲﾊﾟｽ不許可  1:RO2FB_cal:ﾊﾞｲﾊﾟｽ許可" VALUE 0x0000834D REC_UBYTE_C 0 COMP_0283 0 1 BIT_MASK 0x0020 /end CHARACTERISTIC
/begin CHARACTERISTIC mfBPS061 "0:EMVTCE_cal:ﾊﾞｲﾊﾟｽ不許可  1:EMVTCE_cal:ﾊﾞｲﾊﾟｽ許可" VALUE 0x0000834D REC_UBYTE_C 0 COMP_0283 0 1 BIT_MASK 0x0010 /end CHARACTERISTIC
/begin CHARACTERISTIC mfBPS060 "0:EMVTCI_cal:ﾊﾞｲﾊﾟｽ不許可  1:EMVTCI_cal:ﾊﾞｲﾊﾟｽ許可" VALUE 0x0000834D REC_UBYTE_C 0 COMP_0283 0 1 BIT_MASK 0x0008 /end CHARACTERISTIC
/begin CHARACTERISTIC mfBPS059 "0:CVTC_cal:ﾊﾞｲﾊﾟｽ不許可  1:CVTC_cal:ﾊﾞｲﾊﾟｽ許可" VALUE 0x0000834D REC_UBYTE_C 0 COMP_0283 0 1 BIT_MASK 0x0004 /end CHARACTERISTIC
/begin CHARACTERISTIC mfBPS058 "0:TGVEL_cal:ﾊﾞｲﾊﾟｽ不許可  1:TGVEL_cal:ﾊﾞｲﾊﾟｽ許可" VALUE 0x0000834D REC_UBYTE_C 0 COMP_0283 0 1 BIT_MASK 0x0002 /end CHARACTERISTIC
/begin CHARACTERISTIC mfBPS057 "0:RQBST_cal:ﾊﾞｲﾊﾟｽ不許可  1:RQBST_cal:ﾊﾞｲﾊﾟｽ許可" VALUE 0x0000834D REC_UBYTE_C 0 COMP_0283 0 1 BIT_MASK 0x0001 /end CHARACTERISTIC
/begin CHARACTERISTIC mBYPASS09 "Flag mBYPASS09" VALUE 0x0000834E REC_UBYTE_C 0 COMP_0283 0 255 /end CHARACTERISTIC
/begin CHARACTERISTIC mfBPS072 "0:ThrdO2SensorDiag_cal:ﾊﾞｲﾊﾟｽ不許  1:ThrdO2SensorDiag_cal:ﾊﾞｲﾊﾟｽ許可" VALUE 0x0000834E REC_UBYTE_C 0 COMP_0283 0 1 BIT_MASK 0x0080 /end CHARACTERISTIC
/begin CHARACTERISTIC mfBPS071 "0:HCtrap_diag_cal:ﾊﾞｲﾊﾟｽ不許可  1:HCtrap_diag_cal:ﾊﾞｲﾊﾟｽ許可" VALUE 0x0000834E REC_UBYTE_C 0 COMP_0283 0 1 BIT_MASK 0x0040 /end CHARACTERISTIC
/begin CHARACTERISTIC mfBPS070 "0:CSSDGN_cal:ﾊﾞｲﾊﾟｽ不許可  1:CSSDGN_cal:ﾊﾞｲﾊﾟｽ許可" VALUE 0x0000834E REC_UBYTE_C 0 COMP_0283 0 1 BIT_MASK 0x0020 /end CHARACTERISTIC
/begin CHARACTERISTIC mfBPS069 "0:AFDIAG_kal_cal:ﾊﾞｲﾊﾟｽ不許可  1:AFDIAG_kal_cal:ﾊﾞｲﾊﾟｽ許可" VALUE 0x0000834E REC_UBYTE_C 0 COMP_0283 0 1 BIT_MASK 0x0010 /end CHARACTERISTIC
/begin CHARACTERISTIC mfBPS068 "0:THMMDL_cal:ﾊﾞｲﾊﾟｽ不許可  1:THMMDL_cal:ﾊﾞｲﾊﾟｽ許可" VALUE 0x0000834E REC_UBYTE_C 0 COMP_0283 0 1 BIT_MASK 0x0008 /end CHARACTERISTIC
/begin CHARACTERISTIC mfBPS067 "0:RearO2HeaterDiag_cal:ﾊﾞｲﾊﾟｽ不許  1:RearO2HeaterDiag_cal:ﾊﾞｲﾊﾟｽ許可" VALUE 0x0000834E REC_UBYTE_C 0 COMP_0283 0 1 BIT_MASK 0x0004 /end CHARACTERISTIC
/begin CHARACTERISTIC mfBPS066 "0:RearO2SensorDiag_cal:ﾊﾞｲﾊﾟｽ不許  1:RearO2SensorDiag_cal:ﾊﾞｲﾊﾟｽ許可" VALUE 0x0000834E REC_UBYTE_C 0 COMP_0283 0 1 BIT_MASK 0x0002 /end CHARACTERISTIC
/begin CHARACTERISTIC mfBPS065 "0:CATDGN_cal:ﾊﾞｲﾊﾟｽ不許可  1:CATDGN_cal:ﾊﾞｲﾊﾟｽ許可" VALUE 0x0000834E REC_UBYTE_C 0 COMP_0283 0 1 BIT_MASK 0x0001 /end CHARACTERISTIC
/begin CHARACTERISTIC mBYPASS10 "Flag mBYPASS10" VALUE 0x0000834F REC_UBYTE_C 0 COMP_0283 0 255 /end CHARACTERISTIC
/begin CHARACTERISTIC mfBPS080 "0:TP2ms_cal:ﾊﾞｲﾊﾟｽ不許可  1:TP2ms_cal:ﾊﾞｲﾊﾟｽ許可" VALUE 0x0000834F REC_UBYTE_C 0 COMP_0283 0 1 BIT_MASK 0x0080 /end CHARACTERISTIC
/begin CHARACTERISTIC mfBPS079 "0:MACYL_set:ﾊﾞｲﾊﾟｽ不許可  1:MACYL_set:ﾊﾞｲﾊﾟｽ許可" VALUE 0x0000834F REC_UBYTE_C 0 COMP_0283 0 1 BIT_MASK 0x0040 /end CHARACTERISTIC
/begin CHARACTERISTIC mfBPS078 "0:MAMANI_set:ﾊﾞｲﾊﾟｽ不許可  1:MAMANI_set:ﾊﾞｲﾊﾟｽ許可" VALUE 0x0000834F REC_UBYTE_C 0 COMP_0283 0 1 BIT_MASK 0x0020 /end CHARACTERISTIC
/begin CHARACTERISTIC mfBPS077 "0:NEWQ_2ms_cal:ﾊﾞｲﾊﾟｽ不許可  1:NEWQ_2ms_cal:ﾊﾞｲﾊﾟｽ許可" VALUE 0x0000834F REC_UBYTE_C 0 COMP_0283 0 1 BIT_MASK 0x0010 /end CHARACTERISTIC
/begin CHARACTERISTIC mfBPS076 "0:ROBUSTcal:ﾊﾞｲﾊﾟｽ不許可  1:ROBUSTcal:ﾊﾞｲﾊﾟｽ許可" VALUE 0x0000834F REC_UBYTE_C 0 COMP_0283 0 1 BIT_MASK 0x0008 /end CHARACTERISTIC
/begin CHARACTERISTIC mfBPS075 "0:LEAK002_cal:ﾊﾞｲﾊﾟｽ不許可  1:LEAK002_cal:ﾊﾞｲﾊﾟｽ許可" VALUE 0x0000834F REC_UBYTE_C 0 COMP_0283 0 1 BIT_MASK 0x0004 /end CHARACTERISTIC
/begin CHARACTERISTIC mfBPS074 "0:SEA_MASTER:ﾊﾞｲﾊﾟｽ不許可  1:SEA_MASTER:ﾊﾞｲﾊﾟｽ許可" VALUE 0x0000834F REC_UBYTE_C 0 COMP_0283 0 1 BIT_MASK 0x0002 /end CHARACTERISTIC
/begin CHARACTERISTIC mfBPS073 "0:TO2HeaterDiag_cal:ﾊﾞｲﾊﾟｽ不許可  1:TO2HeaterDiag_cal:ﾊﾞｲﾊﾟｽ許可" VALUE 0x0000834F REC_UBYTE_C 0 COMP_0283 0 1 BIT_MASK 0x0001 /end CHARACTERISTIC
/begin CHARACTERISTIC mBYPASS11 "Flag mBYPASS11" VALUE 0x00008350 REC_UBYTE_C 0 COMP_0283 0 255 /end CHARACTERISTIC
/begin CHARACTERISTIC mfBPS088 "0:EVPRES_cal:ﾊﾞｲﾊﾟｽ不許可  1:EVPRES_cal:ﾊﾞｲﾊﾟｽ許可" VALUE 0x00008350 REC_UBYTE_C 0 COMP_0283 0 1 BIT_MASK 0x0080 /end CHARACTERISTIC
/begin CHARACTERISTIC mfBPS087 "0:VCYL_cal:ﾊﾞｲﾊﾟｽ不許可  1:VCYL_cal:ﾊﾞｲﾊﾟｽ許可" VALUE 0x00008350 REC_UBYTE_C 0 COMP_0283 0 1 BIT_MASK 0x0040 /end CHARACTERISTIC
/begin CHARACTERISTIC mfBPS086 "0:NEWQ_10ms_cal:ﾊﾞｲﾊﾟｽ不許可  1:NEWQ_10ms_cal:ﾊﾞｲﾊﾟｽ許可" VALUE 0x00008350 REC_UBYTE_C 0 COMP_0283 0 1 BIT_MASK 0x0020 /end CHARACTERISTIC
/begin CHARACTERISTIC mfBPS085 "0:QH0_cal:ﾊﾞｲﾊﾟｽ不許可  1:QH0_cal:ﾊﾞｲﾊﾟｽ許可" VALUE 0x00008350 REC_UBYTE_C 0 COMP_0283 0 1 BIT_MASK 0x0010 /end CHARACTERISTIC
/begin CHARACTERISTIC mfBPS084 "0:CANAPPRX:ﾊﾞｲﾊﾟｽ不許可  1:CANAPPRX:ﾊﾞｲﾊﾟｽ許可" VALUE 0x00008350 REC_UBYTE_C 0 COMP_0283 0 1 BIT_MASK 0x0008 /end CHARACTERISTIC
/begin CHARACTERISTIC mfBPS083 "0:TP4ms_cal:ﾊﾞｲﾊﾟｽ不許可  1:TP4ms_cal:ﾊﾞｲﾊﾟｽ許可" VALUE 0x00008350 REC_UBYTE_C 0 COMP_0283 0 1 BIT_MASK 0x0004 /end CHARACTERISTIC
/begin CHARACTERISTIC mfBPS082 "0:Q_cal:ﾊﾞｲﾊﾟｽ不許可  1:Q_cal:ﾊﾞｲﾊﾟｽ許可" VALUE 0x00008350 REC_UBYTE_C 0 COMP_0283 0 1 BIT_MASK 0x0002 /end CHARACTERISTIC
/begin CHARACTERISTIC mfBPS081 "0:TP_set:ﾊﾞｲﾊﾟｽ不許可  1:TP_set:ﾊﾞｲﾊﾟｽ許可" VALUE 0x00008350 REC_UBYTE_C 0 COMP_0283 0 1 BIT_MASK 0x0001 /end CHARACTERISTIC
/begin CHARACTERISTIC mBYPASS12 "Flag mBYPASS12" VALUE 0x00008351 REC_UBYTE_C 0 COMP_0283 0 255 /end CHARACTERISTIC
/begin CHARACTERISTIC mfBPS096 "0:S_PULSset:ﾊﾞｲﾊﾟｽ不許可  1:S_PULSset:ﾊﾞｲﾊﾟｽ許可" VALUE 0x00008351 REC_UBYTE_C 0 COMP_0283 0 1 BIT_MASK 0x0080 /end CHARACTERISTIC
/begin CHARACTERISTIC mfBPS095 "0:S_REFEGIcal:ﾊﾞｲﾊﾟｽ不許可  1:S_REFEGIcal:ﾊﾞｲﾊﾟｽ許可" VALUE 0x00008351 REC_UBYTE_C 0 COMP_0283 0 1 BIT_MASK 0x0040 /end CHARACTERISTIC
/begin CHARACTERISTIC mfBPS094 "0:MFrev_cal:ﾊﾞｲﾊﾟｽ不許可  1:MFrev_cal:ﾊﾞｲﾊﾟｽ許可" VALUE 0x00008351 REC_UBYTE_C 0 COMP_0283 0 1 BIT_MASK 0x0020 /end CHARACTERISTIC
/begin CHARACTERISTIC mfBPS093 "0:MFref_cal:ﾊﾞｲﾊﾟｽ不許可  1:MFref_cal:ﾊﾞｲﾊﾟｽ許可" VALUE 0x00008351 REC_UBYTE_C 0 COMP_0283 0 1 BIT_MASK 0x0010 /end CHARACTERISTIC
/begin CHARACTERISTIC mfBPS092 "0:Coldstrategy_cal:ﾊﾞｲﾊﾟｽ不許可  1:Coldstrategy_cal:ﾊﾞｲﾊﾟｽ許可" VALUE 0x00008351 REC_UBYTE_C 0 COMP_0283 0 1 BIT_MASK 0x0008 /end CHARACTERISTIC
/begin CHARACTERISTIC mfBPS091 "0:AF_cal:ﾊﾞｲﾊﾟｽ不許可  1:AF_cal:ﾊﾞｲﾊﾟｽ許可" VALUE 0x00008351 REC_UBYTE_C 0 COMP_0283 0 1 BIT_MASK 0x0004 /end CHARACTERISTIC
/begin CHARACTERISTIC mfBPS090 "0:CANAPPTX:ﾊﾞｲﾊﾟｽ不許可  1:CANAPPTX:ﾊﾞｲﾊﾟｽ許可" VALUE 0x00008351 REC_UBYTE_C 0 COMP_0283 0 1 BIT_MASK 0x0002 /end CHARACTERISTIC
/begin CHARACTERISTIC mfBPS089 "0:FGAGE_cal:ﾊﾞｲﾊﾟｽ不許可  1:FGAGE_cal:ﾊﾞｲﾊﾟｽ許可" VALUE 0x00008351 REC_UBYTE_C 0 COMP_0283 0 1 BIT_MASK 0x0001 /end CHARACTERISTIC
/begin CHARACTERISTIC mBYPASS13 "Flag mBYPASS13" VALUE 0x00008352 REC_UBYTE_C 0 COMP_0283 0 255 /end CHARACTERISTIC
/begin CHARACTERISTIC mfBPS098 "0:EVAPOUT_cal:ﾊﾞｲﾊﾟｽ不許可  1:EVAPOUT_cal:ﾊﾞｲﾊﾟｽ許可" VALUE 0x00008352 REC_UBYTE_C 0 COMP_0283 0 1 BIT_MASK 0x0002 /end CHARACTERISTIC
/begin CHARACTERISTIC mfBPS097 "0:ADVcal:ﾊﾞｲﾊﾟｽ不許可  1:ADVcal:ﾊﾞｲﾊﾟｽ許可" VALUE 0x00008352 REC_UBYTE_C 0 COMP_0283 0 1 BIT_MASK 0x0001 /end CHARACTERISTIC
/begin CHARACTERISTIC mCANFLG "Flag mCANFLG" VALUE 0x00008357 REC_UBYTE_C 0 COMP_0283 0 255 /end CHARACTERISTIC
/begin CHARACTERISTIC mfRADCAN "0:LOW要求  1:MID要求" VALUE 0x00008357 REC_UBYTE_C 0 COMP_0283 0 1 BIT_MASK 0x0080 /end CHARACTERISTIC
/begin CHARACTERISTIC mfACPDCUT "0:ﾒｰﾀCAN_#PDCUT出力無し_(#METCAN=0  1:ﾒｰﾀCAN_#PDCUT出力有り_(#METCAN=0" VALUE 0x00008357 REC_UBYTE_C 0 COMP_0283 0 1 BIT_MASK 0x0040 /end CHARACTERISTIC
/begin CHARACTERISTIC mfMETIPDM1 "0:IPDM対応無し  1:IPDM対応有り" VALUE 0x00008357 REC_UBYTE_C 0 COMP_0283 0 1 BIT_MASK 0x0020 /end CHARACTERISTIC
/begin CHARACTERISTIC mfMETIPDM "0:IPDM対応無し  1:IPDM対応有り" VALUE 0x00008357 REC_UBYTE_C 0 COMP_0283 0 1 BIT_MASK 0x0010 /end CHARACTERISTIC
/begin CHARACTERISTIC mfMETCAN3 "0:CAN入力以外  1:CAN入力" VALUE 0x00008357 REC_UBYTE_C 0 COMP_0283 0 1 BIT_MASK 0x0008 /end CHARACTERISTIC
/begin CHARACTERISTIC mfMETCAN2 "0:CAN入力以外  1:CAN入力" VALUE 0x00008357 REC_UBYTE_C 0 COMP_0283 0 1 BIT_MASK 0x0004 /end CHARACTERISTIC
/begin CHARACTERISTIC mfMETCAN1 "0:CAN入力以外  1:CAN入力" VALUE 0x00008357 REC_UBYTE_C 0 COMP_0283 0 1 BIT_MASK 0x0002 /end CHARACTERISTIC
/begin CHARACTERISTIC mfMETCAN "0:CAN入力以外  1:CAN入力" VALUE 0x00008357 REC_UBYTE_C 0 COMP_0283 0 1 BIT_MASK 0x0001 /end CHARACTERISTIC
/begin CHARACTERISTIC mCOMMON "Flag mCOMMON" VALUE 0x000083C0 REC_UBYTE_C 0 COMP_0283 0 255 /end CHARACTERISTIC
/begin CHARACTERISTIC mfPDLFMMNL "0:ペダル特性係数反映あり  1:ペダル特性係数固定" VALUE 0x000083C0 REC_UBYTE_C 0 COMP_0283 0 1 BIT_MASK 0x0080 /end CHARACTERISTIC
/begin CHARACTERISTIC mfPMDSWARI "0:オートパワーモード  1:パワーSWパワーモード" VALUE 0x000083C0 REC_UBYTE_C 0 COMP_0283 0 1 BIT_MASK 0x0040 /end CHARACTERISTIC
/begin CHARACTERISTIC mfSWREFTRQ "0:目標トルク(TTEP)ベースリタード  1:実トルク(TENG)ベースリタード" VALUE 0x000083C0 REC_UBYTE_C 0 COMP_0283 0 1 BIT_MASK 0x0020 /end CHARACTERISTIC
/begin CHARACTERISTIC mfCANGNSW "0:CAN3世代対応  1:CAN1.5世代対応" VALUE 0x000083C0 REC_UBYTE_C 0 COMP_0283 0 1 BIT_MASK 0x0010 /end CHARACTERISTIC
/begin CHARACTERISTIC mfSWROC "0:K-Line使用リプロ  1:ReprogOnCAN" VALUE 0x000083C0 REC_UBYTE_C 0 COMP_0283 0 1 BIT_MASK 0x0008 /end CHARACTERISTIC
/begin CHARACTERISTIC mfSWDOC "0:DDL  1:DiagOnCAN" VALUE 0x000083C0 REC_UBYTE_C 0 COMP_0283 0 1 BIT_MASK 0x0004 /end CHARACTERISTIC
/begin CHARACTERISTIC mfPOWER "0:日産PTD  1:パワーコンセプト" VALUE 0x000083C0 REC_UBYTE_C 0 COMP_0283 0 1 BIT_MASK 0x0002 /end CHARACTERISTIC
/begin CHARACTERISTIC mfRENAULT "0:日産仕様  1:ルノー仕様" VALUE 0x000083C0 REC_UBYTE_C 0 COMP_0283 0 1 BIT_MASK 0x0001 /end CHARACTERISTIC
/begin CHARACTERISTIC mCSBUID "Flag mCSBUID" VALUE 0x000083CE REC_UBYTE_C 0 COMP_0283 0 255 /end CHARACTERISTIC
/begin CHARACTERISTIC mfFFITIM "0:始動時初回燃料噴射1回  1:始動時初回燃料噴射2回" VALUE 0x000083CE REC_UBYTE_C 0 COMP_0283 0 1 BIT_MASK 0x0020 /end CHARACTERISTIC
/begin CHARACTERISTIC mfFCSMK "0:始動時C/Sﾏｽｸ制御無し  1:始動時C/Sﾏｽｸ制御有り" VALUE 0x000083CE REC_UBYTE_C 0 COMP_0283 0 1 BIT_MASK 0x0010 /end CHARACTERISTIC
/begin CHARACTERISTIC mfFIGNRG "0:点火誤配電防止機能無し  1:点火誤配電防止機能有り" VALUE 0x000083CE REC_UBYTE_C 0 COMP_0283 0 1 BIT_MASK 0x0004 /end CHARACTERISTIC
/begin CHARACTERISTIC mfFRF110C "0:疑似REF生成無し  1:疑似REF生成有り" VALUE 0x000083CE REC_UBYTE_C 0 COMP_0283 0 1 BIT_MASK 0x0002 /end CHARACTERISTIC
/begin CHARACTERISTIC mfCSBU "0:C/Sﾊﾞｯｸｱｯﾌﾟ無し  1:C/Sﾊﾞｯｸｱｯﾌﾟ有り" VALUE 0x000083CE REC_UBYTE_C 0 COMP_0283 0 1 BIT_MASK 0x0001 /end CHARACTERISTIC
/begin CHARACTERISTIC mCSBUID_S "Flag mCSBUID_S" VALUE 0x000157CB REC_UBYTE_C 0 COMP_0283 0 255 /end CHARACTERISTIC
/begin CHARACTERISTIC mfCSBU_S "0:C/Sﾊﾞｯｸｱｯﾌﾟ無し  1:C/Sﾊﾞｯｸｱｯﾌﾟ有り" VALUE 0x000157CB REC_UBYTE_C 0 COMP_0283 0 1 BIT_MASK 0x0001 /end CHARACTERISTIC
/begin CHARACTERISTIC mCSDGKI "Flag mCSDGKI" VALUE 0x000083CF REC_UBYTE_C 0 COMP_0283 0 255 /end CHARACTERISTIC
/begin CHARACTERISTIC mfFCSTR1 "0:2TRIP診断  1:1TRIP診断" VALUE 0x000083CF REC_UBYTE_C 0 COMP_0283 0 1 BIT_MASK 0x0001 /end CHARACTERISTIC
/begin CHARACTERISTIC mCSDGKI_S "Flag mCSDGKI_S" VALUE 0x000157CC REC_UBYTE_C 0 COMP_0283 0 255 /end CHARACTERISTIC
/begin CHARACTERISTIC mfFCSTR1_S "0:2TRIP診断  1:1TRIP診断" VALUE 0x000157CC REC_UBYTE_C 0 COMP_0283 0 1 BIT_MASK 0x0001 /end CHARACTERISTIC
/begin CHARACTERISTIC mCSIGNS "Flag mCSIGNS" VALUE 0x000083D0 REC_UBYTE_C 0 COMP_0283 0 255 /end CHARACTERISTIC
/begin CHARACTERISTIC mfCHIGER "0:同時通電禁止  1:同時通電許可" VALUE 0x000083D0 REC_UBYTE_C 0 COMP_0283 0 1 BIT_MASK 0x0080 /end CHARACTERISTIC
/begin CHARACTERISTIC mDIGCHK "Flag mDIGCHK" VALUE 0x0000842C REC_UBYTE_C 0 COMP_0283 0 255 /end CHARACTERISTIC
/begin CHARACTERISTIC mfMBTCAL "0:MBTCALの計算なし  1:MBTCALの計算あり" VALUE 0x0000842C REC_UBYTE_C 0 COMP_0283 0 1 BIT_MASK 0x0001 /end CHARACTERISTIC
/begin CHARACTERISTIC mDRIVMOD2 "Flag mDRIVMOD2" VALUE 0x00008498 REC_UBYTE_C 0 COMP_0283 0 255 /end CHARACTERISTIC
/begin CHARACTERISTIC mfDRMDRMUP "0:ﾓｰﾄﾞSW開き側移行禁止(Mode_SW_ope  1:ﾓｰﾄﾞSW開き側移行許可(Mode_SW_ope" VALUE 0x00008498 REC_UBYTE_C 0 COMP_0283 0 1 BIT_MASK 0x0001 /end CHARACTERISTIC
/begin CHARACTERISTIC mDRIVMODE "Flag mDRIVMODE" VALUE 0x00008499 REC_UBYTE_C 0 COMP_0283 0 255 /end CHARACTERISTIC
/begin CHARACTERISTIC mfDRV_NTQH "0:回転数ﾄﾙｸ補正作動＿ﾓｰﾄﾞ条件無し  1:回転数ﾄﾙｸ補正作動＿SPORTﾓｰﾄﾞのみ" VALUE 0x00008499 REC_UBYTE_C 0 COMP_0283 0 1 BIT_MASK 0x0080 /end CHARACTERISTIC
/begin CHARACTERISTIC mfDRV_EPDL "0:ECOﾍﾟﾀﾞﾙ作動時ECOﾓｰﾄﾞ制御禁止  1:ECOﾍﾟﾀﾞﾙ作動時ECOﾓｰﾄﾞ制御許可" VALUE 0x00008499 REC_UBYTE_C 0 COMP_0283 0 1 BIT_MASK 0x0020 /end CHARACTERISTIC
/begin CHARACTERISTIC mfECO_TQLM "0:ﾄﾙｸﾘﾐｯﾀ作動禁止  1:ﾄﾙｸﾘﾐｯﾀ作動許可" VALUE 0x00008499 REC_UBYTE_C 0 COMP_0283 0 1 BIT_MASK 0x0010 /end CHARACTERISTIC
/begin CHARACTERISTIC mfPDL_RAMP "0:ｱｸｾﾙ開度変化量ﾘﾐｯﾀ作動禁止  1:ｱｸｾﾙ開度変化量ﾘﾐｯﾀ作動許可" VALUE 0x00008499 REC_UBYTE_C 0 COMP_0283 0 1 BIT_MASK 0x0008 /end CHARACTERISTIC
/begin CHARACTERISTIC mfASC_RAMP "0:ASC連動ｱｸｾﾙ開度変化量ﾘﾐｯﾀ作動禁  1:ASC連動ｱｸｾﾙ開度変化量ﾘﾐｯﾀ作動許" VALUE 0x00008499 REC_UBYTE_C 0 COMP_0283 0 1 BIT_MASK 0x0004 /end CHARACTERISTIC
/begin CHARACTERISTIC mfASC_ECO "0:ASC_ECOﾓｰﾄﾞ連動禁止  1:ASC_ECOﾓｰﾄﾞ連動許可" VALUE 0x00008499 REC_UBYTE_C 0 COMP_0283 0 1 BIT_MASK 0x0002 /end CHARACTERISTIC
/begin CHARACTERISTIC mfDRIVEMOD "0:ﾄﾞﾗｲﾌﾞﾓｰﾄﾞSW非対応  1:ﾄﾞﾗｲﾌﾞﾓｰﾄﾞSW対応" VALUE 0x00008499 REC_UBYTE_C 0 COMP_0283 0 1 BIT_MASK 0x0001 /end CHARACTERISTIC
/begin CHARACTERISTIC mDTSET "Flag mDTSET" VALUE 0x000084BE REC_UBYTE_C 0 COMP_0283 0 255 /end CHARACTERISTIC
/begin CHARACTERISTIC mfFLSINH "0:禁止制御なし  1:禁止制御あり" VALUE 0x000084BE REC_UBYTE_C 0 COMP_0283 0 1 BIT_MASK 0x0001 /end CHARACTERISTIC
/begin CHARACTERISTIC mDUBSW "Flag mDUBSW" VALUE 0x000084D1 REC_UBYTE_C 0 COMP_0283 0 255 /end CHARACTERISTIC
/begin CHARACTERISTIC mfDUCL "0:ＩＮＪ_D/U診断ＯＫ判定許可  1:ＩＮＪ_D/U診断ＯＫ判定禁止" VALUE 0x000084D1 REC_UBYTE_C 0 COMP_0283 0 1 BIT_MASK 0x0002 /end CHARACTERISTIC
/begin CHARACTERISTIC mfDUBSYL "0:気筒毎診断禁止  1:気筒毎診断許可" VALUE 0x000084D1 REC_UBYTE_C 0 COMP_0283 0 1 BIT_MASK 0x0001 /end CHARACTERISTIC
/begin CHARACTERISTIC mEGRFMPSW "Flag mEGRFMPSW" VALUE 0x00008507 REC_UBYTE_C 0 COMP_0283 0 255 /end CHARACTERISTIC
/begin CHARACTERISTIC mfEGRNGPC "0:ﾊﾟｰｼﾞｶｯﾄ非実行  1:ﾊﾟｰｼﾞｶｯﾄ実行" VALUE 0x00008507 REC_UBYTE_C 0 COMP_0283 0 1 BIT_MASK 0x0001 /end CHARACTERISTIC
/begin CHARACTERISTIC mETCLHM "Flag mETCLHM" VALUE 0x0000851D REC_UBYTE_C 0 COMP_0283 0 255 /end CHARACTERISTIC
/begin CHARACTERISTIC mfAPSSLH "0:非実行  1:実行" VALUE 0x0000851D REC_UBYTE_C 0 COMP_0283 0 1 BIT_MASK 0x0080 /end CHARACTERISTIC
/begin CHARACTERISTIC mfTPSSLH "0:非実行  1:実行" VALUE 0x0000851D REC_UBYTE_C 0 COMP_0283 0 1 BIT_MASK 0x0040 /end CHARACTERISTIC
/begin CHARACTERISTIC mFAPCDISW "Flag mFAPCDISW" VALUE 0x00008544 REC_UBYTE_C 0 COMP_0283 0 255 /end CHARACTERISTIC
/begin CHARACTERISTIC mfFHPCH "0:無し  1:有り" VALUE 0x00008544 REC_UBYTE_C 0 COMP_0283 0 1 BIT_MASK 0x0020 /end CHARACTERISTIC
/begin CHARACTERISTIC mfFINJCH "0:無し  1:有り" VALUE 0x00008544 REC_UBYTE_C 0 COMP_0283 0 1 BIT_MASK 0x0010 /end CHARACTERISTIC
/begin CHARACTERISTIC mfFHPEDCIN "0:禁止  1:許可" VALUE 0x00008544 REC_UBYTE_C 0 COMP_0283 0 1 BIT_MASK 0x0008 /end CHARACTERISTIC
/begin CHARACTERISTIC mfFIJCM2IN "0:normal  1:fast" VALUE 0x00008544 REC_UBYTE_C 0 COMP_0283 0 1 BIT_MASK 0x0004 /end CHARACTERISTIC
/begin CHARACTERISTIC mfFIJCM1IN "0:normal  1:fast" VALUE 0x00008544 REC_UBYTE_C 0 COMP_0283 0 1 BIT_MASK 0x0002 /end CHARACTERISTIC
/begin CHARACTERISTIC mfFNBSTIN "0:ピーク有り  1:ピーク無し" VALUE 0x00008544 REC_UBYTE_C 0 COMP_0283 0 1 BIT_MASK 0x0001 /end CHARACTERISTIC
/begin CHARACTERISTIC mFATAS "Flag mFATAS" VALUE 0x00008545 REC_UBYTE_C 0 COMP_0283 0 255 /end CHARACTERISTIC
/begin CHARACTERISTIC mfTVOFQLA "0:高速空気量アクティブ学習しない  1:高速空気量アクティブ学習する" VALUE 0x00008545 REC_UBYTE_C 0 COMP_0283 0 1 BIT_MASK 0x0010 /end CHARACTERISTIC
/begin CHARACTERISTIC mfFTASAC "0:A/CﾊﾟﾈﾙSW_ON時学習をしない  1:A/CﾊﾟﾈﾙSW_ON時学習をする" VALUE 0x00008545 REC_UBYTE_C 0 COMP_0283 0 1 BIT_MASK 0x0008 /end CHARACTERISTIC
/begin CHARACTERISTIC mfFFRQTAS "0:フリクション学習制御しない  1:フリクション学習制御する" VALUE 0x00008545 REC_UBYTE_C 0 COMP_0283 0 1 BIT_MASK 0x0004 /end CHARACTERISTIC
/begin CHARACTERISTIC mfTASSW "0:現行仕様  1:提案仕様" VALUE 0x00008545 REC_UBYTE_C 0 COMP_0283 0 1 BIT_MASK 0x0002 /end CHARACTERISTIC
/begin CHARACTERISTIC mfFATAS "0:ﾃﾞﾎﾟ対応無し  1:ﾃﾞﾎﾟ対応有り" VALUE 0x00008545 REC_UBYTE_C 0 COMP_0283 0 1 BIT_MASK 0x0001 /end CHARACTERISTIC
/begin CHARACTERISTIC mFFVSW "Flag mFFVSW" VALUE 0x0000856C REC_UBYTE_C 0 COMP_0283 0 255 /end CHARACTERISTIC
/begin CHARACTERISTIC mfFFVSYS "0:GAS仕様採用  1:FFV仕様採用" VALUE 0x0000856C REC_UBYTE_C 0 COMP_0283 0 1 BIT_MASK 0x0001 /end CHARACTERISTIC
/begin CHARACTERISTIC mFLGALT "Flag mFLGALT" VALUE 0x00008578 REC_UBYTE_C 0 COMP_0283 0 255 /end CHARACTERISTIC
/begin CHARACTERISTIC mfLSWD "0:R/Fより負荷状態判定なし  1:R/Fより負荷状態判定あり" VALUE 0x00008578 REC_UBYTE_C 0 COMP_0283 0 1 BIT_MASK 0x0080 /end CHARACTERISTIC
/begin CHARACTERISTIC mfFALFBK "0:ﾚｷﾞｭﾚｰﾄ電圧制御なし  1:ﾚｷﾞｭﾚｰﾄ電圧制御あり" VALUE 0x00008578 REC_UBYTE_C 0 COMP_0283 0 1 BIT_MASK 0x0040 /end CHARACTERISTIC
/begin CHARACTERISTIC mfFLDALC "0:OFF  1:ON" VALUE 0x00008578 REC_UBYTE_C 0 COMP_0283 0 1 BIT_MASK 0x0020 /end CHARACTERISTIC
/begin CHARACTERISTIC mfFACALC "0:OFF  1:ON" VALUE 0x00008578 REC_UBYTE_C 0 COMP_0283 0 1 BIT_MASK 0x0010 /end CHARACTERISTIC
/begin CHARACTERISTIC mfFRFALC "0:OFF  1:ON" VALUE 0x00008578 REC_UBYTE_C 0 COMP_0283 0 1 BIT_MASK 0x0008 /end CHARACTERISTIC
/begin CHARACTERISTIC mfFLALTAB "0:発電電流情報A(生値)  1:発電電流情報B(補正済値)" VALUE 0x00008578 REC_UBYTE_C 0 COMP_0283 0 1 BIT_MASK 0x0004 /end CHARACTERISTIC
/begin CHARACTERISTIC mfFALNLW "0:ｴﾝｼﾞﾝ回転低下時制御なし  1:ｴﾝｼﾞﾝ回転低下時制御あり" VALUE 0x00008578 REC_UBYTE_C 0 COMP_0283 0 1 BIT_MASK 0x0001 /end CHARACTERISTIC
/begin CHARACTERISTIC mFLGBRK "Flag mFLGBRK" VALUE 0x00008579 REC_UBYTE_C 0 COMP_0283 0 255 /end CHARACTERISTIC
/begin CHARACTERISTIC mfBOSBCMSW "0:BOS用BCMﾌﾞﾚｰｷSW読込み無し  1:BOS用BCMﾌﾞﾚｰｷSW読込み有り" VALUE 0x00008579 REC_UBYTE_C 0 COMP_0283 0 1 BIT_MASK 0x0080 /end CHARACTERISTIC
/begin CHARACTERISTIC mfPMVSYS "0:M/Vac負圧ｾﾝｻECM読込み  1:M/Vac負圧ｾﾝｻVDC読込み" VALUE 0x00008579 REC_UBYTE_C 0 COMP_0283 0 1 BIT_MASK 0x0020 /end CHARACTERISTIC
/begin CHARACTERISTIC mfNPBRKSW "0:ブレーキSW_OFF  1:ブレーキSW_切替時" VALUE 0x00008579 REC_UBYTE_C 0 COMP_0283 0 1 BIT_MASK 0x0010 /end CHARACTERISTIC
/begin CHARACTERISTIC mfGYKSEN "0:ﾉｰﾏﾙ特性  1:逆特性" VALUE 0x00008579 REC_UBYTE_C 0 COMP_0283 0 1 BIT_MASK 0x0008 /end CHARACTERISTIC
/begin CHARACTERISTIC mfSUBCSL "0:#FMVSWを生成  1:常時#FMVSW=1" VALUE 0x00008579 REC_UBYTE_C 0 COMP_0283 0 1 BIT_MASK 0x0004 /end CHARACTERISTIC
/begin CHARACTERISTIC mfONESEN "0:#FMVSWを生成  1:常時#FMVSW=1" VALUE 0x00008579 REC_UBYTE_C 0 COMP_0283 0 1 BIT_MASK 0x0002 /end CHARACTERISTIC
/begin CHARACTERISTIC mfBRKCONT "0:減速･ｱｲﾄﾞﾙ時負圧管理制御無し  1:減速･ｱｲﾄﾞﾙ時負圧管理制御有り" VALUE 0x00008579 REC_UBYTE_C 0 COMP_0283 0 1 BIT_MASK 0x0001 /end CHARACTERISTIC
/begin CHARACTERISTIC mFLGBRK_S "Flag mFLGBRK_S" VALUE 0x000157D1 REC_UBYTE_C 0 COMP_0283 0 255 /end CHARACTERISTIC
/begin CHARACTERISTIC mfONESEN_S "0:#FMWSW_Sを生成する。  1:常時#FMWSW_S=1" VALUE 0x000157D1 REC_UBYTE_C 0 COMP_0283 0 1 BIT_MASK 0x0002 /end CHARACTERISTIC
/begin CHARACTERISTIC mfBRKCNT_S "0:負圧管理制御を行わない  1:負圧管理制御を行う" VALUE 0x000157D1 REC_UBYTE_C 0 COMP_0283 0 1 BIT_MASK 0x0001 /end CHARACTERISTIC
/begin CHARACTERISTIC mFLGDJTR "Flag mFLGDJTR" VALUE 0x0000857A REC_UBYTE_C 0 COMP_0283 0 255 /end CHARACTERISTIC
/begin CHARACTERISTIC mfFTPOQL "0:高速空気学習不許可  1:高速空気学習許可" VALUE 0x0000857A REC_UBYTE_C 0 COMP_0283 0 1 BIT_MASK 0x0001 /end CHARACTERISTIC
/begin CHARACTERISTIC mFLGDU "Flag mFLGDU" VALUE 0x0000857B REC_UBYTE_C 0 COMP_0283 0 255 /end CHARACTERISTIC
/begin CHARACTERISTIC mfDCFCSC "0:単気筒燃料ｶｯﾄ  1:複数気筒燃料ｶｯﾄ" VALUE 0x0000857B REC_UBYTE_C 0 COMP_0283 0 1 BIT_MASK 0x0001 /end CHARACTERISTIC
/begin CHARACTERISTIC mFLGPTN "Flag mFLGPTN" VALUE 0x0000857C REC_UBYTE_C 0 COMP_0283 0 255 /end CHARACTERISTIC
/begin CHARACTERISTIC mfDTYFLG "0:無し  1:有り" VALUE 0x0000857C REC_UBYTE_C 0 COMP_0283 0 1 BIT_MASK 0x0080 /end CHARACTERISTIC
/begin CHARACTERISTIC mfROGFLG "0:ﾃﾞｨｻﾞｰ制御  1:PID制御" VALUE 0x0000857C REC_UBYTE_C 0 COMP_0283 0 1 BIT_MASK 0x0040 /end CHARACTERISTIC
/begin CHARACTERISTIC mfFLGEDGE "0:UD-lot以前  1:UC-lot以後" VALUE 0x0000857C REC_UBYTE_C 0 COMP_0283 0 1 BIT_MASK 0x0020 /end CHARACTERISTIC
/begin CHARACTERISTIC mfVTCUC "0:UC-lot以外  1:UC-lotのみ" VALUE 0x0000857C REC_UBYTE_C 0 COMP_0283 0 1 BIT_MASK 0x0010 /end CHARACTERISTIC
/begin CHARACTERISTIC mfFVTCHG "0:PID制御  1:SMC制御" VALUE 0x0000857C REC_UBYTE_C 0 COMP_0283 0 1 BIT_MASK 0x0008 /end CHARACTERISTIC
/begin CHARACTERISTIC mfVVTCE "0:BASTRGE通常演算  1:BASTRGEﾊﾞﾘｱﾌﾞﾙ演算" VALUE 0x0000857C REC_UBYTE_C 0 COMP_0283 0 1 BIT_MASK 0x0004 /end CHARACTERISTIC
/begin CHARACTERISTIC mfFVTNWST "0:処理無し  1:処理有り" VALUE 0x0000857C REC_UBYTE_C 0 COMP_0283 0 1 BIT_MASK 0x0002 /end CHARACTERISTIC
/begin CHARACTERISTIC mfFFULVTC "0:対応なし  1:対応あり" VALUE 0x0000857C REC_UBYTE_C 0 COMP_0283 0 1 BIT_MASK 0x0001 /end CHARACTERISTIC
/begin CHARACTERISTIC mFLGPTN1 "Flag mFLGPTN1" VALUE 0x0000857D REC_UBYTE_C 0 COMP_0283 0 255 /end CHARACTERISTIC
/begin CHARACTERISTIC mfVTONTWDP "0:VTC_On-Off時水温ﾀﾞﾝﾊﾟ非採用車  1:VTC_On-Off時水温ﾀﾞﾝﾊﾟ採用車" VALUE 0x0000857D REC_UBYTE_C 0 COMP_0283 0 1 BIT_MASK 0x0080 /end CHARACTERISTIC
/begin CHARACTERISTIC mfFVTWSDP "0:VTC遷移切り替え水温ﾀﾞﾝﾊﾟ非採用車  1:VTC遷移切り替え水温ﾀﾞﾝﾊﾟ採用車" VALUE 0x0000857D REC_UBYTE_C 0 COMP_0283 0 1 BIT_MASK 0x0040 /end CHARACTERISTIC
/begin CHARACTERISTIC mfVTKYOSEI "0:強制VTC学習・診断モード無し  1:強制VTC学習・診断モード有り" VALUE 0x0000857D REC_UBYTE_C 0 COMP_0283 0 1 BIT_MASK 0x0020 /end CHARACTERISTIC
/begin CHARACTERISTIC mfVTACTVCL "0:VTCｱｸﾃｨﾌﾞｸﾘｰﾆﾝｸﾞﾓｰﾄﾞ制御非対応  1:VTCｱｸﾃｨﾌﾞｸﾘｰﾆﾝｸﾞﾓｰﾄﾞ制御対応" VALUE 0x0000857D REC_UBYTE_C 0 COMP_0283 0 1 BIT_MASK 0x0008 /end CHARACTERISTIC
/begin CHARACTERISTIC mfVTCHIRES "0:VTC制御高精度化非対応  1:VTC制御高精度化対応" VALUE 0x0000857D REC_UBYTE_C 0 COMP_0283 0 1 BIT_MASK 0x0004 /end CHARACTERISTIC
/begin CHARACTERISTIC mfVTCIFBC "0:VTC電流モニタ回路無し  1:VTC電流モニタ回路あり" VALUE 0x0000857D REC_UBYTE_C 0 COMP_0283 0 1 BIT_MASK 0x0002 /end CHARACTERISTIC
/begin CHARACTERISTIC mfOTSNS "0:対応なし  1:対応あり" VALUE 0x0000857D REC_UBYTE_C 0 COMP_0283 0 1 BIT_MASK 0x0001 /end CHARACTERISTIC
/begin CHARACTERISTIC mFLGPTN2 "Flag mFLGPTN2" VALUE 0x0000857E REC_UBYTE_C 0 COMP_0283 0 255 /end CHARACTERISTIC
/begin CHARACTERISTIC mfFLJVTC "0:fFULTVO_によるVTCﾌﾙ判定  1:(ｆFQH0LMT_or_fFULTVO)によるVTCﾌ" VALUE 0x0000857E REC_UBYTE_C 0 COMP_0283 0 1 BIT_MASK 0x0010 /end CHARACTERISTIC
/begin CHARACTERISTIC mfFFLVTC2 "0:VTC目標ﾏｯﾌﾟ参照負荷vITAC  1:VTC目標ﾏｯﾌﾟ参照負荷vVTCMITC" VALUE 0x0000857E REC_UBYTE_C 0 COMP_0283 0 1 BIT_MASK 0x0008 /end CHARACTERISTIC
/begin CHARACTERISTIC mfSTRATVTC "0:成層運転時吸気VTC非作動選択  1:成層運転時吸気VTC作動選択" VALUE 0x0000857E REC_UBYTE_C 0 COMP_0283 0 1 BIT_MASK 0x0004 /end CHARACTERISTIC
/begin CHARACTERISTIC mFLGPTNE "Flag mFLGPTNE" VALUE 0x0000857F REC_UBYTE_C 0 COMP_0283 0 255 /end CHARACTERISTIC
/begin CHARACTERISTIC mfDTYFLGE "0:無し  1:有り" VALUE 0x0000857F REC_UBYTE_C 0 COMP_0283 0 1 BIT_MASK 0x0080 /end CHARACTERISTIC
/begin CHARACTERISTIC mfROGFLGE "0:ディザー制御  1:PID制御" VALUE 0x0000857F REC_UBYTE_C 0 COMP_0283 0 1 BIT_MASK 0x0040 /end CHARACTERISTIC
/begin CHARACTERISTIC mfFFULVTCE "0:無し  1:有り" VALUE 0x0000857F REC_UBYTE_C 0 COMP_0283 0 1 BIT_MASK 0x0001 /end CHARACTERISTIC
/begin CHARACTERISTIC mFLGTCS "Flag mFLGTCS" VALUE 0x00008580 REC_UBYTE_C 0 COMP_0283 0 255 /end CHARACTERISTIC
/begin CHARACTERISTIC mfFSHTCS "0:TCS即ｽﾄｲｷ要求なし  1:TCS即ｽﾄｲｷ要求あり" VALUE 0x00008580 REC_UBYTE_C 0 COMP_0283 0 1 BIT_MASK 0x0002 /end CHARACTERISTIC
/begin CHARACTERISTIC mfFTRQCT "0:TCSCMD使用  1:TCSMDD使用" VALUE 0x00008580 REC_UBYTE_C 0 COMP_0283 0 1 BIT_MASK 0x0001 /end CHARACTERISTIC
/begin CHARACTERISTIC mFMASK "Flag mFMASK" VALUE 0x00008582 REC_UBYTE_C 0 COMP_0283 0 255 /end CHARACTERISTIC
/begin CHARACTERISTIC mfFMASK8 "0:14.6kHz成分除去しない  1:14.6kHz成分除去" VALUE 0x00008582 REC_UBYTE_C 0 COMP_0283 0 1 BIT_MASK 0x0080 /end CHARACTERISTIC
/begin CHARACTERISTIC mfFMASK7 "0:13.4kHz成分除去しない  1:13.4kHz成分除去" VALUE 0x00008582 REC_UBYTE_C 0 COMP_0283 0 1 BIT_MASK 0x0040 /end CHARACTERISTIC
/begin CHARACTERISTIC mfFMASK6 "0:12.2kHz成分除去しない  1:12.2kHz成分除去" VALUE 0x00008582 REC_UBYTE_C 0 COMP_0283 0 1 BIT_MASK 0x0020 /end CHARACTERISTIC
/begin CHARACTERISTIC mfFMASK5 "0:11.0kHz成分除去しない  1:11.0kHz成分除去" VALUE 0x00008582 REC_UBYTE_C 0 COMP_0283 0 1 BIT_MASK 0x0010 /end CHARACTERISTIC
/begin CHARACTERISTIC mfFMASK4 "0:9.8kHz成分除去しない  1:9.8kHz成分除去" VALUE 0x00008582 REC_UBYTE_C 0 COMP_0283 0 1 BIT_MASK 0x0008 /end CHARACTERISTIC
/begin CHARACTERISTIC mfFMASK3 "0:8.5kHz成分除去しない  1:8.5kHz成分除去" VALUE 0x00008582 REC_UBYTE_C 0 COMP_0283 0 1 BIT_MASK 0x0004 /end CHARACTERISTIC
/begin CHARACTERISTIC mfFMASK2 "0:7.3kHz成分除去しない  1:7.3kHz成分除去" VALUE 0x00008582 REC_UBYTE_C 0 COMP_0283 0 1 BIT_MASK 0x0002 /end CHARACTERISTIC
/begin CHARACTERISTIC mfFMASK1 "0:6.1kHz成分除去しない  1:6.1kHz成分除去" VALUE 0x00008582 REC_UBYTE_C 0 COMP_0283 0 1 BIT_MASK 0x0001 /end CHARACTERISTIC
/begin CHARACTERISTIC mFPROM "Flag mFPROM" VALUE 0x00008595 REC_UBYTE_C 0 COMP_0283 0 255 /end CHARACTERISTIC
/begin CHARACTERISTIC mfFLRNIDL "0:EVPOUT条件でﾏｯﾌﾟ学習禁止する  1:EVPOUT条件でﾏｯﾌﾟ学習禁止しない" VALUE 0x00008595 REC_UBYTE_C 0 COMP_0283 0 1 BIT_MASK 0x0008 /end CHARACTERISTIC
/begin CHARACTERISTIC mfFLEJDG "0:ﾏｯﾌﾟ学習収束結果をﾁｪｯｸする  1:ﾏｯﾌﾟ学習収束結果をﾁｪｯｸしない" VALUE 0x00008595 REC_UBYTE_C 0 COMP_0283 0 1 BIT_MASK 0x0004 /end CHARACTERISTIC
/begin CHARACTERISTIC mFPROMA "Flag mFPROMA" VALUE 0x00008596 REC_UBYTE_C 0 COMP_0283 0 255 /end CHARACTERISTIC
/begin CHARACTERISTIC mfFVKMR "0:ﾊﾞﾘｱﾌﾞﾙ制御有り  1:ﾊﾞﾘｱﾌﾞﾙ制御なし" VALUE 0x00008596 REC_UBYTE_C 0 COMP_0283 0 1 BIT_MASK 0x0080 /end CHARACTERISTIC
/begin CHARACTERISTIC mfFKMRFB "0:有り  1:ﾌｨｰﾄﾞﾊﾞｯｸ" VALUE 0x00008596 REC_UBYTE_C 0 COMP_0283 0 1 BIT_MASK 0x0020 /end CHARACTERISTIC
/begin CHARACTERISTIC mfFIJCLP "0:無し  1:有り" VALUE 0x00008596 REC_UBYTE_C 0 COMP_0283 0 1 BIT_MASK 0x0010 /end CHARACTERISTIC
/begin CHARACTERISTIC mfIRSPIK "0:ｱｲﾄﾞﾙﾘｯﾁｼﾌﾄ無し  1:ｱｲﾄﾞﾙﾘｯﾁｼﾌﾄ有り" VALUE 0x00008596 REC_UBYTE_C 0 COMP_0283 0 1 BIT_MASK 0x0008 /end CHARACTERISTIC
/begin CHARACTERISTIC mfBUCLR "0:INCAﾌﾗｯｼｭ後BURAMはEEPROM記憶値を  1:INCAﾌﾗｯｼｭ後BURAMはBURAM初期値を" VALUE 0x00008596 REC_UBYTE_C 0 COMP_0283 0 1 BIT_MASK 0x0004 /end CHARACTERISTIC
/begin CHARACTERISTIC mfFSCLRA "0:無し  1:有り" VALUE 0x00008596 REC_UBYTE_C 0 COMP_0283 0 1 BIT_MASK 0x0002 /end CHARACTERISTIC
/begin CHARACTERISTIC mfFBLRC "0:空燃比学習あり  1:空燃比学習なし" VALUE 0x00008596 REC_UBYTE_C 0 COMP_0283 0 1 BIT_MASK 0x0001 /end CHARACTERISTIC
/begin CHARACTERISTIC mFUELCH "Flag mFUELCH" VALUE 0x000085C4 REC_UBYTE_C 0 COMP_0283 0 255 /end CHARACTERISTIC
/begin CHARACTERISTIC mfST4FPCM "0:4段階流量FPCM用制御無し  1:4段階流量FPCM用制御有り" VALUE 0x000085C4 REC_UBYTE_C 0 COMP_0283 0 1 BIT_MASK 0x0080 /end CHARACTERISTIC
/begin CHARACTERISTIC mfSPIONP "0:HDP5固有ﾌｪｰﾙｾｰﾙ制御無し(Without_  1:HDP5固有ﾌｪｰﾙｾｰﾙ制御有り(With_fai" VALUE 0x000085C4 REC_UBYTE_C 0 COMP_0283 0 1 BIT_MASK 0x0040 /end CHARACTERISTIC
/begin CHARACTERISTIC mfSPIONGND "0:HDP5固有ﾌｪｰﾙｾｰﾙ制御無し(Without_  1:HDP5固有ﾌｪｰﾙｾｰﾙ制御有り(With_fai" VALUE 0x000085C4 REC_UBYTE_C 0 COMP_0283 0 1 BIT_MASK 0x0020 /end CHARACTERISTIC
/begin CHARACTERISTIC mfSPIONVBS "0:HDP5固有ﾌｪｰﾙｾｰﾙ制御無し(Without_  1:HDP5固有ﾌｪｰﾙｾｰﾙ制御有り(With_fai" VALUE 0x000085C4 REC_UBYTE_C 0 COMP_0283 0 1 BIT_MASK 0x0010 /end CHARACTERISTIC
/begin CHARACTERISTIC mfDIGFLT "0:燃料系故障時ﾄﾙｸﾘｸｴｽﾄｽﾃｰﾀｽ送信無  1:燃料系故障時ﾄﾙｸﾘｸｴｽﾄｽﾃｰﾀｽ送信あ" VALUE 0x000085C4 REC_UBYTE_C 0 COMP_0283 0 1 BIT_MASK 0x0002 /end CHARACTERISTIC
/begin CHARACTERISTIC mfKAIDCH "0:PFUEL，AVEPF移動平均処理なし  1:PFUEL，AVEPF移動平均処理あり" VALUE 0x000085C4 REC_UBYTE_C 0 COMP_0283 0 1 BIT_MASK 0x0001 /end CHARACTERISTIC
/begin CHARACTERISTIC mHIERAFS1 "Flag mHIERAFS1" VALUE 0x00008635 REC_UBYTE_C 0 COMP_0283 0 255 /end CHARACTERISTIC
/begin CHARACTERISTIC mfTQNGAFM "0:AFMフェイルセイフ時トルク不定信  1:AFMフェイルセイフ時トルク不定信" VALUE 0x00008635 REC_UBYTE_C 0 COMP_0283 0 1 BIT_MASK 0x0008 /end CHARACTERISTIC
/begin CHARACTERISTIC mfHIERAMD7 "0:階層化F/Sモード7非反映  1:階層化F/Sモード7反映" VALUE 0x00008635 REC_UBYTE_C 0 COMP_0283 0 1 BIT_MASK 0x0004 /end CHARACTERISTIC
/begin CHARACTERISTIC mfKFSAFMCL "0:AFM_F/S解除許可不採用車  1:AFM_F/S解除許可採用車" VALUE 0x00008635 REC_UBYTE_C 0 COMP_0283 0 1 BIT_MASK 0x0002 /end CHARACTERISTIC
/begin CHARACTERISTIC mfKFSAFM "0:AFM故障時α-N不採用車(The_vheicl  1:AFM故障時α-N採用車(The_vheicle_" VALUE 0x00008635 REC_UBYTE_C 0 COMP_0283 0 1 BIT_MASK 0x0001 /end CHARACTERISTIC
/begin CHARACTERISTIC mID "Flag mID" VALUE 0x00008687 REC_UBYTE_C 0 COMP_0283 0 255 /end CHARACTERISTIC
/begin CHARACTERISTIC mfRICHSEL "0:リーン後リッチシフト制御  1:リーン後リッチスパイク制御" VALUE 0x00008687 REC_UBYTE_C 0 COMP_0283 0 1 BIT_MASK 0x0080 /end CHARACTERISTIC
/begin CHARACTERISTIC mfFMILON "0:MIL表示なし  1:MIL表示あり" VALUE 0x00008687 REC_UBYTE_C 0 COMP_0283 0 1 BIT_MASK 0x0040 /end CHARACTERISTIC
/begin CHARACTERISTIC mfFCOVR "0:CO調整ボリュームなし  1:CO調整ボリュームあり" VALUE 0x00008687 REC_UBYTE_C 0 COMP_0283 0 1 BIT_MASK 0x0020 /end CHARACTERISTIC
/begin CHARACTERISTIC mfDRVFBS "0:運転性対策λコン制御なし  1:運転性対策λコン制御あり" VALUE 0x00008687 REC_UBYTE_C 0 COMP_0283 0 1 BIT_MASK 0x0010 /end CHARACTERISTIC
/begin CHARACTERISTIC mfSWTF "0:燃温ｾﾝｻなし  1:燃温ｾﾝｻあり" VALUE 0x00008687 REC_UBYTE_C 0 COMP_0283 0 1 BIT_MASK 0x0008 /end CHARACTERISTIC
/begin CHARACTERISTIC mfISLBCL "0:DDLでISC学習値をクリアする  1:DDLで空燃比学習値をクリアする" VALUE 0x00008687 REC_UBYTE_C 0 COMP_0283 0 1 BIT_MASK 0x0004 /end CHARACTERISTIC
/begin CHARACTERISTIC mfFINCA "0:INCA対応制御なし  1:INCA対応制御あり" VALUE 0x00008687 REC_UBYTE_C 0 COMP_0283 0 1 BIT_MASK 0x0002 /end CHARACTERISTIC
/begin CHARACTERISTIC mfNEWADJ "0:外付調整ﾓｼﾞｭｰﾙ未対応  1:外付調整ﾓｼﾞｭｰﾙ対応" VALUE 0x00008687 REC_UBYTE_C 0 COMP_0283 0 1 BIT_MASK 0x0001 /end CHARACTERISTIC
/begin CHARACTERISTIC mIDOS "Flag mIDOS" VALUE 0x00008698 REC_UBYTE_C 0 COMP_0283 0 255 /end CHARACTERISTIC
/begin CHARACTERISTIC mfFFTASW "0:ISCｴｱｺﾝ補正TASWなし  1:ISCｴｱｺﾝ補正TASWあり" VALUE 0x00008698 REC_UBYTE_C 0 COMP_0283 0 1 BIT_MASK 0x0080 /end CHARACTERISTIC
/begin CHARACTERISTIC mfFO2H "0:前_O2ﾋｰﾀ_ON/OFF_駆動なし  1:前_O2ﾋｰﾀ_ON/OFF_駆動あり" VALUE 0x00008698 REC_UBYTE_C 0 COMP_0283 0 1 BIT_MASK 0x0040 /end CHARACTERISTIC
/begin CHARACTERISTIC mfFAFICD "0:PWST連動FICD補正なし  1:PWST連動FICD補正あり" VALUE 0x00008698 REC_UBYTE_C 0 COMP_0283 0 1 BIT_MASK 0x0020 /end CHARACTERISTIC
/begin CHARACTERISTIC mfSWAP "0:排気2次空気ﾎﾟﾝﾌﾟ制御なし  1:排気2次空気ﾎﾟﾝﾌﾟ制御あり" VALUE 0x00008698 REC_UBYTE_C 0 COMP_0283 0 1 BIT_MASK 0x0010 /end CHARACTERISTIC
/begin CHARACTERISTIC mfBGLINH "0:KNK領域突入時BGL制御なし  1:KNK領域突入時BGL制御あり" VALUE 0x00008698 REC_UBYTE_C 0 COMP_0283 0 1 BIT_MASK 0x0008 /end CHARACTERISTIC
/begin CHARACTERISTIC mfFTCS "0:TCS制御なし  1:TCS制御あり" VALUE 0x00008698 REC_UBYTE_C 0 COMP_0283 0 1 BIT_MASK 0x0004 /end CHARACTERISTIC
/begin CHARACTERISTIC mfFKORFN "0:ﾗｼﾞﾌｧﾝ制御なし  1:ﾗｼﾞﾌｧﾝ制御あり" VALUE 0x00008698 REC_UBYTE_C 0 COMP_0283 0 1 BIT_MASK 0x0002 /end CHARACTERISTIC
/begin CHARACTERISTIC mfFLNBRN "0:ﾘｰﾝﾊﾞｰﾝ制御なし  1:ﾘｰﾝﾊﾞｰﾝ制御あり" VALUE 0x00008698 REC_UBYTE_C 0 COMP_0283 0 1 BIT_MASK 0x0001 /end CHARACTERISTIC
/begin CHARACTERISTIC mIDOS_S "Flag mIDOS_S" VALUE 0x000157D2 REC_UBYTE_C 0 COMP_0283 0 255 /end CHARACTERISTIC
/begin CHARACTERISTIC mfFTCS_S "0:非実行  1:診断実行" VALUE 0x000157D2 REC_UBYTE_C 0 COMP_0283 0 1 BIT_MASK 0x0004 /end CHARACTERISTIC
/begin CHARACTERISTIC mIDOS2 "Flag mIDOS2" VALUE 0x00008699 REC_UBYTE_C 0 COMP_0283 0 255 /end CHARACTERISTIC
/begin CHARACTERISTIC mfECVT "0:非CVT対応  1:CVT対応" VALUE 0x00008699 REC_UBYTE_C 0 COMP_0283 0 1 BIT_MASK 0x0080 /end CHARACTERISTIC
/begin CHARACTERISTIC mfFDUET "0:非DUETTE対応  1:DUETTE対応" VALUE 0x00008699 REC_UBYTE_C 0 COMP_0283 0 1 BIT_MASK 0x0040 /end CHARACTERISTIC
/begin CHARACTERISTIC mfFEEGR "0:EGRなし又はｶｯﾄ/導入ｿﾚﾉｲﾄﾞ式EGR  1:電制EGR" VALUE 0x00008699 REC_UBYTE_C 0 COMP_0283 0 1 BIT_MASK 0x0020 /end CHARACTERISTIC
/begin CHARACTERISTIC mfCVTC "0:C-VTC非対応  1:C-VTC対応" VALUE 0x00008699 REC_UBYTE_C 0 COMP_0283 0 1 BIT_MASK 0x0010 /end CHARACTERISTIC
/begin CHARACTERISTIC mfFEGRCT "0:EGRｶｯﾄｿﾚﾉｲﾄﾞONでEGRｶｯﾄ  1:EGRｶｯﾄｿﾚﾉｲﾄﾞOFFでEGRｶｯﾄ" VALUE 0x00008699 REC_UBYTE_C 0 COMP_0283 0 1 BIT_MASK 0x0008 /end CHARACTERISTIC
/begin CHARACTERISTIC mfFLAN "0:DUETTE制御が5本線/3本線  1:DUETTE制御がLAN/1CPU" VALUE 0x00008699 REC_UBYTE_C 0 COMP_0283 0 1 BIT_MASK 0x0004 /end CHARACTERISTIC
/begin CHARACTERISTIC mfFHTWLU "0:高水温2ndL/U制御未対応  1:高水温2ndL/U制御対応" VALUE 0x00008699 REC_UBYTE_C 0 COMP_0283 0 1 BIT_MASK 0x0002 /end CHARACTERISTIC
/begin CHARACTERISTIC mfCPCCHK "0:cal  1:fed" VALUE 0x00008699 REC_UBYTE_C 0 COMP_0283 0 1 BIT_MASK 0x0001 /end CHARACTERISTIC
/begin CHARACTERISTIC mIDOS3 "Flag mIDOS3" VALUE 0x0000869A REC_UBYTE_C 0 COMP_0283 0 255 /end CHARACTERISTIC
/begin CHARACTERISTIC mfFLCFCA "0:切換無し  1:切換あり" VALUE 0x0000869A REC_UBYTE_C 0 COMP_0283 0 1 BIT_MASK 0x0080 /end CHARACTERISTIC
/begin CHARACTERISTIC mfCMADVC "0:非L/UP位相制御あり  1:非L/UP位相制御なし" VALUE 0x0000869A REC_UBYTE_C 0 COMP_0283 0 1 BIT_MASK 0x0040 /end CHARACTERISTIC
/begin CHARACTERISTIC mfFCSCVL "0:1個  1:2個" VALUE 0x0000869A REC_UBYTE_C 0 COMP_0283 0 1 BIT_MASK 0x0020 /end CHARACTERISTIC
/begin CHARACTERISTIC mfF1OR3 "0:DUETTE制御がLANあるいは5本線  1:DUETTE制御が1CPUあるいは3本線" VALUE 0x0000869A REC_UBYTE_C 0 COMP_0283 0 1 BIT_MASK 0x0010 /end CHARACTERISTIC
/begin CHARACTERISTIC mfPWSTV "0:ﾊﾟﾜｽﾃﾊﾞﾙﾌﾞなし  1:ﾊﾟﾜｽﾃﾊﾞﾙﾌﾞあり" VALUE 0x0000869A REC_UBYTE_C 0 COMP_0283 0 1 BIT_MASK 0x0008 /end CHARACTERISTIC
/begin CHARACTERISTIC mfFACPDS "0:A/C_Pd圧ｾﾝｻなし  1:A/C_Pd圧ｾﾝｻあり" VALUE 0x0000869A REC_UBYTE_C 0 COMP_0283 0 1 BIT_MASK 0x0004 /end CHARACTERISTIC
/begin CHARACTERISTIC mfFFANSET "0:電動ﾌｧﾝ  1:油圧駆動ﾌｧﾝ" VALUE 0x0000869A REC_UBYTE_C 0 COMP_0283 0 1 BIT_MASK 0x0002 /end CHARACTERISTIC
/begin CHARACTERISTIC mfSCHARGER "0:ｽｰﾊﾟｰﾁｬｰｼﾞｬｰ用DUETTE非対応  1:ｽｰﾊﾟｰﾁｬｰｼﾞｬｰ用DUETTE対応" VALUE 0x0000869A REC_UBYTE_C 0 COMP_0283 0 1 BIT_MASK 0x0001 /end CHARACTERISTIC
/begin CHARACTERISTIC mIDOS4 "Flag mIDOS4" VALUE 0x0000869B REC_UBYTE_C 0 COMP_0283 0 255 /end CHARACTERISTIC
/begin CHARACTERISTIC mfBRKTD "0:ﾌﾞﾚｰｷﾝｸﾞｽﾄｰﾙ時ﾄﾙｸﾀﾞｳﾝ制御なし  1:ﾌﾞﾚｰｷﾝｸﾞｽﾄｰﾙ時ﾄﾙｸﾀﾞｳﾝ制御あり" VALUE 0x0000869B REC_UBYTE_C 0 COMP_0283 0 1 BIT_MASK 0x0080 /end CHARACTERISTIC
/begin CHARACTERISTIC mfCANDAT "0:CAN入力  1:CAN入力以外" VALUE 0x0000869B REC_UBYTE_C 0 COMP_0283 0 1 BIT_MASK 0x0040 /end CHARACTERISTIC
/begin CHARACTERISTIC mfFLANCAN "0:LAN通信使用時  1:CAN通信使用時" VALUE 0x0000869B REC_UBYTE_C 0 COMP_0283 0 1 BIT_MASK 0x0020 /end CHARACTERISTIC
/begin CHARACTERISTIC mfFBAROS "0:大気圧センサなし  1:大気圧センサあり" VALUE 0x0000869B REC_UBYTE_C 0 COMP_0283 0 1 BIT_MASK 0x0010 /end CHARACTERISTIC
/begin CHARACTERISTIC mfPSS "0:P/S油圧ｾﾝｻなし  1:P/S油圧ｾﾝｻあり" VALUE 0x0000869B REC_UBYTE_C 0 COMP_0283 0 1 BIT_MASK 0x0008 /end CHARACTERISTIC
/begin CHARACTERISTIC mfPRINJ "0:始動時燃料予備噴射制御を行わない  1:始動時燃料予備噴射制御を行う" VALUE 0x0000869B REC_UBYTE_C 0 COMP_0283 0 1 BIT_MASK 0x0004 /end CHARACTERISTIC
/begin CHARACTERISTIC mfTQD1 "0:1速時ﾄﾙｸﾀﾞｳﾝ制御無し  1:1速時ﾄﾙｸﾀﾞｳﾝ制御有り" VALUE 0x0000869B REC_UBYTE_C 0 COMP_0283 0 1 BIT_MASK 0x0002 /end CHARACTERISTIC
/begin CHARACTERISTIC mfFISCV "0:ECM内臓ISCVvol未使用  1:ECM内臓ISCVvol使用" VALUE 0x0000869B REC_UBYTE_C 0 COMP_0283 0 1 BIT_MASK 0x0001 /end CHARACTERISTIC
/begin CHARACTERISTIC mIDOS5 "Flag mIDOS5" VALUE 0x0000869C REC_UBYTE_C 0 COMP_0283 0 255 /end CHARACTERISTIC
/begin CHARACTERISTIC mfREGGASI "0:#REGGASの初期値_0  1:#REGGASの初期値_1" VALUE 0x0000869C REC_UBYTE_C 0 COMP_0283 0 1 BIT_MASK 0x0080 /end CHARACTERISTIC
/begin CHARACTERISTIC mfASCDTYP1 "0:ASCD_SW_TYPE2  1:ASCD_SW_TYPE1" VALUE 0x0000869C REC_UBYTE_C 0 COMP_0283 0 1 BIT_MASK 0x0020 /end CHARACTERISTIC
/begin CHARACTERISTIC mfFDMFFC "0:自励振動時F/C制御（DMF保護）なし  1:自励振動時F/C制御（DMF保護）あり" VALUE 0x0000869C REC_UBYTE_C 0 COMP_0283 0 1 BIT_MASK 0x0010 /end CHARACTERISTIC
/begin CHARACTERISTIC mfEMSYS "0:DCﾓｰﾀ式  1:負圧ｿﾚﾉｲﾄﾞ式" VALUE 0x0000869C REC_UBYTE_C 0 COMP_0283 0 1 BIT_MASK 0x0008 /end CHARACTERISTIC
/begin CHARACTERISTIC mfPRGFHCH "0:可変P/REG駆動周波数=320Hz  1:可変P/REG駆動周波数=780Hz" VALUE 0x0000869C REC_UBYTE_C 0 COMP_0283 0 1 BIT_MASK 0x0004 /end CHARACTERISTIC
/begin CHARACTERISTIC mfFTARTD "0:高吸気温ﾘﾀｰﾄﾞｱｲﾄﾞﾙ時有り  1:高吸気温ﾘﾀｰﾄﾞｱｲﾄﾞﾙ時無し" VALUE 0x0000869C REC_UBYTE_C 0 COMP_0283 0 1 BIT_MASK 0x0002 /end CHARACTERISTIC
/begin CHARACTERISTIC mfTASEN "0:吸気温センサ無し  1:吸気温センサ有り" VALUE 0x0000869C REC_UBYTE_C 0 COMP_0283 0 1 BIT_MASK 0x0001 /end CHARACTERISTIC
/begin CHARACTERISTIC mIDOS6 "Flag mIDOS6" VALUE 0x0000869D REC_UBYTE_C 0 COMP_0283 0 255 /end CHARACTERISTIC
/begin CHARACTERISTIC mfCVTFCD "0:fCVTFAIL条件無効  1:fCVTFAIL条件有効" VALUE 0x0000869D REC_UBYTE_C 0 COMP_0283 0 1 BIT_MASK 0x0080 /end CHARACTERISTIC
/begin CHARACTERISTIC mfMUPTDRON "0:ｱｯﾌﾟｼﾌﾄﾘﾀｰﾄﾞ斜め出し有り  1:ｱｯﾌﾟｼﾌﾄﾘﾀｰﾄﾞ斜め出し無し" VALUE 0x0000869D REC_UBYTE_C 0 COMP_0283 0 1 BIT_MASK 0x0040 /end CHARACTERISTIC
/begin CHARACTERISTIC mfTENGADV "0:実ADVトルク補正なし  1:実ADVトルク補正あり" VALUE 0x0000869D REC_UBYTE_C 0 COMP_0283 0 1 BIT_MASK 0x0020 /end CHARACTERISTIC
/begin CHARACTERISTIC mfGAKUCON "0:REF間△N点火時期ﾌｨｰﾄﾞﾊﾞｯｸ制御な  1:REF間△N点火時期ﾌｨｰﾄﾞﾊﾞｯｸ制御あ" VALUE 0x0000869D REC_UBYTE_C 0 COMP_0283 0 1 BIT_MASK 0x0010 /end CHARACTERISTIC
/begin CHARACTERISTIC mfHISECT "0:NSETDをNEUTDで制限  1:NSETDをNEUTで制限" VALUE 0x0000869D REC_UBYTE_C 0 COMP_0283 0 1 BIT_MASK 0x0008 /end CHARACTERISTIC
/begin CHARACTERISTIC mfCANSUP "0:CAN通信診断強化非対応  1:CAN通信診断強化対応" VALUE 0x0000869D REC_UBYTE_C 0 COMP_0283 0 1 BIT_MASK 0x0004 /end CHARACTERISTIC
/begin CHARACTERISTIC mfDEADTIME "0:ETCﾛﾊﾞｽﾄ補償器内むだ時間なし  1:ETCﾛﾊﾞｽﾄ補償器内むだ時間あり" VALUE 0x0000869D REC_UBYTE_C 0 COMP_0283 0 1 BIT_MASK 0x0002 /end CHARACTERISTIC
/begin CHARACTERISTIC mfTOWHTWFC "0:ﾄｰｲﾝｸﾞ時高水温燃料ｶｯﾄ無し  1:ﾄｰｲﾝｸﾞ時高水温燃料ｶｯﾄ有り" VALUE 0x0000869D REC_UBYTE_C 0 COMP_0283 0 1 BIT_MASK 0x0001 /end CHARACTERISTIC
/begin CHARACTERISTIC mIDOS7 "Flag mIDOS7" VALUE 0x0000869E REC_UBYTE_C 0 COMP_0283 0 255 /end CHARACTERISTIC
/begin CHARACTERISTIC mfTURBOSW "0:過給機なしENGENG(without_superch  1:過給機付き(ENG_with_supercharger" VALUE 0x0000869E REC_UBYTE_C 0 COMP_0283 0 1 BIT_MASK 0x0040 /end CHARACTERISTIC
/begin CHARACTERISTIC mfTWNINJ "0:TwinINJ非対応  1:TwinINJ対応" VALUE 0x0000869E REC_UBYTE_C 0 COMP_0283 0 1 BIT_MASK 0x0020 /end CHARACTERISTIC
/begin CHARACTERISTIC mfEDGDIR "0:POS立ち下がりｴｯｼﾞ検出  1:POS立ち上がりｴｯｼﾞ検出" VALUE 0x0000869E REC_UBYTE_C 0 COMP_0283 0 1 BIT_MASK 0x0010 /end CHARACTERISTIC
/begin CHARACTERISTIC mfSGADVON "0:SGADV制御不許可  1:SGADV制御許可" VALUE 0x0000869E REC_UBYTE_C 0 COMP_0283 0 1 BIT_MASK 0x0001 /end CHARACTERISTIC
/begin CHARACTERISTIC mIDSCI "Flag mIDSCI" VALUE 0x0000869F REC_UBYTE_C 0 COMP_0283 0 255 /end CHARACTERISTIC
/begin CHARACTERISTIC mfFSR "0:SR制御しない  1:SR制御する" VALUE 0x0000869F REC_UBYTE_C 0 COMP_0283 0 1 BIT_MASK 0x0040 /end CHARACTERISTIC
/begin CHARACTERISTIC mfECOEXP "0:通常時設定  1:車両適合時設定" VALUE 0x0000869F REC_UBYTE_C 0 COMP_0283 0 1 BIT_MASK 0x0020 /end CHARACTERISTIC
/begin CHARACTERISTIC mfFGVARI "0:ギア位置バリアブル制御非実行  1:ギア位置バリアブル制御実行" VALUE 0x0000869F REC_UBYTE_C 0 COMP_0283 0 1 BIT_MASK 0x0008 /end CHARACTERISTIC
/begin CHARACTERISTIC mfDUETOTON "0:AT信号線異常時ﾘｰﾝ禁止する  1:AT信号線異常時ﾘｰﾝ禁止しない" VALUE 0x0000869F REC_UBYTE_C 0 COMP_0283 0 1 BIT_MASK 0x0004 /end CHARACTERISTIC
/begin CHARACTERISTIC mfFPSR "0:通常PSR制御  1:DUETTE制御無視ﾓｰﾄﾞ" VALUE 0x0000869F REC_UBYTE_C 0 COMP_0283 0 1 BIT_MASK 0x0002 /end CHARACTERISTIC
/begin CHARACTERISTIC mfLUINHEM "0:排気変速線選択時L/U禁止しない  1:排気変速線選択時L/U禁止する" VALUE 0x0000869F REC_UBYTE_C 0 COMP_0283 0 1 BIT_MASK 0x0001 /end CHARACTERISTIC
/begin CHARACTERISTIC mIDSTSW "Flag mIDSTSW" VALUE 0x000086A0 REC_UBYTE_C 0 COMP_0283 0 255 /end CHARACTERISTIC
/begin CHARACTERISTIC mfISTEST "0:通常のIS制御動作  1:台上、適合実験用のIS制御動作" VALUE 0x000086A0 REC_UBYTE_C 0 COMP_0283 0 1 BIT_MASK 0x0080 /end CHARACTERISTIC
/begin CHARACTERISTIC mfACSWJDG "0:A/C作動時IS禁止制御無し  1:A/C作動時IS禁止制御有り" VALUE 0x000086A0 REC_UBYTE_C 0 COMP_0283 0 1 BIT_MASK 0x0040 /end CHARACTERISTIC
/begin CHARACTERISTIC mfISRSPKJG "0:ｱｲﾄﾞﾙｽﾄｯﾌﾟ条件にﾘｯﾁｽﾊﾟｲｸ反映せず  1:ｱｲﾄﾞﾙｽﾄｯﾌﾟ条件にﾘｯﾁｽﾊﾟｲｸ反映する" VALUE 0x000086A0 REC_UBYTE_C 0 COMP_0283 0 1 BIT_MASK 0x0020 /end CHARACTERISTIC
/begin CHARACTERISTIC mfSTARTSYS "0:SSG式ｱｲﾄﾞﾙｽﾄｯﾌﾟ  1:ｽﾀｰﾀ式ｱｲﾄﾞﾙｽﾄｯﾌﾟ" VALUE 0x000086A0 REC_UBYTE_C 0 COMP_0283 0 1 BIT_MASK 0x0010 /end CHARACTERISTIC
/begin CHARACTERISTIC mfSSTMDOK "0:アイドルストップ条件にSSTMD反映  1:アイドルストップ条件にSSTMD反映" VALUE 0x000086A0 REC_UBYTE_C 0 COMP_0283 0 1 BIT_MASK 0x0008 /end CHARACTERISTIC
/begin CHARACTERISTIC mfISQCIOK "0:ｱｲﾄﾞﾙｽﾄｯﾌﾟ再始動時QFBIﾘﾐｯﾀ制御禁  1:ｱｲﾄﾞﾙｽﾄｯﾌﾟ再始動時QFBIﾘﾐｯﾀ制御許" VALUE 0x000086A0 REC_UBYTE_C 0 COMP_0283 0 1 BIT_MASK 0x0004 /end CHARACTERISTIC
/begin CHARACTERISTIC mfQKREST "0:ｱｲﾄﾞﾙｽﾄｯﾌﾟ始動早期化制御禁止  1:ｱｲﾄﾞﾙｽﾄｯﾌﾟ始動早期化制御許可" VALUE 0x000086A0 REC_UBYTE_C 0 COMP_0283 0 1 BIT_MASK 0x0002 /end CHARACTERISTIC
/begin CHARACTERISTIC mfIDSTPOK "0:アイドルストップ禁止  1:アイドルストップ許可" VALUE 0x000086A0 REC_UBYTE_C 0 COMP_0283 0 1 BIT_MASK 0x0001 /end CHARACTERISTIC
/begin CHARACTERISTIC mIDSTSW2 "Flag mIDSTSW2" VALUE 0x000086A1 REC_UBYTE_C 0 COMP_0283 0 255 /end CHARACTERISTIC
/begin CHARACTERISTIC mfMTINLKSW "0:INH_RLY_コイル上流MTインターロッ  1:INH_RLY_コイル上流MTインターロッ" VALUE 0x000086A1 REC_UBYTE_C 0 COMP_0283 0 1 BIT_MASK 0x0008 /end CHARACTERISTIC
/begin CHARACTERISTIC mfBRKSYS "0:ブレーキ液圧センサ無し(Not_adapt  1:ブレーキ液圧センサ有り(Adapted_t" VALUE 0x000086A1 REC_UBYTE_C 0 COMP_0283 0 1 BIT_MASK 0x0004 /end CHARACTERISTIC
/begin CHARACTERISTIC mfHSA "0:アイドルストップHSA無し(Not_adap  1:アイドルストップHSA有り(Adapted_" VALUE 0x000086A1 REC_UBYTE_C 0 COMP_0283 0 1 BIT_MASK 0x0002 /end CHARACTERISTIC
/begin CHARACTERISTIC mfQSCSSYS "0:逆転検知ﾘﾝｸﾞｷﾞｱｾﾝｻ式  1:逆転検知POSｾﾝｻ式" VALUE 0x000086A1 REC_UBYTE_C 0 COMP_0283 0 1 BIT_MASK 0x0001 /end CHARACTERISTIC
/begin CHARACTERISTIC mIMBSW "Flag mIMBSW" VALUE 0x000086B7 REC_UBYTE_C 0 COMP_0283 0 255 /end CHARACTERISTIC
/begin CHARACTERISTIC mfFIMMOCOM "0:ｲﾓﾋﾞ通信CAN対応  1:ｲﾓﾋﾞ通信IMLINE対応" VALUE 0x000086B7 REC_UBYTE_C 0 COMP_0283 0 1 BIT_MASK 0x0002 /end CHARACTERISTIC
/begin CHARACTERISTIC mfFLIBS "0:処理無し  1:処理有り" VALUE 0x000086B7 REC_UBYTE_C 0 COMP_0283 0 1 BIT_MASK 0x0001 /end CHARACTERISTIC
/begin CHARACTERISTIC mLAMBDA "Flag mLAMBDA" VALUE 0x000087A5 REC_UBYTE_C 0 COMP_0283 0 255 /end CHARACTERISTIC
/begin CHARACTERISTIC mfNSENTENG "0:TENGに燃料先行を反映させない  1:TENGに燃料先行を反映させる" VALUE 0x000087A5 REC_UBYTE_C 0 COMP_0283 0 1 BIT_MASK 0x0008 /end CHARACTERISTIC
/begin CHARACTERISTIC mfNSENADV "0:ADVに燃料先行を反映させない  1:ADVに燃料先行を反映させる" VALUE 0x000087A5 REC_UBYTE_C 0 COMP_0283 0 1 BIT_MASK 0x0004 /end CHARACTERISTIC
/begin CHARACTERISTIC mfTP4 "0:4byte_TP_使用しない  1:4byte_TP_使用する" VALUE 0x000087A5 REC_UBYTE_C 0 COMP_0283 0 1 BIT_MASK 0x0002 /end CHARACTERISTIC
/begin CHARACTERISTIC mfCYLFPU "0:float使用しない  1:float使用する" VALUE 0x000087A5 REC_UBYTE_C 0 COMP_0283 0 1 BIT_MASK 0x0001 /end CHARACTERISTIC
/begin CHARACTERISTIC mLGTRMMD "Flag mLGTRMMD" VALUE 0x000087B3 REC_UBYTE_C 0 COMP_0283 0 255 /end CHARACTERISTIC
/begin CHARACTERISTIC mfDLNGSHT "0:学習値ﾛﾝｸﾞ/ｼｮｰﾄ非分割仕様(Fuel_t  1:学習値ﾛﾝｸﾞ/ｼｮｰﾄ分割仕様(Fuel_tri" VALUE 0x000087B3 REC_UBYTE_C 0 COMP_0283 0 1 BIT_MASK 0x0080 /end CHARACTERISTIC
/begin CHARACTERISTIC mfSTRLLN "0:ﾛﾝｸﾞ学習値始動時非反映(Long_fuel  1:ﾛﾝｸﾞ学習値始動時反映(Long_fuel_t" VALUE 0x000087B3 REC_UBYTE_C 0 COMP_0283 0 1 BIT_MASK 0x0040 /end CHARACTERISTIC
/begin CHARACTERISTIC mfKMRLLN "0:ﾛﾝｸﾞ学習値KMR領域非反映(Long_fue  1:ﾛﾝｸﾞ学習値KMR領域反映(Long_fuel_" VALUE 0x000087B3 REC_UBYTE_C 0 COMP_0283 0 1 BIT_MASK 0x0020 /end CHARACTERISTIC
/begin CHARACTERISTIC mfLNIENAC "0:ｼｮｰﾄ学習条件でﾛﾝｸﾞ非ｱｲﾄﾞﾙ領域学  1:ｼｮｰﾄ学習条件でﾛﾝｸﾞ非ｱｲﾄﾞﾙ領域学" VALUE 0x000087B3 REC_UBYTE_C 0 COMP_0283 0 1 BIT_MASK 0x0008 /end CHARACTERISTIC
/begin CHARACTERISTIC mfLNPENAC "0:ｼｮｰﾄ学習条件でﾛﾝｸﾞｱｲﾄﾞﾙ領域学習  1:ｼｮｰﾄ学習条件でﾛﾝｸﾞｱｲﾄﾞﾙ領域学習" VALUE 0x000087B3 REC_UBYTE_C 0 COMP_0283 0 1 BIT_MASK 0x0004 /end CHARACTERISTIC
/begin CHARACTERISTIC mfRTRISAC "0:空燃比学習要求ｱｲﾄﾞﾙｽﾄｯﾌﾟ禁止要求  1:空燃比学習要求ｱｲﾄﾞﾙｽﾄｯﾌﾟ禁止要求" VALUE 0x000087B3 REC_UBYTE_C 0 COMP_0283 0 1 BIT_MASK 0x0002 /end CHARACTERISTIC
/begin CHARACTERISTIC mfELPGSTAC "0:空燃比学習要求ﾊﾟｰｼﾞ制御禁止無(In  1:空燃比学習要求ﾊﾟｰｼﾞ制御禁止有(Pu" VALUE 0x000087B3 REC_UBYTE_C 0 COMP_0283 0 1 BIT_MASK 0x0001 /end CHARACTERISTIC
/begin CHARACTERISTIC mLINSW "Flag mLINSW" VALUE 0x000087B6 REC_UBYTE_C 0 COMP_0283 0 255 /end CHARACTERISTIC
/begin CHARACTERISTIC mfVSSIN1 "0:LIN-ID:10受信設定無し  1:LIN-ID:10受信設定有り" VALUE 0x000087B6 REC_UBYTE_C 0 COMP_0283 0 1 BIT_MASK 0x0008 /end CHARACTERISTIC
/begin CHARACTERISTIC mfSSGLCN1 "0:LIN-ID:30受信設定無し  1:LIN-ID:30受信設定有り" VALUE 0x000087B6 REC_UBYTE_C 0 COMP_0283 0 1 BIT_MASK 0x0004 /end CHARACTERISTIC
/begin CHARACTERISTIC mfECMLCN1 "0:LIN-ID:20送信設定無し  1:LIN-ID:20送信設定有り" VALUE 0x000087B6 REC_UBYTE_C 0 COMP_0283 0 1 BIT_MASK 0x0002 /end CHARACTERISTIC
/begin CHARACTERISTIC mfLIN "0:LIN通信制御無し  1:LIN通信制御有り" VALUE 0x000087B6 REC_UBYTE_C 0 COMP_0283 0 1 BIT_MASK 0x0001 /end CHARACTERISTIC
/begin CHARACTERISTIC mLNBNSW "Flag mLNBNSW" VALUE 0x000087C5 REC_UBYTE_C 0 COMP_0283 0 255 /end CHARACTERISTIC
/begin CHARACTERISTIC mfSTSTND "0:超リタード燃焼時NDセレクト制御な  1:超リタード燃焼時NDセレクト制御あ" VALUE 0x000087C5 REC_UBYTE_C 0 COMP_0283 0 1 BIT_MASK 0x0080 /end CHARACTERISTIC
/begin CHARACTERISTIC mfFIRINJ "0:INJ先端温度対応FIR制御なし(INJ_t  1:INJ先端温度対応FIR制御あり(INJ_t" VALUE 0x000087C5 REC_UBYTE_C 0 COMP_0283 0 1 BIT_MASK 0x0040 /end CHARACTERISTIC
/begin CHARACTERISTIC mfNIFSTR "0:超ﾘﾀｰﾄﾞ燃焼時Nｱｲﾄﾞﾙ不許可  1:超ﾘﾀｰﾄﾞ燃焼時Nｱｲﾄﾞﾙ許可" VALUE 0x000087C5 REC_UBYTE_C 0 COMP_0283 0 1 BIT_MASK 0x0020 /end CHARACTERISTIC
/begin CHARACTERISTIC mfFTASLCFP "0:急TAS経験要  1:急TAS経験不要" VALUE 0x000087C5 REC_UBYTE_C 0 COMP_0283 0 1 BIT_MASK 0x0008 /end CHARACTERISTIC
/begin CHARACTERISTIC mfSLOPEST "0:CVT読み込みGセンサ処理なし(CVT_r  1:CVT読み込みGセンサ処理あり(CVT_r" VALUE 0x000087C5 REC_UBYTE_C 0 COMP_0283 0 1 BIT_MASK 0x0004 /end CHARACTERISTIC
/begin CHARACTERISTIC mfCHNGGSEN "0:ＥＣＭ読込みＧセンサ無し(Without  1:ＥＣＭ読込みＧセンサ有り(With_G_" VALUE 0x000087C5 REC_UBYTE_C 0 COMP_0283 0 1 BIT_MASK 0x0002 /end CHARACTERISTIC
/begin CHARACTERISTIC mfLLCENL "0:ﾘｰﾝ禁止判定有り  1:ﾘｰﾝ禁止判定無し" VALUE 0x000087C5 REC_UBYTE_C 0 COMP_0283 0 1 BIT_MASK 0x0001 /end CHARACTERISTIC
/begin CHARACTERISTIC mMESAIR "Flag mMESAIR" VALUE 0x000087E1 REC_UBYTE_C 0 COMP_0283 0 255 /end CHARACTERISTIC
/begin CHARACTERISTIC mfQH0TRMTC "0:QH0TR演算値(QH0TR_calculate_valu  1:QH0TRﾊﾞﾘｱﾌﾞﾙ(QH0TR_variable_valu" VALUE 0x000087E1 REC_UBYTE_C 0 COMP_0283 0 1 BIT_MASK 0x0010 /end CHARACTERISTIC
/begin CHARACTERISTIC mfEXTEGR "0:外部EGR対応無(Not_to_apply_exter  1:外部EGR対応有(Apply_external_EGR" VALUE 0x000087E1 REC_UBYTE_C 0 COMP_0283 0 1 BIT_MASK 0x0008 /end CHARACTERISTIC
/begin CHARACTERISTIC mfADFEXP "0:燃料先行領域拡大不許可  1:燃料先行領域拡大許可" VALUE 0x000087E1 REC_UBYTE_C 0 COMP_0283 0 1 BIT_MASK 0x0004 /end CHARACTERISTIC
/begin CHARACTERISTIC mfCALC2MS "0:QA4_4ms演算(QA4_4ms_calculation)  1:QA4_2ms演算(QA4_2ms_calculation)" VALUE 0x000087E1 REC_UBYTE_C 0 COMP_0283 0 1 BIT_MASK 0x0002 /end CHARACTERISTIC
/begin CHARACTERISTIC mfMPINEGQH "0:残ｶﾞｽﾏｯﾌﾟ軸QH0(QH0_for_residual_  1:残ｶﾞｽﾏｯﾌﾟ軸QH0TR(QH0TR_for_resid" VALUE 0x000087E1 REC_UBYTE_C 0 COMP_0283 0 1 BIT_MASK 0x0001 /end CHARACTERISTIC
/begin CHARACTERISTIC mMFPRMM "Flag mMFPRMM" VALUE 0x000087F2 REC_UBYTE_C 0 COMP_0283 0 255 /end CHARACTERISTIC
/begin CHARACTERISTIC mfKTIUSE "0:TINT補正禁止  1:TINT補正許可" VALUE 0x000087F2 REC_UBYTE_C 0 COMP_0283 0 1 BIT_MASK 0x0080 /end CHARACTERISTIC
/begin CHARACTERISTIC mfMFJDG3 "0:モニタ禁止  1:モニタ許可" VALUE 0x000087F2 REC_UBYTE_C 0 COMP_0283 0 1 BIT_MASK 0x0004 /end CHARACTERISTIC
/begin CHARACTERISTIC mfMFJDG2 "0:モニタ禁止  1:モニタ許可" VALUE 0x000087F2 REC_UBYTE_C 0 COMP_0283 0 1 BIT_MASK 0x0002 /end CHARACTERISTIC
/begin CHARACTERISTIC mfMFJDG1 "0:モニタ禁止  1:モニタ許可" VALUE 0x000087F2 REC_UBYTE_C 0 COMP_0283 0 1 BIT_MASK 0x0001 /end CHARACTERISTIC
/begin CHARACTERISTIC mNENPI "Flag mNENPI" VALUE 0x0000884D REC_UBYTE_C 0 COMP_0283 0 255 /end CHARACTERISTIC
/begin CHARACTERISTIC mfFKYUGEN "0:急減速時補機制御＿非対応  1:急減速時補機制御＿対応" VALUE 0x0000884D REC_UBYTE_C 0 COMP_0283 0 1 BIT_MASK 0x0080 /end CHARACTERISTIC
/begin CHARACTERISTIC mfIDLETEST "0:アイドルフラクチュエーション実験  1:アイドルフラクチュエーション実験" VALUE 0x0000884D REC_UBYTE_C 0 COMP_0283 0 1 BIT_MASK 0x0040 /end CHARACTERISTIC
/begin CHARACTERISTIC mfKAISEI "0:回生制御＿非対応車両  1:回生制御＿対応車両" VALUE 0x0000884D REC_UBYTE_C 0 COMP_0283 0 1 BIT_MASK 0x0020 /end CHARACTERISTIC
/begin CHARACTERISTIC mfNIDLESYS "0:Nｱｲﾄﾞﾙｼｽﾃﾑ_非対応  1:Nｱｲﾄﾞﾙｼｽﾃﾑ_対応" VALUE 0x0000884D REC_UBYTE_C 0 COMP_0283 0 1 BIT_MASK 0x0010 /end CHARACTERISTIC
/begin CHARACTERISTIC mfALTWIP "0:ワイパon時＿低電圧制御禁止＿非対  1:ワイパon時＿低電圧制御禁止＿対応" VALUE 0x0000884D REC_UBYTE_C 0 COMP_0283 0 1 BIT_MASK 0x0008 /end CHARACTERISTIC
/begin CHARACTERISTIC mfALTSYS "0:オルタネータC端子制御非対応  1:オルタネータC端子制御対応" VALUE 0x0000884D REC_UBYTE_C 0 COMP_0283 0 1 BIT_MASK 0x0004 /end CHARACTERISTIC
/begin CHARACTERISTIC mfACSYS "0:エアコン＿協調制御_非対応  1:エアコン＿協調制御＿対応" VALUE 0x0000884D REC_UBYTE_C 0 COMP_0283 0 1 BIT_MASK 0x0002 /end CHARACTERISTIC
/begin CHARACTERISTIC mfFANSYS "0:リレー駆動＿M/FAN制御＿対応  1:PWM駆動＿M/FAN制御＿対応" VALUE 0x0000884D REC_UBYTE_C 0 COMP_0283 0 1 BIT_MASK 0x0001 /end CHARACTERISTIC
/begin CHARACTERISTIC mNENPI2 "Flag mNENPI2" VALUE 0x0000884E REC_UBYTE_C 0 COMP_0283 0 255 /end CHARACTERISTIC
/begin CHARACTERISTIC mfUSMTYPE "0:チョン掛けパカンストン非対応USM  1:チョン掛けパカンストン対応USM搭" VALUE 0x0000884E REC_UBYTE_C 0 COMP_0283 0 1 BIT_MASK 0x0080 /end CHARACTERISTIC
/begin CHARACTERISTIC mfSTTYP "0:Push始動ｼｽﾃﾑ  1:Key始動ｼｽﾃﾑ" VALUE 0x0000884E REC_UBYTE_C 0 COMP_0283 0 1 BIT_MASK 0x0040 /end CHARACTERISTIC
/begin CHARACTERISTIC mfSTMTDR "0:ｽﾀｰﾀﾓｰﾀ駆動制御ｼｽﾃﾑ非採用  1:ｽﾀｰﾀﾓｰﾀ駆動制御ｼｽﾃﾑ採用" VALUE 0x0000884E REC_UBYTE_C 0 COMP_0283 0 1 BIT_MASK 0x0020 /end CHARACTERISTIC
/begin CHARACTERISTIC mfSTCFG "0:Push/Key始動ｼｽﾃﾑ非共存  1:Push/Key始動ｼｽﾃﾑ共存" VALUE 0x0000884E REC_UBYTE_C 0 COMP_0283 0 1 BIT_MASK 0x0010 /end CHARACTERISTIC
/begin CHARACTERISTIC mfNISNWCAN "0:SNOWﾓｰﾄﾞ時Nｱｲﾄﾞﾙ許可  1:SNOWﾓｰﾄﾞ時Nｱｲﾄﾞﾙ禁止" VALUE 0x0000884E REC_UBYTE_C 0 COMP_0283 0 1 BIT_MASK 0x0008 /end CHARACTERISTIC
/begin CHARACTERISTIC mfNIDLEEM "0:排気要求冷機時Nアイドル無し  1:排気要求冷機時Nアイドル有り" VALUE 0x0000884E REC_UBYTE_C 0 COMP_0283 0 1 BIT_MASK 0x0002 /end CHARACTERISTIC
/begin CHARACTERISTIC mfNIDLENCN "0:Nアイドル_クリアニュートラル  1:Nアイドル_非クリアニュートラル" VALUE 0x0000884E REC_UBYTE_C 0 COMP_0283 0 1 BIT_MASK 0x0001 /end CHARACTERISTIC
/begin CHARACTERISTIC mNENPI3 "Flag mNENPI3" VALUE 0x0000884F REC_UBYTE_C 0 COMP_0283 0 255 /end CHARACTERISTIC
/begin CHARACTERISTIC mfGSIGEAR "0:GSI推奨ギヤ表示＿非対応  1:GSI推奨ギヤ表示＿対応" VALUE 0x0000884F REC_UBYTE_C 0 COMP_0283 0 1 BIT_MASK 0x0080 /end CHARACTERISTIC
/begin CHARACTERISTIC mfALTEUR5P "0:第2世代ALT回生制御_SOC5pt×1回放  1:第2世代ALT回生制御_SOC5pt×1回放" VALUE 0x0000884F REC_UBYTE_C 0 COMP_0283 0 1 BIT_MASK 0x0020 /end CHARACTERISTIC
/begin CHARACTERISTIC mfGSI "0:GSI非採用車  1:GSI採用車" VALUE 0x0000884F REC_UBYTE_C 0 COMP_0283 0 1 BIT_MASK 0x0010 /end CHARACTERISTIC
/begin CHARACTERISTIC mfECOPEDAL "0:ECOペダル＿なし  1:ECOペダル＿搭載" VALUE 0x0000884F REC_UBYTE_C 0 COMP_0283 0 1 BIT_MASK 0x0008 /end CHARACTERISTIC
/begin CHARACTERISTIC mfKAIPURA "0:減速回生ﾌﾟﾗｲｵﾘﾃｨ制御＿非対応(Not  1:減速回生ﾌﾟﾗｲｵﾘﾃｨ制御＿対応(Adapt" VALUE 0x0000884F REC_UBYTE_C 0 COMP_0283 0 1 BIT_MASK 0x0004 /end CHARACTERISTIC
/begin CHARACTERISTIC mfTFBATT "0:燃温ｾﾝｻ入力  1:BATT雰囲気温度ｾﾝｻ入力" VALUE 0x0000884F REC_UBYTE_C 0 COMP_0283 0 1 BIT_MASK 0x0002 /end CHARACTERISTIC
/begin CHARACTERISTIC mfKAISEI2 "0:第二世代ｵﾙﾀﾈｰﾀ回生発電制御_非対  1:第二世代ｵﾙﾀﾈｰﾀ回生発電制御_対応(" VALUE 0x0000884F REC_UBYTE_C 0 COMP_0283 0 1 BIT_MASK 0x0001 /end CHARACTERISTIC
/begin CHARACTERISTIC mO2S "Flag mO2S" VALUE 0x000088C0 REC_UBYTE_C 0 COMP_0283 0 255 /end CHARACTERISTIC
/begin CHARACTERISTIC mfS2O2B2 "0:バンク2、センサ4_O2/S無し  1:バンク2、センサ4_O2/S有り" VALUE 0x000088C0 REC_UBYTE_C 0 COMP_0283 0 1 BIT_MASK 0x0080 /end CHARACTERISTIC
/begin CHARACTERISTIC mfS1O2B2 "0:バンク2、センサ3_O2/S無し  1:バンク2、センサ3_O2/S有り" VALUE 0x000088C0 REC_UBYTE_C 0 COMP_0283 0 1 BIT_MASK 0x0040 /end CHARACTERISTIC
/begin CHARACTERISTIC mfRO2B2 "0:バンク2、センサ2_O2/S無し  1:バンク2、センサ2_O2/S有り" VALUE 0x000088C0 REC_UBYTE_C 0 COMP_0283 0 1 BIT_MASK 0x0020 /end CHARACTERISTIC
/begin CHARACTERISTIC mfFO2B2 "0:バンク2、センサ1_O2/S無し  1:バンク2、センサ1_O2/S有り" VALUE 0x000088C0 REC_UBYTE_C 0 COMP_0283 0 1 BIT_MASK 0x0010 /end CHARACTERISTIC
/begin CHARACTERISTIC mfS2O2B1 "0:バンク1、センサ4_O2/S無し  1:バンク1、センサ4_O2/S有り" VALUE 0x000088C0 REC_UBYTE_C 0 COMP_0283 0 1 BIT_MASK 0x0008 /end CHARACTERISTIC
/begin CHARACTERISTIC mfS1O2B1 "0:バンク1、センサ3_O2/S無し  1:バンク1、センサ3_O2/S有り" VALUE 0x000088C0 REC_UBYTE_C 0 COMP_0283 0 1 BIT_MASK 0x0004 /end CHARACTERISTIC
/begin CHARACTERISTIC mfRO2B1 "0:バンク1、センサ2_O2/S無し  1:バンク1、センサ2_O2/S有り" VALUE 0x000088C0 REC_UBYTE_C 0 COMP_0283 0 1 BIT_MASK 0x0002 /end CHARACTERISTIC
/begin CHARACTERISTIC mfFO2B1 "0:バンク1、センサ1_O2/S無し  1:バンク1、センサ1_O2/S有り" VALUE 0x000088C0 REC_UBYTE_C 0 COMP_0283 0 1 BIT_MASK 0x0001 /end CHARACTERISTIC
/begin CHARACTERISTIC mOBDSW "Flag mOBDSW" VALUE 0x000088C7 REC_UBYTE_C 0 COMP_0283 0 255 /end CHARACTERISTIC
/begin CHARACTERISTIC mfCJST2 "0:触媒診断STAGE2繰り返し無し  1:触媒診断STAGE2繰り返しあり" VALUE 0x000088C7 REC_UBYTE_C 0 COMP_0283 0 1 BIT_MASK 0x0080 /end CHARACTERISTIC
/begin CHARACTERISTIC mfFCATP "0:触媒診断ﾊﾟﾗﾒｰﾀHZRATE  1:触媒診断ﾊﾟﾗﾒｰﾀSUMAMP" VALUE 0x000088C7 REC_UBYTE_C 0 COMP_0283 0 1 BIT_MASK 0x0040 /end CHARACTERISTIC
/begin CHARACTERISTIC mfFLEET "0:非実験車  1:実験車" VALUE 0x000088C7 REC_UBYTE_C 0 COMP_0283 0 1 BIT_MASK 0x0020 /end CHARACTERISTIC
/begin CHARACTERISTIC mfFCATS "0:触媒診断1STAGE診断  1:触媒診断2STAGE診断" VALUE 0x000088C7 REC_UBYTE_C 0 COMP_0283 0 1 BIT_MASK 0x0010 /end CHARACTERISTIC
/begin CHARACTERISTIC mfDUETSW "0:DUETTE診断RTDNG.NGMEMセット  1:DUETTE信号線診断2TRIPでセット" VALUE 0x000088C7 REC_UBYTE_C 0 COMP_0283 0 1 BIT_MASK 0x0008 /end CHARACTERISTIC
/begin CHARACTERISTIC mfCATDGN "0:触媒診断仕様通常  1:触媒診断仕様実験用" VALUE 0x000088C7 REC_UBYTE_C 0 COMP_0283 0 1 BIT_MASK 0x0004 /end CHARACTERISTIC
/begin CHARACTERISTIC mfFMRKMR "0:全域学習値をKMRに付加しない  1:全域学習値をKMRに付加する" VALUE 0x000088C7 REC_UBYTE_C 0 COMP_0283 0 1 BIT_MASK 0x0002 /end CHARACTERISTIC
/begin CHARACTERISTIC mfPRIDRV "0:ﾌﾟﾘﾄﾞﾗｲﾊﾞ断線診断対応  1:ﾌﾟﾘﾄﾞﾗｲﾊﾞ断線診断未対応" VALUE 0x000088C7 REC_UBYTE_C 0 COMP_0283 0 1 BIT_MASK 0x0001 /end CHARACTERISTIC
/begin CHARACTERISTIC mOBDSW10 "Flag mOBDSW10" VALUE 0x000088C8 REC_UBYTE_C 0 COMP_0283 0 255 /end CHARACTERISTIC
/begin CHARACTERISTIC mfTATHTMP "0:温度センサ相互監視診断スロットル  1:温度センサ相互監視診断スロットル" VALUE 0x000088C8 REC_UBYTE_C 0 COMP_0283 0 1 BIT_MASK 0x0080 /end CHARACTERISTIC
/begin CHARACTERISTIC mfCSSNGSEL "0:回転・トルク比パラメータ（Ne/Tp  1:直接パラメータモニタ方式（回転数" VALUE 0x000088C8 REC_UBYTE_C 0 COMP_0283 0 1 BIT_MASK 0x0040 /end CHARACTERISTIC
/begin CHARACTERISTIC mfRATECLRT "0:演算不許可  1:演算許可" VALUE 0x000088C8 REC_UBYTE_C 0 COMP_0283 0 1 BIT_MASK 0x0020 /end CHARACTERISTIC
/begin CHARACTERISTIC mfFCCONMSK "0:F/C条件をマスクしない  1:F/C条件をマスクする" VALUE 0x000088C8 REC_UBYTE_C 0 COMP_0283 0 1 BIT_MASK 0x0010 /end CHARACTERISTIC
/begin CHARACTERISTIC mfHOLDTM "0:温度センサ相互監視診断連続タイマ  1:温度センサ相互監視診断累積タイマ" VALUE 0x000088C8 REC_UBYTE_C 0 COMP_0283 0 1 BIT_MASK 0x0002 /end CHARACTERISTIC
/begin CHARACTERISTIC mfOILTMP "0:温度センサ相互監視診断油温センサ  1:温度センサ相互監視診断油温センサ" VALUE 0x000088C8 REC_UBYTE_C 0 COMP_0283 0 1 BIT_MASK 0x0001 /end CHARACTERISTIC
/begin CHARACTERISTIC mOBDSW11 "Flag mOBDSW11" VALUE 0x000088C9 REC_UBYTE_C 0 COMP_0283 0 255 /end CHARACTERISTIC
/begin CHARACTERISTIC mfCSSFIRC "0:診断許可条件内のFIR条件を無効と  1:診断許可条件内のFIR条件を有効と" VALUE 0x000088C9 REC_UBYTE_C 0 COMP_0283 0 1 BIT_MASK 0x0080 /end CHARACTERISTIC
/begin CHARACTERISTIC mfCSSFIRB "0:診断許可条件内のFIR条件を無効と  1:診断許可条件内のFIR条件を有効と" VALUE 0x000088C9 REC_UBYTE_C 0 COMP_0283 0 1 BIT_MASK 0x0040 /end CHARACTERISTIC
/begin CHARACTERISTIC mfCSSRPMC "0:機能診断（回転）をしない（高度に  1:機能診断（回転）をする（高度によ" VALUE 0x000088C9 REC_UBYTE_C 0 COMP_0283 0 1 BIT_MASK 0x0020 /end CHARACTERISTIC
/begin CHARACTERISTIC mfCSSRPMB "0:機能診断(回転)をしない（傾斜によ  1:機能診断(回転)をする（傾斜による" VALUE 0x000088C9 REC_UBYTE_C 0 COMP_0283 0 1 BIT_MASK 0x0010 /end CHARACTERISTIC
/begin CHARACTERISTIC mfCSSRPMA "0:機能診断（回転）をしない（成層燃  1:機能診断（回転）をする（成層燃焼" VALUE 0x000088C9 REC_UBYTE_C 0 COMP_0283 0 1 BIT_MASK 0x0008 /end CHARACTERISTIC
/begin CHARACTERISTIC mfCSSTNGC "0:熱量診断をしない（高度による均質  1:熱量診断をする（高度による均質燃" VALUE 0x000088C9 REC_UBYTE_C 0 COMP_0283 0 1 BIT_MASK 0x0004 /end CHARACTERISTIC
/begin CHARACTERISTIC mfCSSTNGB "0:熱量診断をしない（傾斜による均質  1:熱量診断をする（傾斜による均質燃" VALUE 0x000088C9 REC_UBYTE_C 0 COMP_0283 0 1 BIT_MASK 0x0002 /end CHARACTERISTIC
/begin CHARACTERISTIC mfCSSTNGA "0:熱量診断をしない（成層燃焼時）  1:熱量診断をする（成層燃焼時）" VALUE 0x000088C9 REC_UBYTE_C 0 COMP_0283 0 1 BIT_MASK 0x0001 /end CHARACTERISTIC
/begin CHARACTERISTIC mOBDSW12 "Flag mOBDSW12" VALUE 0x000088CA REC_UBYTE_C 0 COMP_0283 0 255 /end CHARACTERISTIC
/begin CHARACTERISTIC mfMFIDHOS "0:暖気後Idle判定時用失火判定ｸﾗｲﾃﾘｱ  1:暖気後Idle判定時用失火判定ｸﾗｲﾃﾘｱ" VALUE 0x000088CA REC_UBYTE_C 0 COMP_0283 0 1 BIT_MASK 0x0020 /end CHARACTERISTIC
/begin CHARACTERISTIC mfCSSDOK2 "0:ｺｰﾙﾄﾞｽﾄﾗﾃｼﾞ診断Dﾚﾝｼﾞ不許可  1:ｺｰﾙﾄﾞｽﾄﾗﾃｼﾞ診断Dﾚﾝｼﾞ許可" VALUE 0x000088CA REC_UBYTE_C 0 COMP_0283 0 1 BIT_MASK 0x0008 /end CHARACTERISTIC
/begin CHARACTERISTIC mfCSSADVC "0:機能診断（点火）をしない（高度に  1:機能診断（点火）をする（高度によ" VALUE 0x000088CA REC_UBYTE_C 0 COMP_0283 0 1 BIT_MASK 0x0004 /end CHARACTERISTIC
/begin CHARACTERISTIC mfCSSADVB "0:機能診断（点火)をしない（傾斜に  1:機能診断（点火)をする（傾斜によ" VALUE 0x000088CA REC_UBYTE_C 0 COMP_0283 0 1 BIT_MASK 0x0002 /end CHARACTERISTIC
/begin CHARACTERISTIC mfCSSADVA "0:機能診断（点火）をしない（成層燃  1:機能診断（点火）をする（成層燃焼" VALUE 0x000088CA REC_UBYTE_C 0 COMP_0283 0 1 BIT_MASK 0x0001 /end CHARACTERISTIC
/begin CHARACTERISTIC mOBDSW2 "Flag mOBDSW2" VALUE 0x000088CB REC_UBYTE_C 0 COMP_0283 0 255 /end CHARACTERISTIC
/begin CHARACTERISTIC mfFEVAP5 "0:相対圧計測タイプ_ライン圧センサ  1:絶対圧計測タイプ_ライン圧センサ" VALUE 0x000088CB REC_UBYTE_C 0 COMP_0283 0 1 BIT_MASK 0x0080 /end CHARACTERISTIC
/begin CHARACTERISTIC mfFEVAP4 "0:空間容積補正有り  1:空間容積補正無し" VALUE 0x000088CB REC_UBYTE_C 0 COMP_0283 0 1 BIT_MASK 0x0040 /end CHARACTERISTIC
/begin CHARACTERISTIC mfFEVAP3 "0:減速中プルダウン_無し  1:減速中プルダウン_有り" VALUE 0x000088CB REC_UBYTE_C 0 COMP_0283 0 1 BIT_MASK 0x0020 /end CHARACTERISTIC
/begin CHARACTERISTIC mfFEVAP2 "0:ﾌﾟﾙﾀﾞｳﾝ～ﾘｰｸﾀﾞｳﾝ診断繰り返し無し  1:ﾌﾟﾙﾀﾞｳﾝ～ﾘｰｸﾀﾞｳﾝ診断繰り返し有り" VALUE 0x000088CB REC_UBYTE_C 0 COMP_0283 0 1 BIT_MASK 0x0010 /end CHARACTERISTIC
/begin CHARACTERISTIC mfFEVAP1 "0:ﾀﾝｸ正圧時ﾘｰｸﾀﾞｳﾝ診断繰り返し無し  1:ﾀﾝｸ正圧時ﾘｰｸﾀﾞｳﾝ診断繰り返し有り" VALUE 0x000088CB REC_UBYTE_C 0 COMP_0283 0 1 BIT_MASK 0x0008 /end CHARACTERISTIC
/begin CHARACTERISTIC mfFFPCM "0:非実験用  1:実験用(FPCM診断)" VALUE 0x000088CB REC_UBYTE_C 0 COMP_0283 0 1 BIT_MASK 0x0004 /end CHARACTERISTIC
/begin CHARACTERISTIC mfTCATB2 "0:触媒温度入力なしBANK2  1:触媒温度入力ありBANK2" VALUE 0x000088CB REC_UBYTE_C 0 COMP_0283 0 1 BIT_MASK 0x0002 /end CHARACTERISTIC
/begin CHARACTERISTIC mfTCATB1 "0:触媒温度入力なしBANK1  1:触媒温度入力ありBANK1" VALUE 0x000088CB REC_UBYTE_C 0 COMP_0283 0 1 BIT_MASK 0x0001 /end CHARACTERISTIC
/begin CHARACTERISTIC mOBDSW3 "Flag mOBDSW3" VALUE 0x000088CC REC_UBYTE_C 0 COMP_0283 0 255 /end CHARACTERISTIC
/begin CHARACTERISTIC mfVPRES12 "0:内蔵大気圧ｾﾝｻ1倍入力をVPRESへ反  1:内蔵大気圧ｾﾝｻ2倍入力をVPRESへ反" VALUE 0x000088CC REC_UBYTE_C 0 COMP_0283 0 1 BIT_MASK 0x0080 /end CHARACTERISTIC
/begin CHARACTERISTIC mfPAMB00 "0:PAMBにVPRESを反映させる  1:PAMBにPAMBO#を反映させる（大気圧" VALUE 0x000088CC REC_UBYTE_C 0 COMP_0283 0 1 BIT_MASK 0x0040 /end CHARACTERISTIC
/begin CHARACTERISTIC mfEVPSCR "0:正圧診断のNG判定ｸﾗｲﾃﾘｱはφ0.04in  1:正圧診断のNG判定ｸﾗｲﾃﾘｱはφ0.02in" VALUE 0x000088CC REC_UBYTE_C 0 COMP_0283 0 1 BIT_MASK 0x0020 /end CHARACTERISTIC
/begin CHARACTERISTIC mfEVF2NG "0:NG判定するクライテリアはΦ0.04in  1:NG判定するクライテリアはΦ0.02in" VALUE 0x000088CC REC_UBYTE_C 0 COMP_0283 0 1 BIT_MASK 0x0010 /end CHARACTERISTIC
/begin CHARACTERISTIC mfFKHMIL "0:高水温増量診断MIL点灯不許可  1:高水温増量診断MIL点灯許可" VALUE 0x000088CC REC_UBYTE_C 0 COMP_0283 0 1 BIT_MASK 0x0008 /end CHARACTERISTIC
/begin CHARACTERISTIC mfTO2SE2 "0:FrO2/sﾊﾞﾝｸ2素子温A/D変換無し  1:FrO2/sﾊﾞﾝｸ2素子温A/D変換有り" VALUE 0x000088CC REC_UBYTE_C 0 COMP_0283 0 1 BIT_MASK 0x0002 /end CHARACTERISTIC
/begin CHARACTERISTIC mfTO2SE1 "0:FrO2/sﾊﾞﾝｸ1素子温A/D変換無し  1:FrO2/sﾊﾞﾝｸ1素子温A/D変換有り" VALUE 0x000088CC REC_UBYTE_C 0 COMP_0283 0 1 BIT_MASK 0x0001 /end CHARACTERISTIC
/begin CHARACTERISTIC mOBDSW4 "Flag mOBDSW4" VALUE 0x000088CD REC_UBYTE_C 0 COMP_0283 0 255 /end CHARACTERISTIC
/begin CHARACTERISTIC mfCSMSEL "0:ｺｰﾙﾄﾞｽﾄﾗﾃｼﾞ診断_TPTFBYA方式  1:ｺｰﾙﾄﾞｽﾄﾗﾃｼﾞ診断_TP方式" VALUE 0x000088CD REC_UBYTE_C 0 COMP_0283 0 1 BIT_MASK 0x0080 /end CHARACTERISTIC
/begin CHARACTERISTIC mfMBTHMPA "0:水温推定ﾓﾃﾞﾙﾍﾞｰｽｻｰﾓｽﾀｯﾄ診断_ﾊﾟﾗﾒ  1:水温推定ﾓﾃﾞﾙﾍﾞｰｽｻｰﾓｽﾀｯﾄ診断_ﾊﾟﾗﾒ" VALUE 0x000088CD REC_UBYTE_C 0 COMP_0283 0 1 BIT_MASK 0x0040 /end CHARACTERISTIC
/begin CHARACTERISTIC mfMBTHMD "0:ｻｰﾓｽﾀｯﾄ診断許可_<故障ｺｰﾄﾞ分離対  1:吹Eｷ推定ﾓﾃﾞﾙﾍﾞｰｽｻｰﾓｽﾀｯﾄ診断許可" VALUE 0x000088CD REC_UBYTE_C 0 COMP_0283 0 1 BIT_MASK 0x0020 /end CHARACTERISTIC
/begin CHARACTERISTIC mfFMRKMR2 "0:OPEN_LOOP中にはKBLRC付加しない  1:KMR領域中のみKBLRC付加しない" VALUE 0x000088CD REC_UBYTE_C 0 COMP_0283 0 1 BIT_MASK 0x0010 /end CHARACTERISTIC
/begin CHARACTERISTIC mfVTCSLW "0:右以外  1:VTCｽﾛｰﾚｽﾎﾟﾝｽ状態再現" VALUE 0x000088CD REC_UBYTE_C 0 COMP_0283 0 1 BIT_MASK 0x0008 /end CHARACTERISTIC
/begin CHARACTERISTIC mfVTCTGE "0:右以外  1:VTCﾀｰｹﾞｯﾄｴﾗｰ状態再現" VALUE 0x000088CD REC_UBYTE_C 0 COMP_0283 0 1 BIT_MASK 0x0004 /end CHARACTERISTIC
/begin CHARACTERISTIC mfIDLVTC "0:VTCｱｲﾄﾞﾙ時駆動不許可  1:VTCｱｲﾄﾞﾙ時駆動許可" VALUE 0x000088CD REC_UBYTE_C 0 COMP_0283 0 1 BIT_MASK 0x0002 /end CHARACTERISTIC
/begin CHARACTERISTIC mfCSSMPM "0:ｺｰﾙﾄﾞｽﾄﾗﾃｼﾞﾊﾟﾗﾒｰﾀ演算不許可  1:ｺｰﾙﾄﾞｽﾄﾗﾃｼﾞﾊﾟﾗﾒｰﾀ演算許可" VALUE 0x000088CD REC_UBYTE_C 0 COMP_0283 0 1 BIT_MASK 0x0001 /end CHARACTERISTIC
/begin CHARACTERISTIC mOBDSW5 "Flag mOBDSW5" VALUE 0x000088CE REC_UBYTE_C 0 COMP_0283 0 255 /end CHARACTERISTIC
/begin CHARACTERISTIC mfHTPAKN "0:ﾊﾟｰｼﾞ禁止  1:ﾊﾟｰｼﾞ許可" VALUE 0x000088CE REC_UBYTE_C 0 COMP_0283 0 1 BIT_MASK 0x0080 /end CHARACTERISTIC
/begin CHARACTERISTIC mfTO2RSD "0:3rdO2ｾﾝｻ応答ﾘｯﾁ→ﾘｰﾝ片側診断  1:3rdO2ｾﾝｻ応答両側診断" VALUE 0x000088CE REC_UBYTE_C 0 COMP_0283 0 1 BIT_MASK 0x0040 /end CHARACTERISTIC
/begin CHARACTERISTIC mfHCTPRM "0:空気量積算  1:酸素量積算" VALUE 0x000088CE REC_UBYTE_C 0 COMP_0283 0 1 BIT_MASK 0x0020 /end CHARACTERISTIC
/begin CHARACTERISTIC mfHCTCLB "0:生産仕様  1:実験仕様(繰返し)" VALUE 0x000088CE REC_UBYTE_C 0 COMP_0283 0 1 BIT_MASK 0x0010 /end CHARACTERISTIC
/begin CHARACTERISTIC mOBDSW6 "Flag mOBDSW6" VALUE 0x000088CF REC_UBYTE_C 0 COMP_0283 0 255 /end CHARACTERISTIC
/begin CHARACTERISTIC mfEVPINTG "0:統合化ｴﾊﾞﾎﾟﾘｰｸ診断でない  1:統合化ｴﾊﾞﾎﾟﾘｰｸ診断である" VALUE 0x000088CF REC_UBYTE_C 0 COMP_0283 0 1 BIT_MASK 0x0040 /end CHARACTERISTIC
/begin CHARACTERISTIC mfCATTGT "0:触媒診断＿目標A/F_P分切り替えな  1:触媒診断＿目標A/F_P分切り替えあ" VALUE 0x000088CF REC_UBYTE_C 0 COMP_0283 0 1 BIT_MASK 0x0020 /end CHARACTERISTIC
/begin CHARACTERISTIC mfEOIMGGO "0:EONV仮想診断実行無し  1:EONV仮想診断実行有り" VALUE 0x000088CF REC_UBYTE_C 0 COMP_0283 0 1 BIT_MASK 0x0010 /end CHARACTERISTIC
/begin CHARACTERISTIC mfEOLCNL "0:EONV負圧ｽﾃｰﾄ強制移行ﾛｼﾞｯｸ無し  1:EONV負圧ｽﾃｰﾄ強制移行ﾛｼﾞｯｸ有り" VALUE 0x000088CF REC_UBYTE_C 0 COMP_0283 0 1 BIT_MASK 0x0004 /end CHARACTERISTIC
/begin CHARACTERISTIC mfLGTANK "0:通常タンク_空間容積<128L  1:大型タンク対応_空間容積_≧128L" VALUE 0x000088CF REC_UBYTE_C 0 COMP_0283 0 1 BIT_MASK 0x0002 /end CHARACTERISTIC
/begin CHARACTERISTIC mOBDSW7 "Flag mOBDSW7" VALUE 0x000088D0 REC_UBYTE_C 0 COMP_0283 0 255 /end CHARACTERISTIC
/begin CHARACTERISTIC mfSCVPOSCH "0:TCV_Position_Sen.順特性  1:TCV_Position_Sen.逆特性" VALUE 0x000088D0 REC_UBYTE_C 0 COMP_0283 0 1 BIT_MASK 0x0080 /end CHARACTERISTIC
/begin CHARACTERISTIC mfAFDHYB "0:A/Fｾﾝｻ応答診断ｱｸﾃｨﾌﾞ方式  1:A/Fｾﾝｻ応答診断ｶﾙﾏﾝ＋ｱｸﾃｨﾌﾞ方式" VALUE 0x000088D0 REC_UBYTE_C 0 COMP_0283 0 1 BIT_MASK 0x0040 /end CHARACTERISTIC
/begin CHARACTERISTIC mfIDLVTCE "0:排気VTCｱｲﾄﾞﾙ時駆動不許可  1:排気VTCｱｲﾄﾞﾙ時駆動許可" VALUE 0x000088D0 REC_UBYTE_C 0 COMP_0283 0 1 BIT_MASK 0x0010 /end CHARACTERISTIC
/begin CHARACTERISTIC mfVTGESW "0:VTC故障模擬制御(吸気側作動)  1:VTC故障模擬制御(排気側作動)" VALUE 0x000088D0 REC_UBYTE_C 0 COMP_0283 0 1 BIT_MASK 0x0004 /end CHARACTERISTIC
/begin CHARACTERISTIC mOBDSW8 "Flag mOBDSW8" VALUE 0x000088D1 REC_UBYTE_C 0 COMP_0283 0 255 /end CHARACTERISTIC
/begin CHARACTERISTIC mfVSPDSEL "0:回転･TP相関方式  1:OUTREV相関方式" VALUE 0x000088D1 REC_UBYTE_C 0 COMP_0283 0 1 BIT_MASK 0x0080 /end CHARACTERISTIC
/begin CHARACTERISTIC mfSELFGST "0:GST個別通信非対応  1:GST個別通信対応" VALUE 0x000088D1 REC_UBYTE_C 0 COMP_0283 0 1 BIT_MASK 0x0040 /end CHARACTERISTIC
/begin CHARACTERISTIC mfAFDLYMT "0:A/Fｾﾝｻ無駄時間測定⊿A/F方式  1:A/Fｾﾝｻ無駄時間測定A/F振幅方式" VALUE 0x000088D1 REC_UBYTE_C 0 COMP_0283 0 1 BIT_MASK 0x0008 /end CHARACTERISTIC
/begin CHARACTERISTIC mfRODRPM "0:RrO2無駄時間診断実行仕様  1:RrO2無駄時間診断ﾊﾟﾗﾓﾆ仕様" VALUE 0x000088D1 REC_UBYTE_C 0 COMP_0283 0 1 BIT_MASK 0x0004 /end CHARACTERISTIC
/begin CHARACTERISTIC mfCSSDOK "0:ｺｰﾙﾄﾞｽﾄﾗﾃｼﾞ診断Dﾚﾝｼﾞ許可  1:ｺｰﾙﾄﾞｽﾄﾗﾃｼﾞ診断Dﾚﾝｼﾞ不許可" VALUE 0x000088D1 REC_UBYTE_C 0 COMP_0283 0 1 BIT_MASK 0x0002 /end CHARACTERISTIC
/begin CHARACTERISTIC mfRODRFC "0:FCUT=3で無駄時間ﾀｲﾏ計測開始  1:FCUT=1で無駄時間ﾀｲﾏ計測開始" VALUE 0x000088D1 REC_UBYTE_C 0 COMP_0283 0 1 BIT_MASK 0x0001 /end CHARACTERISTIC
/begin CHARACTERISTIC mOBDSW9 "Flag mOBDSW9" VALUE 0x000088D2 REC_UBYTE_C 0 COMP_0283 0 255 /end CHARACTERISTIC
/begin CHARACTERISTIC mfCAPWARI "0:ﾌｭｰｴﾙｷｬｯﾌﾟ警告灯制御非作動(Fuel_  1:ﾌｭｰｴﾙｷｬｯﾌﾟ警告灯制御作動(Fuel_ca" VALUE 0x000088D2 REC_UBYTE_C 0 COMP_0283 0 1 BIT_MASK 0x0010 /end CHARACTERISTIC
/begin CHARACTERISTIC mfAFNGSIM "0:A/Fｾﾝｻ故障模擬非作動  1:A/Fｾﾝｻ故障模擬作動" VALUE 0x000088D2 REC_UBYTE_C 0 COMP_0283 0 1 BIT_MASK 0x0008 /end CHARACTERISTIC
/begin CHARACTERISTIC mfAFMDGSW "0:AFMDGを充填効率方式で演算する  1:AFMDGを推定吸気圧方式で演算する" VALUE 0x000088D2 REC_UBYTE_C 0 COMP_0283 0 1 BIT_MASK 0x0004 /end CHARACTERISTIC
/begin CHARACTERISTIC mfIDLMRLRN "0:ｱｲﾄﾞﾙ時全域空燃比学習しない(With  1:ｱｲﾄﾞﾙ時全域空燃比学習する(With_I" VALUE 0x000088D2 REC_UBYTE_C 0 COMP_0283 0 1 BIT_MASK 0x0002 /end CHARACTERISTIC
/begin CHARACTERISTIC mOSCSW "Flag mOSCSW" VALUE 0x00008904 REC_UBYTE_C 0 COMP_0283 0 255 /end CHARACTERISTIC
/begin CHARACTERISTIC mfCATCNG "0:触媒診断終了までｽﾗｲｽ低下  1:触媒診断領域内のみｽﾗｲｽ低下" VALUE 0x00008904 REC_UBYTE_C 0 COMP_0283 0 1 BIT_MASK 0x0080 /end CHARACTERISTIC
/begin CHARACTERISTIC mfPREDAF "0:SMC予測A/F無し  1:SMC予測A/F有り" VALUE 0x00008904 REC_UBYTE_C 0 COMP_0283 0 1 BIT_MASK 0x0040 /end CHARACTERISTIC
/begin CHARACTERISTIC mfOSCBANK "0:ﾊﾞﾝｸ非対応制御選択  1:ﾊﾞﾝｸ対応制御選択" VALUE 0x00008904 REC_UBYTE_C 0 COMP_0283 0 1 BIT_MASK 0x0020 /end CHARACTERISTIC
/begin CHARACTERISTIC mfAFIDLESW "0:IDLE_SW_enable  1:IDLE_SW_disable" VALUE 0x00008904 REC_UBYTE_C 0 COMP_0283 0 1 BIT_MASK 0x0010 /end CHARACTERISTIC
/begin CHARACTERISTIC mfAFDCHG "0:時間切り替え  1:ｽﾗｲｽ切り替え" VALUE 0x00008904 REC_UBYTE_C 0 COMP_0283 0 1 BIT_MASK 0x0004 /end CHARACTERISTIC
/begin CHARACTERISTIC mfAFDTGCLP "0:-  1:Target_A/F_mABFCMVに固定" VALUE 0x00008904 REC_UBYTE_C 0 COMP_0283 0 1 BIT_MASK 0x0002 /end CHARACTERISTIC
/begin CHARACTERISTIC mfAFDSEL "0:α方式  1:Target_方式" VALUE 0x00008904 REC_UBYTE_C 0 COMP_0283 0 1 BIT_MASK 0x0001 /end CHARACTERISTIC
/begin CHARACTERISTIC mOSCSW2 "Flag mOSCSW2" VALUE 0x00008905 REC_UBYTE_C 0 COMP_0283 0 255 /end CHARACTERISTIC
/begin CHARACTERISTIC mfAFAIRH "0:大気圧条件不成立時圧力補正なし  1:大気圧条件不成立時圧力補正あり" VALUE 0x00008905 REC_UBYTE_C 0 COMP_0283 0 1 BIT_MASK 0x0001 /end CHARACTERISTIC
/begin CHARACTERISTIC mPFLCHK "Flag mPFLCHK" VALUE 0x0000893E REC_UBYTE_C 0 COMP_0283 0 255 /end CHARACTERISTIC
/begin CHARACTERISTIC mfPFBGIN "0:制御DUTY上下限無  1:制御DUTY上下限有" VALUE 0x0000893E REC_UBYTE_C 0 COMP_0283 0 1 BIT_MASK 0x0002 /end CHARACTERISTIC
/begin CHARACTERISTIC mfPFSTART "0:IGNSW_OFF後燃圧ﾌｨｰﾄﾞﾊﾞｯｸ停止無  1:IGNSW_OFF後燃圧ﾌｨｰﾄﾞﾊﾞｯｸ停止有" VALUE 0x0000893E REC_UBYTE_C 0 COMP_0283 0 1 BIT_MASK 0x0001 /end CHARACTERISTIC
/begin CHARACTERISTIC mPLTFRM "Flag mPLTFRM" VALUE 0x0000894C REC_UBYTE_C 0 COMP_0283 0 255 /end CHARACTERISTIC
/begin CHARACTERISTIC mfSPDOLDMD "0:SRC回転同期  1:旧型Mモード回転同期" VALUE 0x0000894C REC_UBYTE_C 0 COMP_0283 0 1 BIT_MASK 0x0080 /end CHARACTERISTIC
/begin CHARACTERISTIC mfUNIGMASK "0:ASCD車速異常判定ﾏｽｸ処理無し  1:ASCD車速異常判定ﾏｽｸ処理有り" VALUE 0x0000894C REC_UBYTE_C 0 COMP_0283 0 1 BIT_MASK 0x0040 /end CHARACTERISTIC
/begin CHARACTERISTIC mfUNIVSP "0:車速1系統仕様車種無し  1:車速1系統仕様車種有り" VALUE 0x0000894C REC_UBYTE_C 0 COMP_0283 0 1 BIT_MASK 0x0020 /end CHARACTERISTIC
/begin CHARACTERISTIC mfAL_TDRAT "0:FASTﾄﾙｸ要求方式次世代DUETTE  1:ﾄﾙｸﾀﾞｳﾝ率通信方式次世代DUETTE" VALUE 0x0000894C REC_UBYTE_C 0 COMP_0283 0 1 BIT_MASK 0x0010 /end CHARACTERISTIC
/begin CHARACTERISTIC mfIKPRECMN "0:それ以外  1:ｺﾓﾝ仕様移行過渡期のIK搭載車" VALUE 0x0000894C REC_UBYTE_C 0 COMP_0283 0 1 BIT_MASK 0x0008 /end CHARACTERISTIC
/begin CHARACTERISTIC mfPWTSPFAL "0:ErgonomicPedal_Invalid処理無し  1:ErgonomicPedal_Invalid処理有り" VALUE 0x0000894C REC_UBYTE_C 0 COMP_0283 0 1 BIT_MASK 0x0004 /end CHARACTERISTIC
/begin CHARACTERISTIC mfFLAG8TRQ "0:12bit_トルクCAN仕様  1:8bit_トルクCAN仕様" VALUE 0x0000894C REC_UBYTE_C 0 COMP_0283 0 1 BIT_MASK 0x0002 /end CHARACTERISTIC
/begin CHARACTERISTIC mfFLAGBC "0:コモンB-Platform仕様  1:コモンB-Platform以外" VALUE 0x0000894C REC_UBYTE_C 0 COMP_0283 0 1 BIT_MASK 0x0001 /end CHARACTERISTIC
/begin CHARACTERISTIC mPROTOP "Flag mPROTOP" VALUE 0x00008964 REC_UBYTE_C 0 COMP_0283 0 255 /end CHARACTERISTIC
/begin CHARACTERISTIC mfHPFULCT "0:油圧低下判定時燃料カット禁止  1:油圧低下判定時燃料カット許可" VALUE 0x00008964 REC_UBYTE_C 0 COMP_0283 0 1 BIT_MASK 0x0004 /end CHARACTERISTIC
/begin CHARACTERISTIC mfRFOPLOW "0:機能要求油圧低下判定禁止  1:機能要求油圧低下判定許可" VALUE 0x00008964 REC_UBYTE_C 0 COMP_0283 0 1 BIT_MASK 0x0002 /end CHARACTERISTIC
/begin CHARACTERISTIC mfOPSSTP "0:OPSによるOPS領域油圧低下判定許可  1:油圧センサによるOPS領域油圧低下" VALUE 0x00008964 REC_UBYTE_C 0 COMP_0283 0 1 BIT_MASK 0x0001 /end CHARACTERISTIC
/begin CHARACTERISTIC mPTDSW "Flag mPTDSW" VALUE 0x0000898F REC_UBYTE_C 0 COMP_0283 0 255 /end CHARACTERISTIC
/begin CHARACTERISTIC mfTTE_ON "0:ﾄﾙｸTTE制御無効(TATE=APP0)  1:ﾄﾙｸTTE制御有効(TATE←TTEPTD)" VALUE 0x0000898F REC_UBYTE_C 0 COMP_0283 0 1 BIT_MASK 0x0040 /end CHARACTERISTIC
/begin CHARACTERISTIC mfTFD_ON "0:駆動力TFD制御無効(TTEPDT=TTEAP0)  1:駆動力TFD制御有効(TATE←TTEPTD)" VALUE 0x0000898F REC_UBYTE_C 0 COMP_0283 0 1 BIT_MASK 0x0020 /end CHARACTERISTIC
/begin CHARACTERISTIC mfTFDCVT "0:TFD0をCVTへ送信  1:TFDDをCVTへ送信" VALUE 0x0000898F REC_UBYTE_C 0 COMP_0283 0 1 BIT_MASK 0x0004 /end CHARACTERISTIC
/begin CHARACTERISTIC mfCVTFL_ON "0:CVTFAILﾌﾗｸﾞ無効  1:CVTFAILﾌﾗｸﾞ有効" VALUE 0x0000898F REC_UBYTE_C 0 COMP_0283 0 1 BIT_MASK 0x0002 /end CHARACTERISTIC
/begin CHARACTERISTIC mfPTD_ON "0:駆動力ﾃﾞﾏﾝﾄﾞ制御OFF  1:駆動力ﾃﾞﾏﾝﾄﾞ制御ON" VALUE 0x0000898F REC_UBYTE_C 0 COMP_0283 0 1 BIT_MASK 0x0001 /end CHARACTERISTIC
/begin CHARACTERISTIC mPTDSW2 "Flag mPTDSW2" VALUE 0x00008990 REC_UBYTE_C 0 COMP_0283 0 255 /end CHARACTERISTIC
/begin CHARACTERISTIC mfITOHOSON "0:意図検知制御OFF  1:意図検知制御ON" VALUE 0x00008990 REC_UBYTE_C 0 COMP_0283 0 1 BIT_MASK 0x0080 /end CHARACTERISTIC
/begin CHARACTERISTIC mfJERKON "0:ジャークコントロール制御無し  1:ジャークコントロール制御あり" VALUE 0x00008990 REC_UBYTE_C 0 COMP_0283 0 1 BIT_MASK 0x0040 /end CHARACTERISTIC
/begin CHARACTERISTIC mfFNETQHOS "0:回転数ﾄﾙｸ補正無し  1:回転数ﾄﾙｸ補正有り" VALUE 0x00008990 REC_UBYTE_C 0 COMP_0283 0 1 BIT_MASK 0x0020 /end CHARACTERISTIC
/begin CHARACTERISTIC mfFHHTQHOS "0:高地・熱地補正制御無し  1:高地・熱地補正制御有り" VALUE 0x00008990 REC_UBYTE_C 0 COMP_0283 0 1 BIT_MASK 0x0010 /end CHARACTERISTIC
/begin CHARACTERISTIC mfTRLNON "0:踏込み時加速リニアリティ制御無し  1:踏込み時加速リニアリティ制御あり" VALUE 0x00008990 REC_UBYTE_C 0 COMP_0283 0 1 BIT_MASK 0x0008 /end CHARACTERISTIC
/begin CHARACTERISTIC mfFSPTFAC "0:意図検知制御ﾁｭｰﾆﾝｸﾞOFF  1:意図検知制御ﾁｭｰﾆﾝｸﾞON" VALUE 0x00008990 REC_UBYTE_C 0 COMP_0283 0 1 BIT_MASK 0x0004 /end CHARACTERISTIC
/begin CHARACTERISTIC mfFZADDFD "0:地域属性対応制御OFF  1:地域属性対応制御ON" VALUE 0x00008990 REC_UBYTE_C 0 COMP_0283 0 1 BIT_MASK 0x0002 /end CHARACTERISTIC
/begin CHARACTERISTIC mfFADDFD "0:走行抵抗対応制御OFF  1:走行抵抗対応制御ON" VALUE 0x00008990 REC_UBYTE_C 0 COMP_0283 0 1 BIT_MASK 0x0001 /end CHARACTERISTIC
/begin CHARACTERISTIC mPTDSW2_S "Flag mPTDSW2_S" VALUE 0x000157D5 REC_UBYTE_C 0 COMP_0283 0 255 /end CHARACTERISTIC
/begin CHARACTERISTIC mfFZADFD_S "0:地域属性対応制御OFF  1:地域属性対応制御ON" VALUE 0x000157D5 REC_UBYTE_C 0 COMP_0283 0 1 BIT_MASK 0x0002 /end CHARACTERISTIC
/begin CHARACTERISTIC mfFADDFD_S "0:走行抵抗対応制御OFF  1:走行抵抗対応制御ON" VALUE 0x000157D5 REC_UBYTE_C 0 COMP_0283 0 1 BIT_MASK 0x0001 /end CHARACTERISTIC
/begin CHARACTERISTIC mREGSRQ "Flag mREGSRQ" VALUE 0x000089F5 REC_UBYTE_C 0 COMP_0283 0 255 /end CHARACTERISTIC
/begin CHARACTERISTIC mfFINTCLe "0:0点校正全開側  1:0点校正全閉側" VALUE 0x000089F5 REC_UBYTE_C 0 COMP_0283 0 1 BIT_MASK 0x0080 /end CHARACTERISTIC
/begin CHARACTERISTIC mfFDRHYSe "0:回転方向駆動周期切り換え無  1:回転方向駆動周期切り換え有" VALUE 0x000089F5 REC_UBYTE_C 0 COMP_0283 0 1 BIT_MASK 0x0040 /end CHARACTERISTIC
/begin CHARACTERISTIC mfFDRPCHe "0:着座駆動周期切り換え無  1:着座駆動周期切り換え有" VALUE 0x000089F5 REC_UBYTE_C 0 COMP_0283 0 1 BIT_MASK 0x0020 /end CHARACTERISTIC
/begin CHARACTERISTIC mfFHLDTMe "0:目標一致時ﾎ-ﾙﾄﾞ時間無  1:目標一致時ﾎ-ﾙﾄﾞ時間有" VALUE 0x000089F5 REC_UBYTE_C 0 COMP_0283 0 1 BIT_MASK 0x0010 /end CHARACTERISTIC
/begin CHARACTERISTIC mfFPTNTBLe "0:ﾓ-ﾀ励磁ﾊﾟﾀ-ﾝﾃ-ﾌﾞﾙNo.1選択  1:ﾓ-ﾀ励磁ﾊﾟﾀ-ﾝﾃ-ﾌﾞﾙNo.２選択" VALUE 0x000089F5 REC_UBYTE_C 0 COMP_0283 0 1 BIT_MASK 0x0008 /end CHARACTERISTIC
/begin CHARACTERISTIC mRISSRQ "Flag mRISSRQ" VALUE 0x00008A46 REC_UBYTE_C 0 COMP_0283 0 255 /end CHARACTERISTIC
/begin CHARACTERISTIC mfFINTCLi "0:0点校正全開側  1:0点校正全閉側" VALUE 0x00008A46 REC_UBYTE_C 0 COMP_0283 0 1 BIT_MASK 0x0080 /end CHARACTERISTIC
/begin CHARACTERISTIC mfFDRHYSi "0:回転方向駆動周期切り換え無  1:回転方向駆動周期切り換え有" VALUE 0x00008A46 REC_UBYTE_C 0 COMP_0283 0 1 BIT_MASK 0x0040 /end CHARACTERISTIC
/begin CHARACTERISTIC mfFDRPCHi "0:着座駆動周期切り換え無  1:着座駆動周期切り換え有" VALUE 0x00008A46 REC_UBYTE_C 0 COMP_0283 0 1 BIT_MASK 0x0020 /end CHARACTERISTIC
/begin CHARACTERISTIC mfFPTNTBLi "0:ﾓ-ﾀ励磁ﾊﾟﾀ-ﾝﾃ-ﾌﾞﾙNo.1選択  1:ﾓ-ﾀ励磁ﾊﾟﾀ-ﾝﾃ-ﾌﾞﾙNo.２選択" VALUE 0x00008A46 REC_UBYTE_C 0 COMP_0283 0 1 BIT_MASK 0x0008 /end CHARACTERISTIC
/begin CHARACTERISTIC mRSCSRQ "Flag mRSCSRQ" VALUE 0x00008A7C REC_UBYTE_C 0 COMP_0283 0 255 /end CHARACTERISTIC
/begin CHARACTERISTIC mfFINTCLs "0:0点校正全開側  1:0点校正全閉側" VALUE 0x00008A7C REC_UBYTE_C 0 COMP_0283 0 1 BIT_MASK 0x0080 /end CHARACTERISTIC
/begin CHARACTERISTIC mfFDRHYSs "0:回転方向駆動周期切り換え無  1:回転方向駆動周期切り換え有" VALUE 0x00008A7C REC_UBYTE_C 0 COMP_0283 0 1 BIT_MASK 0x0040 /end CHARACTERISTIC
/begin CHARACTERISTIC mfFDRPCHs "0:着座駆動周期切り換え無  1:着座駆動周期切り換え有" VALUE 0x00008A7C REC_UBYTE_C 0 COMP_0283 0 1 BIT_MASK 0x0020 /end CHARACTERISTIC
/begin CHARACTERISTIC mfFHLDTMs "0:目標一致時ﾎ-ﾙﾄﾞ時間無  1:目標一致時ﾎ-ﾙﾄﾞ時間有" VALUE 0x00008A7C REC_UBYTE_C 0 COMP_0283 0 1 BIT_MASK 0x0010 /end CHARACTERISTIC
/begin CHARACTERISTIC mfFPTNTBLs "0:ﾓ-ﾀ励磁ﾊﾟﾀ-ﾝﾃ-ﾌﾞﾙNo.1選択  1:ﾓ-ﾀ励磁ﾊﾟﾀ-ﾝﾃ-ﾌﾞﾙNo.２選択" VALUE 0x00008A7C REC_UBYTE_C 0 COMP_0283 0 1 BIT_MASK 0x0008 /end CHARACTERISTIC
/begin CHARACTERISTIC mRSCSRQL "Flag mRSCSRQL" VALUE 0x00008A7D REC_UBYTE_C 0 COMP_0283 0 255 /end CHARACTERISTIC
/begin CHARACTERISTIC mfFINTCLsL "0:0点校正全開側  1:0点校正全閉側" VALUE 0x00008A7D REC_UBYTE_C 0 COMP_0283 0 1 BIT_MASK 0x0080 /end CHARACTERISTIC
/begin CHARACTERISTIC mfFDRHYSsL "0:回転方向駆動周期切り換え無  1:回転方向駆動周期切り換え有" VALUE 0x00008A7D REC_UBYTE_C 0 COMP_0283 0 1 BIT_MASK 0x0040 /end CHARACTERISTIC
/begin CHARACTERISTIC mfFDRPCHsL "0:着座駆動周期切り換え無  1:着座駆動周期切り換え有" VALUE 0x00008A7D REC_UBYTE_C 0 COMP_0283 0 1 BIT_MASK 0x0020 /end CHARACTERISTIC
/begin CHARACTERISTIC mfFHLDTMsL "0:目標一致時ﾎ-ﾙﾄﾞ時間無  1:目標一致時ﾎ-ﾙﾄﾞ時間有" VALUE 0x00008A7D REC_UBYTE_C 0 COMP_0283 0 1 BIT_MASK 0x0010 /end CHARACTERISTIC
/begin CHARACTERISTIC mfFPTNTBLs_1 "0:ﾓ-ﾀ励磁ﾊﾟﾀ-ﾝﾃ-ﾌﾞﾙNo.1選択  1:ﾓ-ﾀ励磁ﾊﾟﾀ-ﾝﾃ-ﾌﾞﾙNo.２選択" VALUE 0x00008A7D REC_UBYTE_C 0 COMP_0283 0 1 BIT_MASK 0x0008 /end CHARACTERISTIC
/begin CHARACTERISTIC mS2K0DASH "Flag mS2K0DASH" VALUE 0x00008A8B REC_UBYTE_C 0 COMP_0283 0 255 /end CHARACTERISTIC
/begin CHARACTERISTIC mfGSENCAN "0:GｾﾝｻCANﾃﾞｰﾀﾓﾆﾀ対応  1:GｾﾝｻCANﾃﾞｰﾀﾓﾆﾀ非対応" VALUE 0x00008A8B REC_UBYTE_C 0 COMP_0283 0 1 BIT_MASK 0x0002 /end CHARACTERISTIC
/begin CHARACTERISTIC mSCRNC "Flag mSCRNC" VALUE 0x00008A93 REC_UBYTE_C 0 COMP_0283 0 255 /end CHARACTERISTIC
/begin CHARACTERISTIC mfTIKINJ "0:KINJ反映後ﾊﾟﾙｽでIT･ADVﾏｯﾌﾟ検索  1:KINJ反映前ﾊﾟﾙｽでIT･ADVﾏｯﾌﾟ検索" VALUE 0x00008A93 REC_UBYTE_C 0 COMP_0283 0 1 BIT_MASK 0x0080 /end CHARACTERISTIC
/begin CHARACTERISTIC mfFLNHYS "0:ﾌﾗｸﾞFMAPCH=0、>0で切換  1:ﾌﾗｸﾞFLEAN0=0、１で切換" VALUE 0x00008A93 REC_UBYTE_C 0 COMP_0283 0 1 BIT_MASK 0x0002 /end CHARACTERISTIC
/begin CHARACTERISTIC mfDMPTFC "0:TFBYA00使用  1:TFBYA00T使用" VALUE 0x00008A93 REC_UBYTE_C 0 COMP_0283 0 1 BIT_MASK 0x0001 /end CHARACTERISTIC
/begin CHARACTERISTIC mSOBDSW "Flag mSOBDSW" VALUE 0x00008AD2 REC_UBYTE_C 0 COMP_0283 0 255 /end CHARACTERISTIC
/begin CHARACTERISTIC mfEVPLNP "0:ﾘｰｸﾀﾞｳﾝ解除条件ﾗｲﾝ圧ｷｬﾝｾﾙ条件あ  1:ﾘｰｸﾀﾞｳﾝ解除条件ﾗｲﾝ圧ｷｬﾝｾﾙ条件な" VALUE 0x00008AD2 REC_UBYTE_C 0 COMP_0283 0 1 BIT_MASK 0x0080 /end CHARACTERISTIC
/begin CHARACTERISTIC mfFROSEL "0:燃料ｶｯﾄ条件有り  1:燃料ｶｯﾄ条件無し" VALUE 0x00008AD2 REC_UBYTE_C 0 COMP_0283 0 1 BIT_MASK 0x0040 /end CHARACTERISTIC
/begin CHARACTERISTIC mfAFSDIAG "0:燃料カット方式  1:ｱｸﾃｨﾌﾞ方式" VALUE 0x00008AD2 REC_UBYTE_C 0 COMP_0283 0 1 BIT_MASK 0x0020 /end CHARACTERISTIC
/begin CHARACTERISTIC mfMFSTSW "0:失火診断_診断許可STSW条件あり  1:失火診断_診断許可STSW条件なし" VALUE 0x00008AD2 REC_UBYTE_C 0 COMP_0283 0 1 BIT_MASK 0x0008 /end CHARACTERISTIC
/begin CHARACTERISTIC mfGSTM8 "0:GSTモード8に対応しない  1:GSTモード8に対応する" VALUE 0x00008AD2 REC_UBYTE_C 0 COMP_0283 0 1 BIT_MASK 0x0004 /end CHARACTERISTIC
/begin CHARACTERISTIC mfGSTM67 "0:GSTモード6、7に対応しない  1:GSTモード6、7に対応する" VALUE 0x00008AD2 REC_UBYTE_C 0 COMP_0283 0 1 BIT_MASK 0x0002 /end CHARACTERISTIC
/begin CHARACTERISTIC mfRATECLR "0:自己診断ｸﾘｱによるｶｳﾝﾀｸﾘｱ禁止  1:自己診断ｸﾘｱによるｶｳﾝﾀｸﾘｱ許可" VALUE 0x00008AD2 REC_UBYTE_C 0 COMP_0283 0 1 BIT_MASK 0x0001 /end CHARACTERISTIC
/begin CHARACTERISTIC mSOBSW2 "Flag mSOBSW2" VALUE 0x00008AD3 REC_UBYTE_C 0 COMP_0283 0 255 /end CHARACTERISTIC
/begin CHARACTERISTIC mfRO2OUS "0:RrO2/S応答時間診断ｽﾃｰｼﾞ1診断のみ  1:RrO2/S応答時間診断ｽﾃｰｼﾞ2診断実施" VALUE 0x00008AD3 REC_UBYTE_C 0 COMP_0283 0 1 BIT_MASK 0x0080 /end CHARACTERISTIC
/begin CHARACTERISTIC mfRO2IZS "0:RrO2/S異常電圧診断ｽﾃｰｼﾞ1診断のみ  1:RrO2/S異常電圧診断ｽﾃｰｼﾞ2診断実施" VALUE 0x00008AD3 REC_UBYTE_C 0 COMP_0283 0 1 BIT_MASK 0x0040 /end CHARACTERISTIC
/begin CHARACTERISTIC mfAFSMF "0:失火診断NG時学習しない  1:失火診断NG時学習する" VALUE 0x00008AD3 REC_UBYTE_C 0 COMP_0283 0 1 BIT_MASK 0x0020 /end CHARACTERISTIC
/begin CHARACTERISTIC mfHOSMF "0:失火診断NG時学習しない  1:失火診断NG時学習する" VALUE 0x00008AD3 REC_UBYTE_C 0 COMP_0283 0 1 BIT_MASK 0x0010 /end CHARACTERISTIC
/begin CHARACTERISTIC mfHOSKIN "0:HOSCMAX学習する  1:HOSCMAX学習しない" VALUE 0x00008AD3 REC_UBYTE_C 0 COMP_0283 0 1 BIT_MASK 0x0008 /end CHARACTERISTIC
/begin CHARACTERISTIC mfRO2OUST "0:3rdO2/S応答時間診断ステージ１診  1:ErdO2/S応答時間診断ステージ２診" VALUE 0x00008AD3 REC_UBYTE_C 0 COMP_0283 0 1 BIT_MASK 0x0004 /end CHARACTERISTIC
/begin CHARACTERISTIC mfRO2IZST "0:3rdO2/S異常電圧診断ステージ１診  1:ErdO2/S異常電圧診断ステージ２診" VALUE 0x00008AD3 REC_UBYTE_C 0 COMP_0283 0 1 BIT_MASK 0x0002 /end CHARACTERISTIC
/begin CHARACTERISTIC mfAFHZLR "0:A/FセンサL→R応答診断しない  1:A/FセンサL→R応答診断する" VALUE 0x00008AD3 REC_UBYTE_C 0 COMP_0283 0 1 BIT_MASK 0x0001 /end CHARACTERISTIC
/begin CHARACTERISTIC mSPDSW "Flag mSPDSW" VALUE 0x00008ADC REC_UBYTE_C 0 COMP_0283 0 255 /end CHARACTERISTIC
/begin CHARACTERISTIC mfJKRTTMOV "0:ﾘﾀｰﾄﾞﾀｲﾑｵｰﾊﾞ時SRC禁止無し  1:ﾘﾀｰﾄﾞﾀｲﾑｵｰﾊﾞ時SRC禁止有り" VALUE 0x00008ADC REC_UBYTE_C 0 COMP_0283 0 1 BIT_MASK 0x0080 /end CHARACTERISTIC
/begin CHARACTERISTIC mfJKTQTMOV "0:ﾄﾙｸｱｯﾌﾟﾀｲﾑｵｰﾊﾞ時SRC禁止無し  1:ﾄﾙｸｱｯﾌﾟﾀｲﾑｵｰﾊﾞ時SRC禁止有り" VALUE 0x00008ADC REC_UBYTE_C 0 COMP_0283 0 1 BIT_MASK 0x0040 /end CHARACTERISTIC
/begin CHARACTERISTIC mfCCSRCINH "0:ASCD作動時SRC作動許可  1:ASCD作動時SRC作動禁止" VALUE 0x00008ADC REC_UBYTE_C 0 COMP_0283 0 1 BIT_MASK 0x0020 /end CHARACTERISTIC
/begin CHARACTERISTIC mfSPDLMTON "0:それ以外  1:SRC作動中ﾄﾙｸﾘﾐｯﾄ対応車種" VALUE 0x00008ADC REC_UBYTE_C 0 COMP_0283 0 1 BIT_MASK 0x0001 /end CHARACTERISTIC
/begin CHARACTERISTIC mSpecADV "Flag mSpecADV" VALUE 0x00008B14 REC_UBYTE_C 0 COMP_0283 0 255 /end CHARACTERISTIC
/begin CHARACTERISTIC mfFKNK "0:ノック制御なし  1:ノック制御あり" VALUE 0x00008B14 REC_UBYTE_C 0 COMP_0283 0 1 BIT_MASK 0x0080 /end CHARACTERISTIC
/begin CHARACTERISTIC mfFREGDT "0:制御禁止しない  1:制御禁止する" VALUE 0x00008B14 REC_UBYTE_C 0 COMP_0283 0 1 BIT_MASK 0x0040 /end CHARACTERISTIC
/begin CHARACTERISTIC mfADVKNK "0:ｱﾄﾞﾊﾞﾝｽﾄﾞﾉｯｸ制御なし  1:ｱﾄﾞﾊﾞﾝｽﾄﾞﾉｯｸ制御あり" VALUE 0x00008B14 REC_UBYTE_C 0 COMP_0283 0 1 BIT_MASK 0x0020 /end CHARACTERISTIC
/begin CHARACTERISTIC mfNCIMBT "0:燃焼予測型点火時期制御なし  1:燃焼予測型点火時期制御あり" VALUE 0x00008B14 REC_UBYTE_C 0 COMP_0283 0 1 BIT_MASK 0x0010 /end CHARACTERISTIC
/begin CHARACTERISTIC mfKNKTYP2 "0:ｼﾝｸﾞﾙﾉｯｸｾﾝｻ(2段ｹﾞｲﾝ)  1:ﾂｲﾝﾉｯｸｾﾝｻ(2段ｹﾞｲﾝ)" VALUE 0x00008B14 REC_UBYTE_C 0 COMP_0283 0 1 BIT_MASK 0x0008 /end CHARACTERISTIC
/begin CHARACTERISTIC mfADVFB "0:N-Dｾﾚｸﾄ時ﾘﾀｰﾄﾞ制限なし  1:N-Dｾﾚｸﾄ時ﾘﾀｰﾄﾞ制限あり" VALUE 0x00008B14 REC_UBYTE_C 0 COMP_0283 0 1 BIT_MASK 0x0004 /end CHARACTERISTIC
/begin CHARACTERISTIC mfFFULTRM "0:ﾌﾙ増量時ﾄﾘﾐﾝｸﾞﾏｯﾌﾟ補正しない  1:ﾌﾙ増量時ﾄﾘﾐﾝｸﾞﾏｯﾌﾟ補正する" VALUE 0x00008B14 REC_UBYTE_C 0 COMP_0283 0 1 BIT_MASK 0x0002 /end CHARACTERISTIC
/begin CHARACTERISTIC mfFAVCLR "0:TRADVｸﾘｱしない  1:TRADVｸﾘｱする" VALUE 0x00008B14 REC_UBYTE_C 0 COMP_0283 0 1 BIT_MASK 0x0001 /end CHARACTERISTIC
/begin CHARACTERISTIC mSpecADV2 "Flag mSpecADV2" VALUE 0x00008B15 REC_UBYTE_C 0 COMP_0283 0 255 /end CHARACTERISTIC
/begin CHARACTERISTIC mfKNKIN "0:S/L切替え時ノック判定あり  1:S/L切替え時ノック判定しない" VALUE 0x00008B15 REC_UBYTE_C 0 COMP_0283 0 1 BIT_MASK 0x0080 /end CHARACTERISTIC
/begin CHARACTERISTIC mfTRMMAPS "0:MBTTRM多面化無し  1:MBTTRM多面化有り" VALUE 0x00008B15 REC_UBYTE_C 0 COMP_0283 0 1 BIT_MASK 0x0008 /end CHARACTERISTIC
/begin CHARACTERISTIC mfIADVLIM "0:アイドルADVリミッタ無し(Without_  1:アイドルADVリミッタ有り(With_Idl" VALUE 0x00008B15 REC_UBYTE_C 0 COMP_0283 0 1 BIT_MASK 0x0004 /end CHARACTERISTIC
/begin CHARACTERISTIC mfADFCADV "0:アイドルADVリミッタFCADV反映無し  1:アイドルADVリミッタFCADV反映あり" VALUE 0x00008B15 REC_UBYTE_C 0 COMP_0283 0 1 BIT_MASK 0x0002 /end CHARACTERISTIC
/begin CHARACTERISTIC mSpecADV3 "Flag mSpecADV3" VALUE 0x00008B16 REC_UBYTE_C 0 COMP_0283 0 255 /end CHARACTERISTIC
/begin CHARACTERISTIC mfKNKLRN "0:Advanced_Knock_Control_Phase2_使  1:Advanced_Knock_Control_Phase3_使" VALUE 0x00008B16 REC_UBYTE_C 0 COMP_0283 0 1 BIT_MASK 0x0001 /end CHARACTERISTIC
/begin CHARACTERISTIC mSpecALLC "Flag mSpecALLC" VALUE 0x00008B17 REC_UBYTE_C 0 COMP_0283 0 255 /end CHARACTERISTIC
/begin CHARACTERISTIC mfHRFLEV "0:低抵抗燃料ﾚﾍﾞﾙｹﾞｰｼﾞ(硫化対策前:  1:高秩ER燃料ﾚﾍﾞﾙｹﾞｰｼﾞ(硫化対策後:" VALUE 0x00008B17 REC_UBYTE_C 0 COMP_0283 0 1 BIT_MASK 0x0010 /end CHARACTERISTIC
/begin CHARACTERISTIC mfFMFLPF "0:通常（LPF使用）  1:LPF未使用" VALUE 0x00008B17 REC_UBYTE_C 0 COMP_0283 0 1 BIT_MASK 0x0008 /end CHARACTERISTIC
/begin CHARACTERISTIC mfFMFBRF1 "0:通常（0.5次BRF使用）  1:BRF未使用" VALUE 0x00008B17 REC_UBYTE_C 0 COMP_0283 0 1 BIT_MASK 0x0004 /end CHARACTERISTIC
/begin CHARACTERISTIC mfFSINFAIL "0:禁止  1:許可" VALUE 0x00008B17 REC_UBYTE_C 0 COMP_0283 0 1 BIT_MASK 0x0002 /end CHARACTERISTIC
/begin CHARACTERISTIC mfFSTRFAIL "0:禁止  1:許可" VALUE 0x00008B17 REC_UBYTE_C 0 COMP_0283 0 1 BIT_MASK 0x0001 /end CHARACTERISTIC
/begin CHARACTERISTIC mSpecDIRCT "Flag mSpecDIRCT" VALUE 0x00008B18 REC_UBYTE_C 0 COMP_0283 0 255 /end CHARACTERISTIC
/begin CHARACTERISTIC mfATMT "0:ATまたはCVT  1:MT" VALUE 0x00008B18 REC_UBYTE_C 0 COMP_0283 0 1 BIT_MASK 0x0080 /end CHARACTERISTIC
/begin CHARACTERISTIC mfUJH "0:拡張無しﾊｰﾄﾞ  1:拡張有りﾊｰﾄﾞ" VALUE 0x00008B18 REC_UBYTE_C 0 COMP_0283 0 1 BIT_MASK 0x0040 /end CHARACTERISTIC
/begin CHARACTERISTIC mfLKUP "0:DT5出力  1:ﾛｯｸｱｯﾌﾟ" VALUE 0x00008B18 REC_UBYTE_C 0 COMP_0283 0 1 BIT_MASK 0x0020 /end CHARACTERISTIC
/begin CHARACTERISTIC mfFATTRQ "0:ﾄﾙｸ通信型AT以外  1:ﾄﾙｸ通信型AT" VALUE 0x00008B18 REC_UBYTE_C 0 COMP_0283 0 1 BIT_MASK 0x0010 /end CHARACTERISTIC
/begin CHARACTERISTIC mfATTNS "0:ATﾀｰﾋﾞﾝｾﾝｻ無し  1:ATﾀｰﾋﾞﾝｾﾝｻ有り" VALUE 0x00008B18 REC_UBYTE_C 0 COMP_0283 0 1 BIT_MASK 0x0008 /end CHARACTERISTIC
/begin CHARACTERISTIC mfRATIOFB "0:ﾚｼｵF/B制御無し(mfFATTRQ=0の時)  1:ﾚｼｵF/B制御有り" VALUE 0x00008B18 REC_UBYTE_C 0 COMP_0283 0 1 BIT_MASK 0x0004 /end CHARACTERISTIC
/begin CHARACTERISTIC mfREGHOS "0:TENGレギュラー補正無し  1:TENGレギュラー補正有り" VALUE 0x00008B18 REC_UBYTE_C 0 COMP_0283 0 1 BIT_MASK 0x0002 /end CHARACTERISTIC
/begin CHARACTERISTIC mfCOADJ "0:CONSULT通信によるCO調整制御無し  1:CONSULT通信によるCO調整制御有り" VALUE 0x00008B18 REC_UBYTE_C 0 COMP_0283 0 1 BIT_MASK 0x0001 /end CHARACTERISTIC
/begin CHARACTERISTIC mSpecEGI "Flag mSpecEGI" VALUE 0x00008B19 REC_UBYTE_C 0 COMP_0283 0 255 /end CHARACTERISTIC
/begin CHARACTERISTIC mfFBSCLR "0:電源ON時ﾍﾞｰｽ学習ｸﾘｱなし  1:電源ON時ﾍﾞｰｽ学習ｸﾘｱあり" VALUE 0x00008B19 REC_UBYTE_C 0 COMP_0283 0 1 BIT_MASK 0x0080 /end CHARACTERISTIC
/begin CHARACTERISTIC mfFSCLR "0:電源ON時学習ﾏｯﾌﾟｸﾘｱなし  1:電源ON時学習ﾏｯﾌﾟｸﾘｱあり" VALUE 0x00008B19 REC_UBYTE_C 0 COMP_0283 0 1 BIT_MASK 0x0040 /end CHARACTERISTIC
/begin CHARACTERISTIC mfFTSCLR "0:電源ON時TS対応学習ｸﾘｱなし  1:電源ON時TS対応学習ｸﾘｱあり" VALUE 0x00008B19 REC_UBYTE_C 0 COMP_0283 0 1 BIT_MASK 0x0020 /end CHARACTERISTIC
/begin CHARACTERISTIC mfFSHLRSP "0:切換時脱離要求しない  1:切換時脱離要求する" VALUE 0x00008B19 REC_UBYTE_C 0 COMP_0283 0 1 BIT_MASK 0x0010 /end CHARACTERISTIC
/begin CHARACTERISTIC mfLTEGRCT "0:EGRｶｯﾄしない  1:EGRｶｯﾄする" VALUE 0x00008B19 REC_UBYTE_C 0 COMP_0283 0 1 BIT_MASK 0x0008 /end CHARACTERISTIC
/begin CHARACTERISTIC mfISCKH "0:KATHOS付加する  1:KATHOS付加しない" VALUE 0x00008B19 REC_UBYTE_C 0 COMP_0283 0 1 BIT_MASK 0x0004 /end CHARACTERISTIC
/begin CHARACTERISTIC mfFREBEN "0:ﾍﾞｰｽ再学習なし  1:ﾍﾞｰｽ再学習あり" VALUE 0x00008B19 REC_UBYTE_C 0 COMP_0283 0 1 BIT_MASK 0x0002 /end CHARACTERISTIC
/begin CHARACTERISTIC mfFKPART "0:分割無し  1:分割有り" VALUE 0x00008B19 REC_UBYTE_C 0 COMP_0283 0 1 BIT_MASK 0x0001 /end CHARACTERISTIC
/begin CHARACTERISTIC mSpecOTHER "Flag mSpecOTHER" VALUE 0x00008B1A REC_UBYTE_C 0 COMP_0283 0 255 /end CHARACTERISTIC
/begin CHARACTERISTIC mfFALRN "0:無し  1:有り" VALUE 0x00008B1A REC_UBYTE_C 0 COMP_0283 0 1 BIT_MASK 0x0080 /end CHARACTERISTIC
/begin CHARACTERISTIC mfFQINT "0:#FQLRN=0  1:#FQLRN=1" VALUE 0x00008B1A REC_UBYTE_C 0 COMP_0283 0 1 BIT_MASK 0x0040 /end CHARACTERISTIC
/begin CHARACTERISTIC mfFCLPON "0:条件無し  1:条件有り" VALUE 0x00008B1A REC_UBYTE_C 0 COMP_0283 0 1 BIT_MASK 0x0020 /end CHARACTERISTIC
/begin CHARACTERISTIC mfFIDLP "0:制御無し  1:制御有り" VALUE 0x00008B1A REC_UBYTE_C 0 COMP_0283 0 1 BIT_MASK 0x0010 /end CHARACTERISTIC
/begin CHARACTERISTIC mfFPGCUT "0:禁止  1:許可" VALUE 0x00008B1A REC_UBYTE_C 0 COMP_0283 0 1 BIT_MASK 0x0008 /end CHARACTERISTIC
/begin CHARACTERISTIC mfISCSF "0:旧制御  1:気筒別制御禁止" VALUE 0x00008B1A REC_UBYTE_C 0 COMP_0283 0 1 BIT_MASK 0x0004 /end CHARACTERISTIC
/begin CHARACTERISTIC mfO2SENSOR "0:ｼﾝｸﾞﾙO2ｾﾝｻ  1:ﾂｲﾝO2ｾﾝｻ" VALUE 0x00008B1A REC_UBYTE_C 0 COMP_0283 0 1 BIT_MASK 0x0002 /end CHARACTERISTIC
/begin CHARACTERISTIC mfTWO "0:水温ｾﾝｻﾃﾞｰﾀ送信制御未対応  1:水温ｾﾝｻﾃﾞｰﾀ送信制御対応" VALUE 0x00008B1A REC_UBYTE_C 0 COMP_0283 0 1 BIT_MASK 0x0001 /end CHARACTERISTIC
/begin CHARACTERISTIC mSpecVARI "Flag mSpecVARI" VALUE 0x00008B1B REC_UBYTE_C 0 COMP_0283 0 255 /end CHARACTERISTIC
/begin CHARACTERISTIC mfVADV "0:点火ﾊﾞﾘｱﾌﾞﾙ制御有り  1:点火ﾊﾞﾘｱﾌﾞﾙ制御無し" VALUE 0x00008B1B REC_UBYTE_C 0 COMP_0283 0 1 BIT_MASK 0x0080 /end CHARACTERISTIC
/begin CHARACTERISTIC mfVKNK "0:気筒別点火ﾊﾞﾘｱﾌﾞﾙ制御有り  1:気筒別点火ﾊﾞﾘｱﾌﾞﾙ制御無し" VALUE 0x00008B1B REC_UBYTE_C 0 COMP_0283 0 1 BIT_MASK 0x0040 /end CHARACTERISTIC
/begin CHARACTERISTIC mfFVKTRM "0:KTRMﾊﾞﾘｱﾌﾞﾙ制御有り  1:KTRMﾊﾞﾘｱﾌﾞﾙ制御なし" VALUE 0x00008B1B REC_UBYTE_C 0 COMP_0283 0 1 BIT_MASK 0x0020 /end CHARACTERISTIC
/begin CHARACTERISTIC mfVEGR "0:EGRQ通常演算  1:EGRQﾊﾞﾘｱﾌﾞﾙ演算" VALUE 0x00008B1B REC_UBYTE_C 0 COMP_0283 0 1 BIT_MASK 0x0010 /end CHARACTERISTIC
/begin CHARACTERISTIC mfVPFUEL "0:PFDUTY通常演算  1:PFDUTYﾊﾞﾘｱﾌﾞﾙ演算" VALUE 0x00008B1B REC_UBYTE_C 0 COMP_0283 0 1 BIT_MASK 0x0008 /end CHARACTERISTIC
/begin CHARACTERISTIC mfVSCV "0:SCVSTPD通常演算  1:SCVSTPDﾊﾞﾘｱﾌﾞﾙ演算" VALUE 0x00008B1B REC_UBYTE_C 0 COMP_0283 0 1 BIT_MASK 0x0004 /end CHARACTERISTIC
/begin CHARACTERISTIC mfVVTC "0:VTCTRG通常演算  1:VTCTRGﾊﾞﾘｱﾌﾞﾙ演算" VALUE 0x00008B1B REC_UBYTE_C 0 COMP_0283 0 1 BIT_MASK 0x0002 /end CHARACTERISTIC
/begin CHARACTERISTIC mfANADEG "0:ｱﾅﾛｸﾞﾊﾞﾘｱﾌﾞﾙ制御選択  1:ﾃﾞｼﾞﾀﾙﾊﾞﾘｱﾌﾞﾙ制御選択" VALUE 0x00008B1B REC_UBYTE_C 0 COMP_0283 0 1 BIT_MASK 0x0001 /end CHARACTERISTIC
/begin CHARACTERISTIC mSWAJ "Flag mSWAJ" VALUE 0x00008AFB REC_UBYTE_C 0 COMP_0283 0 255 /end CHARACTERISTIC
/begin CHARACTERISTIC mfAJNXGPSL "0:CURGP選択  1:NEXTGP選択" VALUE 0x00008AFB REC_UBYTE_C 0 COMP_0283 0 1 BIT_MASK 0x0010 /end CHARACTERISTIC
/begin CHARACTERISTIC mfAJOWCTSW "0:OWCｼｮｯｸ対策制御OFF  1:OWCｼｮｯｸ対策制御ON" VALUE 0x00008AFB REC_UBYTE_C 0 COMP_0283 0 1 BIT_MASK 0x0008 /end CHARACTERISTIC
/begin CHARACTERISTIC mfAJCLUTSW "0:ﾘﾐｯﾄ初期ﾄﾙｸ保持作動OFF  1:ﾘﾐｯﾄ初期ﾄﾙｸ保持作動ON" VALUE 0x00008AFB REC_UBYTE_C 0 COMP_0283 0 1 BIT_MASK 0x0004 /end CHARACTERISTIC
/begin CHARACTERISTIC mfAJRMPSW "0:ｱﾝﾁｼﾞｬｰｸ_ﾗﾝﾌﾟ制御OFF  1:ｱﾝﾁｼﾞｬｰｸ_ﾗﾝﾌﾟ制御ON" VALUE 0x00008AFB REC_UBYTE_C 0 COMP_0283 0 1 BIT_MASK 0x0002 /end CHARACTERISTIC
/begin CHARACTERISTIC mfAJCTRLON "0:ｱﾝﾁｼﾞｬｰｸ制御OFF  1:ｱﾝﾁｼﾞｬｰｸ制御ON" VALUE 0x00008AFB REC_UBYTE_C 0 COMP_0283 0 1 BIT_MASK 0x0001 /end CHARACTERISTIC
/begin CHARACTERISTIC mSWASCD "Flag mSWASCD" VALUE 0x00008AFC REC_UBYTE_C 0 COMP_0283 0 255 /end CHARACTERISTIC
/begin CHARACTERISTIC mfFLGNICCS "0:NICCS対応制御OFF  1:NICCS対応制御ON" VALUE 0x00008AFC REC_UBYTE_C 0 COMP_0283 0 1 BIT_MASK 0x0080 /end CHARACTERISTIC
/begin CHARACTERISTIC mfCOASTINI "0:ｺｰｽﾄ終了時ｻｰﾎﾞ初期化無し  1:ｺｰｽﾄ終了時ｻｰﾎﾞ初期化有り" VALUE 0x00008AFC REC_UBYTE_C 0 COMP_0283 0 1 BIT_MASK 0x0040 /end CHARACTERISTIC
/begin CHARACTERISTIC mfFLGBCACC "0:ACCﾌﾞﾚｰｷ制御対応無し  1:ACCﾌﾞﾚｰｷ制御対応有り" VALUE 0x00008AFC REC_UBYTE_C 0 COMP_0283 0 1 BIT_MASK 0x0020 /end CHARACTERISTIC
/begin CHARACTERISTIC mfACCPUB "0:ACCｱｸﾃｨﾌﾞﾌﾞｰｽﾀｰ仕様  1:ACCﾎﾟﾝﾌﾟｱｯﾌﾟﾌﾞﾚｰｷ仕様" VALUE 0x00008AFC REC_UBYTE_C 0 COMP_0283 0 1 BIT_MASK 0x0010 /end CHARACTERISTIC
/begin CHARACTERISTIC mfMFTYPESW "0:通常ﾀｲﾌﾟASCDSW(独立SW)  1:MFﾀｲﾌﾟASCDSW(ｼｰｿｰSW)" VALUE 0x00008AFC REC_UBYTE_C 0 COMP_0283 0 1 BIT_MASK 0x0008 /end CHARACTERISTIC
/begin CHARACTERISTIC mfFLGINCH "0:ｲﾝﾁﾝｸﾞ対応制御OFF  1:ｲﾝﾁﾝｸﾞ対応制御ON" VALUE 0x00008AFC REC_UBYTE_C 0 COMP_0283 0 1 BIT_MASK 0x0004 /end CHARACTERISTIC
/begin CHARACTERISTIC mfFLGACC "0:ACC対応制御OFF  1:ACC対応制御ON" VALUE 0x00008AFC REC_UBYTE_C 0 COMP_0283 0 1 BIT_MASK 0x0002 /end CHARACTERISTIC
/begin CHARACTERISTIC mfFASCD "0:非実行  1:実行" VALUE 0x00008AFC REC_UBYTE_C 0 COMP_0283 0 1 BIT_MASK 0x0001 /end CHARACTERISTIC
/begin CHARACTERISTIC mSWASCD2 "Flag mSWASCD2" VALUE 0x00008AFD REC_UBYTE_C 0 COMP_0283 0 255 /end CHARACTERISTIC
/begin CHARACTERISTIC mfCRUONAGB "0:CRUISE2通常送信  1:CRUISE2一時加速中非送信" VALUE 0x00008AFD REC_UBYTE_C 0 COMP_0283 0 1 BIT_MASK 0x0080 /end CHARACTERISTIC
/begin CHARACTERISTIC mfPTDASCD "0:ASCD時駆動力演算なし  1:ASCD時駆動力演算あり" VALUE 0x00008AFD REC_UBYTE_C 0 COMP_0283 0 1 BIT_MASK 0x0040 /end CHARACTERISTIC
/begin CHARACTERISTIC mfSWDECSS "0:ｺｰｽﾄ時車速ｻｰﾎﾞ制御使用  1:ｺｰｽﾄ時車速ｻｰﾎ停止" VALUE 0x00008AFD REC_UBYTE_C 0 COMP_0283 0 1 BIT_MASK 0x0020 /end CHARACTERISTIC
/begin CHARACTERISTIC mfMMODECAN "0:MMODEでASCD解除なし  1:MMODEでASCD解除あり" VALUE 0x00008AFD REC_UBYTE_C 0 COMP_0283 0 1 BIT_MASK 0x0010 /end CHARACTERISTIC
/begin CHARACTERISTIC mfDSFTNEGP "0:ﾀﾞｳﾝｼﾌﾄ時CURGPを使用  1:ﾀﾞｳﾝｼﾌﾄ時NEXTGPを使用" VALUE 0x00008AFD REC_UBYTE_C 0 COMP_0283 0 1 BIT_MASK 0x0008 /end CHARACTERISTIC
/begin CHARACTERISTIC mfACCENINI "0:ｱｸｾﾗﾚｰﾄ終了時位相補償器ｸﾘｱなし  1:ｱｸｾﾗﾚｰﾄ終了時位相補償器ｸﾘｱ有" VALUE 0x00008AFD REC_UBYTE_C 0 COMP_0283 0 1 BIT_MASK 0x0004 /end CHARACTERISTIC
/begin CHARACTERISTIC mfACCADCLR "0:ｱｸｾﾗﾚｰﾄ終了時加算ｸﾘｱなし  1:ｱｸｾﾗﾚｰﾄ終了時加算ｸﾘｱあり" VALUE 0x00008AFD REC_UBYTE_C 0 COMP_0283 0 1 BIT_MASK 0x0002 /end CHARACTERISTIC
/begin CHARACTERISTIC mfACCODOFF "0:ｱｸｾﾗﾚｰﾄ時ODｵﾌ固定なし  1:ｱｸｾﾗﾚｰﾄ時ODｵﾌ固定あり" VALUE 0x00008AFD REC_UBYTE_C 0 COMP_0283 0 1 BIT_MASK 0x0001 /end CHARACTERISTIC
/begin CHARACTERISTIC mSWASCD3 "Flag mSWASCD3" VALUE 0x00008AFE REC_UBYTE_C 0 COMP_0283 0 255 /end CHARACTERISTIC
/begin CHARACTERISTIC mfDISPMRKT "0:単位切換えMARKET情報不使用  1:単位切換えMARKET情報使用" VALUE 0x00008AFE REC_UBYTE_C 0 COMP_0283 0 1 BIT_MASK 0x0008 /end CHARACTERISTIC
/begin CHARACTERISTIC mfDISPKMH "0:METER表示用車速km/h／MPH切換え  1:METER表示用車速km/h固定" VALUE 0x00008AFE REC_UBYTE_C 0 COMP_0283 0 1 BIT_MASK 0x0004 /end CHARACTERISTIC
/begin CHARACTERISTIC mfVSPDISP "0:従来車輪速(DSP)入力  1:METER表示用車速入力" VALUE 0x00008AFE REC_UBYTE_C 0 COMP_0283 0 1 BIT_MASK 0x0002 /end CHARACTERISTIC
/begin CHARACTERISTIC mfCLINPTYP "0:ASCDクラッチペダルSW単独入力無し  1:ASCDクラッチペダルSW単独入力有り" VALUE 0x00008AFE REC_UBYTE_C 0 COMP_0283 0 1 BIT_MASK 0x0001 /end CHARACTERISTIC
/begin CHARACTERISTIC mSWDOS "Flag mSWDOS" VALUE 0x00008AFF REC_UBYTE_C 0 COMP_0283 0 255 /end CHARACTERISTIC
/begin CHARACTERISTIC mfSDFED "0:全域DOS制御を行う  1:FED向け領域限定DOS制御を行う" VALUE 0x00008AFF REC_UBYTE_C 0 COMP_0283 0 1 BIT_MASK 0x0010 /end CHARACTERISTIC
/begin CHARACTERISTIC mfFDOSL "0:DOS学習無し  1:DOS学習有り" VALUE 0x00008AFF REC_UBYTE_C 0 COMP_0283 0 1 BIT_MASK 0x0008 /end CHARACTERISTIC
/begin CHARACTERISTIC mfF2IN1 "0:O2/Sｼｽﾃﾑが1in1または2in2  1:O2/Sｼｽﾃﾑが2in1" VALUE 0x00008AFF REC_UBYTE_C 0 COMP_0283 0 1 BIT_MASK 0x0004 /end CHARACTERISTIC
/begin CHARACTERISTIC mfFDOSGO "0:DOS制御無し  1:DOS制御有り" VALUE 0x00008AFF REC_UBYTE_C 0 COMP_0283 0 1 BIT_MASK 0x0001 /end CHARACTERISTIC
/begin CHARACTERISTIC mSWDSA "Flag mSWDSA" VALUE 0x00008B00 REC_UBYTE_C 0 COMP_0283 0 255 /end CHARACTERISTIC
/begin CHARACTERISTIC mfDSASW "0:D.S.A.無し  1:D.S.A.有り" VALUE 0x00008B00 REC_UBYTE_C 0 COMP_0283 0 1 BIT_MASK 0x0020 /end CHARACTERISTIC
/begin CHARACTERISTIC mfSWAPOFAC "0:APOFSRファクター無し  1:APOFSRファクター有り" VALUE 0x00008B00 REC_UBYTE_C 0 COMP_0283 0 1 BIT_MASK 0x0010 /end CHARACTERISTIC
/begin CHARACTERISTIC mSWDX "Flag mSWDX" VALUE 0x00008B01 REC_UBYTE_C 0 COMP_0283 0 255 /end CHARACTERISTIC
/begin CHARACTERISTIC mfDX "0:副変速機無しCVT（通常のCVT）  1:副変速機有りCVT" VALUE 0x00008B01 REC_UBYTE_C 0 COMP_0283 0 1 BIT_MASK 0x0001 /end CHARACTERISTIC
/begin CHARACTERISTIC mSWETD "Flag mSWETD" VALUE 0x00008B02 REC_UBYTE_C 0 COMP_0283 0 255 /end CHARACTERISTIC
/begin CHARACTERISTIC mfFSEISOR "0:減速成層-成層燃焼ﾘｶﾊﾞｰしない  1:減速成層-成層燃焼ﾘｶﾊﾞｰする" VALUE 0x00008B02 REC_UBYTE_C 0 COMP_0283 0 1 BIT_MASK 0x0080 /end CHARACTERISTIC
/begin CHARACTERISTIC mfFIDLHS "0:右記以外  1:成層ﾏｯﾌﾟ選択" VALUE 0x00008B02 REC_UBYTE_C 0 COMP_0283 0 1 BIT_MASK 0x0040 /end CHARACTERISTIC
/begin CHARACTERISTIC mfFDIDHS "0:ｱｲﾄﾞﾙ成層不許可  1:ｱｲﾄﾞﾙ成層許可" VALUE 0x00008B02 REC_UBYTE_C 0 COMP_0283 0 1 BIT_MASK 0x0020 /end CHARACTERISTIC
/begin CHARACTERISTIC mfFPSSPH "0:右記以外  1:ｱｲﾄﾞﾙﾊﾟﾜｽﾃON時成層禁止" VALUE 0x00008B02 REC_UBYTE_C 0 COMP_0283 0 1 BIT_MASK 0x0010 /end CHARACTERISTIC
/begin CHARACTERISTIC mfFBCFBYA "0:当量比補正なし  1:当量比補正あり" VALUE 0x00008B02 REC_UBYTE_C 0 COMP_0283 0 1 BIT_MASK 0x0008 /end CHARACTERISTIC
/begin CHARACTERISTIC mfFTWSEL "0:始動時水温使用  1:A/C用外気温SW入力使用" VALUE 0x00008B02 REC_UBYTE_C 0 COMP_0283 0 1 BIT_MASK 0x0004 /end CHARACTERISTIC
/begin CHARACTERISTIC mfFETC "0:ETC制御無し  1:ETC制御有り" VALUE 0x00008B02 REC_UBYTE_C 0 COMP_0283 0 1 BIT_MASK 0x0002 /end CHARACTERISTIC
/begin CHARACTERISTIC mfFETDEN "0:ETD制御無し  1:ETD制御有り" VALUE 0x00008B02 REC_UBYTE_C 0 COMP_0283 0 1 BIT_MASK 0x0001 /end CHARACTERISTIC
/begin CHARACTERISTIC mSWETD_S "Flag mSWETD_S" VALUE 0x000157D9 REC_UBYTE_C 0 COMP_0283 0 255 /end CHARACTERISTIC
/begin CHARACTERISTIC mfFETDEN_S "0:ETD制御なし  1:ETD制御あり" VALUE 0x000157D9 REC_UBYTE_C 0 COMP_0283 0 1 BIT_MASK 0x0001 /end CHARACTERISTIC
/begin CHARACTERISTIC mSWETD2 "Flag mSWETD2" VALUE 0x00008B03 REC_UBYTE_C 0 COMP_0283 0 255 /end CHARACTERISTIC
/begin CHARACTERISTIC mfFITAFSV "0:燃焼効率補正率動作点補正しない  1:燃焼効率補正率動作点補正する" VALUE 0x00008B03 REC_UBYTE_C 0 COMP_0283 0 1 BIT_MASK 0x0080 /end CHARACTERISTIC
/begin CHARACTERISTIC mfVFLD4 "0:ISCｸﾛｰｽﾞ時FLOAD4_通常制御  1:ISCｸﾛｰｽﾞ時FLOAD4_ﾊﾞﾘｱﾌﾞﾙ制御" VALUE 0x00008B03 REC_UBYTE_C 0 COMP_0283 0 1 BIT_MASK 0x0040 /end CHARACTERISTIC
/begin CHARACTERISTIC mfFBRTIOS "0:判定ｽﾗｲｽﾚﾍﾞﾙ1回読み  1:判定ｽﾗｲｽﾚﾍﾞﾙ2回読み" VALUE 0x00008B03 REC_UBYTE_C 0 COMP_0283 0 1 BIT_MASK 0x0020 /end CHARACTERISTIC
/begin CHARACTERISTIC mfFGOVL "0:GOVノーマル要求  1:GOVバリアブル要求" VALUE 0x00008B03 REC_UBYTE_C 0 COMP_0283 0 1 BIT_MASK 0x0010 /end CHARACTERISTIC
/begin CHARACTERISTIC mfFHTFMN "0:当量比とばし量ノーマル要求  1:当量比とばし量バリアブル要求" VALUE 0x00008B03 REC_UBYTE_C 0 COMP_0283 0 1 BIT_MASK 0x0008 /end CHARACTERISTIC
/begin CHARACTERISTIC mfFCUTCH "0:F/CUT中切換を禁止しない  1:F/CUT中切換を禁止する" VALUE 0x00008B03 REC_UBYTE_C 0 COMP_0283 0 1 BIT_MASK 0x0004 /end CHARACTERISTIC
/begin CHARACTERISTIC mfFLD4DCH "0:吸気系応答時定数参照ﾏｯﾌﾟ選択  1:ISC_OPEN/CLOSED時定数参照ﾏｯﾌﾟ選" VALUE 0x00008B03 REC_UBYTE_C 0 COMP_0283 0 1 BIT_MASK 0x0002 /end CHARACTERISTIC
/begin CHARACTERISTIC mfFSHSKP "0:緊急成層不許可時運転領域移行ﾌﾗｸﾞ  1:成層不許可時運転領域移行ﾌﾗｸﾞON" VALUE 0x00008B03 REC_UBYTE_C 0 COMP_0283 0 1 BIT_MASK 0x0001 /end CHARACTERISTIC
/begin CHARACTERISTIC mSWETD3 "Flag mSWETD3" VALUE 0x00008B04 REC_UBYTE_C 0 COMP_0283 0 255 /end CHARACTERISTIC
/begin CHARACTERISTIC mfFTVFQSNG "0:許可  1:禁止" VALUE 0x00008B04 REC_UBYTE_C 0 COMP_0283 0 1 BIT_MASK 0x0080 /end CHARACTERISTIC
/begin CHARACTERISTIC mfQH0ETD "0:従来SOFIS仕様  1:ETD空気量学習で演算するQH0基本値" VALUE 0x00008B04 REC_UBYTE_C 0 COMP_0283 0 1 BIT_MASK 0x0040 /end CHARACTERISTIC
/begin CHARACTERISTIC mfFTTCPB "0:ISC分のTTCを大気圧/吸気温補正し  1:ESC分のTTCを大気圧/吸気温補正す" VALUE 0x00008B04 REC_UBYTE_C 0 COMP_0283 0 1 BIT_MASK 0x0020 /end CHARACTERISTIC
/begin CHARACTERISTIC mfFALLPART "0:一部燃焼切換2段噴射  1:全燃焼切換2段噴射" VALUE 0x00008B04 REC_UBYTE_C 0 COMP_0283 0 1 BIT_MASK 0x0010 /end CHARACTERISTIC
/begin CHARACTERISTIC mfFSTRSTP "0:右記以外  1:成層始動許可" VALUE 0x00008B04 REC_UBYTE_C 0 COMP_0283 0 1 BIT_MASK 0x0008 /end CHARACTERISTIC
/begin CHARACTERISTIC mfFBSLCFP "0:ベース学習条件適用  1:ベース学習条件無視" VALUE 0x00008B04 REC_UBYTE_C 0 COMP_0283 0 1 BIT_MASK 0x0004 /end CHARACTERISTIC
/begin CHARACTERISTIC mfRESPINH "0:応答遅れ補償実行  1:応答遅れ補償禁止" VALUE 0x00008B04 REC_UBYTE_C 0 COMP_0283 0 1 BIT_MASK 0x0002 /end CHARACTERISTIC
/begin CHARACTERISTIC mfETDIDLCH "0:応答遅れ補償実行  1:応答遅れ補償禁止" VALUE 0x00008B04 REC_UBYTE_C 0 COMP_0283 0 1 BIT_MASK 0x0001 /end CHARACTERISTIC
/begin CHARACTERISTIC mSWETD6 "Flag mSWETD6" VALUE 0x00008B05 REC_UBYTE_C 0 COMP_0283 0 255 /end CHARACTERISTIC
/begin CHARACTERISTIC mfFSTRSTGO "0:fFSTRKINは始動時燃圧に従う  1:常時fFSTRKIN=0(実験対応)" VALUE 0x00008B05 REC_UBYTE_C 0 COMP_0283 0 1 BIT_MASK 0x0080 /end CHARACTERISTIC
/begin CHARACTERISTIC mfJUMPDI "0:ｼﾞｬﾝﾌﾟｺﾝｾﾌﾟﾄDIG対応無し  1:ｼﾞｬﾝﾌﾟｺﾝｾﾌﾟﾄDIG対応有り" VALUE 0x00008B05 REC_UBYTE_C 0 COMP_0283 0 1 BIT_MASK 0x0020 /end CHARACTERISTIC
/begin CHARACTERISTIC mfFSTSCVCL "0:成層始動時SCVを閉しない  1:成層始動時SCVを閉する" VALUE 0x00008B05 REC_UBYTE_C 0 COMP_0283 0 1 BIT_MASK 0x0010 /end CHARACTERISTIC
/begin CHARACTERISTIC mfSREXP "0:それ以外  1:超リタード実験対応" VALUE 0x00008B05 REC_UBYTE_C 0 COMP_0283 0 1 BIT_MASK 0x0008 /end CHARACTERISTIC
/begin CHARACTERISTIC mfSSEXP "0:それ以外  1:成層始動実験対応" VALUE 0x00008B05 REC_UBYTE_C 0 COMP_0283 0 1 BIT_MASK 0x0004 /end CHARACTERISTIC
/begin CHARACTERISTIC mfEVCSLCT "0:EVCRAMP1に排気VTCを反映  1:EVCRAMP1に排気VTCを反映しない" VALUE 0x00008B05 REC_UBYTE_C 0 COMP_0283 0 1 BIT_MASK 0x0002 /end CHARACTERISTIC
/begin CHARACTERISTIC mfTDTVCN "0:TTAAPO入力固定無  1:TTAAPO入力固定有" VALUE 0x00008B05 REC_UBYTE_C 0 COMP_0283 0 1 BIT_MASK 0x0001 /end CHARACTERISTIC
/begin CHARACTERISTIC mSWETD7 "Flag mSWETD7" VALUE 0x00008B06 REC_UBYTE_C 0 COMP_0283 0 255 /end CHARACTERISTIC
/begin CHARACTERISTIC mfRSPETDFS "0:AFMF/S時応答規範ETD禁止  1:AFMF/S時応答規範ETD許可" VALUE 0x00008B06 REC_UBYTE_C 0 COMP_0283 0 1 BIT_MASK 0x0004 /end CHARACTERISTIC
/begin CHARACTERISTIC mSWHEV "Flag mSWHEV" VALUE 0x00008B07 REC_UBYTE_C 0 COMP_0283 0 255 /end CHARACTERISTIC
/begin CHARACTERISTIC mfHEV "0:非HEVシステム  1:HEVシステム" VALUE 0x00008B07 REC_UBYTE_C 0 COMP_0283 0 1 BIT_MASK 0x0020 /end CHARACTERISTIC
/begin CHARACTERISTIC mfNESC "0:エンジン自律制御無し  1:エンジン自律制御有り" VALUE 0x00008B07 REC_UBYTE_C 0 COMP_0283 0 1 BIT_MASK 0x0002 /end CHARACTERISTIC
/begin CHARACTERISTIC mfED "0:THS対応車両用  1:ﾍﾞﾝﾁ実験用" VALUE 0x00008B07 REC_UBYTE_C 0 COMP_0283 0 1 BIT_MASK 0x0001 /end CHARACTERISTIC
/begin CHARACTERISTIC mSWM4WD "Flag mSWM4WD" VALUE 0x00008B08 REC_UBYTE_C 0 COMP_0283 0 255 /end CHARACTERISTIC
/begin CHARACTERISTIC mfFM4WD "0:M4WD対応無し  1:M4WD対応有り" VALUE 0x00008B08 REC_UBYTE_C 0 COMP_0283 0 1 BIT_MASK 0x0001 /end CHARACTERISTIC
/begin CHARACTERISTIC mSWREG "Flag mSWREG" VALUE 0x00008B09 REC_UBYTE_C 0 COMP_0283 0 255 /end CHARACTERISTIC
/begin CHARACTERISTIC mfOVH_FC "0:ｵｰﾊﾞｰﾋｰﾄ時燃料ｶｯﾄ制御なし  1:ｵｰﾊﾞｰﾋｰﾄ時燃料ｶｯﾄ制御あり" VALUE 0x00008B09 REC_UBYTE_C 0 COMP_0283 0 1 BIT_MASK 0x0080 /end CHARACTERISTIC
/begin CHARACTERISTIC mfICREGIN "0:不許可  1:許可" VALUE 0x00008B09 REC_UBYTE_C 0 COMP_0283 0 1 BIT_MASK 0x0040 /end CHARACTERISTIC
/begin CHARACTERISTIC mfFFSTEN "0:不許可  1:許可" VALUE 0x00008B09 REC_UBYTE_C 0 COMP_0283 0 1 BIT_MASK 0x0020 /end CHARACTERISTIC
/begin CHARACTERISTIC mfFCHVER "0:一律不許可  1:個別許可" VALUE 0x00008B09 REC_UBYTE_C 0 COMP_0283 0 1 BIT_MASK 0x0010 /end CHARACTERISTIC
/begin CHARACTERISTIC mfFTEGRV "0:不許可  1:許可" VALUE 0x00008B09 REC_UBYTE_C 0 COMP_0283 0 1 BIT_MASK 0x0008 /end CHARACTERISTIC
/begin CHARACTERISTIC mfFTRGPHI "0:TTC判定  1:FLGHS設定" VALUE 0x00008B09 REC_UBYTE_C 0 COMP_0283 0 1 BIT_MASK 0x0004 /end CHARACTERISTIC
/begin CHARACTERISTIC mfFVTFA0 "0:TFBYA0ﾊﾞﾘｱﾌﾞﾙ制御なし  1:ﾊﾞﾘｱﾌﾞﾙ制御あり" VALUE 0x00008B09 REC_UBYTE_C 0 COMP_0283 0 1 BIT_MASK 0x0002 /end CHARACTERISTIC
/begin CHARACTERISTIC mfFVTIM "0:TITMﾊﾞﾘｱﾌﾞﾙ制御あり  1:ﾊﾞﾘｱﾌﾞﾙ制御なし" VALUE 0x00008B09 REC_UBYTE_C 0 COMP_0283 0 1 BIT_MASK 0x0001 /end CHARACTERISTIC
/begin CHARACTERISTIC mSWREG2 "Flag mSWREG2" VALUE 0x00008B0A REC_UBYTE_C 0 COMP_0283 0 255 /end CHARACTERISTIC
/begin CHARACTERISTIC mfAPOTD "0:制御非実行  1:制御実行" VALUE 0x00008B0A REC_UBYTE_C 0 COMP_0283 0 1 BIT_MASK 0x0080 /end CHARACTERISTIC
/begin CHARACTERISTIC mfFTASEEP "0:EEP-ROM書き込み無し  1:EEP-ROM書き込み有り" VALUE 0x00008B0A REC_UBYTE_C 0 COMP_0283 0 1 BIT_MASK 0x0040 /end CHARACTERISTIC
/begin CHARACTERISTIC mfFTPDGN "0:TCSｼｽﾃﾑ異常診断禁止  1:TCSｼｽﾃﾑ異常診断許可" VALUE 0x00008B0A REC_UBYTE_C 0 COMP_0283 0 1 BIT_MASK 0x0020 /end CHARACTERISTIC
/begin CHARACTERISTIC mfFVTCS "0:TCS燃料ｶｯﾄﾊﾞﾘｱﾌﾞﾙ制御なし  1:TCS燃料ｶｯﾄﾊﾞﾘｱﾌﾞﾙ制御あり" VALUE 0x00008B0A REC_UBYTE_C 0 COMP_0283 0 1 BIT_MASK 0x0010 /end CHARACTERISTIC
/begin CHARACTERISTIC mfFTXACR "0:TCS_A/Cﾘﾚｰ制御なし  1:TCS_A/Cﾘﾚｰ制御あり" VALUE 0x00008B0A REC_UBYTE_C 0 COMP_0283 0 1 BIT_MASK 0x0008 /end CHARACTERISTIC
/begin CHARACTERISTIC mfFETDMM "0:ETD通常ﾓｰﾄﾞ  1:ETDﾏｯﾁﾝｸﾞﾓｰﾄﾞ" VALUE 0x00008B0A REC_UBYTE_C 0 COMP_0283 0 1 BIT_MASK 0x0004 /end CHARACTERISTIC
/begin CHARACTERISTIC mfFLTC "0:ﾄﾙｸ制御なし  1:ﾄﾙｸ制御あり" VALUE 0x00008B0A REC_UBYTE_C 0 COMP_0283 0 1 BIT_MASK 0x0002 /end CHARACTERISTIC
/begin CHARACTERISTIC mfFKNALL "0:ﾉｯｸ制御中ALLC許可  1:ﾉｯｸ制御中ALLC禁止" VALUE 0x00008B0A REC_UBYTE_C 0 COMP_0283 0 1 BIT_MASK 0x0001 /end CHARACTERISTIC
/begin CHARACTERISTIC mSWREG3 "Flag mSWREG3" VALUE 0x00008B0B REC_UBYTE_C 0 COMP_0283 0 255 /end CHARACTERISTIC
/begin CHARACTERISTIC mfVPASS "0:ﾏｯﾁﾝｸﾞ用制御無切換  1:ﾏｯﾁﾝｸﾞ用制御有切換" VALUE 0x00008B0B REC_UBYTE_C 0 COMP_0283 0 1 BIT_MASK 0x0080 /end CHARACTERISTIC
/begin CHARACTERISTIC mfVINV "0:ﾏｯﾁﾝｸﾞ用制御無切換  1:ﾏｯﾁﾝｸﾞ用制御有切換" VALUE 0x00008B0B REC_UBYTE_C 0 COMP_0283 0 1 BIT_MASK 0x0040 /end CHARACTERISTIC
/begin CHARACTERISTIC mfECOIDLE "0:ｱｲﾄﾞﾙ時ｴｺﾗﾝﾌﾟ非点灯  1:ｱｲﾄﾞﾙ時ｴｺﾗﾝﾌﾟ点灯" VALUE 0x00008B0B REC_UBYTE_C 0 COMP_0283 0 1 BIT_MASK 0x0020 /end CHARACTERISTIC
/begin CHARACTERISTIC mfFLNJS "0:TP固定値制御  1:TPFBYA算出にSTFBYAを反映する" VALUE 0x00008B0B REC_UBYTE_C 0 COMP_0283 0 1 BIT_MASK 0x0010 /end CHARACTERISTIC
/begin CHARACTERISTIC mfDLGACON "0:ｴｱｺﾝｽｲｯﾁON条件無し  1:ｴｱｺﾝｽｲｯﾁON条件有り" VALUE 0x00008B0B REC_UBYTE_C 0 COMP_0283 0 1 BIT_MASK 0x0008 /end CHARACTERISTIC
/begin CHARACTERISTIC mfSNOWARI "0:制御禁止  1:制御許可" VALUE 0x00008B0B REC_UBYTE_C 0 COMP_0283 0 1 BIT_MASK 0x0004 /end CHARACTERISTIC
/begin CHARACTERISTIC mfSTFSARI "0:変換処理無し  1:変換処理有り" VALUE 0x00008B0B REC_UBYTE_C 0 COMP_0283 0 1 BIT_MASK 0x0002 /end CHARACTERISTIC
/begin CHARACTERISTIC mSWSL "Flag mSWSL" VALUE 0x00008B0C REC_UBYTE_C 0 COMP_0283 0 255 /end CHARACTERISTIC
/begin CHARACTERISTIC mfSLBASPDL "0:送信開度ペダル特性補正なし  1:送信開度ペダル特性補正あり" VALUE 0x00008B0C REC_UBYTE_C 0 COMP_0283 0 1 BIT_MASK 0x0080 /end CHARACTERISTIC
/begin CHARACTERISTIC mfSLVS0SET "0:0km/h時セットなし  1:0km/h時セットあり" VALUE 0x00008B0C REC_UBYTE_C 0 COMP_0283 0 1 BIT_MASK 0x0020 /end CHARACTERISTIC
/begin CHARACTERISTIC mfSLCLCUT "0:クラッチ踏み込み時リミット解除な  1:クラッチ踏み込み時リミット解除あ" VALUE 0x00008B0C REC_UBYTE_C 0 COMP_0283 0 1 BIT_MASK 0x0010 /end CHARACTERISTIC
/begin CHARACTERISTIC mfMEMVSOFF "0:メモリ車速表示ON  1:メモリ車速表示OFF" VALUE 0x00008B0C REC_UBYTE_C 0 COMP_0283 0 1 BIT_MASK 0x0008 /end CHARACTERISTIC
/begin CHARACTERISTIC mfSLRESRST "0:減速ﾘｼﾞｭｰﾑ時再ｾｯﾄなし  1:減速ﾘｼﾞｭｰﾑ時再ｾｯﾄあり" VALUE 0x00008B0C REC_UBYTE_C 0 COMP_0283 0 1 BIT_MASK 0x0004 /end CHARACTERISTIC
/begin CHARACTERISTIC mfKDSLCAN "0:ｷｯｸﾀﾞｳﾝ時ｽﾋﾟｰﾄﾞﾘﾐｯﾀ解除なし  1:ｷｯｸﾀﾞｳﾝ時ｽﾋﾟｰﾄﾞﾘﾐｯﾀ解除あり" VALUE 0x00008B0C REC_UBYTE_C 0 COMP_0283 0 1 BIT_MASK 0x0002 /end CHARACTERISTIC
/begin CHARACTERISTIC mfSL "0:ｽﾋﾟｰﾄﾞﾘﾐｯﾀ制御OFF  1:ｽﾋﾟｰﾄﾞﾘﾐｯﾀ制御ON" VALUE 0x00008B0C REC_UBYTE_C 0 COMP_0283 0 1 BIT_MASK 0x0001 /end CHARACTERISTIC
/begin CHARACTERISTIC mSWSL2 "Flag mSWSL2" VALUE 0x00008B0D REC_UBYTE_C 0 COMP_0283 0 255 /end CHARACTERISTIC
/begin CHARACTERISTIC mfSLPTDAPO "0:ｽﾋﾟｰﾄﾞﾘﾐｯﾀ駆動力開度演算なし  1:ｽﾋﾟｰﾄﾞﾘﾐｯﾀ駆動力開度演算あり" VALUE 0x00008B0D REC_UBYTE_C 0 COMP_0283 0 1 BIT_MASK 0x0010 /end CHARACTERISTIC
/begin CHARACTERISTIC mfSLVAPOSL "0:送信開度VAPO上限ﾘﾐｯﾄなし  1:送信開度VAPO上限ﾘﾐｯﾄあり" VALUE 0x00008B0D REC_UBYTE_C 0 COMP_0283 0 1 BIT_MASK 0x0004 /end CHARACTERISTIC
/begin CHARACTERISTIC mfMAON1CMD "0:ﾒｲﾝSW_即ON切替なし  1:ﾒｲﾝSW_即ON切替あり" VALUE 0x00008B0D REC_UBYTE_C 0 COMP_0283 0 1 BIT_MASK 0x0002 /end CHARACTERISTIC
/begin CHARACTERISTIC mSWSOFS "Flag mSWSOFS" VALUE 0x00008B0E REC_UBYTE_C 0 COMP_0283 0 255 /end CHARACTERISTIC
/begin CHARACTERISTIC mfFQTCI "0:ISCｸﾛｰｽﾞ条件なし  1:ISCｸﾛｰｽﾞ条件有り" VALUE 0x00008B0E REC_UBYTE_C 0 COMP_0283 0 1 BIT_MASK 0x0080 /end CHARACTERISTIC
/begin CHARACTERISTIC mfMKSCV "0:SCV使用せず  1:SCV使用" VALUE 0x00008B0E REC_UBYTE_C 0 COMP_0283 0 1 BIT_MASK 0x0040 /end CHARACTERISTIC
/begin CHARACTERISTIC mfIDCHOS "0:ｱｲﾄﾞﾙ時CHOSｷｬﾝｾﾙ制御なし  1:ｱｲﾄﾞﾙ時CHOSｷｬﾝｾﾙ制御あり" VALUE 0x00008B0E REC_UBYTE_C 0 COMP_0283 0 1 BIT_MASK 0x0020 /end CHARACTERISTIC
/begin CHARACTERISTIC mfSTPKUB "0:始動時未燃分停止なし  1:始動時未燃分停止あり" VALUE 0x00008B0E REC_UBYTE_C 0 COMP_0283 0 1 BIT_MASK 0x0010 /end CHARACTERISTIC
/begin CHARACTERISTIC mfFTWTWF "0:TMFHQTの格子にTWKを使用  1:TMFHQTの格子にTWFを使用" VALUE 0x00008B0E REC_UBYTE_C 0 COMP_0283 0 1 BIT_MASK 0x0004 /end CHARACTERISTIC
/begin CHARACTERISTIC mSWVDC "Flag mSWVDC" VALUE 0x00008B0F REC_UBYTE_C 0 COMP_0283 0 255 /end CHARACTERISTIC
/begin CHARACTERISTIC mfKT "0:非トロイダルCVT機種  1:トロイダルCVT機種" VALUE 0x00008B0F REC_UBYTE_C 0 COMP_0283 0 1 BIT_MASK 0x0080 /end CHARACTERISTIC
/begin CHARACTERISTIC mfTRQ4WDSW "0:電制4WD駆動保護制御を行わない  1:電制4WD駆動保護制御を行う" VALUE 0x00008B0F REC_UBYTE_C 0 COMP_0283 0 1 BIT_MASK 0x0040 /end CHARACTERISTIC
/begin CHARACTERISTIC mfESP "0:従来仕様のTCS/VDC(非ESP仕様)  1:ESP仕様のTCS/VDC" VALUE 0x00008B0F REC_UBYTE_C 0 COMP_0283 0 1 BIT_MASK 0x0020 /end CHARACTERISTIC
/begin CHARACTERISTIC mfJK "0:非JK機種  1:JK機種" VALUE 0x00008B0F REC_UBYTE_C 0 COMP_0283 0 1 BIT_MASK 0x0010 /end CHARACTERISTIC
/begin CHARACTERISTIC mfMU "0:非MU機種  1:MU機種（ｱｲｼﾝAW製5速AT）" VALUE 0x00008B0F REC_UBYTE_C 0 COMP_0283 0 1 BIT_MASK 0x0008 /end CHARACTERISTIC
/begin CHARACTERISTIC mfFCTCS "0:点火時期ﾘﾀｰﾄﾞ式TCS  1:燃料ｶｯﾄ式TCS" VALUE 0x00008B0F REC_UBYTE_C 0 COMP_0283 0 1 BIT_MASK 0x0002 /end CHARACTERISTIC
/begin CHARACTERISTIC mfMSR_ON "0:MSR制御なし  1:MSR制御あり" VALUE 0x00008B0F REC_UBYTE_C 0 COMP_0283 0 1 BIT_MASK 0x0001 /end CHARACTERISTIC
/begin CHARACTERISTIC mTENGSW "Flag mTENGSW" VALUE 0x00008B6F REC_UBYTE_C 0 COMP_0283 0 255 /end CHARACTERISTIC
/begin CHARACTERISTIC mfTENGMBT "0:vMBTCAL使用  1:vMBT使用" VALUE 0x00008B6F REC_UBYTE_C 0 COMP_0283 0 1 BIT_MASK 0x0001 /end CHARACTERISTIC
/begin CHARACTERISTIC mTRIPSWS "Flag mTRIPSWS" VALUE 0x00008C41 REC_UBYTE_C 0 COMP_0283 0 255 /end CHARACTERISTIC
/begin CHARACTERISTIC mfNG1DFLT2 "0:ﾃﾞﾌｫﾙﾄ機構診断2TRIP選択（ﾊﾞﾝｸ2）  1:ﾃﾞﾌｫﾙﾄ機構診断1TRIP選択（ﾊﾞﾝｸ2）" VALUE 0x00008C41 REC_UBYTE_C 0 COMP_0283 0 1 BIT_MASK 0x0040 /end CHARACTERISTIC
/begin CHARACTERISTIC mfNG1SPG22 "0:keyOFF時ﾘﾀｰﾝｽﾌﾟﾘﾝｸﾞ診断2TRIP選択  1:keyOFF時ﾘﾀｰﾝｽﾌﾟﾘﾝｸﾞ診断1TRIP選択" VALUE 0x00008C41 REC_UBYTE_C 0 COMP_0283 0 1 BIT_MASK 0x0020 /end CHARACTERISTIC
/begin CHARACTERISTIC mfNG1SPG12 "0:keyON時ﾘﾀｰﾝｽﾌﾟﾘﾝｸﾞ診断2TRIP選択  1:keyON時ﾘﾀｰﾝｽﾌﾟﾘﾝｸﾞ診断1TRIP選択" VALUE 0x00008C41 REC_UBYTE_C 0 COMP_0283 0 1 BIT_MASK 0x0010 /end CHARACTERISTIC
/begin CHARACTERISTIC mfNG1RLYON "0:モータリレー診断2TRIPする  1:モータリレー診断2TRIPしない" VALUE 0x00008C41 REC_UBYTE_C 0 COMP_0283 0 1 BIT_MASK 0x0008 /end CHARACTERISTIC
/begin CHARACTERISTIC mfNG1DEFLT "0:ﾃﾞﾌｫﾙﾄ機構診断2TRIP選択  1:ﾃﾞﾌｫﾙﾄ機構診断1TRIP選択" VALUE 0x00008C41 REC_UBYTE_C 0 COMP_0283 0 1 BIT_MASK 0x0004 /end CHARACTERISTIC
/begin CHARACTERISTIC mfNG1SPRG2 "0:keyOFF時ﾘﾀｰﾝｽﾌﾟﾘﾝｸﾞ診断2TRIP選択  1:keyOFF時ﾘﾀｰﾝｽﾌﾟﾘﾝｸﾞ診断1TRIP選択" VALUE 0x00008C41 REC_UBYTE_C 0 COMP_0283 0 1 BIT_MASK 0x0002 /end CHARACTERISTIC
/begin CHARACTERISTIC mfNG1SPRG1 "0:keyON時ﾘﾀｰﾝｽﾌﾟﾘﾝｸﾞ診断2TRIP選択  1:keyON時ﾘﾀｰﾝｽﾌﾟﾘﾝｸﾞ診断1TRIP選択" VALUE 0x00008C41 REC_UBYTE_C 0 COMP_0283 0 1 BIT_MASK 0x0001 /end CHARACTERISTIC
/begin CHARACTERISTIC mVLVALTM "Flag mVLVALTM" VALUE 0x00008D17 REC_UBYTE_C 0 COMP_0283 0 255 /end CHARACTERISTIC
/begin CHARACTERISTIC mfTBSOLHZ "0:ﾀｰﾎﾞｿﾚﾉｲﾄﾞ駆動周波数；20Hz  1:ﾀｰﾎﾞｿﾚﾉｲﾄﾞ駆動周波数；30Hz" VALUE 0x00008D17 REC_UBYTE_C 0 COMP_0283 0 1 BIT_MASK 0x0002 /end CHARACTERISTIC
/begin CHARACTERISTIC mVP3HDROM "Flag mVP3HDROM" VALUE 0x00008D1A REC_UBYTE_C 0 COMP_0283 0 255 /end CHARACTERISTIC
/begin CHARACTERISTIC mfCAN6E2 "0:CAN_ID:6E2_DT7で、 ECO_MeterDisC  1:AN_ID:6E2_DT7で、 BOOST_pressu30" VALUE 0x00008D1A REC_UBYTE_C 0 COMP_0283 0 1 BIT_MASK 0x0002 /end CHARACTERISTIC
/begin CHARACTERISTIC mVP3K2ROM "Flag mVP3K2ROM" VALUE 0x00008D1B REC_UBYTE_C 0 COMP_0283 0 255 /end CHARACTERISTIC
/begin CHARACTERISTIC mfKHK1VC "0:KHK1系DIG_UC-lot仕様  1:KHK1系DIG_VC-lot仕様" VALUE 0x00008D1B REC_UBYTE_C 0 COMP_0283 0 1 BIT_MASK 0x0080 /end CHARACTERISTIC
/begin CHARACTERISTIC mfCRKRVS "0:逆転検知無し  1:逆転検知有り" VALUE 0x00008D1B REC_UBYTE_C 0 COMP_0283 0 1 BIT_MASK 0x0040 /end CHARACTERISTIC
/begin CHARACTERISTIC mfMYTRKTYP "0:10MY以降TRK1(竹)系ハード  1:10MY以降(竹)以外TRK1系ハード" VALUE 0x00008D1B REC_UBYTE_C 0 COMP_0283 0 1 BIT_MASK 0x0020 /end CHARACTERISTIC
/begin CHARACTERISTIC mfKHTRKTYP "0:KH_SULEV系ハード  1:10MY以降TRK1(竹)系ハード" VALUE 0x00008D1B REC_UBYTE_C 0 COMP_0283 0 1 BIT_MASK 0x0010 /end CHARACTERISTIC
/begin CHARACTERISTIC mfEVPVCC "0:EVAP電圧VCC無調整化後値(PVEVPR)  1:EVAP電圧VCC無調整化前値(VEVPR)" VALUE 0x00008D1B REC_UBYTE_C 0 COMP_0283 0 1 BIT_MASK 0x0001 /end CHARACTERISTIC
/begin CHARACTERISTIC mVP3KROM "Flag mVP3KROM" VALUE 0x00008D1C REC_UBYTE_C 0 COMP_0283 0 255 /end CHARACTERISTIC
/begin CHARACTERISTIC mfTRK1TYP "0:TRK1_6.x次正規版ハード対応  1:それ以外" VALUE 0x00008D1C REC_UBYTE_C 0 COMP_0283 0 1 BIT_MASK 0x0080 /end CHARACTERISTIC
/begin CHARACTERISTIC mfMILGSTIM "0:KeyON時MIL点滅  1:KeyON時MIL点灯" VALUE 0x00008D1C REC_UBYTE_C 0 COMP_0283 0 1 BIT_MASK 0x0040 /end CHARACTERISTIC
/begin CHARACTERISTIC mfAFMDGSEL "0:05MY以降OBD仕様  1:04MY以前OBD(国内SSS)仕様" VALUE 0x00008D1C REC_UBYTE_C 0 COMP_0283 0 1 BIT_MASK 0x0020 /end CHARACTERISTIC
/begin CHARACTERISTIC mfWOTTP "0:WOT非採用  1:WOT採用" VALUE 0x00008D1C REC_UBYTE_C 0 COMP_0283 0 1 BIT_MASK 0x0010 /end CHARACTERISTIC
/begin CHARACTERISTIC mfACCINJ "0:ΔTP判定方式なし  1:ΔTP判定方式あり" VALUE 0x00008D1C REC_UBYTE_C 0 COMP_0283 0 1 BIT_MASK 0x0008 /end CHARACTERISTIC
/begin CHARACTERISTIC mfKNKTYP "0:ｼﾝｸﾞﾙﾉｯｸｾﾝｻ  1:ﾂｲﾝﾉｯｸｾﾝｻ" VALUE 0x00008D1C REC_UBYTE_C 0 COMP_0283 0 1 BIT_MASK 0x0004 /end CHARACTERISTIC
/begin CHARACTERISTIC mfNEUTLH "0:NEUTL参照  1:NEUTH参照" VALUE 0x00008D1C REC_UBYTE_C 0 COMP_0283 0 1 BIT_MASK 0x0002 /end CHARACTERISTIC
/begin CHARACTERISTIC mfVP3KTYP "0:A-Type  1:B-Type" VALUE 0x00008D1C REC_UBYTE_C 0 COMP_0283 0 1 BIT_MASK 0x0001 /end CHARACTERISTIC
/begin CHARACTERISTIC mDGNSW[0] "Flag mDGNSW[0]" VALUE 0x000162A8 REC_UBYTE_C 0 COMP_0283 0 255 /end CHARACTERISTIC
/begin CHARACTERISTIC mfCSNG "0:Not DGN  1:DGN" VALUE 0x000162A8 REC_UBYTE_C 0 COMP_0283 0 1 BIT_MASK 0x0080 /end CHARACTERISTIC
/begin CHARACTERISTIC mfAFMNG "0:Not DGN  1:DGN" VALUE 0x000162A8 REC_UBYTE_C 0 COMP_0283 0 1 BIT_MASK 0x0040 /end CHARACTERISTIC
/begin CHARACTERISTIC mfTWNG "0:Not DGN  1:DGN" VALUE 0x000162A8 REC_UBYTE_C 0 COMP_0283 0 1 BIT_MASK 0x0020 /end CHARACTERISTIC
/begin CHARACTERISTIC mfVSPNG "0:Not DGN  1:DGN" VALUE 0x000162A8 REC_UBYTE_C 0 COMP_0283 0 1 BIT_MASK 0x0010 /end CHARACTERISTIC
/begin CHARACTERISTIC mfTCSNG "0:Not DGN  1:DGN" VALUE 0x000162A8 REC_UBYTE_C 0 COMP_0283 0 1 BIT_MASK 0x0004 /end CHARACTERISTIC
/begin CHARACTERISTIC mfTXCUNG "0:Not DGN  1:DGN" VALUE 0x000162A8 REC_UBYTE_C 0 COMP_0283 0 1 BIT_MASK 0x0002 /end CHARACTERISTIC
/begin CHARACTERISTIC mfVATMNG "0:Not DGN  1:DGN" VALUE 0x000162A8 REC_UBYTE_C 0 COMP_0283 0 1 BIT_MASK 0x0001 /end CHARACTERISTIC
/begin CHARACTERISTIC mDGNSW[1] "Flag mDGNSW[1]" VALUE 0x000162A9 REC_UBYTE_C 0 COMP_0283 0 255 /end CHARACTERISTIC
/begin CHARACTERISTIC mfIGNG "0:Not DGN  1:DGN" VALUE 0x000162A9 REC_UBYTE_C 0 COMP_0283 0 1 BIT_MASK 0x0080 /end CHARACTERISTIC
/begin CHARACTERISTIC mfFPNG "0:Not DGN  1:DGN" VALUE 0x000162A9 REC_UBYTE_C 0 COMP_0283 0 1 BIT_MASK 0x0040 /end CHARACTERISTIC
/begin CHARACTERISTIC mfIDLENG "0:Not DGN  1:DGN" VALUE 0x000162A9 REC_UBYTE_C 0 COMP_0283 0 1 BIT_MASK 0x0020 /end CHARACTERISTIC
/begin CHARACTERISTIC mfFULL "0:Not DGN  1:DGN" VALUE 0x000162A9 REC_UBYTE_C 0 COMP_0283 0 1 BIT_MASK 0x0010 /end CHARACTERISTIC
/begin CHARACTERISTIC mfISCNG "0:Not DGN  1:DGN" VALUE 0x000162A9 REC_UBYTE_C 0 COMP_0283 0 1 BIT_MASK 0x0008 /end CHARACTERISTIC
/begin CHARACTERISTIC mfVPBNG "0:Not DGN  1:DGN" VALUE 0x000162A9 REC_UBYTE_C 0 COMP_0283 0 1 BIT_MASK 0x0004 /end CHARACTERISTIC
/begin CHARACTERISTIC mfTXLTNG "0:Not DGN  1:DGN" VALUE 0x000162A9 REC_UBYTE_C 0 COMP_0283 0 1 BIT_MASK 0x0002 /end CHARACTERISTIC
/begin CHARACTERISTIC mfOVHEAT "0:Not DGN  1:DGN" VALUE 0x000162A9 REC_UBYTE_C 0 COMP_0283 0 1 BIT_MASK 0x0001 /end CHARACTERISTIC
/begin CHARACTERISTIC mDGNSW[2] "Flag mDGNSW[2]" VALUE 0x000162AA REC_UBYTE_C 0 COMP_0283 0 255 /end CHARACTERISTIC
/begin CHARACTERISTIC mfCUNG "0:Not DGN  1:DGN" VALUE 0x000162AA REC_UBYTE_C 0 COMP_0283 0 1 BIT_MASK 0x0080 /end CHARACTERISTIC
/begin CHARACTERISTIC mfEGRNG "0:Not DGN  1:DGN" VALUE 0x000162AA REC_UBYTE_C 0 COMP_0283 0 1 BIT_MASK 0x0040 /end CHARACTERISTIC
/begin CHARACTERISTIC mfO2F1NG "0:Not DGN  1:DGN" VALUE 0x000162AA REC_UBYTE_C 0 COMP_0283 0 1 BIT_MASK 0x0020 /end CHARACTERISTIC
/begin CHARACTERISTIC mfKNKNG "0:Not DGN  1:DGN" VALUE 0x000162AA REC_UBYTE_C 0 COMP_0283 0 1 BIT_MASK 0x0010 /end CHARACTERISTIC
/begin CHARACTERISTIC mfEGRSNG "0:Not DGN  1:DGN" VALUE 0x000162AA REC_UBYTE_C 0 COMP_0283 0 1 BIT_MASK 0x0008 /end CHARACTERISTIC
/begin CHARACTERISTIC mfEGRFNG "0:Not DGN  1:DGN" VALUE 0x000162AA REC_UBYTE_C 0 COMP_0283 0 1 BIT_MASK 0x0004 /end CHARACTERISTIC
/begin CHARACTERISTIC mfO2CLB1 "0:Not DGN  1:DGN" VALUE 0x000162AA REC_UBYTE_C 0 COMP_0283 0 1 BIT_MASK 0x0002 /end CHARACTERISTIC
/begin CHARACTERISTIC mfO2CLB2 "0:Not DGN  1:DGN" VALUE 0x000162AA REC_UBYTE_C 0 COMP_0283 0 1 BIT_MASK 0x0001 /end CHARACTERISTIC
/begin CHARACTERISTIC mDGNSW[3] "Flag mDGNSW[3]" VALUE 0x000162AB REC_UBYTE_C 0 COMP_0283 0 255 /end CHARACTERISTIC
/begin CHARACTERISTIC mfTANG "0:Not DGN  1:DGN" VALUE 0x000162AB REC_UBYTE_C 0 COMP_0283 0 1 BIT_MASK 0x0080 /end CHARACTERISTIC
/begin CHARACTERISTIC mfTFNG "0:Not DGN  1:DGN" VALUE 0x000162AB REC_UBYTE_C 0 COMP_0283 0 1 BIT_MASK 0x0040 /end CHARACTERISTIC
/begin CHARACTERISTIC mfTHSNG "0:Not DGN  1:DGN" VALUE 0x000162AB REC_UBYTE_C 0 COMP_0283 0 1 BIT_MASK 0x0020 /end CHARACTERISTIC
/begin CHARACTERISTIC mfTXLNNG "0:Not DGN  1:DGN" VALUE 0x000162AB REC_UBYTE_C 0 COMP_0283 0 1 BIT_MASK 0x0010 /end CHARACTERISTIC
/begin CHARACTERISTIC mfINJL "0:Not DGN  1:DGN" VALUE 0x000162AB REC_UBYTE_C 0 COMP_0283 0 1 BIT_MASK 0x0008 /end CHARACTERISTIC
/begin CHARACTERISTIC mfTVO2NG "0:Not DGN  1:DGN" VALUE 0x000162AB REC_UBYTE_C 0 COMP_0283 0 1 BIT_MASK 0x0004 /end CHARACTERISTIC
/begin CHARACTERISTIC mfCS2NG "0:Not DGN  1:DGN" VALUE 0x000162AB REC_UBYTE_C 0 COMP_0283 0 1 BIT_MASK 0x0002 /end CHARACTERISTIC
/begin CHARACTERISTIC mDGNSW[4] "Flag mDGNSW[4]" VALUE 0x000162AC REC_UBYTE_C 0 COMP_0283 0 255 /end CHARACTERISTIC
/begin CHARACTERISTIC mfINONG "0:Not DGN  1:DGN" VALUE 0x000162AC REC_UBYTE_C 0 COMP_0283 0 1 BIT_MASK 0x0080 /end CHARACTERISTIC
/begin CHARACTERISTIC mfVBNG "0:Not DGN  1:DGN" VALUE 0x000162AC REC_UBYTE_C 0 COMP_0283 0 1 BIT_MASK 0x0040 /end CHARACTERISTIC
/begin CHARACTERISTIC mfO2F2NG "0:Not DGN  1:DGN" VALUE 0x000162AC REC_UBYTE_C 0 COMP_0283 0 1 BIT_MASK 0x0020 /end CHARACTERISTIC
/begin CHARACTERISTIC mfDUETNG "0:Not DGN  1:DGN" VALUE 0x000162AC REC_UBYTE_C 0 COMP_0283 0 1 BIT_MASK 0x0010 /end CHARACTERISTIC
/begin CHARACTERISTIC mfAFMNR2 "0:Not DGN  1:DGN" VALUE 0x000162AC REC_UBYTE_C 0 COMP_0283 0 1 BIT_MASK 0x0004 /end CHARACTERISTIC
/begin CHARACTERISTIC mfAFMNL2 "0:Not DGN  1:DGN" VALUE 0x000162AC REC_UBYTE_C 0 COMP_0283 0 1 BIT_MASK 0x0002 /end CHARACTERISTIC
/begin CHARACTERISTIC mfAFMNH2 "0:Not DGN  1:DGN" VALUE 0x000162AC REC_UBYTE_C 0 COMP_0283 0 1 BIT_MASK 0x0001 /end CHARACTERISTIC
/begin CHARACTERISTIC mDGNSW[5] "Flag mDGNSW[5]" VALUE 0x000162AD REC_UBYTE_C 0 COMP_0283 0 255 /end CHARACTERISTIC
/begin CHARACTERISTIC mfMF8NG "0:Not DGN  1:DGN" VALUE 0x000162AD REC_UBYTE_C 0 COMP_0283 0 1 BIT_MASK 0x0080 /end CHARACTERISTIC
/begin CHARACTERISTIC mfMF7NG "0:Not DGN  1:DGN" VALUE 0x000162AD REC_UBYTE_C 0 COMP_0283 0 1 BIT_MASK 0x0040 /end CHARACTERISTIC
/begin CHARACTERISTIC mfMF6NG "0:Not DGN  1:DGN" VALUE 0x000162AD REC_UBYTE_C 0 COMP_0283 0 1 BIT_MASK 0x0020 /end CHARACTERISTIC
/begin CHARACTERISTIC mfMF5NG "0:Not DGN  1:DGN" VALUE 0x000162AD REC_UBYTE_C 0 COMP_0283 0 1 BIT_MASK 0x0010 /end CHARACTERISTIC
/begin CHARACTERISTIC mfMF4NG "0:Not DGN  1:DGN" VALUE 0x000162AD REC_UBYTE_C 0 COMP_0283 0 1 BIT_MASK 0x0008 /end CHARACTERISTIC
/begin CHARACTERISTIC mfMF3NG "0:Not DGN  1:DGN" VALUE 0x000162AD REC_UBYTE_C 0 COMP_0283 0 1 BIT_MASK 0x0004 /end CHARACTERISTIC
/begin CHARACTERISTIC mfMF2NG "0:Not DGN  1:DGN" VALUE 0x000162AD REC_UBYTE_C 0 COMP_0283 0 1 BIT_MASK 0x0002 /end CHARACTERISTIC
/begin CHARACTERISTIC mfMF1NG "0:Not DGN  1:DGN" VALUE 0x000162AD REC_UBYTE_C 0 COMP_0283 0 1 BIT_MASK 0x0001 /end CHARACTERISTIC
/begin CHARACTERISTIC mDGNSW[6] "Flag mDGNSW[6]" VALUE 0x000162AE REC_UBYTE_C 0 COMP_0283 0 255 /end CHARACTERISTIC
/begin CHARACTERISTIC mfMFMCNG "0:Not DGN  1:DGN" VALUE 0x000162AE REC_UBYTE_C 0 COMP_0283 0 1 BIT_MASK 0x0080 /end CHARACTERISTIC
/begin CHARACTERISTIC mfCAT1NG "0:Not DGN  1:DGN" VALUE 0x000162AE REC_UBYTE_C 0 COMP_0283 0 1 BIT_MASK 0x0040 /end CHARACTERISTIC
/begin CHARACTERISTIC mfCAT2NG "0:Not DGN  1:DGN" VALUE 0x000162AE REC_UBYTE_C 0 COMP_0283 0 1 BIT_MASK 0x0020 /end CHARACTERISTIC
/begin CHARACTERISTIC mfEPRSNG "0:Not DGN  1:DGN" VALUE 0x000162AE REC_UBYTE_C 0 COMP_0283 0 1 BIT_MASK 0x0010 /end CHARACTERISTIC
/begin CHARACTERISTIC mfEVPNG "0:Not DGN  1:DGN" VALUE 0x000162AE REC_UBYTE_C 0 COMP_0283 0 1 BIT_MASK 0x0008 /end CHARACTERISTIC
/begin CHARACTERISTIC mfMRNG "0:Not DGN  1:DGN" VALUE 0x000162AE REC_UBYTE_C 0 COMP_0283 0 1 BIT_MASK 0x0004 /end CHARACTERISTIC
/begin CHARACTERISTIC mfO2R1NG "0:Not DGN  1:DGN" VALUE 0x000162AE REC_UBYTE_C 0 COMP_0283 0 1 BIT_MASK 0x0002 /end CHARACTERISTIC
/begin CHARACTERISTIC mfO2R2NG "0:Not DGN  1:DGN" VALUE 0x000162AE REC_UBYTE_C 0 COMP_0283 0 1 BIT_MASK 0x0001 /end CHARACTERISTIC
/begin CHARACTERISTIC mDGNSW[7] "Flag mDGNSW[7]" VALUE 0x000162AF REC_UBYTE_C 0 COMP_0283 0 255 /end CHARACTERISTIC
/begin CHARACTERISTIC mfCVBVNG "0:Not DGN  1:DGN" VALUE 0x000162AF REC_UBYTE_C 0 COMP_0283 0 1 BIT_MASK 0x0080 /end CHARACTERISTIC
/begin CHARACTERISTIC mfRCSNG "0:Not DGN  1:DGN" VALUE 0x000162AF REC_UBYTE_C 0 COMP_0283 0 1 BIT_MASK 0x0040 /end CHARACTERISTIC
/begin CHARACTERISTIC mfPRESNG "0:Not DGN  1:DGN" VALUE 0x000162AF REC_UBYTE_C 0 COMP_0283 0 1 BIT_MASK 0x0020 /end CHARACTERISTIC
/begin CHARACTERISTIC mfATCUNG "0:Not DGN  1:DGN" VALUE 0x000162AF REC_UBYTE_C 0 COMP_0283 0 1 BIT_MASK 0x0010 /end CHARACTERISTIC
/begin CHARACTERISTIC mfVTC1NG "0:Not DGN  1:DGN" VALUE 0x000162AF REC_UBYTE_C 0 COMP_0283 0 1 BIT_MASK 0x0008 /end CHARACTERISTIC
/begin CHARACTERISTIC mfMRNG2 "0:Not DGN  1:DGN" VALUE 0x000162AF REC_UBYTE_C 0 COMP_0283 0 1 BIT_MASK 0x0004 /end CHARACTERISTIC
/begin CHARACTERISTIC mfCPCNG "0:Not DGN  1:DGN" VALUE 0x000162AF REC_UBYTE_C 0 COMP_0283 0 1 BIT_MASK 0x0002 /end CHARACTERISTIC
/begin CHARACTERISTIC mfMPSNG "0:Not DGN  1:DGN" VALUE 0x000162AF REC_UBYTE_C 0 COMP_0283 0 1 BIT_MASK 0x0001 /end CHARACTERISTIC
/begin CHARACTERISTIC mDGNSW[8] "Flag mDGNSW[8]" VALUE 0x000162B0 REC_UBYTE_C 0 COMP_0283 0 255 /end CHARACTERISTIC
/begin CHARACTERISTIC mfO2HF1 "0:Not DGN  1:DGN" VALUE 0x000162B0 REC_UBYTE_C 0 COMP_0283 0 1 BIT_MASK 0x0080 /end CHARACTERISTIC
/begin CHARACTERISTIC mfO2HR1 "0:Not DGN  1:DGN" VALUE 0x000162B0 REC_UBYTE_C 0 COMP_0283 0 1 BIT_MASK 0x0040 /end CHARACTERISTIC
/begin CHARACTERISTIC mfCDCNG "0:Not DGN  1:DGN" VALUE 0x000162B0 REC_UBYTE_C 0 COMP_0283 0 1 BIT_MASK 0x0020 /end CHARACTERISTIC
/begin CHARACTERISTIC mfLUCSNG "0:Not DGN  1:DGN" VALUE 0x000162B0 REC_UBYTE_C 0 COMP_0283 0 1 BIT_MASK 0x0010 /end CHARACTERISTIC
/begin CHARACTERISTIC mfRCHSNG "0:Not DGN  1:DGN" VALUE 0x000162B0 REC_UBYTE_C 0 COMP_0283 0 1 BIT_MASK 0x0008 /end CHARACTERISTIC
/begin CHARACTERISTIC mfAIRPNG "0:Not DGN  1:DGN" VALUE 0x000162B0 REC_UBYTE_C 0 COMP_0283 0 1 BIT_MASK 0x0004 /end CHARACTERISTIC
/begin CHARACTERISTIC mfTWCLNG "0:Not DGN  1:DGN" VALUE 0x000162B0 REC_UBYTE_C 0 COMP_0283 0 1 BIT_MASK 0x0001 /end CHARACTERISTIC
/begin CHARACTERISTIC mDGNSW[9] "Flag mDGNSW[9]" VALUE 0x000162B1 REC_UBYTE_C 0 COMP_0283 0 255 /end CHARACTERISTIC
/begin CHARACTERISTIC mfO2HF2 "0:Not DGN  1:DGN" VALUE 0x000162B1 REC_UBYTE_C 0 COMP_0283 0 1 BIT_MASK 0x0080 /end CHARACTERISTIC
/begin CHARACTERISTIC mfO2HR2 "0:Not DGN  1:DGN" VALUE 0x000162B1 REC_UBYTE_C 0 COMP_0283 0 1 BIT_MASK 0x0040 /end CHARACTERISTIC
/begin CHARACTERISTIC mfNSNG "0:Not DGN  1:DGN" VALUE 0x000162B1 REC_UBYTE_C 0 COMP_0283 0 1 BIT_MASK 0x0020 /end CHARACTERISTIC
/begin CHARACTERISTIC mfSCVSNG "0:Not DGN  1:DGN" VALUE 0x000162B1 REC_UBYTE_C 0 COMP_0283 0 1 BIT_MASK 0x0010 /end CHARACTERISTIC
/begin CHARACTERISTIC mfEGCSNG "0:Not DGN  1:DGN" VALUE 0x000162B1 REC_UBYTE_C 0 COMP_0283 0 1 BIT_MASK 0x0008 /end CHARACTERISTIC
/begin CHARACTERISTIC mfSAIRCS "0:Not DGN  1:DGN" VALUE 0x000162B1 REC_UBYTE_C 0 COMP_0283 0 1 BIT_MASK 0x0004 /end CHARACTERISTIC
/begin CHARACTERISTIC mfEVCN3 "0:Not DGN  1:DGN" VALUE 0x000162B1 REC_UBYTE_C 0 COMP_0283 0 1 BIT_MASK 0x0002 /end CHARACTERISTIC
/begin CHARACTERISTIC mfEVCNNG "0:Not DGN  1:DGN" VALUE 0x000162B1 REC_UBYTE_C 0 COMP_0283 0 1 BIT_MASK 0x0001 /end CHARACTERISTIC
/begin CHARACTERISTIC mDGNSW[10] "Flag mDGNSW[10]" VALUE 0x000162B2 REC_UBYTE_C 0 COMP_0283 0 255 /end CHARACTERISTIC
/begin CHARACTERISTIC mfINHSW "0:Not DGN  1:DGN" VALUE 0x000162B2 REC_UBYTE_C 0 COMP_0283 0 1 BIT_MASK 0x0080 /end CHARACTERISTIC
/begin CHARACTERISTIC mfOUTSNG "0:Not DGN  1:DGN" VALUE 0x000162B2 REC_UBYTE_C 0 COMP_0283 0 1 BIT_MASK 0x0040 /end CHARACTERISTIC
/begin CHARACTERISTIC mfSP1NG "0:Not DGN  1:DGN" VALUE 0x000162B2 REC_UBYTE_C 0 COMP_0283 0 1 BIT_MASK 0x0020 /end CHARACTERISTIC
/begin CHARACTERISTIC mfSP2NG "0:Not DGN  1:DGN" VALUE 0x000162B2 REC_UBYTE_C 0 COMP_0283 0 1 BIT_MASK 0x0010 /end CHARACTERISTIC
/begin CHARACTERISTIC mfSP3NG "0:Not DGN  1:DGN" VALUE 0x000162B2 REC_UBYTE_C 0 COMP_0283 0 1 BIT_MASK 0x0008 /end CHARACTERISTIC
/begin CHARACTERISTIC mfSP4NG "0:Not DGN  1:DGN" VALUE 0x000162B2 REC_UBYTE_C 0 COMP_0283 0 1 BIT_MASK 0x0004 /end CHARACTERISTIC
/begin CHARACTERISTIC mfLUFNG "0:Not DGN  1:DGN" VALUE 0x000162B2 REC_UBYTE_C 0 COMP_0283 0 1 BIT_MASK 0x0002 /end CHARACTERISTIC
/begin CHARACTERISTIC mfSHANG "0:Not DGN  1:DGN" VALUE 0x000162B2 REC_UBYTE_C 0 COMP_0283 0 1 BIT_MASK 0x0001 /end CHARACTERISTIC
/begin CHARACTERISTIC mDGNSW[11] "Flag mDGNSW[11]" VALUE 0x000162B3 REC_UBYTE_C 0 COMP_0283 0 255 /end CHARACTERISTIC
/begin CHARACTERISTIC mfSHBNG "0:Not DGN  1:DGN" VALUE 0x000162B3 REC_UBYTE_C 0 COMP_0283 0 1 BIT_MASK 0x0080 /end CHARACTERISTIC
/begin CHARACTERISTIC mfSP7NG "0:Not DGN  1:DGN" VALUE 0x000162B3 REC_UBYTE_C 0 COMP_0283 0 1 BIT_MASK 0x0040 /end CHARACTERISTIC
/begin CHARACTERISTIC mfOVRSNG "0:Not DGN  1:DGN" VALUE 0x000162B3 REC_UBYTE_C 0 COMP_0283 0 1 BIT_MASK 0x0020 /end CHARACTERISTIC
/begin CHARACTERISTIC mfLUSNG "0:Not DGN  1:DGN" VALUE 0x000162B3 REC_UBYTE_C 0 COMP_0283 0 1 BIT_MASK 0x0010 /end CHARACTERISTIC
/begin CHARACTERISTIC mfPLSNG "0:Not DGN  1:DGN" VALUE 0x000162B3 REC_UBYTE_C 0 COMP_0283 0 1 BIT_MASK 0x0008 /end CHARACTERISTIC
/begin CHARACTERISTIC mfATTHNG "0:Not DGN  1:DGN" VALUE 0x000162B3 REC_UBYTE_C 0 COMP_0283 0 1 BIT_MASK 0x0004 /end CHARACTERISTIC
/begin CHARACTERISTIC mfENINNG "0:Not DGN  1:DGN" VALUE 0x000162B3 REC_UBYTE_C 0 COMP_0283 0 1 BIT_MASK 0x0002 /end CHARACTERISTIC
/begin CHARACTERISTIC mfSOTMP "0:Not DGN  1:DGN" VALUE 0x000162B3 REC_UBYTE_C 0 COMP_0283 0 1 BIT_MASK 0x0001 /end CHARACTERISTIC
/begin CHARACTERISTIC mDGNSW[12] "Flag mDGNSW[12]" VALUE 0x000162B4 REC_UBYTE_C 0 COMP_0283 0 255 /end CHARACTERISTIC
/begin CHARACTERISTIC mfVTC2NG "0:Not DGN  1:DGN" VALUE 0x000162B4 REC_UBYTE_C 0 COMP_0283 0 1 BIT_MASK 0x0080 /end CHARACTERISTIC
/begin CHARACTERISTIC mfABCSNG "0:Not DGN  1:DGN" VALUE 0x000162B4 REC_UBYTE_C 0 COMP_0283 0 1 BIT_MASK 0x0040 /end CHARACTERISTIC
/begin CHARACTERISTIC mfPUS1NG "0:Not DGN  1:DGN" VALUE 0x000162B4 REC_UBYTE_C 0 COMP_0283 0 1 BIT_MASK 0x0020 /end CHARACTERISTIC
/begin CHARACTERISTIC mfPUS2NG "0:Not DGN  1:DGN" VALUE 0x000162B4 REC_UBYTE_C 0 COMP_0283 0 1 BIT_MASK 0x0010 /end CHARACTERISTIC
/begin CHARACTERISTIC mfFPCMNG "0:Not DGN  1:DGN" VALUE 0x000162B4 REC_UBYTE_C 0 COMP_0283 0 1 BIT_MASK 0x0008 /end CHARACTERISTIC
/begin CHARACTERISTIC mfWGC1NG "0:Not DGN  1:DGN" VALUE 0x000162B4 REC_UBYTE_C 0 COMP_0283 0 1 BIT_MASK 0x0004 /end CHARACTERISTIC
/begin CHARACTERISTIC mfWGC2NG "0:Not DGN  1:DGN" VALUE 0x000162B4 REC_UBYTE_C 0 COMP_0283 0 1 BIT_MASK 0x0002 /end CHARACTERISTIC
/begin CHARACTERISTIC mfABVSNG "0:Not DGN  1:DGN" VALUE 0x000162B4 REC_UBYTE_C 0 COMP_0283 0 1 BIT_MASK 0x0001 /end CHARACTERISTIC
/begin CHARACTERISTIC mDGNSW[13] "Flag mDGNSW[13]" VALUE 0x000162B5 REC_UBYTE_C 0 COMP_0283 0 255 /end CHARACTERISTIC
/begin CHARACTERISTIC mfO2PH1 "0:Not DGN  1:DGN" VALUE 0x000162B5 REC_UBYTE_C 0 COMP_0283 0 1 BIT_MASK 0x0080 /end CHARACTERISTIC
/begin CHARACTERISTIC mfO2PH2 "0:Not DGN  1:DGN" VALUE 0x000162B5 REC_UBYTE_C 0 COMP_0283 0 1 BIT_MASK 0x0040 /end CHARACTERISTIC
/begin CHARACTERISTIC mfLCMNG "0:Not DGN  1:DGN" VALUE 0x000162B5 REC_UBYTE_C 0 COMP_0283 0 1 BIT_MASK 0x0020 /end CHARACTERISTIC
/begin CHARACTERISTIC mfVIDNG "0:Not DGN  1:DGN" VALUE 0x000162B5 REC_UBYTE_C 0 COMP_0283 0 1 BIT_MASK 0x0010 /end CHARACTERISTIC
/begin CHARACTERISTIC mfCOMNG "0:Not DGN  1:DGN" VALUE 0x000162B5 REC_UBYTE_C 0 COMP_0283 0 1 BIT_MASK 0x0008 /end CHARACTERISTIC
/begin CHARACTERISTIC mfIMLCK "0:Not DGN  1:DGN" VALUE 0x000162B5 REC_UBYTE_C 0 COMP_0283 0 1 BIT_MASK 0x0004 /end CHARACTERISTIC
/begin CHARACTERISTIC mfKEYNG "0:Not DGN  1:DGN" VALUE 0x000162B5 REC_UBYTE_C 0 COMP_0283 0 1 BIT_MASK 0x0002 /end CHARACTERISTIC
/begin CHARACTERISTIC mfKEYER "0:Not DGN  1:DGN" VALUE 0x000162B5 REC_UBYTE_C 0 COMP_0283 0 1 BIT_MASK 0x0001 /end CHARACTERISTIC
/begin CHARACTERISTIC mDGNSW[14] "Flag mDGNSW[14]" VALUE 0x000162B6 REC_UBYTE_C 0 COMP_0283 0 255 /end CHARACTERISTIC
/begin CHARACTERISTIC mfFPRVPF "0:Not DGN  1:DGN" VALUE 0x000162B6 REC_UBYTE_C 0 COMP_0283 0 1 BIT_MASK 0x0080 /end CHARACTERISTIC
/begin CHARACTERISTIC mfTTHSNG "0:Not DGN  1:DGN" VALUE 0x000162B6 REC_UBYTE_C 0 COMP_0283 0 1 BIT_MASK 0x0040 /end CHARACTERISTIC
/begin CHARACTERISTIC mfEVPSYS "0:Not DGN  1:DGN" VALUE 0x000162B6 REC_UBYTE_C 0 COMP_0283 0 1 BIT_MASK 0x0020 /end CHARACTERISTIC
/begin CHARACTERISTIC mfSCVBSW "0:Not DGN  1:DGN" VALUE 0x000162B6 REC_UBYTE_C 0 COMP_0283 0 1 BIT_MASK 0x0010 /end CHARACTERISTIC
/begin CHARACTERISTIC mfCPCBSW "0:Not DGN  1:DGN" VALUE 0x000162B6 REC_UBYTE_C 0 COMP_0283 0 1 BIT_MASK 0x0008 /end CHARACTERISTIC
/begin CHARACTERISTIC mfMRNGR "0:Not DGN  1:DGN" VALUE 0x000162B6 REC_UBYTE_C 0 COMP_0283 0 1 BIT_MASK 0x0004 /end CHARACTERISTIC
/begin CHARACTERISTIC mfMRNGL "0:Not DGN  1:DGN" VALUE 0x000162B6 REC_UBYTE_C 0 COMP_0283 0 1 BIT_MASK 0x0002 /end CHARACTERISTIC
/begin CHARACTERISTIC mfEVPNG3 "0:Not DGN  1:DGN" VALUE 0x000162B6 REC_UBYTE_C 0 COMP_0283 0 1 BIT_MASK 0x0001 /end CHARACTERISTIC
/begin CHARACTERISTIC mDGNSW[15] "Flag mDGNSW[15]" VALUE 0x000162B7 REC_UBYTE_C 0 COMP_0283 0 255 /end CHARACTERISTIC
/begin CHARACTERISTIC mfMRNGR2 "0:Not DGN  1:DGN" VALUE 0x000162B7 REC_UBYTE_C 0 COMP_0283 0 1 BIT_MASK 0x0080 /end CHARACTERISTIC
/begin CHARACTERISTIC mfMRNGL2 "0:Not DGN  1:DGN" VALUE 0x000162B7 REC_UBYTE_C 0 COMP_0283 0 1 BIT_MASK 0x0040 /end CHARACTERISTIC
/begin CHARACTERISTIC mfKHTDGN "0:Not DGN  1:DGN" VALUE 0x000162B7 REC_UBYTE_C 0 COMP_0283 0 1 BIT_MASK 0x0020 /end CHARACTERISTIC
/begin CHARACTERISTIC mfKNKNG2 "0:Not DGN  1:DGN" VALUE 0x000162B7 REC_UBYTE_C 0 COMP_0283 0 1 BIT_MASK 0x0010 /end CHARACTERISTIC
/begin CHARACTERISTIC mfEVPNG2 "0:Not DGN  1:DGN" VALUE 0x000162B7 REC_UBYTE_C 0 COMP_0283 0 1 BIT_MASK 0x0008 /end CHARACTERISTIC
/begin CHARACTERISTIC mfEVCN2 "0:Not DGN  1:DGN" VALUE 0x000162B7 REC_UBYTE_C 0 COMP_0283 0 1 BIT_MASK 0x0004 /end CHARACTERISTIC
/begin CHARACTERISTIC mfCDCNG2 "0:Not DGN  1:DGN" VALUE 0x000162B7 REC_UBYTE_C 0 COMP_0283 0 1 BIT_MASK 0x0002 /end CHARACTERISTIC
/begin CHARACTERISTIC mfFLRNG "0:Not DGN  1:DGN" VALUE 0x000162B7 REC_UBYTE_C 0 COMP_0283 0 1 BIT_MASK 0x0001 /end CHARACTERISTIC
/begin CHARACTERISTIC mDGNSW[16] "Flag mDGNSW[16]" VALUE 0x000162B8 REC_UBYTE_C 0 COMP_0283 0 255 /end CHARACTERISTIC
/begin CHARACTERISTIC mfCDCNG3 "0:Not DGN  1:DGN" VALUE 0x000162B8 REC_UBYTE_C 0 COMP_0283 0 1 BIT_MASK 0x0080 /end CHARACTERISTIC
/begin CHARACTERISTIC mfCVBV2 "0:Not DGN  1:DGN" VALUE 0x000162B8 REC_UBYTE_C 0 COMP_0283 0 1 BIT_MASK 0x0020 /end CHARACTERISTIC
/begin CHARACTERISTIC mfCPCNG2 "0:Not DGN  1:DGN" VALUE 0x000162B8 REC_UBYTE_C 0 COMP_0283 0 1 BIT_MASK 0x0010 /end CHARACTERISTIC
/begin CHARACTERISTIC mfO2R2RO "0:Not DGN  1:DGN" VALUE 0x000162B8 REC_UBYTE_C 0 COMP_0283 0 1 BIT_MASK 0x0008 /end CHARACTERISTIC
/begin CHARACTERISTIC mfO2R2LO "0:Not DGN  1:DGN" VALUE 0x000162B8 REC_UBYTE_C 0 COMP_0283 0 1 BIT_MASK 0x0004 /end CHARACTERISTIC
/begin CHARACTERISTIC mfO2R2AV "0:Not DGN  1:DGN" VALUE 0x000162B8 REC_UBYTE_C 0 COMP_0283 0 1 BIT_MASK 0x0002 /end CHARACTERISTIC
/begin CHARACTERISTIC mfO2R1DN "0:Not DGN  1:DGN" VALUE 0x000162B8 REC_UBYTE_C 0 COMP_0283 0 1 BIT_MASK 0x0001 /end CHARACTERISTIC
/begin CHARACTERISTIC mDGNSW[17] "Flag mDGNSW[17]" VALUE 0x000162B9 REC_UBYTE_C 0 COMP_0283 0 255 /end CHARACTERISTIC
/begin CHARACTERISTIC mfO2F1HZ "0:Not DGN  1:DGN" VALUE 0x000162B9 REC_UBYTE_C 0 COMP_0283 0 1 BIT_MASK 0x0080 /end CHARACTERISTIC
/begin CHARACTERISTIC mfO2F1RS "0:Not DGN  1:DGN" VALUE 0x000162B9 REC_UBYTE_C 0 COMP_0283 0 1 BIT_MASK 0x0040 /end CHARACTERISTIC
/begin CHARACTERISTIC mfO2F1LS "0:Not DGN  1:DGN" VALUE 0x000162B9 REC_UBYTE_C 0 COMP_0283 0 1 BIT_MASK 0x0020 /end CHARACTERISTIC
/begin CHARACTERISTIC mfO2F1AV "0:Not DGN  1:DGN" VALUE 0x000162B9 REC_UBYTE_C 0 COMP_0283 0 1 BIT_MASK 0x0010 /end CHARACTERISTIC
/begin CHARACTERISTIC mfO2F2HZ "0:Not DGN  1:DGN" VALUE 0x000162B9 REC_UBYTE_C 0 COMP_0283 0 1 BIT_MASK 0x0008 /end CHARACTERISTIC
/begin CHARACTERISTIC mfO2F2RS "0:Not DGN  1:DGN" VALUE 0x000162B9 REC_UBYTE_C 0 COMP_0283 0 1 BIT_MASK 0x0004 /end CHARACTERISTIC
/begin CHARACTERISTIC mfO2F2LS "0:Not DGN  1:DGN" VALUE 0x000162B9 REC_UBYTE_C 0 COMP_0283 0 1 BIT_MASK 0x0002 /end CHARACTERISTIC
/begin CHARACTERISTIC mfO2R2DN "0:Not DGN  1:DGN" VALUE 0x000162B9 REC_UBYTE_C 0 COMP_0283 0 1 BIT_MASK 0x0001 /end CHARACTERISTIC
/begin CHARACTERISTIC mDGNSW[18] "Flag mDGNSW[18]" VALUE 0x000162BA REC_UBYTE_C 0 COMP_0283 0 255 /end CHARACTERISTIC
/begin CHARACTERISTIC mfO2F2AV "0:Not DGN  1:DGN" VALUE 0x000162BA REC_UBYTE_C 0 COMP_0283 0 1 BIT_MASK 0x0080 /end CHARACTERISTIC
/begin CHARACTERISTIC mfO2R1RO "0:Not DGN  1:DGN" VALUE 0x000162BA REC_UBYTE_C 0 COMP_0283 0 1 BIT_MASK 0x0040 /end CHARACTERISTIC
/begin CHARACTERISTIC mfO2R1LO "0:Not DGN  1:DGN" VALUE 0x000162BA REC_UBYTE_C 0 COMP_0283 0 1 BIT_MASK 0x0020 /end CHARACTERISTIC
/begin CHARACTERISTIC mfO2R1AV "0:Not DGN  1:DGN" VALUE 0x000162BA REC_UBYTE_C 0 COMP_0283 0 1 BIT_MASK 0x0010 /end CHARACTERISTIC
/begin CHARACTERISTIC mfLUCS2 "0:Not DGN  1:DGN" VALUE 0x000162BA REC_UBYTE_C 0 COMP_0283 0 1 BIT_MASK 0x0008 /end CHARACTERISTIC
/begin CHARACTERISTIC mfEGRNG2 "0:Not DGN  1:DGN" VALUE 0x000162BA REC_UBYTE_C 0 COMP_0283 0 1 BIT_MASK 0x0004 /end CHARACTERISTIC
/begin CHARACTERISTIC mfISCDN "0:Not DGN  1:DGN" VALUE 0x000162BA REC_UBYTE_C 0 COMP_0283 0 1 BIT_MASK 0x0002 /end CHARACTERISTIC
/begin CHARACTERISTIC mfTHMNG "0:Not DGN  1:DGN" VALUE 0x000162BA REC_UBYTE_C 0 COMP_0283 0 1 BIT_MASK 0x0001 /end CHARACTERISTIC
/begin CHARACTERISTIC mDGNSW[19] "Flag mDGNSW[19]" VALUE 0x000162BB REC_UBYTE_C 0 COMP_0283 0 255 /end CHARACTERISTIC
/begin CHARACTERISTIC mfEGRDN "0:Not DGN  1:DGN" VALUE 0x000162BB REC_UBYTE_C 0 COMP_0283 0 1 BIT_MASK 0x0080 /end CHARACTERISTIC
/begin CHARACTERISTIC mfSCVDN "0:Not DGN  1:DGN" VALUE 0x000162BB REC_UBYTE_C 0 COMP_0283 0 1 BIT_MASK 0x0040 /end CHARACTERISTIC
/begin CHARACTERISTIC mfSACSDN "0:Not DGN  1:DGN" VALUE 0x000162BB REC_UBYTE_C 0 COMP_0283 0 1 BIT_MASK 0x0020 /end CHARACTERISTIC
/begin CHARACTERISTIC mfVTCSV1 "0:Not DGN  1:DGN" VALUE 0x000162BB REC_UBYTE_C 0 COMP_0283 0 1 BIT_MASK 0x0010 /end CHARACTERISTIC
/begin CHARACTERISTIC mfVTCSV2 "0:Not DGN  1:DGN" VALUE 0x000162BB REC_UBYTE_C 0 COMP_0283 0 1 BIT_MASK 0x0008 /end CHARACTERISTIC
/begin CHARACTERISTIC mfIDLSDN "0:Not DGN  1:DGN" VALUE 0x000162BB REC_UBYTE_C 0 COMP_0283 0 1 BIT_MASK 0x0004 /end CHARACTERISTIC
/begin CHARACTERISTIC mfORFSDN "0:Not DGN  1:DGN" VALUE 0x000162BB REC_UBYTE_C 0 COMP_0283 0 1 BIT_MASK 0x0002 /end CHARACTERISTIC
/begin CHARACTERISTIC mfVVLDN "0:Not DGN  1:DGN" VALUE 0x000162BB REC_UBYTE_C 0 COMP_0283 0 1 BIT_MASK 0x0001 /end CHARACTERISTIC
/begin CHARACTERISTIC mDGNSW[20] "Flag mDGNSW[20]" VALUE 0x000162BC REC_UBYTE_C 0 COMP_0283 0 255 /end CHARACTERISTIC
/begin CHARACTERISTIC mfVIASDN "0:Not DGN  1:DGN" VALUE 0x000162BC REC_UBYTE_C 0 COMP_0283 0 1 BIT_MASK 0x0080 /end CHARACTERISTIC
/begin CHARACTERISTIC mfSCVSYS "0:Not DGN  1:DGN" VALUE 0x000162BC REC_UBYTE_C 0 COMP_0283 0 1 BIT_MASK 0x0040 /end CHARACTERISTIC
/begin CHARACTERISTIC mfSTMFNG "0:Not DGN  1:DGN" VALUE 0x000162BC REC_UBYTE_C 0 COMP_0283 0 1 BIT_MASK 0x0020 /end CHARACTERISTIC
/begin CHARACTERISTIC mfPRINNG "0:Not DGN  1:DGN" VALUE 0x000162BC REC_UBYTE_C 0 COMP_0283 0 1 BIT_MASK 0x0010 /end CHARACTERISTIC
/begin CHARACTERISTIC mfSTMDNG "0:Not DGN  1:DGN" VALUE 0x000162BC REC_UBYTE_C 0 COMP_0283 0 1 BIT_MASK 0x0008 /end CHARACTERISTIC
/begin CHARACTERISTIC mfOPSNG "0:Not DGN  1:DGN" VALUE 0x000162BC REC_UBYTE_C 0 COMP_0283 0 1 BIT_MASK 0x0004 /end CHARACTERISTIC
/begin CHARACTERISTIC mfCLUDNG "0:Not DGN  1:DGN" VALUE 0x000162BC REC_UBYTE_C 0 COMP_0283 0 1 BIT_MASK 0x0002 /end CHARACTERISTIC
/begin CHARACTERISTIC mfCPLDNG "0:Not DGN  1:DGN" VALUE 0x000162BC REC_UBYTE_C 0 COMP_0283 0 1 BIT_MASK 0x0001 /end CHARACTERISTIC
/begin CHARACTERISTIC mDGNSW[21] "Flag mDGNSW[21]" VALUE 0x000162BD REC_UBYTE_C 0 COMP_0283 0 255 /end CHARACTERISTIC
/begin CHARACTERISTIC mfFPSNG "0:Not DGN  1:DGN" VALUE 0x000162BD REC_UBYTE_C 0 COMP_0283 0 1 BIT_MASK 0x0080 /end CHARACTERISTIC
/begin CHARACTERISTIC mfPREGNG "0:Not DGN  1:DGN" VALUE 0x000162BD REC_UBYTE_C 0 COMP_0283 0 1 BIT_MASK 0x0040 /end CHARACTERISTIC
/begin CHARACTERISTIC mfCLUFNG "0:Not DGN  1:DGN" VALUE 0x000162BD REC_UBYTE_C 0 COMP_0283 0 1 BIT_MASK 0x0020 /end CHARACTERISTIC
/begin CHARACTERISTIC mfCPLFNG "0:Not DGN  1:DGN" VALUE 0x000162BD REC_UBYTE_C 0 COMP_0283 0 1 BIT_MASK 0x0010 /end CHARACTERISTIC
/begin CHARACTERISTIC mfSSFNG "0:Not DGN  1:DGN" VALUE 0x000162BD REC_UBYTE_C 0 COMP_0283 0 1 BIT_MASK 0x0008 /end CHARACTERISTIC
/begin CHARACTERISTIC mfSSDNG "0:Not DGN  1:DGN" VALUE 0x000162BD REC_UBYTE_C 0 COMP_0283 0 1 BIT_MASK 0x0004 /end CHARACTERISTIC
/begin CHARACTERISTIC mfLSSDNG "0:Not DGN  1:DGN" VALUE 0x000162BD REC_UBYTE_C 0 COMP_0283 0 1 BIT_MASK 0x0002 /end CHARACTERISTIC
/begin CHARACTERISTIC mfSCVPSD "0:Not DGN  1:DGN" VALUE 0x000162BD REC_UBYTE_C 0 COMP_0283 0 1 BIT_MASK 0x0001 /end CHARACTERISTIC
/begin CHARACTERISTIC mDGNSW[22] "Flag mDGNSW[22]" VALUE 0x000162BE REC_UBYTE_C 0 COMP_0283 0 255 /end CHARACTERISTIC
/begin CHARACTERISTIC mfVIAS2D "0:Not DGN  1:DGN" VALUE 0x000162BE REC_UBYTE_C 0 COMP_0283 0 1 BIT_MASK 0x0080 /end CHARACTERISTIC
/begin CHARACTERISTIC mfTANGR2 "0:Not DGN  1:DGN" VALUE 0x000162BE REC_UBYTE_C 0 COMP_0283 0 1 BIT_MASK 0x0040 /end CHARACTERISTIC
/begin CHARACTERISTIC mfTANGH2 "0:Not DGN  1:DGN" VALUE 0x000162BE REC_UBYTE_C 0 COMP_0283 0 1 BIT_MASK 0x0020 /end CHARACTERISTIC
/begin CHARACTERISTIC mfTANGL2 "0:Not DGN  1:DGN" VALUE 0x000162BE REC_UBYTE_C 0 COMP_0283 0 1 BIT_MASK 0x0010 /end CHARACTERISTIC
/begin CHARACTERISTIC mfSCV1NG "0:Not DGN  1:DGN" VALUE 0x000162BE REC_UBYTE_C 0 COMP_0283 0 1 BIT_MASK 0x0008 /end CHARACTERISTIC
/begin CHARACTERISTIC mfSCV2NG "0:Not DGN  1:DGN" VALUE 0x000162BE REC_UBYTE_C 0 COMP_0283 0 1 BIT_MASK 0x0004 /end CHARACTERISTIC
/begin CHARACTERISTIC mfVTSVE1 "0:Not DGN  1:DGN" VALUE 0x000162BE REC_UBYTE_C 0 COMP_0283 0 1 BIT_MASK 0x0002 /end CHARACTERISTIC
/begin CHARACTERISTIC mfVTSVE2 "0:Not DGN  1:DGN" VALUE 0x000162BE REC_UBYTE_C 0 COMP_0283 0 1 BIT_MASK 0x0001 /end CHARACTERISTIC
/begin CHARACTERISTIC mDGNSW[23] "Flag mDGNSW[23]" VALUE 0x000162BF REC_UBYTE_C 0 COMP_0283 0 255 /end CHARACTERISTIC
/begin CHARACTERISTIC mfEVP2NG "0:Not DGN  1:DGN" VALUE 0x000162BF REC_UBYTE_C 0 COMP_0283 0 1 BIT_MASK 0x0080 /end CHARACTERISTIC
/begin CHARACTERISTIC mfFGPNG1 "0:Not DGN  1:DGN" VALUE 0x000162BF REC_UBYTE_C 0 COMP_0283 0 1 BIT_MASK 0x0040 /end CHARACTERISTIC
/begin CHARACTERISTIC mfFGPNG2 "0:Not DGN  1:DGN" VALUE 0x000162BF REC_UBYTE_C 0 COMP_0283 0 1 BIT_MASK 0x0020 /end CHARACTERISTIC
/begin CHARACTERISTIC mfFGPNG3 "0:Not DGN  1:DGN" VALUE 0x000162BF REC_UBYTE_C 0 COMP_0283 0 1 BIT_MASK 0x0010 /end CHARACTERISTIC
/begin CHARACTERISTIC mfFGMNG "0:Not DGN  1:DGN" VALUE 0x000162BF REC_UBYTE_C 0 COMP_0283 0 1 BIT_MASK 0x0008 /end CHARACTERISTIC
/begin CHARACTERISTIC mDGNSW[24] "Flag mDGNSW[24]" VALUE 0x000162C0 REC_UBYTE_C 0 COMP_0283 0 255 /end CHARACTERISTIC
/begin CHARACTERISTIC mfODFNG "0:Not DGN  1:DGN" VALUE 0x000162C0 REC_UBYTE_C 0 COMP_0283 0 1 BIT_MASK 0x0080 /end CHARACTERISTIC
/begin CHARACTERISTIC mfROTWNG "0:Not DGN  1:DGN" VALUE 0x000162C0 REC_UBYTE_C 0 COMP_0283 0 1 BIT_MASK 0x0040 /end CHARACTERISTIC
/begin CHARACTERISTIC mfDCS1NG "0:Not DGN  1:DGN" VALUE 0x000162C0 REC_UBYTE_C 0 COMP_0283 0 1 BIT_MASK 0x0020 /end CHARACTERISTIC
/begin CHARACTERISTIC mfDCS2NG "0:Not DGN  1:DGN" VALUE 0x000162C0 REC_UBYTE_C 0 COMP_0283 0 1 BIT_MASK 0x0010 /end CHARACTERISTIC
/begin CHARACTERISTIC mfDCS3NG "0:Not DGN  1:DGN" VALUE 0x000162C0 REC_UBYTE_C 0 COMP_0283 0 1 BIT_MASK 0x0008 /end CHARACTERISTIC
/begin CHARACTERISTIC mfDPS1NG "0:Not DGN  1:DGN" VALUE 0x000162C0 REC_UBYTE_C 0 COMP_0283 0 1 BIT_MASK 0x0004 /end CHARACTERISTIC
/begin CHARACTERISTIC mfDPS2NG "0:Not DGN  1:DGN" VALUE 0x000162C0 REC_UBYTE_C 0 COMP_0283 0 1 BIT_MASK 0x0002 /end CHARACTERISTIC
/begin CHARACTERISTIC mfDPS3NG "0:Not DGN  1:DGN" VALUE 0x000162C0 REC_UBYTE_C 0 COMP_0283 0 1 BIT_MASK 0x0001 /end CHARACTERISTIC
/begin CHARACTERISTIC mDGNSW[25] "Flag mDGNSW[25]" VALUE 0x000162C1 REC_UBYTE_C 0 COMP_0283 0 255 /end CHARACTERISTIC
/begin CHARACTERISTIC mfVBONG8 "0:Not DGN  1:DGN" VALUE 0x000162C1 REC_UBYTE_C 0 COMP_0283 0 1 BIT_MASK 0x0080 /end CHARACTERISTIC
/begin CHARACTERISTIC mfVBONG7 "0:Not DGN  1:DGN" VALUE 0x000162C1 REC_UBYTE_C 0 COMP_0283 0 1 BIT_MASK 0x0040 /end CHARACTERISTIC
/begin CHARACTERISTIC mfVBONG6 "0:Not DGN  1:DGN" VALUE 0x000162C1 REC_UBYTE_C 0 COMP_0283 0 1 BIT_MASK 0x0020 /end CHARACTERISTIC
/begin CHARACTERISTIC mfVBONG5 "0:Not DGN  1:DGN" VALUE 0x000162C1 REC_UBYTE_C 0 COMP_0283 0 1 BIT_MASK 0x0010 /end CHARACTERISTIC
/begin CHARACTERISTIC mfVBONG4 "0:Not DGN  1:DGN" VALUE 0x000162C1 REC_UBYTE_C 0 COMP_0283 0 1 BIT_MASK 0x0008 /end CHARACTERISTIC
/begin CHARACTERISTIC mfVBONG3 "0:Not DGN  1:DGN" VALUE 0x000162C1 REC_UBYTE_C 0 COMP_0283 0 1 BIT_MASK 0x0004 /end CHARACTERISTIC
/begin CHARACTERISTIC mfVBONG2 "0:Not DGN  1:DGN" VALUE 0x000162C1 REC_UBYTE_C 0 COMP_0283 0 1 BIT_MASK 0x0002 /end CHARACTERISTIC
/begin CHARACTERISTIC mfVBONG1 "0:Not DGN  1:DGN" VALUE 0x000162C1 REC_UBYTE_C 0 COMP_0283 0 1 BIT_MASK 0x0001 /end CHARACTERISTIC
/begin CHARACTERISTIC mDGNSW[26] "Flag mDGNSW[26]" VALUE 0x000162C2 REC_UBYTE_C 0 COMP_0283 0 255 /end CHARACTERISTIC
/begin CHARACTERISTIC mfDUCMB "0:Not DGN  1:DGN" VALUE 0x000162C2 REC_UBYTE_C 0 COMP_0283 0 1 BIT_MASK 0x0080 /end CHARACTERISTIC
/begin CHARACTERISTIC mfDUFLB "0:Not DGN  1:DGN" VALUE 0x000162C2 REC_UBYTE_C 0 COMP_0283 0 1 BIT_MASK 0x0040 /end CHARACTERISTIC
/begin CHARACTERISTIC mfSCVDCN "0:Not DGN  1:DGN" VALUE 0x000162C2 REC_UBYTE_C 0 COMP_0283 0 1 BIT_MASK 0x0020 /end CHARACTERISTIC
/begin CHARACTERISTIC mfDUCMCK "0:Not DGN  1:DGN" VALUE 0x000162C2 REC_UBYTE_C 0 COMP_0283 0 1 BIT_MASK 0x0010 /end CHARACTERISTIC
/begin CHARACTERISTIC mfVBONG "0:Not DGN  1:DGN" VALUE 0x000162C2 REC_UBYTE_C 0 COMP_0283 0 1 BIT_MASK 0x0008 /end CHARACTERISTIC
/begin CHARACTERISTIC mfACLNG "0:Not DGN  1:DGN" VALUE 0x000162C2 REC_UBYTE_C 0 COMP_0283 0 1 BIT_MASK 0x0004 /end CHARACTERISTIC
/begin CHARACTERISTIC mfACMPNG "0:Not DGN  1:DGN" VALUE 0x000162C2 REC_UBYTE_C 0 COMP_0283 0 1 BIT_MASK 0x0002 /end CHARACTERISTIC
/begin CHARACTERISTIC mfPPSNG "0:Not DGN  1:DGN" VALUE 0x000162C2 REC_UBYTE_C 0 COMP_0283 0 1 BIT_MASK 0x0001 /end CHARACTERISTIC
/begin CHARACTERISTIC mDGNSW[27] "Flag mDGNSW[27]" VALUE 0x000162C3 REC_UBYTE_C 0 COMP_0283 0 255 /end CHARACTERISTIC
/begin CHARACTERISTIC mfSYNCNG "0:Not DGN  1:DGN" VALUE 0x000162C3 REC_UBYTE_C 0 COMP_0283 0 1 BIT_MASK 0x0080 /end CHARACTERISTIC
/begin CHARACTERISTIC mfALUNG "0:Not DGN  1:DGN" VALUE 0x000162C3 REC_UBYTE_C 0 COMP_0283 0 1 BIT_MASK 0x0040 /end CHARACTERISTIC
/begin CHARACTERISTIC mfQCKNG "0:Not DGN  1:DGN" VALUE 0x000162C3 REC_UBYTE_C 0 COMP_0283 0 1 BIT_MASK 0x0020 /end CHARACTERISTIC
/begin CHARACTERISTIC mfCALCNG "0:Not DGN  1:DGN" VALUE 0x000162C3 REC_UBYTE_C 0 COMP_0283 0 1 BIT_MASK 0x0010 /end CHARACTERISTIC
/begin CHARACTERISTIC mfCANGNE "0:Not DGN  1:DGN" VALUE 0x000162C3 REC_UBYTE_C 0 COMP_0283 0 1 BIT_MASK 0x0008 /end CHARACTERISTIC
/begin CHARACTERISTIC mfADNG "0:Not DGN  1:DGN" VALUE 0x000162C3 REC_UBYTE_C 0 COMP_0283 0 1 BIT_MASK 0x0004 /end CHARACTERISTIC
/begin CHARACTERISTIC mfIC3NG "0:Not DGN  1:DGN" VALUE 0x000162C3 REC_UBYTE_C 0 COMP_0283 0 1 BIT_MASK 0x0002 /end CHARACTERISTIC
/begin CHARACTERISTIC mfCANNG "0:Not DGN  1:DGN" VALUE 0x000162C3 REC_UBYTE_C 0 COMP_0283 0 1 BIT_MASK 0x0001 /end CHARACTERISTIC
/begin CHARACTERISTIC mDGNSW[28] "Flag mDGNSW[28]" VALUE 0x000162C4 REC_UBYTE_C 0 COMP_0283 0 255 /end CHARACTERISTIC
/begin CHARACTERISTIC mfINONG8 "0:Not DGN  1:DGN" VALUE 0x000162C4 REC_UBYTE_C 0 COMP_0283 0 1 BIT_MASK 0x0080 /end CHARACTERISTIC
/begin CHARACTERISTIC mfINONG7 "0:Not DGN  1:DGN" VALUE 0x000162C4 REC_UBYTE_C 0 COMP_0283 0 1 BIT_MASK 0x0040 /end CHARACTERISTIC
/begin CHARACTERISTIC mfINONG6 "0:Not DGN  1:DGN" VALUE 0x000162C4 REC_UBYTE_C 0 COMP_0283 0 1 BIT_MASK 0x0020 /end CHARACTERISTIC
/begin CHARACTERISTIC mfINONG5 "0:Not DGN  1:DGN" VALUE 0x000162C4 REC_UBYTE_C 0 COMP_0283 0 1 BIT_MASK 0x0010 /end CHARACTERISTIC
/begin CHARACTERISTIC mfINONG4 "0:Not DGN  1:DGN" VALUE 0x000162C4 REC_UBYTE_C 0 COMP_0283 0 1 BIT_MASK 0x0008 /end CHARACTERISTIC
/begin CHARACTERISTIC mfINONG3 "0:Not DGN  1:DGN" VALUE 0x000162C4 REC_UBYTE_C 0 COMP_0283 0 1 BIT_MASK 0x0004 /end CHARACTERISTIC
/begin CHARACTERISTIC mfINONG2 "0:Not DGN  1:DGN" VALUE 0x000162C4 REC_UBYTE_C 0 COMP_0283 0 1 BIT_MASK 0x0002 /end CHARACTERISTIC
/begin CHARACTERISTIC mfINONG1 "0:Not DGN  1:DGN" VALUE 0x000162C4 REC_UBYTE_C 0 COMP_0283 0 1 BIT_MASK 0x0001 /end CHARACTERISTIC
/begin CHARACTERISTIC mDGNSW[29] "Flag mDGNSW[29]" VALUE 0x000162C5 REC_UBYTE_C 0 COMP_0283 0 255 /end CHARACTERISTIC
/begin CHARACTERISTIC mfBSNG1 "0:Not DGN  1:DGN" VALUE 0x000162C5 REC_UBYTE_C 0 COMP_0283 0 1 BIT_MASK 0x0080 /end CHARACTERISTIC
/begin CHARACTERISTIC mfBSNG2 "0:Not DGN  1:DGN" VALUE 0x000162C5 REC_UBYTE_C 0 COMP_0283 0 1 BIT_MASK 0x0040 /end CHARACTERISTIC
/begin CHARACTERISTIC mfFMUMH1 "0:Not DGN  1:DGN" VALUE 0x000162C5 REC_UBYTE_C 0 COMP_0283 0 1 BIT_MASK 0x0020 /end CHARACTERISTIC
/begin CHARACTERISTIC mfFMUMH2 "0:Not DGN  1:DGN" VALUE 0x000162C5 REC_UBYTE_C 0 COMP_0283 0 1 BIT_MASK 0x0010 /end CHARACTERISTIC
/begin CHARACTERISTIC mfBRMSNG "0:Not DGN  1:DGN" VALUE 0x000162C5 REC_UBYTE_C 0 COMP_0283 0 1 BIT_MASK 0x0008 /end CHARACTERISTIC
/begin CHARACTERISTIC mfSWSEN "0:Not DGN  1:DGN" VALUE 0x000162C5 REC_UBYTE_C 0 COMP_0283 0 1 BIT_MASK 0x0002 /end CHARACTERISTIC
/begin CHARACTERISTIC mfBSNG3 "0:Not DGN  1:DGN" VALUE 0x000162C5 REC_UBYTE_C 0 COMP_0283 0 1 BIT_MASK 0x0001 /end CHARACTERISTIC
/begin CHARACTERISTIC mDGNSW[30] "Flag mDGNSW[30]" VALUE 0x000162C6 REC_UBYTE_C 0 COMP_0283 0 255 /end CHARACTERISTIC
/begin CHARACTERISTIC mfAPS1NG "0:Not DGN  1:DGN" VALUE 0x000162C6 REC_UBYTE_C 0 COMP_0283 0 1 BIT_MASK 0x0080 /end CHARACTERISTIC
/begin CHARACTERISTIC mfAPS2NG "0:Not DGN  1:DGN" VALUE 0x000162C6 REC_UBYTE_C 0 COMP_0283 0 1 BIT_MASK 0x0040 /end CHARACTERISTIC
/begin CHARACTERISTIC mfAPSXNG "0:Not DGN  1:DGN" VALUE 0x000162C6 REC_UBYTE_C 0 COMP_0283 0 1 BIT_MASK 0x0020 /end CHARACTERISTIC
/begin CHARACTERISTIC mfSCVKNG "0:Not DGN  1:DGN" VALUE 0x000162C6 REC_UBYTE_C 0 COMP_0283 0 1 BIT_MASK 0x0010 /end CHARACTERISTIC
/begin CHARACTERISTIC mfCNGNE2 "0:Not DGN  1:DGN" VALUE 0x000162C6 REC_UBYTE_C 0 COMP_0283 0 1 BIT_MASK 0x0008 /end CHARACTERISTIC
/begin CHARACTERISTIC mfCANNG2 "0:Not DGN  1:DGN" VALUE 0x000162C6 REC_UBYTE_C 0 COMP_0283 0 1 BIT_MASK 0x0004 /end CHARACTERISTIC
/begin CHARACTERISTIC mfSCVPSN "0:Not DGN  1:DGN" VALUE 0x000162C6 REC_UBYTE_C 0 COMP_0283 0 1 BIT_MASK 0x0002 /end CHARACTERISTIC
/begin CHARACTERISTIC mfAVCCNG "0:Not DGN  1:DGN" VALUE 0x000162C6 REC_UBYTE_C 0 COMP_0283 0 1 BIT_MASK 0x0001 /end CHARACTERISTIC
/begin CHARACTERISTIC mDGNSW[31] "Flag mDGNSW[31]" VALUE 0x000162C7 REC_UBYTE_C 0 COMP_0283 0 255 /end CHARACTERISTIC
/begin CHARACTERISTIC mfTPS1NG "0:Not DGN  1:DGN" VALUE 0x000162C7 REC_UBYTE_C 0 COMP_0283 0 1 BIT_MASK 0x0080 /end CHARACTERISTIC
/begin CHARACTERISTIC mfTPS2NG "0:Not DGN  1:DGN" VALUE 0x000162C7 REC_UBYTE_C 0 COMP_0283 0 1 BIT_MASK 0x0040 /end CHARACTERISTIC
/begin CHARACTERISTIC mfTPSXNG "0:Not DGN  1:DGN" VALUE 0x000162C7 REC_UBYTE_C 0 COMP_0283 0 1 BIT_MASK 0x0020 /end CHARACTERISTIC
/begin CHARACTERISTIC mfTPS4NG "0:Not DGN  1:DGN" VALUE 0x000162C7 REC_UBYTE_C 0 COMP_0283 0 1 BIT_MASK 0x0010 /end CHARACTERISTIC
/begin CHARACTERISTIC mfTPCLN2 "0:Not DGN  1:DGN" VALUE 0x000162C7 REC_UBYTE_C 0 COMP_0283 0 1 BIT_MASK 0x0008 /end CHARACTERISTIC
/begin CHARACTERISTIC mfTLRNG2 "0:Not DGN  1:DGN" VALUE 0x000162C7 REC_UBYTE_C 0 COMP_0283 0 1 BIT_MASK 0x0004 /end CHARACTERISTIC
/begin CHARACTERISTIC mfTPCLNG "0:Not DGN  1:DGN" VALUE 0x000162C7 REC_UBYTE_C 0 COMP_0283 0 1 BIT_MASK 0x0002 /end CHARACTERISTIC
/begin CHARACTERISTIC mfTPLRNG "0:Not DGN  1:DGN" VALUE 0x000162C7 REC_UBYTE_C 0 COMP_0283 0 1 BIT_MASK 0x0001 /end CHARACTERISTIC
/begin CHARACTERISTIC mDGNSW[32] "Flag mDGNSW[32]" VALUE 0x000162C8 REC_UBYTE_C 0 COMP_0283 0 255 /end CHARACTERISTIC
/begin CHARACTERISTIC mfTHFBNG "0:Not DGN  1:DGN" VALUE 0x000162C8 REC_UBYTE_C 0 COMP_0283 0 1 BIT_MASK 0x0080 /end CHARACTERISTIC
/begin CHARACTERISTIC mfCSXNG "0:Not DGN  1:DGN" VALUE 0x000162C8 REC_UBYTE_C 0 COMP_0283 0 1 BIT_MASK 0x0040 /end CHARACTERISTIC
/begin CHARACTERISTIC mfVAPXNG "0:Not DGN  1:DGN" VALUE 0x000162C8 REC_UBYTE_C 0 COMP_0283 0 1 BIT_MASK 0x0020 /end CHARACTERISTIC
/begin CHARACTERISTIC mfAPOXNG "0:Not DGN  1:DGN" VALUE 0x000162C8 REC_UBYTE_C 0 COMP_0283 0 1 BIT_MASK 0x0010 /end CHARACTERISTIC
/begin CHARACTERISTIC mfTGTXNG "0:Not DGN  1:DGN" VALUE 0x000162C8 REC_UBYTE_C 0 COMP_0283 0 1 BIT_MASK 0x0008 /end CHARACTERISTIC
/begin CHARACTERISTIC mfTWNXNG "0:Not DGN  1:DGN" VALUE 0x000162C8 REC_UBYTE_C 0 COMP_0283 0 1 BIT_MASK 0x0004 /end CHARACTERISTIC
/begin CHARACTERISTIC mfSERVNG "0:Not DGN  1:DGN" VALUE 0x000162C8 REC_UBYTE_C 0 COMP_0283 0 1 BIT_MASK 0x0002 /end CHARACTERISTIC
/begin CHARACTERISTIC mfASTRNG "0:Not DGN  1:DGN" VALUE 0x000162C8 REC_UBYTE_C 0 COMP_0283 0 1 BIT_MASK 0x0001 /end CHARACTERISTIC
/begin CHARACTERISTIC mDGNSW[33] "Flag mDGNSW[33]" VALUE 0x000162C9 REC_UBYTE_C 0 COMP_0283 0 255 /end CHARACTERISTIC
/begin CHARACTERISTIC mfSCING "0:Not DGN  1:DGN" VALUE 0x000162C9 REC_UBYTE_C 0 COMP_0283 0 1 BIT_MASK 0x0080 /end CHARACTERISTIC
/begin CHARACTERISTIC mfSCINGS "0:Not DGN  1:DGN" VALUE 0x000162C9 REC_UBYTE_C 0 COMP_0283 0 1 BIT_MASK 0x0040 /end CHARACTERISTIC
/begin CHARACTERISTIC mfCTLNNG "0:Not DGN  1:DGN" VALUE 0x000162C9 REC_UBYTE_C 0 COMP_0283 0 1 BIT_MASK 0x0020 /end CHARACTERISTIC
/begin AXIS_PTS mLPINJNE "12.5rpm" 0x000117C7 NO_INPUT_QUANTITY REC_AXIS_UBYTE 0 COMP_0006 8 0 3187.5 /end AXIS_PTS
/begin AXIS_PTS mTTWNPILN "X-50℃" 0x00012A72 NO_INPUT_QUANTITY REC_AXIS_UBYTE 0 COMP_0035 8 -50 205 /end AXIS_PTS
/begin AXIS_PTS mNSLP "12.5rpm" 0x000119B0 NO_INPUT_QUANTITY REC_AXIS_UBYTE 0 COMP_0006 8 0 3187.5 /end AXIS_PTS
/begin AXIS_PTS mLTMHOS "4ms" 0x0001186F NO_INPUT_QUANTITY REC_AXIS_UBYTE 0 COMP_0250 8 0 1020 /end AXIS_PTS
/begin AXIS_PTS mLTPADHD2 "1-" 0x000134FA NO_INPUT_QUANTITY REC_AXIS_UWORD 0 COMP_0455_S 8 -32768 32767 /end AXIS_PTS
/begin AXIS_PTS mLTPADHN2 "1-" 0x0001350A NO_INPUT_QUANTITY REC_AXIS_UWORD 0 COMP_0455_S 8 -32768 32767 /end AXIS_PTS
/begin AXIS_PTS mLTPADHNB "1deg" 0x0001351A NO_INPUT_QUANTITY REC_AXIS_UWORD 0 COMP_0456_S 8 -32768 32767 /end AXIS_PTS
/begin AXIS_PTS mLTPADHNC "1deg" 0x0001352A NO_INPUT_QUANTITY REC_AXIS_UWORD 0 COMP_0456_S 8 -32768 32767 /end AXIS_PTS
/begin AXIS_PTS mLTPFTPNL "0.125ms" 0x00011897 NO_INPUT_QUANTITY REC_AXIS_UBYTE 0 COMP_0001 8 0 31.875 /end AXIS_PTS
/begin AXIS_PTS mLTTPH "1/2048ms" 0x0001366A NO_INPUT_QUANTITY REC_AXIS_UWORD 0 COMP_0144 8 0 31.999495335 /end AXIS_PTS
/begin AXIS_PTS mLTTPHB "1/2048ms" 0x0001367A NO_INPUT_QUANTITY REC_AXIS_UWORD 0 COMP_0144 8 0 31.999495335 /end AXIS_PTS
/begin AXIS_PTS mLTTPHC "1/2048ms" 0x0001368A NO_INPUT_QUANTITY REC_AXIS_UWORD 0 COMP_0144 8 0 31.999495335 /end AXIS_PTS
/begin AXIS_PTS mTPMBTRTP "0.078125mV" 0x00014B52 NO_INPUT_QUANTITY REC_AXIS_UWORD 0 COMP_0050 8 0 5119.921875 /end AXIS_PTS
/begin AXIS_PTS mTTRIDXNE "12.5rpm" 0x000153E0 NO_INPUT_QUANTITY REC_AXIS_UWORD 0 COMP_0006 8 0 819187.5 /end AXIS_PTS
/begin AXIS_PTS mTRQPFLT "0.07808MPa" 0x0001271A NO_INPUT_QUANTITY REC_AXIS_UBYTE 0 COMP_0087_S 8 0 19.9104 /end AXIS_PTS
/begin AXIS_PTS mTPIGNE "12.5rpm" 0x00014B12 NO_INPUT_QUANTITY REC_AXIS_UWORD 0 COMP_0006 8 0 819187.5 /end AXIS_PTS
/begin AXIS_PTS mLVBHOS "1.28*10^6mV^2" 0x000118A7 NO_INPUT_QUANTITY REC_AXIS_UBYTE 0 COMP_0457_S 8 0 326400000 /end AXIS_PTS
/begin AXIS_PTS mLTVGUSED "X-50℃" 0x0001189F NO_INPUT_QUANTITY REC_AXIS_UBYTE 0 COMP_0035 8 -50 205 /end AXIS_PTS
/begin AXIS_PTS mTTVONBP "25rpm" 0x00012A12 NO_INPUT_QUANTITY REC_AXIS_UBYTE 0 COMP_0000 8 0 6375 /end AXIS_PTS
/begin AXIS_PTS mTTVONBPS "25rpm" 0x00012A1A NO_INPUT_QUANTITY REC_AXIS_UBYTE 0 COMP_0000 8 0 6375 /end AXIS_PTS
/begin AXIS_PTS mLTWNH "X-50℃" 0x000136BA NO_INPUT_QUANTITY REC_AXIS_UWORD 0 COMP_0035 8 -50 65485 /end AXIS_PTS
/begin AXIS_PTS mLTWNHB "X-50℃" 0x000136CA NO_INPUT_QUANTITY REC_AXIS_UWORD 0 COMP_0035 8 -50 65485 /end AXIS_PTS
/begin AXIS_PTS mLTWNHC "X-50℃" 0x000136DA NO_INPUT_QUANTITY REC_AXIS_UWORD 0 COMP_0035 8 -50 65485 /end AXIS_PTS
/begin AXIS_PTS mLTWNHD "X-50℃" 0x000136EA NO_INPUT_QUANTITY REC_AXIS_UWORD 0 COMP_0035 8 -50 65485 /end AXIS_PTS
/begin AXIS_PTS mLTWNHN "X-50℃" 0x000136FA NO_INPUT_QUANTITY REC_AXIS_UWORD 0 COMP_0035 8 -50 65485 /end AXIS_PTS
/begin AXIS_PTS mLTWNHNB "X-50℃" 0x0001370A NO_INPUT_QUANTITY REC_AXIS_UWORD 0 COMP_0035 8 -50 65485 /end AXIS_PTS
/begin AXIS_PTS mLTWNHNC "X-50℃" 0x0001371A NO_INPUT_QUANTITY REC_AXIS_UWORD 0 COMP_0035 8 -50 65485 /end AXIS_PTS
/begin AXIS_PTS mLVGUCOD "X-50℃" 0x000118AF NO_INPUT_QUANTITY REC_AXIS_UBYTE 0 COMP_0035 8 -50 205 /end AXIS_PTS
/begin AXIS_PTS mLVGUCWD "0.625X-40℃" 0x000118B7 NO_INPUT_QUANTITY REC_AXIS_UBYTE 0 COMP_0356 8 -40 119.375 /end AXIS_PTS
/begin AXIS_PTS mTRERVSP "0.1km/h" 0x00014D86 NO_INPUT_QUANTITY REC_AXIS_UWORD 0 COMP_0436 8 0 6553.5 /end AXIS_PTS
/begin AXIS_PTS mVTCTWIN "X-50℃" 0x00012C86 NO_INPUT_QUANTITY REC_AXIS_UBYTE 0 COMP_0035 8 -50 205 /end AXIS_PTS
/begin AXIS_PTS mVTCTOIL "X-50℃" 0x00012C76 NO_INPUT_QUANTITY REC_AXIS_UBYTE 0 COMP_0035 8 -50 205 /end AXIS_PTS
/begin AXIS_PTS mVTCTOILE "X-50℃" 0x00012C7E NO_INPUT_QUANTITY REC_AXIS_UBYTE 0 COMP_0035 8 -50 205 /end AXIS_PTS
/begin AXIS_PTS mVTFITWIN "X-50℃" 0x00012C8E NO_INPUT_QUANTITY REC_AXIS_UBYTE 0 COMP_0035 8 -50 205 /end AXIS_PTS
/begin AXIS_PTS mVTRGDMD "0.5degCA" 0x00012C96 NO_INPUT_QUANTITY REC_AXIS_UBYTE 0 COMP_0048 8 0 127.5 /end AXIS_PTS
/begin AXIS_PTS mVTRGDMI "0.5degCA" 0x00012C9E NO_INPUT_QUANTITY REC_AXIS_UBYTE 0 COMP_0048 8 0 127.5 /end AXIS_PTS
/begin AXIS_PTS mVTCDMTW "X-50℃" 0x00012C46 NO_INPUT_QUANTITY REC_AXIS_UBYTE 0 COMP_0035 8 -50 205 /end AXIS_PTS
/begin AXIS_PTS mVTCDMTWE "X-50℃" 0x00012C4E NO_INPUT_QUANTITY REC_AXIS_UBYTE 0 COMP_0035 8 -50 205 /end AXIS_PTS
/begin AXIS_PTS mVCFBTRFE "3.2*10^(-6)sec" 0x00015750 NO_INPUT_QUANTITY REC_AXIS_UWORD 0 COMP_0461_S 8 0 0.209712 /end AXIS_PTS
/begin AXIS_PTS mVCFBTRF "3.2*10^(-6)sec" 0x00015740 NO_INPUT_QUANTITY REC_AXIS_UWORD 0 COMP_0461_S 8 0 0.209712 /end AXIS_PTS
/begin AXIS_PTS mLVSWCFRQ "2km/h" 0x000118BF NO_INPUT_QUANTITY REC_AXIS_UBYTE 0 COMP_0007 8 0 510 /end AXIS_PTS
/begin AXIS_PTS mADVKIRLT "X-50℃" 0x00011566 NO_INPUT_QUANTITY REC_AXIS_UBYTE 0 COMP_0035 4 -50 205 /end AXIS_PTS
/begin AXIS_PTS mNEDWN "12.5rpm" 0x00011951 NO_INPUT_QUANTITY REC_AXIS_UBYTE 0 COMP_0006 4 0 3187.5 /end AXIS_PTS
/begin AXIS_PTS mSTHOSLT "X-50℃" 0x00011AA8 NO_INPUT_QUANTITY REC_AXIS_UBYTE 0 COMP_0035 4 -50 205 /end AXIS_PTS
/begin COMPU_METHOD COMP_0000_S "fixed axis Long" RAT_FUNC "%8.2" "Long" COEFFS 0 1 0 0 0 1 /end COMPU_METHOD
/begin COMPU_METHOD COMP_0068 "1-" RAT_FUNC "%8.2" "-" COEFFS 0 1 0 0 0 1 /end COMPU_METHOD
/begin COMPU_METHOD COMP_0013 "1s" RAT_FUNC "%8.2" "s" COEFFS 0 1 0 0 0 1 /end COMPU_METHOD
/begin COMPU_METHOD COMP_0014 "10ms" RAT_FUNC "%8.2" "ms" COEFFS 0 1 0 0 0 10 /end COMPU_METHOD
/begin COMPU_METHOD COMP_0045 "1/128-" RAT_FUNC "%8.4" "-" COEFFS 0 1 0 0 0 0.0078125 /end COMPU_METHOD
/begin COMPU_METHOD COMP_0009 "100/128%" RAT_FUNC "%8.2" "%" COEFFS 0 1 0 0 0 0.78125 /end COMPU_METHOD
/begin COMPU_METHOD COMP_0000 "25rpm" RAT_FUNC "%8.2" "rpm" COEFFS 0 1 0 0 0 25 /end COMPU_METHOD
/begin COMPU_METHOD COMP_0186 "1/64-" RAT_FUNC "%8.3" "-" COEFFS 0 1 0 0 0 0.015625 /end COMPU_METHOD
/begin COMPU_METHOD COMP_0001 "1/8ms" RAT_FUNC "%8.2" "ms" COEFFS 0 1 0 0 0 0.125 /end COMPU_METHOD
/begin COMPU_METHOD COMP_0373 "1/100-" RAT_FUNC "%8.3" "-" COEFFS 0 1 0 0 0 0.01 /end COMPU_METHOD
/begin COMPU_METHOD COMP_0003 "1℃" RAT_FUNC "%8.2" "℃" COEFFS 0 1 0 0 0 1 /end COMPU_METHOD
/begin COMPU_METHOD COMP_0035 "X-50℃" RAT_FUNC "%8.2" "℃" COEFFS 0 1 50 0 0 1 /end COMPU_METHOD
/begin COMPU_METHOD COMP_0005 "0.11deg" RAT_FUNC "%8.2" "deg" COEFFS 0 1 0 0 0 0.11 /end COMPU_METHOD
/begin COMPU_METHOD COMP_0006 "12.5rpm" RAT_FUNC "%8.2" "rpm" COEFFS 0 1 0 0 0 12.5 /end COMPU_METHOD
/begin COMPU_METHOD COMP_0008 "100ms" RAT_FUNC "%8.2" "ms" COEFFS 0 1 0 0 0 100 /end COMPU_METHOD
/begin COMPU_METHOD COMP_0007 "2km/h" RAT_FUNC "%8.2" "km/h" COEFFS 0 1 0 0 0 2 /end COMPU_METHOD
/begin COMPU_METHOD COMP_0047 "0.5%" RAT_FUNC "%8.2" "%" COEFFS 0 1 0 0 0 0.5 /end COMPU_METHOD
/begin COMPU_METHOD COMP_0250 "4ms" RAT_FUNC "%8.2" "ms" COEFFS 0 1 0 0 0 4 /end COMPU_METHOD
/begin COMPU_METHOD COMP_0049 "1sec" RAT_FUNC "%8.2" "sec" COEFFS 0 1 0 0 0 1 /end COMPU_METHOD
/begin COMPU_METHOD COMP_0032 "1/256－" RAT_FUNC "%8.4" "－" COEFFS 0 1 0 0 0 0.00390625 /end COMPU_METHOD
/begin COMPU_METHOD COMP_0019_S "1/255-" RAT_FUNC "%8.4" "-" COEFFS 0 1 0 0 0 0.003921569 /end COMPU_METHOD
/begin COMPU_METHOD COMP_0436 "0.1km/h" RAT_FUNC "%8.2" "km/h" COEFFS 0 1 0 0 0 0.1 /end COMPU_METHOD
/begin COMPU_METHOD COMP_0263 "1-" RAT_FUNC "%8.2" "-" COEFFS 0 1 0 0 0 1 /end COMPU_METHOD
/begin COMPU_METHOD COMP_0048 "64/128degCA" RAT_FUNC "%8.2" "degCA" COEFFS 0 1 0 0 0 0.5 /end COMPU_METHOD
/begin COMPU_METHOD COMP_0144 "1/2048ms" RAT_FUNC "%8.5" "ms" COEFFS 0 1 0 0 0 0.000488281 /end COMPU_METHOD
/begin COMPU_METHOD COMP_0021 "100/256%" RAT_FUNC "%8.2" "%" COEFFS 0 1 0 0 0 0.390625 /end COMPU_METHOD
/begin COMPU_METHOD COMP_0096 "10s" RAT_FUNC "%8.2" "s" COEFFS 0 1 0 0 0 10 /end COMPU_METHOD
/begin COMPU_METHOD COMP_0087_S "0.07808MPa" RAT_FUNC "%8.3" "MPa" COEFFS 0 1 0 0 0 0.07808 /end COMPU_METHOD
/begin COMPU_METHOD COMP_0050 "5/64mV" RAT_FUNC "%8.3" "mV" COEFFS 0 1 0 0 0 0.078125 /end COMPU_METHOD
/begin COMPU_METHOD COMP_0283 "1flag" RAT_FUNC "%8.2" "flag" COEFFS 0 1 0 0 0 1 /end COMPU_METHOD
/begin COMPU_METHOD COMP_0196 "0.1Nm" RAT_FUNC "%8.2" "Nm" COEFFS 0 1 0 0 0 0.1 /end COMPU_METHOD
/begin COMPU_METHOD COMP_0190 "2deg" RAT_FUNC "%8.2" "deg" COEFFS 0 1 0 0 0 2 /end COMPU_METHOD
/begin COMPU_METHOD COMP_0164 "0.000305MPa" RAT_FUNC "%8.5" "MPa" COEFFS 0 1 0 0 0 0.000305 /end COMPU_METHOD
/begin COMPU_METHOD COMP_0135_S "1/255-" RAT_FUNC "%8.4" "-" COEFFS 0 1 0 0 0 0.003921568 /end COMPU_METHOD
/begin COMPU_METHOD COMP_0182_S "0.001-" RAT_FUNC "%8.4" "-" COEFFS 0 1 0 0 0 0.001 /end COMPU_METHOD
/begin COMPU_METHOD COMP_0052 "1/2048ms" RAT_FUNC "%8.5" "ms" COEFFS 0 1 0 0 0 0.000488282 /end COMPU_METHOD
/begin COMPU_METHOD COMP_0293 "2L/min" RAT_FUNC "%8.2" "L/min" COEFFS 0 1 0 0 0 2 /end COMPU_METHOD
/begin COMPU_METHOD COMP_0356 "0.625X-40℃" RAT_FUNC "%8.2" "℃" COEFFS 0 1 40 0 0 0.625 /end COMPU_METHOD
/begin COMPU_METHOD COMP_0298_S "36*2^-22-" RAT_FUNC "%8.6" "-" COEFFS 0 1 0 0 0 0.00000858307 /end COMPU_METHOD
/begin COMPU_METHOD COMP_0245 "X-64deg" RAT_FUNC "%8.2" "deg" COEFFS 0 1 64 0 0 1 /end COMPU_METHOD
/begin COMPU_METHOD COMP_0300_S "0.5degCA/se" RAT_FUNC "%8.2" "degCA/se" COEFFS 0 1 0 0 0 0.5 /end COMPU_METHOD
/begin COMPU_METHOD COMP_0324_S "fixed axis -" RAT_FUNC "%8.2" "-" COEFFS 0 1 -1 0 0 1 /end COMPU_METHOD
/begin COMPU_METHOD COMP_0329_S "fixed axis rpm" RAT_FUNC "%8.2" "rpm" COEFFS 0 1 0 0 0 800 /end COMPU_METHOD
/begin COMPU_METHOD COMP_0333_S "fixed axis ℃" RAT_FUNC "%8.2" "℃" COEFFS 0 1 40 0 0 20 /end COMPU_METHOD
/begin COMPU_METHOD COMP_0347_S "fixed axis rpm" RAT_FUNC "%8.2" "rpm" COEFFS 0 1 0 0 0 400 /end COMPU_METHOD
/begin COMPU_METHOD COMP_0348_S "fixed axis ℃" RAT_FUNC "%8.2" "℃" COEFFS 0 1 40 0 0 10 /end COMPU_METHOD
/begin COMPU_METHOD COMP_0357_S "fixed axis rpm" RAT_FUNC "%8.2" "rpm" COEFFS 0 1 -400 0 0 400 /end COMPU_METHOD
/begin COMPU_METHOD COMP_0455_S "1-" RAT_FUNC "%8.2" "-" COEFFS 0 1 32768 0 0 1 /end COMPU_METHOD
/begin COMPU_METHOD COMP_0456_S "1deg" RAT_FUNC "%8.2" "deg" COEFFS 0 1 32768 0 0 1 /end COMPU_METHOD
/begin COMPU_METHOD COMP_0457_S "1.28*10^6mV^2" RAT_FUNC "%8.2" "mV^2" COEFFS 0 1 0 0 0 1280000 /end COMPU_METHOD
/begin COMPU_METHOD COMP_0458_S "0.3575deg" RAT_FUNC "%8.2" "deg" COEFFS 0 1 0 0 0 0.3575 /end COMPU_METHOD
/begin COMPU_METHOD COMP_0459_S "fixed axis us" RAT_FUNC "%8.2" "us" COEFFS 0 1 0 0 0 450 /end COMPU_METHOD
/begin COMPU_METHOD COMP_0460_S "fixed axis ℃" RAT_FUNC "%8.2" "℃" COEFFS 0 1 50 0 0 20 /end COMPU_METHOD
/begin COMPU_METHOD COMP_0402 "1/65535-" RAT_FUNC "%8.6" "-" COEFFS 0 1 0 0 0 0.000015259 /end COMPU_METHOD
/begin COMPU_METHOD COMP_0461_S "3.2*10^(-6)sec" RAT_FUNC "%8.6" "sec" COEFFS 0 1 0 0 0 0.0000032 /end COMPU_METHOD
/begin COMPU_METHOD COMP_0324 "2/256L/min" RAT_FUNC "%8.4" "L/min" COEFFS 0 1 0 0 0 0.0078125 /end COMPU_METHOD
/* RECORD_LAYOUT ------------------------------------------------------ */
/begin RECORD_LAYOUT REC_UBYTE_C FNC_VALUES 1 UBYTE COLUMN_DIR DIRECT /end RECORD_LAYOUT
/begin RECORD_LAYOUT REC_UWORD_C FNC_VALUES 1 UWORD COLUMN_DIR DIRECT /end RECORD_LAYOUT
/begin RECORD_LAYOUT REC_SBYTE_C FNC_VALUES 1 SBYTE COLUMN_DIR DIRECT /end RECORD_LAYOUT
/begin RECORD_LAYOUT REC_AXIS_UBYTE AXIS_PTS_X 1 UBYTE INDEX_INCR DIRECT /end RECORD_LAYOUT
/begin RECORD_LAYOUT REC_AXIS_UWORD AXIS_PTS_X 1 UWORD INDEX_INCR DIRECT /end RECORD_LAYOUT
/end MODULE
/end PROJECT
