/begin PROJECT X12C_KH3DT_DI_NAM_R/C ""
/begin HEADER "" /* key HEADER ++ "comment" に Par.scomment */ PROJECT_NO X12C_KH3DT_DI_NAM_R/C /* key PROJECT_NO ++ project number に car_eng_desti_lot */ VERSION "0KHDCFDZ7" /* key VERSION ++ version number に mProgver */ /end HEADER
/begin MODULE DIM ""
/begin MOD_COMMON "" ALIGNMENT_BYTE 1 ALIGNMENT_WORD 2 ALIGNMENT_LONG 4 ALIGNMENT_FLOAT32_IEEE 4 ALIGNMENT_FLOAT64_IEEE 4 DEPOSIT ABSOLUTE BYTE_ORDER MSB_FIRST /* ﾊﾞｲﾄｵｰﾀﾞｰがﾘﾌﾟﾚｰｽされる */ /end MOD_COMMON
/begin MEASUREMENT vGMFAIA "RAM value vGMFAIA" UWORD COMP_0016 1 100 0 65535 ECU_ADDRESS 0xFFFF51C8 READ_WRITE /end MEASUREMENT
/begin MEASUREMENT vGMFCAT "RAM value vGMFCAT" UWORD COMP_0016 1 100 0 65535 ECU_ADDRESS 0xFFFF51CA READ_WRITE /end MEASUREMENT
/begin MEASUREMENT vGMFCEM "RAM value vGMFCEM" UWORD COMP_0016 1 100 0 65535 ECU_ADDRESS 0xFFFF51D4 READ_WRITE /end MEASUREMENT
/begin MEASUREMENT vGMRABf "RAM value vGMRABf" UBYTE COMP_0004 1 100 0 255 ECU_ADDRESS 0xFFFF3746 READ_WRITE /end MEASUREMENT
/begin MEASUREMENT vGMRCf "RAM value vGMRCf" UBYTE COMP_0004 1 100 0 255 ECU_ADDRESS 0xFFFF3747 READ_WRITE /end MEASUREMENT
/begin MEASUREMENT vGMRDf "RAM value vGMRDf" UBYTE COMP_0004 1 100 0 255 ECU_ADDRESS 0xFFFF3748 READ_WRITE /end MEASUREMENT
/begin MEASUREMENT vGMREf "RAM value vGMREf" UBYTE COMP_0004 1 100 0 255 ECU_ADDRESS 0xFFFF3749 READ_WRITE /end MEASUREMENT
/begin MEASUREMENT vGMRFf "RAM value vGMRFf" UBYTE COMP_0004 1 100 0 255 ECU_ADDRESS 0xFFFF374A READ_WRITE /end MEASUREMENT
/begin MEASUREMENT vGNGMS "RAM value vGNGMS" UBYTE COMP_0062_S 1 100 0 255 ECU_ADDRESS 0xFFFF51DE READ_WRITE /end MEASUREMENT
/begin MEASUREMENT vGNMV "RAM value vGNMV" UWORD COMP_0559_S 1 100 0 0.000014535663 ECU_ADDRESS 0xFFFF1630 READ_WRITE /end MEASUREMENT
/begin MEASUREMENT vGNRTRP "RAM value vGNRTRP" UWORD COMP_0016 1 100 0 65535 ECU_ADDRESS 0xFFFF51E0 READ_WRITE /end MEASUREMENT
/begin MEASUREMENT vGNRTRP2 "RAM value vGNRTRP2" UWORD COMP_0016 1 100 0 65535 ECU_ADDRESS 0xFFFF46D8 READ_WRITE /end MEASUREMENT
/begin MEASUREMENT vGNSETST2 "RAM value vGNSETST2" UBYTE COMP_0021 1 100 0 99.609375 ECU_ADDRESS 0xFFFF1B2E READ_WRITE /end MEASUREMENT
/begin MEASUREMENT vGNSETSTV "RAM value vGNSETSTV" UBYTE COMP_0021 1 100 0 99.609375 ECU_ADDRESS 0xFFFF0BFF READ_WRITE /end MEASUREMENT
/begin MEASUREMENT vGNSTTMP "RAM value vGNSTTMP" UBYTE COMP_0081_S 1 100 0 99.609375 ECU_ADDRESS 0xFFFF0C00 READ_WRITE /end MEASUREMENT
/begin MEASUREMENT vGNTST "RAM value vGNTST" UBYTE COMP_0004 1 100 0 255 ECU_ADDRESS 0xFFFF30BB READ_WRITE /end MEASUREMENT
/begin MEASUREMENT vGOERROR "RAM value vGOERROR" SBYTE COMP_0172_S 1 100 -64 63.5 ECU_ADDRESS 0xFFFF51E2 READ_WRITE /end MEASUREMENT
/begin MEASUREMENT vGOERRORE "RAM value vGOERRORE" SBYTE COMP_0172_S 1 100 -64 63.5 ECU_ADDRESS 0xFFFF51E4 READ_WRITE /end MEASUREMENT
/begin MEASUREMENT vGOFAGEN "RAM value vGOFAGEN" SBYTE COMP_0172_S 1 100 -64 63.5 ECU_ADDRESS 0xFFFF51E6 READ_WRITE /end MEASUREMENT
/begin MEASUREMENT vGOFAGEX "RAM value vGOFAGEX" SBYTE COMP_0172_S 1 100 -64 63.5 ECU_ADDRESS 0xFFFF51E8 READ_WRITE /end MEASUREMENT
/begin MEASUREMENT vGOFAGIN "RAM value vGOFAGIN" SBYTE COMP_0172_S 1 100 -64 63.5 ECU_ADDRESS 0xFFFF51EA READ_WRITE /end MEASUREMENT
/begin MEASUREMENT vGOFAGIX "RAM value vGOFAGIX" SBYTE COMP_0172_S 1 100 -64 63.5 ECU_ADDRESS 0xFFFF51EC READ_WRITE /end MEASUREMENT
/begin MEASUREMENT vGOFAGVEN "RAM value vGOFAGVEN" SBYTE COMP_0172_S 1 100 -64 63.5 ECU_ADDRESS 0xFFFF51EE READ_WRITE /end MEASUREMENT
/begin MEASUREMENT vGOFAGVEX "RAM value vGOFAGVEX" SBYTE COMP_0172_S 1 100 -64 63.5 ECU_ADDRESS 0xFFFF51F0 READ_WRITE /end MEASUREMENT
/begin MEASUREMENT vGOFAGVIN "RAM value vGOFAGVIN" SBYTE COMP_0172_S 1 100 -64 63.5 ECU_ADDRESS 0xFFFF51F2 READ_WRITE /end MEASUREMENT
/begin MEASUREMENT vGOFAGVIX "RAM value vGOFAGVIX" SBYTE COMP_0172_S 1 100 -64 63.5 ECU_ADDRESS 0xFFFF51F4 READ_WRITE /end MEASUREMENT
/begin MEASUREMENT vGOFFSET "RAM value vGOFFSET" UWORD COMP_0136_S 1 100 -1.8907 240.5888 ECU_ADDRESS 0xFFFF4402 READ_WRITE /end MEASUREMENT
/begin MEASUREMENT vGOFSDE4Z "RAM value vGOFSDE4Z" ULONG COMP_0560_S 1 100 -1.89069934592 240.592416711543 ECU_ADDRESS 0xFFFF4F10 READ_WRITE /end MEASUREMENT
/begin MEASUREMENT vGOFSDEP "RAM value vGOFSDEP" UWORD COMP_0136_S 1 100 -1.8907 240.5888 ECU_ADDRESS 0xFFFF4404 READ_WRITE /end MEASUREMENT
/begin MEASUREMENT vGOFSDEP4 "RAM value vGOFSDEP4" ULONG COMP_0560_S 1 100 -1.89069934592 240.592416711543 ECU_ADDRESS 0xFFFF4F14 READ_WRITE /end MEASUREMENT
/begin MEASUREMENT vGOV "RAM value vGOV" SBYTE COMP_0018 1 100 -128 127 ECU_ADDRESS 0xFFFF0C01 READ_WRITE /end MEASUREMENT
/begin MEASUREMENT vGOVDMP "RAM value vGOVDMP" SBYTE COMP_0018 1 100 -128 127 ECU_ADDRESS 0xFFFF0C02 READ_WRITE /end MEASUREMENT
/begin MEASUREMENT vGOVDMPWK "RAM value vGOVDMPWK" SBYTE COMP_0018 1 100 -128 127 ECU_ADDRESS 0xFFFF0C03 READ_WRITE /end MEASUREMENT
/begin MEASUREMENT vGOVEGR "RAM value vGOVEGR" UBYTE COMP_0017 1 100 0 255 ECU_ADDRESS 0xFFFF0C04 READ_WRITE /end MEASUREMENT
/begin MEASUREMENT vGOVIDL "RAM value vGOVIDL" SBYTE COMP_0018 1 100 -128 127 ECU_ADDRESS 0xFFFF1B2F READ_WRITE /end MEASUREMENT
/begin MEASUREMENT vGOVVTC "RAM value vGOVVTC" UBYTE COMP_0314 1 100 -128 127 ECU_ADDRESS 0xFFFF0C05 READ_WRITE /end MEASUREMENT
/begin MEASUREMENT vGPIDGTR1 "RAM value vGPIDGTR1" UBYTE COMP_0045 1 100 0 1.9921875 ECU_ADDRESS 0xFFFF1772 READ_WRITE /end MEASUREMENT
/begin MEASUREMENT vGPSEL "RAM value vGPSEL" UBYTE COMP_0068 1 100 0 255 ECU_ADDRESS 0xFFFF0C06 READ_WRITE /end MEASUREMENT
/begin MEASUREMENT vGPSEV "RAM value vGPSEV" UBYTE COMP_0054 1 100 0 5100 ECU_ADDRESS 0xFFFF46DA READ_WRITE /end MEASUREMENT
/begin MEASUREMENT vGPSEV2 "RAM value vGPSEV2" UWORD COMP_0104 1 100 0 655350 ECU_ADDRESS 0xFFFF51F6 READ_WRITE /end MEASUREMENT
/begin MEASUREMENT vGPSYSP "RAM value vGPSYSP" UBYTE COMP_0054 1 100 0 5100 ECU_ADDRESS 0xFFFF46DB READ_WRITE /end MEASUREMENT
/begin MEASUREMENT vGPSYSP2 "RAM value vGPSYSP2" UWORD COMP_0104 1 100 0 655350 ECU_ADDRESS 0xFFFF51F8 READ_WRITE /end MEASUREMENT
/begin MEASUREMENT vGQFBI "RAM value vGQFBI" UWORD COMP_0134_S 1 100 0 65535 ECU_ADDRESS 0xFFFF0C08 READ_WRITE /end MEASUREMENT
/begin MEASUREMENT vGR1NOPK "RAM value vGR1NOPK" UBYTE COMP_0030 1 100 0 255 ECU_ADDRESS 0xFFFF277C READ_WRITE /end MEASUREMENT
/begin MEASUREMENT vGR1NOPKCL "RAM value vGR1NOPKCL" UBYTE COMP_0030 1 100 0 255 ECU_ADDRESS 0xFFFF277D READ_WRITE /end MEASUREMENT
/begin MEASUREMENT vGR1VBOV "RAM value vGR1VBOV" UBYTE COMP_0030 1 100 0 255 ECU_ADDRESS 0xFFFF277E READ_WRITE /end MEASUREMENT
/begin MEASUREMENT vGR1VBOVCL "RAM value vGR1VBOVCL" UBYTE COMP_0030 1 100 0 255 ECU_ADDRESS 0xFFFF277F READ_WRITE /end MEASUREMENT
/begin MEASUREMENT vGR1VHOV "RAM value vGR1VHOV" UBYTE COMP_0030 1 100 0 255 ECU_ADDRESS 0xFFFF2780 READ_WRITE /end MEASUREMENT
/begin MEASUREMENT vGR1VHOVCL "RAM value vGR1VHOVCL" UBYTE COMP_0030 1 100 0 255 ECU_ADDRESS 0xFFFF2781 READ_WRITE /end MEASUREMENT
/begin MEASUREMENT vGR2VHOV "RAM value vGR2VHOV" UBYTE COMP_0030 1 100 0 255 ECU_ADDRESS 0xFFFF2782 READ_WRITE /end MEASUREMENT
/begin MEASUREMENT vGR2VHOVCL "RAM value vGR2VHOVCL" UBYTE COMP_0030 1 100 0 255 ECU_ADDRESS 0xFFFF2783 READ_WRITE /end MEASUREMENT
/begin MEASUREMENT vGRDTNT "RAM value vGRDTNT" SLONG COMP_0433 1 100 -214748364.8 214748364.7 ECU_ADDRESS 0xFFFF3130 READ_WRITE /end MEASUREMENT
/begin MEASUREMENT vGRO2 "RAM value vGRO2" UBYTE COMP_0104 1 100 0 2550 ECU_ADDRESS 0xFFFF51FA READ_WRITE /end MEASUREMENT
/begin MEASUREMENT vGRO2D "RAM value vGRO2D" UBYTE COMP_0295 1 100 0 25500 ECU_ADDRESS 0xFFFF51FB READ_WRITE /end MEASUREMENT
/begin MEASUREMENT vGRO2H "RAM value vGRO2H" UBYTE COMP_0054 1 100 0 5100 ECU_ADDRESS 0xFFFF4F18 READ_WRITE /end MEASUREMENT
/begin MEASUREMENT vGRO2Hf "RAM value vGRO2Hf" UBYTE COMP_0004 1 100 0 255 ECU_ADDRESS 0xFFFF2784 READ_WRITE /end MEASUREMENT
/begin MEASUREMENT vGRO2N "RAM value vGRO2N" UBYTE COMP_0104 1 100 0 2550 ECU_ADDRESS 0xFFFF51FC READ_WRITE /end MEASUREMENT
/begin MEASUREMENT vGRO2R "RAM value vGRO2R" UBYTE COMP_0104 1 100 0 2550 ECU_ADDRESS 0xFFFF51FD READ_WRITE /end MEASUREMENT
/begin MEASUREMENT vGRO2X "RAM value vGRO2X" UBYTE COMP_0104 1 100 0 2550 ECU_ADDRESS 0xFFFF51FE READ_WRITE /end MEASUREMENT
/begin MEASUREMENT vGSENAVE "RAM value vGSENAVE" UWORD COMP_0136_S 1 100 -1.8907 240.5888 ECU_ADDRESS 0xFFFF374C READ_WRITE /end MEASUREMENT
/begin MEASUREMENT vGSENBUMN "RAM value vGSENBUMN" UWORD COMP_0136_S 1 100 -1.8907 240.5888 ECU_ADDRESS 0xFFFF46DC READ_WRITE /end MEASUREMENT
/begin MEASUREMENT vGSENBUMX "RAM value vGSENBUMX" UWORD COMP_0136_S 1 100 -1.8907 240.5888 ECU_ADDRESS 0xFFFF46DE READ_WRITE /end MEASUREMENT
/begin MEASUREMENT vGSENDCNT "RAM value vGSENDCNT" UBYTE COMP_0016 1 100 0 255 ECU_ADDRESS 0xFFFF2785 READ_WRITE /end MEASUREMENT
/begin MEASUREMENT vGSENDFL "RAM value vGSENDFL" UWORD COMP_0136_S 1 100 -1.8907 240.5888 ECU_ADDRESS 0xFFFF2786 READ_WRITE /end MEASUREMENT
/begin MEASUREMENT vGSENFL1 "RAM value vGSENFL1" UWORD COMP_0023 1 100 0 327675 ECU_ADDRESS 0xFFFF374E READ_WRITE /end MEASUREMENT
/begin MEASUREMENT vGSENSOR "RAM value vGSENSOR" UWORD COMP_0061 1 100 0 327675 ECU_ADDRESS 0xFFFF3750 READ_WRITE /end MEASUREMENT
/begin MEASUREMENT vGSENVAL "RAM value vGSENVAL" UWORD COMP_0136_S 1 100 -1.8907 240.5888 ECU_ADDRESS 0xFFFF2052 READ_WRITE /end MEASUREMENT
/begin MEASUREMENT vGSINXGPD "RAM value vGSINXGPD" UBYTE COMP_0068 1 100 0 255 ECU_ADDRESS 0xFFFF2788 READ_WRITE /end MEASUREMENT
/begin MEASUREMENT vGSINXGPU "RAM value vGSINXGPU" UBYTE COMP_0068 1 100 0 255 ECU_ADDRESS 0xFFFF2789 READ_WRITE /end MEASUREMENT
/begin MEASUREMENT vGSINXTGP "RAM value vGSINXTGP" UBYTE COMP_0068 1 100 0 255 ECU_ADDRESS 0xFFFF3B65 READ_WRITE /end MEASUREMENT
/begin MEASUREMENT vGSIRESFD "RAM value vGSIRESFD" UWORD COMP_0064_S 1 100 0 65535 ECU_ADDRESS 0xFFFF278A READ_WRITE /end MEASUREMENT
/begin MEASUREMENT vGSLADLM "RAM value vGSLADLM" SBYTE COMP_0018 1 100 -128 127 ECU_ADDRESS 0xFFFF1773 READ_WRITE /end MEASUREMENT
/begin MEASUREMENT vGSM8RE "RAM value vGSM8RE" UBYTE COMP_0068 1 100 0 255 ECU_ADDRESS 0xFFFF278C READ_WRITE /end MEASUREMENT
/begin MEASUREMENT vGSTDBC "RAM value vGSTDBC" UBYTE COMP_0480_S 1 100 0 255 ECU_ADDRESS 0xFFFF3B66 READ_WRITE /end MEASUREMENT
/begin MEASUREMENT vGSTDVP4 "RAM value vGSTDVP4" UWORD COMP_0050 1 100 0 5119.921875 ECU_ADDRESS 0xFFFF5200 READ_WRITE /end MEASUREMENT
/begin MEASUREMENT vGSTIMR "RAM value vGSTIMR" UBYTE COMP_0004 1 100 0 255 ECU_ADDRESS 0xFFFF5202 READ_WRITE /end MEASUREMENT
/begin MEASUREMENT vGSTIMRT "RAM value vGSTIMRT" UBYTE COMP_0068 1 100 0 255 ECU_ADDRESS 0xFFFF5204 READ_WRITE /end MEASUREMENT
/begin MEASUREMENT vGSTIMRT2 "RAM value vGSTIMRT2" UBYTE COMP_0068 1 100 0 255 ECU_ADDRESS 0xFFFF5206 READ_WRITE /end MEASUREMENT
/begin MEASUREMENT vGSTMLONZ "RAM value vGSTMLONZ" UBYTE COMP_0004 1 100 0 255 ECU_ADDRESS 0xFFFF46E0 READ_WRITE /end MEASUREMENT
/begin MEASUREMENT vGSTPMT2 "RAM value vGSTPMT2" UBYTE COMP_0068 1 100 0 255 ECU_ADDRESS 0xFFFF3B67 READ_WRITE /end MEASUREMENT
/begin MEASUREMENT vGST_CODE "RAM value vGST_CODE" UWORD COMP_0068 1 100 0 65535 ECU_ADDRESS 0xFFFF278E READ_WRITE /end MEASUREMENT
/begin MEASUREMENT vGTEGMX "RAM value vGTEGMX" UBYTE COMP_0035 1 100 -50 205 ECU_ADDRESS 0xFFFF46E1 READ_WRITE /end MEASUREMENT
/begin MEASUREMENT vGTEGOK "RAM value vGTEGOK" UBYTE COMP_0035 1 100 -50 205 ECU_ADDRESS 0xFFFF46E2 READ_WRITE /end MEASUREMENT
/begin MEASUREMENT vGYAKUKI "RAM value vGYAKUKI" SWORD COMP_0397 1 100 -655360 655340 ECU_ADDRESS 0xFFFF3134 READ_WRITE /end MEASUREMENT
/begin MEASUREMENT vGYAKUKI0 "RAM value vGYAKUKI0" SWORD COMP_0397 1 100 -655360 655340 ECU_ADDRESS 0xFFFF3136 READ_WRITE /end MEASUREMENT
/begin MEASUREMENT vGYAKUMAX "RAM value vGYAKUMAX" SWORD COMP_0561_S 1 100 -3276.8 3276.7 ECU_ADDRESS 0xFFFF3138 READ_WRITE /end MEASUREMENT
/begin MEASUREMENT vGYAKUMIN "RAM value vGYAKUMIN" SWORD COMP_0561_S 1 100 -3276.8 3276.7 ECU_ADDRESS 0xFFFF313A READ_WRITE /end MEASUREMENT
/begin MEASUREMENT vGZCY "RAM value vGZCY" UWORD COMP_0017 1 100 0 65535 ECU_ADDRESS 0xFFFF0C0A READ_WRITE /end MEASUREMENT
/begin MEASUREMENT vGZCYN "RAM value vGZCYN" UBYTE COMP_0068 1 100 0 255 ECU_ADDRESS 0xFFFF0C12 READ_WRITE /end MEASUREMENT
/begin MEASUREMENT vGZCYTN "RAM value vGZCYTN" UBYTE COMP_0186 1 100 0 3.984375 ECU_ADDRESS 0xFFFF0C13 READ_WRITE /end MEASUREMENT
/begin MEASUREMENT vGZIVTCA "RAM value vGZIVTCA" UBYTE COMP_0063 1 100 0 0.99609375 ECU_ADDRESS 0xFFFF0C14 READ_WRITE /end MEASUREMENT
/begin MEASUREMENT vGZIVTCD "RAM value vGZIVTCD" UBYTE COMP_0063 1 100 0 0.99609375 ECU_ADDRESS 0xFFFF0C15 READ_WRITE /end MEASUREMENT
/begin MEASUREMENT vGZTP "RAM value vGZTP" UBYTE COMP_0045 1 100 0 1.9921875 ECU_ADDRESS 0xFFFF0C16 READ_WRITE /end MEASUREMENT
/begin MEASUREMENT vGZTWDI "RAM value vGZTWDI" UBYTE COMP_0429_S 1 100 0 5.1 ECU_ADDRESS 0xFFFF0C17 READ_WRITE /end MEASUREMENT
/begin MEASUREMENT vHBUDGET "RAM value vHBUDGET" SLONG COMP_0525_S 1 100 -214748.3648 214748.3647 ECU_ADDRESS 0xFFFF2790 READ_WRITE /end MEASUREMENT
/begin MEASUREMENT vHCSENRF1 "RAM value vHCSENRF1" UBYTE COMP_0006 1 100 0 3187.5 ECU_ADDRESS 0xFFFF2794 READ_WRITE /end MEASUREMENT
/begin MEASUREMENT vHDTYINI "RAM value vHDTYINI" UBYTE COMP_0047 1 100 0 127.5 ECU_ADDRESS 0xFFFF3752 READ_WRITE /end MEASUREMENT
/begin MEASUREMENT vHEONV "RAM value vHEONV" UBYTE COMP_0016 1 100 0 255 ECU_ADDRESS 0xFFFF4F19 READ_WRITE /end MEASUREMENT
/begin MEASUREMENT vHEVMON "RAM value vHEVMON" UBYTE COMP_0068 1 100 0 255 ECU_ADDRESS 0xFFFF2795 READ_WRITE /end MEASUREMENT
/begin MEASUREMENT vHFCRCLPf "RAM value vHFCRCLPf" UBYTE COMP_0004 1 100 0 255 ECU_ADDRESS 0xFFFF2796 READ_WRITE /end MEASUREMENT
/begin MEASUREMENT vHHETCON "RAM value vHHETCON" UBYTE COMP_0016 1 100 0 255 ECU_ADDRESS 0xFFFF4F1A READ_WRITE /end MEASUREMENT
/begin MEASUREMENT vHIERAPO "RAM value vHIERAPO" UWORD COMP_0005 1 100 0 7208.85 ECU_ADDRESS 0xFFFF3754 READ_WRITE /end MEASUREMENT
/begin MEASUREMENT vHIFBPSL "RAM value vHIFBPSL" SWORD COMP_0277 1 100 -32768 32767 ECU_ADDRESS 0xFFFF1774 READ_WRITE /end MEASUREMENT
/begin MEASUREMENT vHLRDIFF "RAM value vHLRDIFF" UWORD COMP_0453 1 100 0 131.07 ECU_ADDRESS 0xFFFF2798 READ_WRITE /end MEASUREMENT
/begin MEASUREMENT vHNRPM "RAM value vHNRPM" UBYTE COMP_0020 1 100 0 12750 ECU_ADDRESS 0xFFFF0956 READ_WRITE /end MEASUREMENT
/begin MEASUREMENT vHNRPM10 "RAM value vHNRPM10" UBYTE COMP_0020 1 100 0 12750 ECU_ADDRESS 0xFFFF08DA READ_WRITE /end MEASUREMENT
/begin MEASUREMENT vHNRPM10Z "RAM value vHNRPM10Z" UBYTE COMP_0020 1 100 0 12750 ECU_ADDRESS 0xFFFF08DB READ_WRITE /end MEASUREMENT
/begin MEASUREMENT vHNTCNT "RAM value vHNTCNT" UBYTE COMP_0030 1 100 0 255 ECU_ADDRESS 0xFFFF0C18 READ_WRITE /end MEASUREMENT
/begin MEASUREMENT vHODTM "RAM value vHODTM" UWORD COMP_0017_S 1 100 0 655.35 ECU_ADDRESS 0xFFFF279C READ_WRITE /end MEASUREMENT
/begin MEASUREMENT vHOSCINBLf "RAM value vHOSCINBLf" UBYTE COMP_0004 1 100 0 255 ECU_ADDRESS 0xFFFF27A0 READ_WRITE /end MEASUREMENT
/begin MEASUREMENT vHOSCMAX "RAM value vHOSCMAX" SLONG COMP_0148_S 1 100 -21474836.48 21474836.47 ECU_ADDRESS 0xFFFF46E4 READ_WRITE /end MEASUREMENT
/begin MEASUREMENT vHOSLGOf "RAM value vHOSLGOf" UBYTE COMP_0004 1 100 0 255 ECU_ADDRESS 0xFFFF27A1 READ_WRITE /end MEASUREMENT
/begin MEASUREMENT vHOSNTP "RAM value vHOSNTP" UBYTE COMP_0045 1 100 0 1.9921875 ECU_ADDRESS 0xFFFF27A2 READ_WRITE /end MEASUREMENT
/begin MEASUREMENT vHOSTR "RAM value vHOSTR" UBYTE COMP_0245 1 100 -64 191 ECU_ADDRESS 0xFFFF1B30 READ_WRITE /end MEASUREMENT
/begin MEASUREMENT vHOTIDCNT "RAM value vHOTIDCNT" UBYTE COMP_0016 1 100 0 255 ECU_ADDRESS 0xFFFF0808 READ_WRITE /end MEASUREMENT
/begin MEASUREMENT vHOUDENVB "RAM value vHOUDENVB" UBYTE COMP_0033 1 100 0 20400 ECU_ADDRESS 0xFFFF27A3 READ_WRITE /end MEASUREMENT
/begin MEASUREMENT vHPGNDT "RAM value vHPGNDT" UBYTE COMP_0030 1 100 0 255 ECU_ADDRESS 0xFFFF27A4 READ_WRITE /end MEASUREMENT
/begin MEASUREMENT vHPGNDTCL "RAM value vHPGNDTCL" UBYTE COMP_0030 1 100 0 255 ECU_ADDRESS 0xFFFF27A5 READ_WRITE /end MEASUREMENT
/begin MEASUREMENT vHPHD "RAM value vHPHD" UBYTE COMP_0149_S 1 100 0 51 ECU_ADDRESS 0xFFFF3756 READ_WRITE /end MEASUREMENT
/begin MEASUREMENT vHPHYS "RAM value vHPHYS" UBYTE COMP_0150_S 1 100 0.4 51.4 ECU_ADDRESS 0xFFFF3757 READ_WRITE /end MEASUREMENT
/begin MEASUREMENT vHPPHT "RAM value vHPPHT" UBYTE COMP_0151_S 1 100 0 102000 ECU_ADDRESS 0xFFFF3758 READ_WRITE /end MEASUREMENT
/begin MEASUREMENT vHPPK "RAM value vHPPK" UBYTE COMP_0149_S 1 100 0 51 ECU_ADDRESS 0xFFFF3759 READ_WRITE /end MEASUREMENT
/begin MEASUREMENT vHPTXCHK "RAM value vHPTXCHK" UBYTE COMP_0068 1 100 0 255 ECU_ADDRESS 0xFFFF375A READ_WRITE /end MEASUREMENT
/begin MEASUREMENT vHPVBST "RAM value vHPVBST" UBYTE COMP_0030 1 100 0 255 ECU_ADDRESS 0xFFFF27A6 READ_WRITE /end MEASUREMENT
/begin MEASUREMENT vHPVBSTCL "RAM value vHPVBSTCL" UBYTE COMP_0030 1 100 0 255 ECU_ADDRESS 0xFFFF27A7 READ_WRITE /end MEASUREMENT
/begin MEASUREMENT vHPVBSTS "RAM value vHPVBSTS" UBYTE COMP_0068 1 100 0 255 ECU_ADDRESS 0xFFFF3350 READ_WRITE /end MEASUREMENT
/begin MEASUREMENT vHRLDIFF "RAM value vHRLDIFF" UWORD COMP_0453 1 100 0 131.07 ECU_ADDRESS 0xFFFF27A8 READ_WRITE /end MEASUREMENT
/begin MEASUREMENT vHRVSP "RAM value vHRVSP" UWORD COMP_0436 1 100 0 6553.5 ECU_ADDRESS 0xFFFF2054 READ_WRITE /end MEASUREMENT
/begin MEASUREMENT vHRVSPCOR "RAM value vHRVSPCOR" SLONG COMP_0144_S 1 100 -1843.20024746394 1843.20024660563 ECU_ADDRESS 0xFFFF375C READ_WRITE /end MEASUREMENT
/begin MEASUREMENT vHRVSPFL "RAM value vHRVSPFL" ULONG COMP_0562_S 1 100 0 6553.6046960946 ECU_ADDRESS 0xFFFF0C1C READ_WRITE /end MEASUREMENT
/begin MEASUREMENT vHRVSPZ "RAM value vHRVSPZ" UWORD COMP_0238_S 1 100 0 655.35 ECU_ADDRESS 0xFFFF27AC READ_WRITE /end MEASUREMENT
/begin MEASUREMENT vHSNOKJD "RAM value vHSNOKJD" UBYTE COMP_0030 1 100 0 255 ECU_ADDRESS 0xFFFF27C0 READ_WRITE /end MEASUREMENT
/begin MEASUREMENT vHSOSQ "RAM value vHSOSQ" SLONG COMP_0148_S 1 100 -21474836.48 21474836.47 ECU_ADDRESS 0xFFFF2108 READ_WRITE /end MEASUREMENT
/begin MEASUREMENT vHST "RAM value vHST" ULONG COMP_0068 1 100 0 4294967295 ECU_ADDRESS 0xFFFF313C READ_WRITE /end MEASUREMENT
/begin MEASUREMENT vHSTNT3 "RAM value vHSTNT3" ULONG COMP_0376 1 100 0 429496729.5 ECU_ADDRESS 0xFFFF3140 READ_WRITE /end MEASUREMENT
/begin MEASUREMENT vHSTNT6 "RAM value vHSTNT6" ULONG COMP_0521_S 1 100 0 429496729.5 ECU_ADDRESS 0xFFFF3144 READ_WRITE /end MEASUREMENT
/begin MEASUREMENT vHSTNT7 "RAM value vHSTNT7" ULONG COMP_0521_S 1 100 0 429496729.5 ECU_ADDRESS 0xFFFF3148 READ_WRITE /end MEASUREMENT
/begin MEASUREMENT vHT "RAM value vHT" UBYTE COMP_0068 1 100 0 255 ECU_ADDRESS 0xFFFF2056 READ_WRITE /end MEASUREMENT
/begin MEASUREMENT vHTARTD "RAM value vHTARTD" UBYTE COMP_0017 1 100 0 255 ECU_ADDRESS 0xFFFF1B31 READ_WRITE /end MEASUREMENT
/begin MEASUREMENT vHTARTDR "RAM value vHTARTDR" UBYTE COMP_0017 1 100 0 255 ECU_ADDRESS 0xFFFF0957 READ_WRITE /end MEASUREMENT
/begin MEASUREMENT vHTMRCNT "RAM value vHTMRCNT" UWORD COMP_0016 1 100 0 65535 ECU_ADDRESS 0xFFFF46EC READ_WRITE /end MEASUREMENT
/begin MEASUREMENT vHTMRTRP "RAM value vHTMRTRP" UWORD COMP_0016 1 100 0 65535 ECU_ADDRESS 0xFFFF46EE READ_WRITE /end MEASUREMENT
/begin MEASUREMENT vHTWLMT "RAM value vHTWLMT" SWORD COMP_0228 1 100 -3276.8 3276.7 ECU_ADDRESS 0xFFFF0C20 READ_WRITE /end MEASUREMENT
/begin MEASUREMENT vHTWLMT0 "RAM value vHTWLMT0" SWORD COMP_0228 1 100 -3276.8 3276.7 ECU_ADDRESS 0xFFFF0C22 READ_WRITE /end MEASUREMENT
/begin MEASUREMENT vHTWTWN "RAM value vHTWTWN" UWORD COMP_0563_S 1 100 -50 206.24185 ECU_ADDRESS 0xFFFF0C24 READ_WRITE /end MEASUREMENT
/begin MEASUREMENT vHWENAVE "RAM value vHWENAVE" UBYTE COMP_0457_S 1 100 0 326400000 ECU_ADDRESS 0xFFFF3304 READ_WRITE /end MEASUREMENT
/begin MEASUREMENT vHWENRG "RAM value vHWENRG" ULONG COMP_0564_S 1 100 0 5497558137600 ECU_ADDRESS 0xFFFF3308 READ_WRITE /end MEASUREMENT
/begin MEASUREMENT vHZNTP "RAM value vHZNTP" UWORD COMP_0565_S 1 100 0 12799.8046875 ECU_ADDRESS 0xFFFF27C2 READ_WRITE /end MEASUREMENT
/begin MEASUREMENT vIA1CL "RAM value vIA1CL" UWORD COMP_0023 1 100 0 327675 ECU_ADDRESS 0xFFFF4F1C READ_WRITE /end MEASUREMENT
/begin MEASUREMENT vIA2CL "RAM value vIA2CL" UWORD COMP_0023 1 100 0 327675 ECU_ADDRESS 0xFFFF4F1E READ_WRITE /end MEASUREMENT
/begin MEASUREMENT vIADVLMTR "RAM value vIADVLMTR" SBYTE COMP_0018 1 100 -128 127 ECU_ADDRESS 0xFFFF27C4 READ_WRITE /end MEASUREMENT
/begin MEASUREMENT vIALP "RAM value vIALP" SWORD COMP_0438 1 100 -128 127.99609375 ECU_ADDRESS 0xFFFF0C26 READ_WRITE /end MEASUREMENT
/begin MEASUREMENT vIATMLINE "RAM value vIATMLINE" ULONG COMP_0001_S 1 100 0 4294967295 ECU_ADDRESS 0xFFFF3760 READ_WRITE /end MEASUREMENT
/begin MEASUREMENT vIBDGNCONf "RAM value vIBDGNCONf" UBYTE COMP_0004 1 100 0 255 ECU_ADDRESS 0xFFFF27C5 READ_WRITE /end MEASUREMENT
/begin MEASUREMENT vICATL "RAM value vICATL" UBYTE COMP_0031 1 100 0 0.99609375 ECU_ADDRESS 0xFFFF27C6 READ_WRITE /end MEASUREMENT
/begin MEASUREMENT vICATR "RAM value vICATR" UBYTE COMP_0031 1 100 0 0.99609375 ECU_ADDRESS 0xFFFF27C7 READ_WRITE /end MEASUREMENT
/begin MEASUREMENT vICLBUF "RAM value vICLBUF" UWORD COMP_0061 1 100 0 327675 ECU_ADDRESS 0xFFFF27C8 READ_WRITE /end MEASUREMENT
/begin MEASUREMENT vICNT "RAM value vICNT" UBYTE COMP_0030 1 100 0 255 ECU_ADDRESS 0xFFFF27CA READ_WRITE /end MEASUREMENT
/begin MEASUREMENT vICOM1S "RAM value vICOM1S" UBYTE COMP_0068 1 100 0 255 ECU_ADDRESS 0xFFFF30D8 READ_WRITE /end MEASUREMENT
/begin MEASUREMENT vICOM1S_1 "RAM value vICOM1S_1" UBYTE COMP_0004 1 100 0 255 ECU_ADDRESS 0xFFFF314C READ_WRITE /end MEASUREMENT
/begin MEASUREMENT vICOM2 "RAM value vICOM2" ULONG COMP_0566_S 1 100 0 32766.305493555 ECU_ADDRESS 0xFFFF1E04 READ_WRITE /end MEASUREMENT
/begin MEASUREMENT vICOM2AVE "RAM value vICOM2AVE" ULONG COMP_0566_S 1 100 0 32766.305493555 ECU_ADDRESS 0xFFFF3764 READ_WRITE /end MEASUREMENT
/begin MEASUREMENT vICOM2S "RAM value vICOM2S" UBYTE COMP_0068 1 100 0 255 ECU_ADDRESS 0xFFFF30D9 READ_WRITE /end MEASUREMENT
/begin MEASUREMENT vICOM2S_1 "RAM value vICOM2S_1" UBYTE COMP_0004 1 100 0 255 ECU_ADDRESS 0xFFFF314D READ_WRITE /end MEASUREMENT
/begin MEASUREMENT vICOM2Sz2 "RAM value vICOM2Sz2" UBYTE COMP_0004 1 100 0 255 ECU_ADDRESS 0xFFFF314E READ_WRITE /end MEASUREMENT
/begin MEASUREMENT vICOM3 "RAM value vICOM3" SLONG COMP_0567_S 1 100 -8192.0058720256 8192.0058682109 ECU_ADDRESS 0xFFFF3150 READ_WRITE /end MEASUREMENT
/begin MEASUREMENT vICOM3LM "RAM value vICOM3LM" SLONG COMP_0567_S 1 100 -8192.0058720256 8192.0058682109 ECU_ADDRESS 0xFFFF3154 READ_WRITE /end MEASUREMENT
/begin MEASUREMENT vICOMFB "RAM value vICOMFB" SLONG COMP_0567_S 1 100 -8192.0058720256 8192.0058682109 ECU_ADDRESS 0xFFFF3158 READ_WRITE /end MEASUREMENT
/begin MEASUREMENT vICOMFBP "RAM value vICOMFBP" SWORD COMP_0568_S 1 100 -32.768 32.767 ECU_ADDRESS 0xFFFF315C READ_WRITE /end MEASUREMENT
/begin MEASUREMENT vICOMFF "RAM value vICOMFF" SLONG COMP_0567_S 1 100 -8192.0058720256 8192.0058682109 ECU_ADDRESS 0xFFFF3160 READ_WRITE /end MEASUREMENT
/begin MEASUREMENT vICOMMM "RAM value vICOMMM" SLONG COMP_0567_S 1 100 -8192.0058720256 8192.0058682109 ECU_ADDRESS 0xFFFF3164 READ_WRITE /end MEASUREMENT
/begin MEASUREMENT vICOMROB "RAM value vICOMROB" SLONG COMP_0567_S 1 100 -8192.0058720256 8192.0058682109 ECU_ADDRESS 0xFFFF3168 READ_WRITE /end MEASUREMENT
/begin MEASUREMENT vICTMP1 "RAM value vICTMP1" UWORD COMP_0023 1 100 0 327675 ECU_ADDRESS 0xFFFF205C READ_WRITE /end MEASUREMENT
/begin MEASUREMENT vICTMP1EX "RAM value vICTMP1EX" UBYTE COMP_0068 1 100 0 255 ECU_ADDRESS 0xFFFF3768 READ_WRITE /end MEASUREMENT
/begin MEASUREMENT vICTMP1F "RAM value vICTMP1F" UWORD COMP_0023 1 100 0 327675 ECU_ADDRESS 0xFFFF376A READ_WRITE /end MEASUREMENT
/begin MEASUREMENT vICTMP2 "RAM value vICTMP2" UWORD COMP_0023 1 100 0 327675 ECU_ADDRESS 0xFFFF205E READ_WRITE /end MEASUREMENT
/begin MEASUREMENT vICTMP2EX "RAM value vICTMP2EX" UBYTE COMP_0068 1 100 0 255 ECU_ADDRESS 0xFFFF376C READ_WRITE /end MEASUREMENT
/begin MEASUREMENT vICTMP2F "RAM value vICTMP2F" UWORD COMP_0023 1 100 0 327675 ECU_ADDRESS 0xFFFF376E READ_WRITE /end MEASUREMENT
/begin MEASUREMENT vICTMPN1 "RAM value vICTMPN1" UWORD COMP_0158_S 1 100 -50 8141.875 ECU_ADDRESS 0xFFFF2060 READ_WRITE /end MEASUREMENT
/begin MEASUREMENT vICTMPN2 "RAM value vICTMPN2" UWORD COMP_0158_S 1 100 -50 8141.875 ECU_ADDRESS 0xFFFF2062 READ_WRITE /end MEASUREMENT
/begin MEASUREMENT vID0 "RAM value vID0" UWORD COMP_0004 1 100 0 65535 ECU_ADDRESS 0xFFFF0C2A READ_WRITE /end MEASUREMENT
/begin MEASUREMENT vID1 "RAM value vID1" UWORD COMP_0004 1 100 0 65535 ECU_ADDRESS 0xFFFF0C2C READ_WRITE /end MEASUREMENT
/begin MEASUREMENT vIDCESTCT "RAM value vIDCESTCT" UWORD COMP_0066_S 1 100 0 6553.5 ECU_ADDRESS 0xFFFF27CC READ_WRITE /end MEASUREMENT
/begin MEASUREMENT vIDCTSCNT "RAM value vIDCTSCNT" UWORD COMP_0068 1 100 0 65535 ECU_ADDRESS 0xFFFF46F0 READ_WRITE /end MEASUREMENT
/begin MEASUREMENT vIDGRAMAD "RAM value vIDGRAMAD" UWORD COMP_0068 1 100 0 65535 ECU_ADDRESS 0xFFFF27CE READ_WRITE /end MEASUREMENT
/begin MEASUREMENT vIDLELIM "RAM value vIDLELIM" UWORD COMP_0269 1 100 0 127.998046875 ECU_ADDRESS 0xFFFF27D0 READ_WRITE /end MEASUREMENT
/begin MEASUREMENT vIDLETIM "RAM value vIDLETIM" ULONG COMP_0376 1 100 0 429496729.5 ECU_ADDRESS 0xFFFF1778 READ_WRITE /end MEASUREMENT
/begin MEASUREMENT vIDLHOS "RAM value vIDLHOS" SWORD COMP_0569_S 1 100 -16.000024576 15.999536294 ECU_ADDRESS 0xFFFF3770 READ_WRITE /end MEASUREMENT
/begin MEASUREMENT vIDLNENDf "RAM value vIDLNENDf" UBYTE COMP_0004 1 100 0 255 ECU_ADDRESS 0xFFFF0C2E READ_WRITE /end MEASUREMENT
/begin MEASUREMENT vIDLVTC "RAM value vIDLVTC" UBYTE COMP_0256 1 100 -64 63.5 ECU_ADDRESS 0xFFFF0C2F READ_WRITE /end MEASUREMENT
/begin MEASUREMENT vIDLVTCE "RAM value vIDLVTCE" UBYTE COMP_0256 1 100 -64 63.5 ECU_ADDRESS 0xFFFF0C30 READ_WRITE /end MEASUREMENT
/begin MEASUREMENT vIDUTY "RAM value vIDUTY" UWORD COMP_0090_S 1 100 0 13107 ECU_ADDRESS 0xFFFF1E08 READ_WRITE /end MEASUREMENT
/begin MEASUREMENT vIDUTYG "RAM value vIDUTYG" UWORD COMP_0160_S 1 100 0 204.796875 ECU_ADDRESS 0xFFFF3772 READ_WRITE /end MEASUREMENT
/begin MEASUREMENT vIDVTCNE "RAM value vIDVTCNE" UBYTE COMP_0256 1 100 -64 63.5 ECU_ADDRESS 0xFFFF0C31 READ_WRITE /end MEASUREMENT
/begin MEASUREMENT vIDVTCNEE "RAM value vIDVTCNEE" UBYTE COMP_0256 1 100 -64 63.5 ECU_ADDRESS 0xFFFF0C32 READ_WRITE /end MEASUREMENT
/begin MEASUREMENT vIDVTCTW "RAM value vIDVTCTW" UBYTE COMP_0009 1 100 0 199.21875 ECU_ADDRESS 0xFFFF0C33 READ_WRITE /end MEASUREMENT
/begin MEASUREMENT vIDVTCTWE "RAM value vIDVTCTWE" UBYTE COMP_0009 1 100 0 199.21875 ECU_ADDRESS 0xFFFF0C34 READ_WRITE /end MEASUREMENT
/begin MEASUREMENT vIFBKS "RAM value vIFBKS" UBYTE COMP_0068 1 100 0 255 ECU_ADDRESS 0xFFFF30DA READ_WRITE /end MEASUREMENT
/begin MEASUREMENT vIFBKS_1 "RAM value vIFBKS_1" UBYTE COMP_0004 1 100 0 255 ECU_ADDRESS 0xFFFF316C READ_WRITE /end MEASUREMENT
/begin MEASUREMENT vIFBKS_2 "RAM value vIFBKS_2" UBYTE COMP_0004 1 100 0 255 ECU_ADDRESS 0xFFFF316D READ_WRITE /end MEASUREMENT
/begin MEASUREMENT vIFBKS_3 "RAM value vIFBKS_3" UBYTE COMP_0004 1 100 0 255 ECU_ADDRESS 0xFFFF316E READ_WRITE /end MEASUREMENT
/begin MEASUREMENT vIFBKS_4 "RAM value vIFBKS_4" UBYTE COMP_0004 1 100 0 255 ECU_ADDRESS 0xFFFF316F READ_WRITE /end MEASUREMENT
/begin MEASUREMENT vIFBKS_5 "RAM value vIFBKS_5" UBYTE COMP_0004 1 100 0 255 ECU_ADDRESS 0xFFFF3170 READ_WRITE /end MEASUREMENT
/begin MEASUREMENT vIFBKS_6 "RAM value vIFBKS_6" UBYTE COMP_0004 1 100 0 255 ECU_ADDRESS 0xFFFF3171 READ_WRITE /end MEASUREMENT
/begin MEASUREMENT vIGAIN1 "RAM value vIGAIN1" SWORD COMP_0195_S 1 100 -3276.8 3276.7 ECU_ADDRESS 0xFFFF0C36 READ_WRITE /end MEASUREMENT
/begin MEASUREMENT vIGNCT "RAM value vIGNCT" UWORD COMP_0390 1 100 0 655350 ECU_ADDRESS 0xFFFF0C38 READ_WRITE /end MEASUREMENT
/begin MEASUREMENT vIGNTM "RAM value vIGNTM" UBYTE COMP_0073 1 100 0 816 ECU_ADDRESS 0xFFFF0C3A READ_WRITE /end MEASUREMENT
/begin MEASUREMENT vIGOF1CT "RAM value vIGOF1CT" UBYTE COMP_0030 1 100 0 255 ECU_ADDRESS 0xFFFF27D2 READ_WRITE /end MEASUREMENT
/begin MEASUREMENT vIGOFCN "RAM value vIGOFCN" UBYTE COMP_0016 1 100 0 255 ECU_ADDRESS 0xFFFF4F20 READ_WRITE /end MEASUREMENT
/begin MEASUREMENT vIGON12CT "RAM value vIGON12CT" UBYTE COMP_0030 1 100 0 255 ECU_ADDRESS 0xFFFF27D3 READ_WRITE /end MEASUREMENT
/begin MEASUREMENT vIGON1CT "RAM value vIGON1CT" UWORD COMP_0030 1 100 0 65535 ECU_ADDRESS 0xFFFF27D4 READ_WRITE /end MEASUREMENT
/begin MEASUREMENT vIH12CHG "RAM value vIH12CHG" UWORD COMP_0157_S 1 100 0 104856 ECU_ADDRESS 0xFFFF27D6 READ_WRITE /end MEASUREMENT
/begin MEASUREMENT vIHMCNT "RAM value vIHMCNT" UBYTE COMP_0030 1 100 0 255 ECU_ADDRESS 0xFFFF27D8 READ_WRITE /end MEASUREMENT
/begin MEASUREMENT vIILRC1 "RAM value vIILRC1" UWORD COMP_0004 1 100 0 65535 ECU_ADDRESS 0xFFFF46F2 READ_WRITE /end MEASUREMENT
/begin MEASUREMENT vIJ1GDSTCL "RAM value vIJ1GDSTCL" UBYTE COMP_0030 1 100 0 255 ECU_ADDRESS 0xFFFF27D9 READ_WRITE /end MEASUREMENT
/begin MEASUREMENT vIJ1GNDST "RAM value vIJ1GNDST" UBYTE COMP_0030 1 100 0 255 ECU_ADDRESS 0xFFFF27DA READ_WRITE /end MEASUREMENT
/begin MEASUREMENT vIJ1HLST "RAM value vIJ1HLST" UBYTE COMP_0030 1 100 0 255 ECU_ADDRESS 0xFFFF27DB READ_WRITE /end MEASUREMENT
/begin MEASUREMENT vIJ1HLSTCL "RAM value vIJ1HLSTCL" UBYTE COMP_0030 1 100 0 255 ECU_ADDRESS 0xFFFF27DC READ_WRITE /end MEASUREMENT
/begin MEASUREMENT vIJ1OPEN "RAM value vIJ1OPEN" UBYTE COMP_0030 1 100 0 255 ECU_ADDRESS 0xFFFF27DD READ_WRITE /end MEASUREMENT
/begin MEASUREMENT vIJ1OPENCL "RAM value vIJ1OPENCL" UBYTE COMP_0030 1 100 0 255 ECU_ADDRESS 0xFFFF27DE READ_WRITE /end MEASUREMENT
/begin MEASUREMENT vIJ1OVST "RAM value vIJ1OVST" UBYTE COMP_0030 1 100 0 255 ECU_ADDRESS 0xFFFF27DF READ_WRITE /end MEASUREMENT
/begin MEASUREMENT vIJ1OVSTCL "RAM value vIJ1OVSTCL" UBYTE COMP_0030 1 100 0 255 ECU_ADDRESS 0xFFFF27E0 READ_WRITE /end MEASUREMENT
/begin MEASUREMENT vIJ1VBST "RAM value vIJ1VBST" UBYTE COMP_0030 1 100 0 255 ECU_ADDRESS 0xFFFF27E1 READ_WRITE /end MEASUREMENT
/begin MEASUREMENT vIJ1VBSTCL "RAM value vIJ1VBSTCL" UBYTE COMP_0030 1 100 0 255 ECU_ADDRESS 0xFFFF27E2 READ_WRITE /end MEASUREMENT
/begin MEASUREMENT vIJ2GDSTCL "RAM value vIJ2GDSTCL" UBYTE COMP_0030 1 100 0 255 ECU_ADDRESS 0xFFFF27E3 READ_WRITE /end MEASUREMENT
/begin MEASUREMENT vIJ2GNDST "RAM value vIJ2GNDST" UBYTE COMP_0030 1 100 0 255 ECU_ADDRESS 0xFFFF27E4 READ_WRITE /end MEASUREMENT
/begin MEASUREMENT vIJ2HLST "RAM value vIJ2HLST" UBYTE COMP_0030 1 100 0 255 ECU_ADDRESS 0xFFFF27E5 READ_WRITE /end MEASUREMENT
/begin MEASUREMENT vIJ2HLSTCL "RAM value vIJ2HLSTCL" UBYTE COMP_0030 1 100 0 255 ECU_ADDRESS 0xFFFF27E6 READ_WRITE /end MEASUREMENT
/begin MEASUREMENT vIJ2OPEN "RAM value vIJ2OPEN" UBYTE COMP_0030 1 100 0 255 ECU_ADDRESS 0xFFFF27E7 READ_WRITE /end MEASUREMENT
/begin MEASUREMENT vIJ2OPENCL "RAM value vIJ2OPENCL" UBYTE COMP_0030 1 100 0 255 ECU_ADDRESS 0xFFFF27E8 READ_WRITE /end MEASUREMENT
/begin MEASUREMENT vIJ2OVST "RAM value vIJ2OVST" UBYTE COMP_0030 1 100 0 255 ECU_ADDRESS 0xFFFF27E9 READ_WRITE /end MEASUREMENT
/begin MEASUREMENT vIJ2OVSTCL "RAM value vIJ2OVSTCL" UBYTE COMP_0030 1 100 0 255 ECU_ADDRESS 0xFFFF27EA READ_WRITE /end MEASUREMENT
/begin MEASUREMENT vIJ2VBST "RAM value vIJ2VBST" UBYTE COMP_0030 1 100 0 255 ECU_ADDRESS 0xFFFF27EB READ_WRITE /end MEASUREMENT
/begin MEASUREMENT vIJ2VBSTCL "RAM value vIJ2VBSTCL" UBYTE COMP_0030 1 100 0 255 ECU_ADDRESS 0xFFFF27EC READ_WRITE /end MEASUREMENT
/begin MEASUREMENT vIJ3GDSTCL "RAM value vIJ3GDSTCL" UBYTE COMP_0030 1 100 0 255 ECU_ADDRESS 0xFFFF27ED READ_WRITE /end MEASUREMENT
/begin MEASUREMENT vIJ3GNDST "RAM value vIJ3GNDST" UBYTE COMP_0030 1 100 0 255 ECU_ADDRESS 0xFFFF27EE READ_WRITE /end MEASUREMENT
/begin MEASUREMENT vIJ3HLST "RAM value vIJ3HLST" UBYTE COMP_0030 1 100 0 255 ECU_ADDRESS 0xFFFF27EF READ_WRITE /end MEASUREMENT
/begin MEASUREMENT vIJ3HLSTCL "RAM value vIJ3HLSTCL" UBYTE COMP_0030 1 100 0 255 ECU_ADDRESS 0xFFFF27F0 READ_WRITE /end MEASUREMENT
/begin MEASUREMENT vIJ3OPEN "RAM value vIJ3OPEN" UBYTE COMP_0030 1 100 0 255 ECU_ADDRESS 0xFFFF27F1 READ_WRITE /end MEASUREMENT
/begin MEASUREMENT vIJ3OPENCL "RAM value vIJ3OPENCL" UBYTE COMP_0030 1 100 0 255 ECU_ADDRESS 0xFFFF27F2 READ_WRITE /end MEASUREMENT
/begin MEASUREMENT vIJ3OVST "RAM value vIJ3OVST" UBYTE COMP_0030 1 100 0 255 ECU_ADDRESS 0xFFFF27F3 READ_WRITE /end MEASUREMENT
/begin MEASUREMENT vIJ3OVSTCL "RAM value vIJ3OVSTCL" UBYTE COMP_0030 1 100 0 255 ECU_ADDRESS 0xFFFF27F4 READ_WRITE /end MEASUREMENT
/begin MEASUREMENT vIJ3VBST "RAM value vIJ3VBST" UBYTE COMP_0030 1 100 0 255 ECU_ADDRESS 0xFFFF27F5 READ_WRITE /end MEASUREMENT
/begin MEASUREMENT vIJ3VBSTCL "RAM value vIJ3VBSTCL" UBYTE COMP_0030 1 100 0 255 ECU_ADDRESS 0xFFFF27F6 READ_WRITE /end MEASUREMENT
/begin MEASUREMENT vIJ4GDSTCL "RAM value vIJ4GDSTCL" UBYTE COMP_0030 1 100 0 255 ECU_ADDRESS 0xFFFF27F7 READ_WRITE /end MEASUREMENT
/begin MEASUREMENT vIJ4GNDST "RAM value vIJ4GNDST" UBYTE COMP_0030 1 100 0 255 ECU_ADDRESS 0xFFFF27F8 READ_WRITE /end MEASUREMENT
/begin MEASUREMENT vIJ4HLST "RAM value vIJ4HLST" UBYTE COMP_0030 1 100 0 255 ECU_ADDRESS 0xFFFF27F9 READ_WRITE /end MEASUREMENT
/begin MEASUREMENT vIJ4HLSTCL "RAM value vIJ4HLSTCL" UBYTE COMP_0030 1 100 0 255 ECU_ADDRESS 0xFFFF27FA READ_WRITE /end MEASUREMENT
/begin MEASUREMENT vIJ4OPEN "RAM value vIJ4OPEN" UBYTE COMP_0030 1 100 0 255 ECU_ADDRESS 0xFFFF27FB READ_WRITE /end MEASUREMENT
/begin MEASUREMENT vIJ4OPENCL "RAM value vIJ4OPENCL" UBYTE COMP_0030 1 100 0 255 ECU_ADDRESS 0xFFFF27FC READ_WRITE /end MEASUREMENT
/begin MEASUREMENT vIJ4OVST "RAM value vIJ4OVST" UBYTE COMP_0030 1 100 0 255 ECU_ADDRESS 0xFFFF27FD READ_WRITE /end MEASUREMENT
/begin MEASUREMENT vIJ4OVSTCL "RAM value vIJ4OVSTCL" UBYTE COMP_0030 1 100 0 255 ECU_ADDRESS 0xFFFF27FE READ_WRITE /end MEASUREMENT
/begin MEASUREMENT vIJ4VBST "RAM value vIJ4VBST" UBYTE COMP_0030 1 100 0 255 ECU_ADDRESS 0xFFFF27FF READ_WRITE /end MEASUREMENT
/begin MEASUREMENT vIJ4VBSTCL "RAM value vIJ4VBSTCL" UBYTE COMP_0030 1 100 0 255 ECU_ADDRESS 0xFFFF2800 READ_WRITE /end MEASUREMENT
/begin MEASUREMENT vIJCUTCYL "RAM value vIJCUTCYL" UBYTE COMP_0068 1 100 0 255 ECU_ADDRESS 0xFFFF2801 READ_WRITE /end MEASUREMENT
/begin MEASUREMENT vIJFSLMT "RAM value vIJFSLMT" UWORD COMP_0162_S 1 100 0 51199.21875 ECU_ADDRESS 0xFFFF2802 READ_WRITE /end MEASUREMENT
/begin MEASUREMENT vIJSETd "RAM value vIJSETd" ULONG COMP_0320 1 100 0 6871947672 ECU_ADDRESS 0xFFFF0C3C READ_WRITE /end MEASUREMENT
/begin MEASUREMENT vIJTPUP "RAM value vIJTPUP" UBYTE COMP_0068 1 100 0 255 ECU_ADDRESS 0xFFFF0C4C READ_WRITE /end MEASUREMENT
/begin MEASUREMENT vIJVBNG "RAM value vIJVBNG" UBYTE COMP_0068 1 100 0 255 ECU_ADDRESS 0xFFFF2804 READ_WRITE /end MEASUREMENT
/begin MEASUREMENT vILI2MX "RAM value vILI2MX" UWORD COMP_0050 1 100 0 5119.921875 ECU_ADDRESS 0xFFFF46F4 READ_WRITE /end MEASUREMENT
/begin MEASUREMENT vIMEM "RAM value vIMEM" UBYTE COMP_0031 1 100 0 0.99609375 ECU_ADDRESS 0xFFFF3774 READ_WRITE /end MEASUREMENT
/begin MEASUREMENT vIMMEEPRQ "RAM value vIMMEEPRQ" UBYTE COMP_0068 1 100 0 255 ECU_ADDRESS 0xFFFF3775 READ_WRITE /end MEASUREMENT
/begin MEASUREMENT vIMMRXBF "RAM value vIMMRXBF" UBYTE COMP_0068 1 100 0 255 ECU_ADDRESS 0xFFFF3776 READ_WRITE /end MEASUREMENT
/begin MEASUREMENT vIMMTXBF "RAM value vIMMTXBF" UBYTE COMP_0068 1 100 0 255 ECU_ADDRESS 0xFFFF377B READ_WRITE /end MEASUREMENT
/begin MEASUREMENT vIMMTXCNT "RAM value vIMMTXCNT" UBYTE COMP_0068 1 100 0 255 ECU_ADDRESS 0xFFFF3780 READ_WRITE /end MEASUREMENT
/begin MEASUREMENT vIMTID "RAM value vIMTID" UBYTE COMP_0283 1 100 0 255 ECU_ADDRESS 0xFFFF2805 READ_WRITE /end MEASUREMENT
/begin MEASUREMENT vIMTMON "RAM value vIMTMON" UBYTE COMP_0068 1 100 0 255 ECU_ADDRESS 0xFFFF3781 READ_WRITE /end MEASUREMENT
/begin MEASUREMENT vIN "RAM value vIN" SLONG COMP_0264 1 100 -2147483648 2147483647 ECU_ADDRESS 0xFFFF177C READ_WRITE /end MEASUREMENT
/begin MEASUREMENT vIN0 "RAM value vIN0" UWORD COMP_0004 1 100 0 65535 ECU_ADDRESS 0xFFFF0C4E READ_WRITE /end MEASUREMENT
/begin MEASUREMENT vIN1 "RAM value vIN1" UWORD COMP_0004 1 100 0 65535 ECU_ADDRESS 0xFFFF0C50 READ_WRITE /end MEASUREMENT
/begin MEASUREMENT vIN2 "RAM value vIN2" UWORD COMP_0004 1 100 0 65535 ECU_ADDRESS 0xFFFF0C52 READ_WRITE /end MEASUREMENT
/begin MEASUREMENT vINDAOUT "RAM value vINDAOUT" UBYTE COMP_0068 1 100 0 255 ECU_ADDRESS 0xFFFF2806 READ_WRITE /end MEASUREMENT
/begin MEASUREMENT vINDAREA "RAM value vINDAREA" UBYTE COMP_0068 1 100 0 255 ECU_ADDRESS 0xFFFF2110 READ_WRITE /end MEASUREMENT
/begin MEASUREMENT vINDGP "RAM value vINDGP" UBYTE COMP_0068 1 100 0 255 ECU_ADDRESS 0xFFFF08DC READ_WRITE /end MEASUREMENT
/begin MEASUREMENT vINEGR "RAM value vINEGR" SWORD COMP_0499_S 1 100 -100.00007168 99.99701992 ECU_ADDRESS 0xFFFF2808 READ_WRITE /end MEASUREMENT
/begin MEASUREMENT vINEGRA "RAM value vINEGRA" UBYTE COMP_0309_S 1 100 -27.5 100 ECU_ADDRESS 0xFFFF280A READ_WRITE /end MEASUREMENT
/begin MEASUREMENT vINEGRB "RAM value vINEGRB" UBYTE COMP_0309_S 1 100 -27.5 100 ECU_ADDRESS 0xFFFF280B READ_WRITE /end MEASUREMENT
/begin MEASUREMENT vINEXPHP "RAM value vINEXPHP" ULONG COMP_0521_S 1 100 0 429496729.5 ECU_ADDRESS 0xFFFF17FC READ_WRITE /end MEASUREMENT
/begin MEASUREMENT vININVEL "RAM value vININVEL" UWORD COMP_0570_S 1 100 -128 127.99609375 ECU_ADDRESS 0xFFFF0C54 READ_WRITE /end MEASUREMENT
/begin MEASUREMENT vINJACC "RAM value vINJACC" UBYTE COMP_0421 1 100 0 255 ECU_ADDRESS 0xFFFF0C56 READ_WRITE /end MEASUREMENT
/begin MEASUREMENT vINJCT1 "RAM value vINJCT1" UBYTE COMP_0165_S 1 100 4 1024 ECU_ADDRESS 0xFFFF3782 READ_WRITE /end MEASUREMENT
/begin MEASUREMENT vINJCT2 "RAM value vINJCT2" UBYTE COMP_0166_S 1 100 0.5 64.25 ECU_ADDRESS 0xFFFF3783 READ_WRITE /end MEASUREMENT
/begin MEASUREMENT vINJCYM "RAM value vINJCYM" UBYTE COMP_0068 1 100 0 255 ECU_ADDRESS 0xFFFF0C57 READ_WRITE /end MEASUREMENT
/begin MEASUREMENT vINJHD1 "RAM value vINJHD1" UBYTE COMP_0149_S 1 100 0 51 ECU_ADDRESS 0xFFFF3784 READ_WRITE /end MEASUREMENT
/begin MEASUREMENT vINJHD2 "RAM value vINJHD2" UBYTE COMP_0149_S 1 100 0 51 ECU_ADDRESS 0xFFFF3785 READ_WRITE /end MEASUREMENT
/begin MEASUREMENT vINJHYS "RAM value vINJHYS" UBYTE COMP_0150_S 1 100 0.4 51.4 ECU_ADDRESS 0xFFFF3786 READ_WRITE /end MEASUREMENT
/begin MEASUREMENT vINJMON "RAM value vINJMON" UBYTE COMP_0421 1 100 0 255 ECU_ADDRESS 0xFFFF1800 READ_WRITE /end MEASUREMENT
/begin MEASUREMENT vINJOFH "RAM value vINJOFH" UBYTE COMP_0068 1 100 0 255 ECU_ADDRESS 0xFFFF1B32 READ_WRITE /end MEASUREMENT
/begin MEASUREMENT vINJOFS "RAM value vINJOFS" UBYTE COMP_0068 1 100 0 255 ECU_ADDRESS 0xFFFF1B33 READ_WRITE /end MEASUREMENT
/begin MEASUREMENT vINJPHT "RAM value vINJPHT" UBYTE COMP_0167_S 1 100 0 10200 ECU_ADDRESS 0xFFFF3787 READ_WRITE /end MEASUREMENT
/begin MEASUREMENT vINJPK "RAM value vINJPK" UBYTE COMP_0168_S 1 100 4.4 55.4 ECU_ADDRESS 0xFFFF3788 READ_WRITE /end MEASUREMENT
/begin MEASUREMENT vINJPRE "RAM value vINJPRE" UBYTE COMP_0149_S 1 100 0 51 ECU_ADDRESS 0xFFFF3789 READ_WRITE /end MEASUREMENT
/begin MEASUREMENT vINJRYO "RAM value vINJRYO" UWORD COMP_0157_S 1 100 0 104856 ECU_ADDRESS 0xFFFF0C58 READ_WRITE /end MEASUREMENT
/begin MEASUREMENT vINJT2D "RAM value vINJT2D" UBYTE COMP_0169_S 1 100 0 1020 ECU_ADDRESS 0xFFFF378A READ_WRITE /end MEASUREMENT
/begin MEASUREMENT vINJTFD "RAM value vINJTFD" UBYTE COMP_0170_S 1 100 0 5100 ECU_ADDRESS 0xFFFF378B READ_WRITE /end MEASUREMENT
/begin MEASUREMENT vINJTMP "RAM value vINJTMP" UBYTE COMP_0068 1 100 0 255 ECU_ADDRESS 0xFFFF280C READ_WRITE /end MEASUREMENT
/begin MEASUREMENT vINJTXCHK "RAM value vINJTXCHK" UBYTE COMP_0068 1 100 0 255 ECU_ADDRESS 0xFFFF378C READ_WRITE /end MEASUREMENT
/begin MEASUREMENT vINLDST "RAM value vINLDST" UBYTE COMP_0013 1 100 0 255 ECU_ADDRESS 0xFFFF280D READ_WRITE /end MEASUREMENT
/begin MEASUREMENT vINPLMTH "RAM value vINPLMTH" UWORD COMP_0443 1 100 0 65535 ECU_ADDRESS 0xFFFF0C5A READ_WRITE /end MEASUREMENT
/begin MEASUREMENT vINPLMTL "RAM value vINPLMTL" UWORD COMP_0443 1 100 0 65535 ECU_ADDRESS 0xFFFF0C5C READ_WRITE /end MEASUREMENT
/begin MEASUREMENT vINPN "RAM value vINPN" UWORD COMP_0443 1 100 0 65535 ECU_ADDRESS 0xFFFF0C5E READ_WRITE /end MEASUREMENT
/begin MEASUREMENT vINPNE "RAM value vINPNE" UWORD COMP_0065 1 100 0 204796.875 ECU_ADDRESS 0xFFFF0C60 READ_WRITE /end MEASUREMENT
/begin MEASUREMENT vINPOS10 "RAM value vINPOS10" UWORD COMP_0189 1 100 0 209712 ECU_ADDRESS 0xFFFF0C62 READ_WRITE /end MEASUREMENT
/begin MEASUREMENT vINPOS10D "RAM value vINPOS10D" ULONG COMP_0376 1 100 0 429496729.5 ECU_ADDRESS 0xFFFF1804 READ_WRITE /end MEASUREMENT
/begin MEASUREMENT vINPREV "RAM value vINPREV" UWORD COMP_0443 1 100 0 65535 ECU_ADDRESS 0xFFFF08DE READ_WRITE /end MEASUREMENT
/begin MEASUREMENT vINPREVFL "RAM value vINPREVFL" UWORD COMP_0443 1 100 0 65535 ECU_ADDRESS 0xFFFF08E0 READ_WRITE /end MEASUREMENT
/begin MEASUREMENT vINPRT "RAM value vINPRT" UWORD COMP_0450 1 100 0 63.999056205 ECU_ADDRESS 0xFFFF0C64 READ_WRITE /end MEASUREMENT
/begin MEASUREMENT vINRNREQf "RAM value vINRNREQf" UBYTE COMP_0004 1 100 0 255 ECU_ADDRESS 0xFFFF280E READ_WRITE /end MEASUREMENT
/begin MEASUREMENT vINSLVEL "RAM value vINSLVEL" UWORD COMP_0571_S 1 100 -15.999991808 15.999503527 ECU_ADDRESS 0xFFFF0C66 READ_WRITE /end MEASUREMENT
/begin MEASUREMENT vINTGSTPf "RAM value vINTGSTPf" UBYTE COMP_0004 1 100 0 255 ECU_ADDRESS 0xFFFF280F READ_WRITE /end MEASUREMENT
/begin MEASUREMENT vINTPA "RAM value vINTPA" UBYTE COMP_0096 1 100 0 2550 ECU_ADDRESS 0xFFFF0C68 READ_WRITE /end MEASUREMENT
/begin MEASUREMENT vINTVTC "RAM value vINTVTC" UWORD COMP_0570_S 1 100 -128 127.99609375 ECU_ADDRESS 0xFFFF0C6A READ_WRITE /end MEASUREMENT
/begin MEASUREMENT vINVPRCT "RAM value vINVPRCT" UWORD COMP_0030 1 100 0 65535 ECU_ADDRESS 0xFFFF2810 READ_WRITE /end MEASUREMENT
/begin MEASUREMENT vINVTMCT "RAM value vINVTMCT" UBYTE COMP_0030 1 100 0 255 ECU_ADDRESS 0xFFFF2812 READ_WRITE /end MEASUREMENT
/begin MEASUREMENT vINWFT "RAM value vINWFT" UBYTE COMP_0323 1 100 -200 118.75 ECU_ADDRESS 0xFFFF1632 READ_WRITE /end MEASUREMENT
/begin MEASUREMENT vIOCALPV "RAM value vIOCALPV" UWORD COMP_0031 1 100 0 255.99609375 ECU_ADDRESS 0xFFFF2814 READ_WRITE /end MEASUREMENT
/begin MEASUREMENT vIOCLID "RAM value vIOCLID" UBYTE COMP_0004 1 100 0 255 ECU_ADDRESS 0xFFFF378D READ_WRITE /end MEASUREMENT
/begin MEASUREMENT vIOCLIDZ "RAM value vIOCLIDZ" UBYTE COMP_0004 1 100 0 255 ECU_ADDRESS 0xFFFF378E READ_WRITE /end MEASUREMENT
/begin MEASUREMENT vIOSTS "RAM value vIOSTS" UBYTE COMP_0004 1 100 0 255 ECU_ADDRESS 0xFFFF378F READ_WRITE /end MEASUREMENT
/begin MEASUREMENT vIQTSEP1 "RAM value vIQTSEP1" UWORD COMP_0068 1 100 0 65535 ECU_ADDRESS 0xFFFF46F6 READ_WRITE /end MEASUREMENT
/begin MEASUREMENT vIREFS "RAM value vIREFS" UBYTE COMP_0068 1 100 0 255 ECU_ADDRESS 0xFFFF30DB READ_WRITE /end MEASUREMENT
/begin MEASUREMENT vIREFS_1 "RAM value vIREFS_1" UBYTE COMP_0004 1 100 0 255 ECU_ADDRESS 0xFFFF3172 READ_WRITE /end MEASUREMENT
/begin MEASUREMENT vIREFS_2 "RAM value vIREFS_2" UBYTE COMP_0004 1 100 0 255 ECU_ADDRESS 0xFFFF3173 READ_WRITE /end MEASUREMENT
/begin MEASUREMENT vIREFS_3 "RAM value vIREFS_3" UBYTE COMP_0004 1 100 0 255 ECU_ADDRESS 0xFFFF3174 READ_WRITE /end MEASUREMENT
/begin MEASUREMENT vIREFS_4 "RAM value vIREFS_4" UBYTE COMP_0004 1 100 0 255 ECU_ADDRESS 0xFFFF3175 READ_WRITE /end MEASUREMENT
/begin MEASUREMENT vIROB "RAM value vIROB" ULONG COMP_0566_S 1 100 0 32766.305493555 ECU_ADDRESS 0xFFFF3178 READ_WRITE /end MEASUREMENT
/begin MEASUREMENT vIROBS "RAM value vIROBS" UBYTE COMP_0068 1 100 0 255 ECU_ADDRESS 0xFFFF30DC READ_WRITE /end MEASUREMENT
/begin MEASUREMENT vIRbuf "RAM value vIRbuf" UWORD COMP_0004 1 100 0 65535 ECU_ADDRESS 0xFFFF3790 READ_WRITE /end MEASUREMENT
/begin MEASUREMENT vISCAU "RAM value vISCAU" UWORD COMP_0444 1 100 0 255.99609375 ECU_ADDRESS 0xFFFF0C6C READ_WRITE /end MEASUREMENT
/begin MEASUREMENT vISCBCP "RAM value vISCBCP" UWORD COMP_0324 1 100 0 511.9921875 ECU_ADDRESS 0xFFFF0C6E READ_WRITE /end MEASUREMENT
/begin MEASUREMENT vISCBFN "RAM value vISCBFN" UWORD COMP_0444 1 100 0 255.99609375 ECU_ADDRESS 0xFFFF0C70 READ_WRITE /end MEASUREMENT
/begin MEASUREMENT vISCCNT "RAM value vISCCNT" UWORD COMP_0016 1 100 0 65535 ECU_ADDRESS 0xFFFF46F8 READ_WRITE /end MEASUREMENT
/begin MEASUREMENT vISCDEF "RAM value vISCDEF" UWORD COMP_0444 1 100 0 255.99609375 ECU_ADDRESS 0xFFFF0C72 READ_WRITE /end MEASUREMENT
/begin MEASUREMENT vISCDPU "RAM value vISCDPU" UWORD COMP_0444 1 100 0 255.99609375 ECU_ADDRESS 0xFFFF0C74 READ_WRITE /end MEASUREMENT
/begin MEASUREMENT vISCHLH "RAM value vISCHLH" UWORD COMP_0444 1 100 0 255.99609375 ECU_ADDRESS 0xFFFF0C76 READ_WRITE /end MEASUREMENT
/begin MEASUREMENT vISCLRC01 "RAM value vISCLRC01" SLONG COMP_0572_S 1 100 -32766.305501184 32766.305485926 ECU_ADDRESS 0xFFFF46FC READ_WRITE /end MEASUREMENT
/begin MEASUREMENT vISCLRC11 "RAM value vISCLRC11" SWORD COMP_0277 1 100 -32768 32767 ECU_ADDRESS 0xFFFF0C78 READ_WRITE /end MEASUREMENT
/begin MEASUREMENT vISCLRC21 "RAM value vISCLRC21" SWORD COMP_0277 1 100 -32768 32767 ECU_ADDRESS 0xFFFF4700 READ_WRITE /end MEASUREMENT
/begin MEASUREMENT vISCLRCB "RAM value vISCLRCB" SWORD COMP_0277 1 100 -32768 32767 ECU_ADDRESS 0xFFFF4702 READ_WRITE /end MEASUREMENT
/begin MEASUREMENT vISCLRCBZ "RAM value vISCLRCBZ" SWORD COMP_0277 1 100 -32768 32767 ECU_ADDRESS 0xFFFF0C7A READ_WRITE /end MEASUREMENT
/begin MEASUREMENT vISCLRCZ0 "RAM value vISCLRCZ0" SWORD COMP_0277 1 100 -32768 32767 ECU_ADDRESS 0xFFFF0C7C READ_WRITE /end MEASUREMENT
/begin MEASUREMENT vISCLRCZ01 "RAM value vISCLRCZ01" SLONG COMP_0573_S 1 100 -8388608 8388607.99609375 ECU_ADDRESS 0xFFFF0C80 READ_WRITE /end MEASUREMENT
/begin MEASUREMENT vISCLU1 "RAM value vISCLU1" UWORD COMP_0444 1 100 0 255.99609375 ECU_ADDRESS 0xFFFF0C84 READ_WRITE /end MEASUREMENT
/begin MEASUREMENT vISCLU2 "RAM value vISCLU2" UWORD COMP_0444 1 100 0 255.99609375 ECU_ADDRESS 0xFFFF0C86 READ_WRITE /end MEASUREMENT
/begin MEASUREMENT vISCPB "RAM value vISCPB" UBYTE COMP_0009 1 100 0 199.21875 ECU_ADDRESS 0xFFFF2818 READ_WRITE /end MEASUREMENT
/begin MEASUREMENT vISCRTD "RAM value vISCRTD" UBYTE COMP_0051 1 100 0 255 ECU_ADDRESS 0xFFFF0C88 READ_WRITE /end MEASUREMENT
/begin MEASUREMENT vISCRU "RAM value vISCRU" UWORD COMP_0444 1 100 0 255.99609375 ECU_ADDRESS 0xFFFF0C8A READ_WRITE /end MEASUREMENT
/begin MEASUREMENT vISCSST "RAM value vISCSST" UBYTE COMP_0293 1 100 0 510 ECU_ADDRESS 0xFFFF0C8C READ_WRITE /end MEASUREMENT
/begin MEASUREMENT vISCST "RAM value vISCST" UBYTE COMP_0293 1 100 0 510 ECU_ADDRESS 0xFFFF0C8D READ_WRITE /end MEASUREMENT
/begin MEASUREMENT vISCST1 "RAM value vISCST1" UWORD COMP_0324 1 100 0 511.9921875 ECU_ADDRESS 0xFFFF0C8E READ_WRITE /end MEASUREMENT
/begin MEASUREMENT vISCSTM "RAM value vISCSTM" UBYTE COMP_0293 1 100 0 510 ECU_ADDRESS 0xFFFF0C90 READ_WRITE /end MEASUREMENT
/begin MEASUREMENT vISCSTT "RAM value vISCSTT" UBYTE COMP_0293 1 100 0 510 ECU_ADDRESS 0xFFFF0C91 READ_WRITE /end MEASUREMENT
/begin MEASUREMENT vISCTA "RAM value vISCTA" UBYTE COMP_0009 1 100 0 199.21875 ECU_ADDRESS 0xFFFF2819 READ_WRITE /end MEASUREMENT
/begin MEASUREMENT vISCV "RAM value vISCV" UBYTE COMP_0054 1 100 0 5100 ECU_ADDRESS 0xFFFF08E2 READ_WRITE /end MEASUREMENT
/begin MEASUREMENT vISCVSP "RAM value vISCVSP" UBYTE COMP_0007 1 100 0 510 ECU_ADDRESS 0xFFFF1633 READ_WRITE /end MEASUREMENT
/begin MEASUREMENT vISQFBI "RAM value vISQFBI" UBYTE COMP_0051 1 100 0 255 ECU_ADDRESS 0xFFFF281A READ_WRITE /end MEASUREMENT
/begin MEASUREMENT vISRINT01 "RAM value vISRINT01" SLONG COMP_0572_S 1 100 -32766.305501184 32766.305485926 ECU_ADDRESS 0xFFFF0C94 READ_WRITE /end MEASUREMENT
/begin MEASUREMENT vISSTPD "RAM value vISSTPD" UWORD COMP_0025 1 100 0 32767.5 ECU_ADDRESS 0xFFFF281C READ_WRITE /end MEASUREMENT
/begin MEASUREMENT vISTPRCVf "RAM value vISTPRCVf" UBYTE COMP_0004 1 100 0 255 ECU_ADDRESS 0xFFFF281E READ_WRITE /end MEASUREMENT
/begin MEASUREMENT vISUT "RAM value vISUT" UBYTE COMP_0049 1 100 0 255 ECU_ADDRESS 0xFFFF0C98 READ_WRITE /end MEASUREMENT
/begin MEASUREMENT vIT1CL "RAM value vIT1CL" SWORD COMP_0408 1 100 -163840 163835 ECU_ADDRESS 0xFFFF4F22 READ_WRITE /end MEASUREMENT
/begin MEASUREMENT vIT2CL "RAM value vIT2CL" SWORD COMP_0408 1 100 -163840 163835 ECU_ADDRESS 0xFFFF4F24 READ_WRITE /end MEASUREMENT
/begin MEASUREMENT vIT4BCL "RAM value vIT4BCL" UWORD COMP_0061 1 100 0 327675 ECU_ADDRESS 0xFFFF4E3A READ_WRITE /end MEASUREMENT
/begin MEASUREMENT vITAC "RAM value vITAC" UBYTE COMP_0009 1 100 0 199.21875 ECU_ADDRESS 0xFFFF0828 READ_WRITE /end MEASUREMENT
/begin MEASUREMENT vITACESTB "RAM value vITACESTB" UBYTE COMP_0009 1 100 0 199.21875 ECU_ADDRESS 0xFFFF0C99 READ_WRITE /end MEASUREMENT
/begin MEASUREMENT vITACTEH "RAM value vITACTEH" UWORD COMP_0209_S 1 100 0 199.996894995 ECU_ADDRESS 0xFFFF0C9C READ_WRITE /end MEASUREMENT
/begin MEASUREMENT vITACWOT "RAM value vITACWOT" UBYTE COMP_0009 1 100 0 199.21875 ECU_ADDRESS 0xFFFF0C9E READ_WRITE /end MEASUREMENT
/begin MEASUREMENT vITAC_F "RAM value vITAC_F" UBYTE COMP_0009 1 100 0 199.21875 ECU_ADDRESS 0xFFFF0829 READ_WRITE /end MEASUREMENT
/begin MEASUREMENT vITAFS2R "RAM value vITAFS2R" UBYTE COMP_0095 1 100 0 398.4375 ECU_ADDRESS 0xFFFF281F READ_WRITE /end MEASUREMENT
/begin MEASUREMENT vITAFSCHR "RAM value vITAFSCHR" UWORD COMP_0456 1 100 0 1.999970916 ECU_ADDRESS 0xFFFF2820 READ_WRITE /end MEASUREMENT
/begin MEASUREMENT vITAFSR "RAM value vITAFSR" UBYTE COMP_0095 1 100 0 398.4375 ECU_ADDRESS 0xFFFF2822 READ_WRITE /end MEASUREMENT
/begin MEASUREMENT vITAFSR_S "RAM value vITAFSR_S" UBYTE COMP_0095 1 100 0 398.4375 ECU_ADDRESS 0xFFFF304A READ_WRITE /end MEASUREMENT
/begin MEASUREMENT vITAN "RAM value vITAN" UBYTE COMP_0009 1 100 0 199.21875 ECU_ADDRESS 0xFFFF08E3 READ_WRITE /end MEASUREMENT
/begin MEASUREMENT vITAND "RAM value vITAND" UBYTE COMP_0009 1 100 0 199.21875 ECU_ADDRESS 0xFFFF15A6 READ_WRITE /end MEASUREMENT
/begin MEASUREMENT vITANQ "RAM value vITANQ" UWORD COMP_0483_S 1 100 0 199.9970916 ECU_ADDRESS 0xFFFF2824 READ_WRITE /end MEASUREMENT
/begin MEASUREMENT vITAN_F "RAM value vITAN_F" UBYTE COMP_0009 1 100 0 199.21875 ECU_ADDRESS 0xFFFF08E4 READ_WRITE /end MEASUREMENT
/begin MEASUREMENT vITDAMP "RAM value vITDAMP" UWORD COMP_0456 1 100 0 1.999970916 ECU_ADDRESS 0xFFFF3B68 READ_WRITE /end MEASUREMENT
/begin MEASUREMENT vITO "RAM value vITO" UBYTE COMP_0425 1 100 0 99.99999981 ECU_ADDRESS 0xFFFF3792 READ_WRITE /end MEASUREMENT
/begin MEASUREMENT vITPGRTD "RAM value vITPGRTD" UBYTE COMP_0190 1 100 0 510 ECU_ADDRESS 0xFFFF2826 READ_WRITE /end MEASUREMENT
/begin MEASUREMENT vITVLNA "RAM value vITVLNA" UWORD COMP_0042 1 100 0 52.428 ECU_ADDRESS 0xFFFF4704 READ_WRITE /end MEASUREMENT
/begin MEASUREMENT vITVLNS "RAM value vITVLNS" UWORD COMP_0042 1 100 0 52.428 ECU_ADDRESS 0xFFFF4706 READ_WRITE /end MEASUREMENT
/begin MEASUREMENT vITVRESET1 "RAM value vITVRESET1" UBYTE COMP_0004 1 100 0 255 ECU_ADDRESS 0xFFFF2827 READ_WRITE /end MEASUREMENT
/begin MEASUREMENT vITVRESET2 "RAM value vITVRESET2" UBYTE COMP_0004 1 100 0 255 ECU_ADDRESS 0xFFFF2828 READ_WRITE /end MEASUREMENT
/begin MEASUREMENT vIVNGCNT "RAM value vIVNGCNT" UBYTE COMP_0068 1 100 0 255 ECU_ADDRESS 0xFFFF2829 READ_WRITE /end MEASUREMENT
/begin MEASUREMENT vIVSPCOMN "RAM value vIVSPCOMN" SLONG COMP_0144_S 1 100 -1843.20024746394 1843.20024660563 ECU_ADDRESS 0xFFFF3B6C READ_WRITE /end MEASUREMENT
/begin MEASUREMENT vIVTCE1 "RAM value vIVTCE1" UBYTE COMP_0046_S 1 100 0 0.99609375 ECU_ADDRESS 0xFFFF317C READ_WRITE /end MEASUREMENT
/begin MEASUREMENT vIVTCE2 "RAM value vIVTCE2" UBYTE COMP_0046_S 1 100 0 0.99609375 ECU_ADDRESS 0xFFFF317D READ_WRITE /end MEASUREMENT
/begin MEASUREMENT vIVTCI1 "RAM value vIVTCI1" UBYTE COMP_0046_S 1 100 0 0.99609375 ECU_ADDRESS 0xFFFF317E READ_WRITE /end MEASUREMENT
/begin MEASUREMENT vIVTCI2 "RAM value vIVTCI2" UBYTE COMP_0046_S 1 100 0 0.99609375 ECU_ADDRESS 0xFFFF317F READ_WRITE /end MEASUREMENT
/begin MEASUREMENT vJGEVP1 "RAM value vJGEVP1" UBYTE COMP_0054 1 100 0 5100 ECU_ADDRESS 0xFFFF282A READ_WRITE /end MEASUREMENT
/begin MEASUREMENT vJGEVP2 "RAM value vJGEVP2" UBYTE COMP_0054 1 100 0 5100 ECU_ADDRESS 0xFFFF282B READ_WRITE /end MEASUREMENT
/begin MEASUREMENT vJGLRD "RAM value vJGLRD" UWORD COMP_0453 1 100 0 131.07 ECU_ADDRESS 0xFFFF282C READ_WRITE /end MEASUREMENT
/begin MEASUREMENT vJGRLD "RAM value vJGRLD" UWORD COMP_0453 1 100 0 131.07 ECU_ADDRESS 0xFFFF2830 READ_WRITE /end MEASUREMENT
/begin MEASUREMENT vJKDTTGNE "RAM value vJKDTTGNE" SWORD COMP_0574_S 1 100 -512 511.984375 ECU_ADDRESS 0xFFFF2834 READ_WRITE /end MEASUREMENT
/begin MEASUREMENT vJKFFTRQ "RAM value vJKFFTRQ" UWORD COMP_0196 1 100 0 6553.5 ECU_ADDRESS 0xFFFF2836 READ_WRITE /end MEASUREMENT
/begin MEASUREMENT vJKGKTQR1 "RAM value vJKGKTQR1" SWORD COMP_0228 1 100 -3276.8 3276.7 ECU_ADDRESS 0xFFFF2838 READ_WRITE /end MEASUREMENT
/begin MEASUREMENT vJKGKTQR2 "RAM value vJKGKTQR2" SWORD COMP_0228 1 100 -3276.8 3276.7 ECU_ADDRESS 0xFFFF283A READ_WRITE /end MEASUREMENT
/begin MEASUREMENT vJKIPGAIN "RAM value vJKIPGAIN" UBYTE COMP_0373 1 100 0 2.55 ECU_ADDRESS 0xFFFF283C READ_WRITE /end MEASUREMENT
/begin MEASUREMENT vJKIPGRAT "RAM value vJKIPGRAT" UWORD COMP_0447 1 100 0 6399.90234375 ECU_ADDRESS 0xFFFF283E READ_WRITE /end MEASUREMENT
/begin MEASUREMENT vJKRTO0F "RAM value vJKRTO0F" UWORD COMP_0028 1 100 0 2.5599609375 ECU_ADDRESS 0xFFFF2112 READ_WRITE /end MEASUREMENT
/begin MEASUREMENT vJKSRCTQ0 "RAM value vJKSRCTQ0" SWORD COMP_0228 1 100 -3276.8 3276.7 ECU_ADDRESS 0xFFFF2840 READ_WRITE /end MEASUREMENT
/begin MEASUREMENT vJKSRCTQF "RAM value vJKSRCTQF" SWORD COMP_0228 1 100 -3276.8 3276.7 ECU_ADDRESS 0xFFFF2842 READ_WRITE /end MEASUREMENT
/begin MEASUREMENT vJKSRCTQS "RAM value vJKSRCTQS" SWORD COMP_0228 1 100 -3276.8 3276.7 ECU_ADDRESS 0xFFFF2844 READ_WRITE /end MEASUREMENT
/begin MEASUREMENT vJOB10MAX "RAM value vJOB10MAX" ULONG COMP_0376 1 100 0 429496729.5 ECU_ADDRESS 0xFFFF3794 READ_WRITE /end MEASUREMENT
/begin MEASUREMENT vJOB10TIM "RAM value vJOB10TIM" ULONG COMP_0376 1 100 0 429496729.5 ECU_ADDRESS 0xFFFF1634 READ_WRITE /end MEASUREMENT
/begin MEASUREMENT vJOB1MAX "RAM value vJOB1MAX" ULONG COMP_0376 1 100 0 429496729.5 ECU_ADDRESS 0xFFFF30BC READ_WRITE /end MEASUREMENT
/begin MEASUREMENT vJOB1TIM "RAM value vJOB1TIM" ULONG COMP_0376 1 100 0 429496729.5 ECU_ADDRESS 0xFFFF1538 READ_WRITE /end MEASUREMENT
/begin MEASUREMENT vJOB2MAX "RAM value vJOB2MAX" ULONG COMP_0376 1 100 0 429496729.5 ECU_ADDRESS 0xFFFF3180 READ_WRITE /end MEASUREMENT
/begin MEASUREMENT vJOB2TIM "RAM value vJOB2TIM" ULONG COMP_0376 1 100 0 429496729.5 ECU_ADDRESS 0xFFFF1544 READ_WRITE /end MEASUREMENT
/begin MEASUREMENT vJOB4MAX "RAM value vJOB4MAX" ULONG COMP_0376 1 100 0 429496729.5 ECU_ADDRESS 0xFFFF330C READ_WRITE /end MEASUREMENT
/begin MEASUREMENT vJOB4TIM "RAM value vJOB4TIM" ULONG COMP_0376 1 100 0 429496729.5 ECU_ADDRESS 0xFFFF1584 READ_WRITE /end MEASUREMENT
/begin MEASUREMENT vJOBFGMAX "RAM value vJOBFGMAX" ULONG COMP_0376 1 100 0 429496729.5 ECU_ADDRESS 0xFFFF3798 READ_WRITE /end MEASUREMENT
/begin MEASUREMENT vJOBFGTIM "RAM value vJOBFGTIM" ULONG COMP_0376 1 100 0 429496729.5 ECU_ADDRESS 0xFFFF1638 READ_WRITE /end MEASUREMENT
/begin MEASUREMENT vJOBRFMAX "RAM value vJOBRFMAX" ULONG COMP_0376 1 100 0 429496729.5 ECU_ADDRESS 0xFFFF3A1C READ_WRITE /end MEASUREMENT
/begin MEASUREMENT vJOBRFTIM "RAM value vJOBRFTIM" ULONG COMP_0376 1 100 0 429496729.5 ECU_ADDRESS 0xFFFF1808 READ_WRITE /end MEASUREMENT
/begin MEASUREMENT vJOBRVMAX "RAM value vJOBRVMAX" ULONG COMP_0376 1 100 0 429496729.5 ECU_ADDRESS 0xFFFF3A58 READ_WRITE /end MEASUREMENT
/begin MEASUREMENT vJOBRVTIM "RAM value vJOBRVTIM" ULONG COMP_0376 1 100 0 429496729.5 ECU_ADDRESS 0xFFFF1A28 READ_WRITE /end MEASUREMENT
/begin MEASUREMENT vJUGCNTf "RAM value vJUGCNTf" UBYTE COMP_0004 1 100 0 255 ECU_ADDRESS 0xFFFF2846 READ_WRITE /end MEASUREMENT
/begin MEASUREMENT vK1 "RAM value vK1" UBYTE COMP_0174_S 1 100 0 255 ECU_ADDRESS 0xFFFF0C9F READ_WRITE /end MEASUREMENT
/begin MEASUREMENT vK2Y "RAM value vK2Y" UBYTE COMP_0174_S 1 100 0 255 ECU_ADDRESS 0xFFFF0CA0 READ_WRITE /end MEASUREMENT
/begin MEASUREMENT vKAFCUT "RAM value vKAFCUT" UBYTE COMP_0388 1 100 0 25.5 ECU_ADDRESS 0xFFFF379C READ_WRITE /end MEASUREMENT
/begin MEASUREMENT vKAISEIVB "RAM value vKAISEIVB" UBYTE COMP_0033 1 100 0 20400 ECU_ADDRESS 0xFFFF2847 READ_WRITE /end MEASUREMENT
/begin MEASUREMENT vKAIVBBK "RAM value vKAIVBBK" UBYTE COMP_0033 1 100 0 20400 ECU_ADDRESS 0xFFFF2848 READ_WRITE /end MEASUREMENT
/begin MEASUREMENT vKAIVBTRQ "RAM value vKAIVBTRQ" UWORD COMP_0575_S 1 100 0 26214 ECU_ADDRESS 0xFFFF284A READ_WRITE /end MEASUREMENT
/begin MEASUREMENT vKAJYU1 "RAM value vKAJYU1" UWORD COMP_0069 1 100 0 1.999970916 ECU_ADDRESS 0xFFFF08E6 READ_WRITE /end MEASUREMENT
/begin MEASUREMENT vKAPS1BK "RAM value vKAPS1BK" UWORD COMP_0004 1 100 0 65535 ECU_ADDRESS 0xFFFF379E READ_WRITE /end MEASUREMENT
/begin MEASUREMENT vKAPS2BK "RAM value vKAPS2BK" UWORD COMP_0004 1 100 0 65535 ECU_ADDRESS 0xFFFF37A0 READ_WRITE /end MEASUREMENT
/begin MEASUREMENT vKAS "RAM value vKAS" UWORD COMP_0217 1 100 0 3.999941832 ECU_ADDRESS 0xFFFF0CA2 READ_WRITE /end MEASUREMENT
/begin MEASUREMENT vKASS "RAM value vKASS" UWORD COMP_0217 1 100 0 3.999941832 ECU_ADDRESS 0xFFFF284C READ_WRITE /end MEASUREMENT
/begin MEASUREMENT vKASSST "RAM value vKASSST" UWORD COMP_0217 1 100 0 3.999941832 ECU_ADDRESS 0xFFFF284E READ_WRITE /end MEASUREMENT
/begin MEASUREMENT vKASST "RAM value vKASST" UWORD COMP_0217 1 100 0 3.999941832 ECU_ADDRESS 0xFFFF0CA4 READ_WRITE /end MEASUREMENT
/begin MEASUREMENT vKCRADV "RAM value vKCRADV" UWORD COMP_0456 1 100 0 1.999970916 ECU_ADDRESS 0xFFFF0CA6 READ_WRITE /end MEASUREMENT
/begin MEASUREMENT vKCTVSP "RAM value vKCTVSP" UBYTE COMP_0009 1 100 0 199.21875 ECU_ADDRESS 0xFFFF2850 READ_WRITE /end MEASUREMENT
/begin MEASUREMENT vKDADV "RAM value vKDADV" UBYTE COMP_0021 1 100 0 99.609375 ECU_ADDRESS 0xFFFF0CA8 READ_WRITE /end MEASUREMENT
/begin MEASUREMENT vKDBIDX "RAM value vKDBIDX" UBYTE COMP_0004 1 100 0 255 ECU_ADDRESS 0xFFFF180C READ_WRITE /end MEASUREMENT
/begin MEASUREMENT vKDGROMAD "RAM value vKDGROMAD" ULONG COMP_0068 1 100 0 4294967295 ECU_ADDRESS 0xFFFF2854 READ_WRITE /end MEASUREMENT
/begin MEASUREMENT vKDL "RAM value vKDL" UWORD COMP_0032 1 100 0 255.99609375 ECU_ADDRESS 0xFFFF180E READ_WRITE /end MEASUREMENT
/begin MEASUREMENT vKDLMON "RAM value vKDLMON" UWORD COMP_0032 1 100 0 255.99609375 ECU_ADDRESS 0xFFFF181E READ_WRITE /end MEASUREMENT
/begin MEASUREMENT vKDLW "RAM value vKDLW" UWORD COMP_0032 1 100 0 255.99609375 ECU_ADDRESS 0xFFFF185E READ_WRITE /end MEASUREMENT
/begin MEASUREMENT vKDSP "RAM value vKDSP" UWORD COMP_0436 1 100 0 6553.5 ECU_ADDRESS 0xFFFF2064 READ_WRITE /end MEASUREMENT
/begin MEASUREMENT vKDUTY "RAM value vKDUTY" UBYTE COMP_0044 1 100 0 1.9921875 ECU_ADDRESS 0xFFFF2858 READ_WRITE /end MEASUREMENT
/begin MEASUREMENT vKETCL "RAM value vKETCL" UBYTE COMP_0265_S 1 100 0 1.275 ECU_ADDRESS 0xFFFF2859 READ_WRITE /end MEASUREMENT
/begin MEASUREMENT vKFP "RAM value vKFP" UBYTE COMP_0063 1 100 0 0.99609375 ECU_ADDRESS 0xFFFF1548 READ_WRITE /end MEASUREMENT
/begin MEASUREMENT vKHOT "RAM value vKHOT" UWORD COMP_0217 1 100 0 3.999941832 ECU_ADDRESS 0xFFFF0CAA READ_WRITE /end MEASUREMENT
/begin MEASUREMENT vKHOTMP "RAM value vKHOTMP" UBYTE COMP_0045 1 100 0 1.9921875 ECU_ADDRESS 0xFFFF0CAC READ_WRITE /end MEASUREMENT
/begin MEASUREMENT vKHOTTN "RAM value vKHOTTN" UBYTE COMP_0045 1 100 0 1.9921875 ECU_ADDRESS 0xFFFF0CAD READ_WRITE /end MEASUREMENT
/begin MEASUREMENT vKHST1S "RAM value vKHST1S" UBYTE COMP_0049 1 100 0 255 ECU_ADDRESS 0xFFFF285A READ_WRITE /end MEASUREMENT
/begin MEASUREMENT vKIGAIN1 "RAM value vKIGAIN1" UWORD COMP_0081 1 100 0 255.99609375 ECU_ADDRESS 0xFFFF0CAE READ_WRITE /end MEASUREMENT
/begin MEASUREMENT vKINJ "RAM value vKINJ" UWORD COMP_0328 1 100 0 399.99392106 ECU_ADDRESS 0xFFFF0CB0 READ_WRITE /end MEASUREMENT
/begin MEASUREMENT vKINSIf "RAM value vKINSIf" UBYTE COMP_0004 1 100 0 255 ECU_ADDRESS 0xFFFF285B READ_WRITE /end MEASUREMENT
/begin MEASUREMENT vKITAEGR "RAM value vKITAEGR" UBYTE COMP_0009 1 100 0 199.21875 ECU_ADDRESS 0xFFFF0CB2 READ_WRITE /end MEASUREMENT
/begin MEASUREMENT vKITAEGR0 "RAM value vKITAEGR0" UBYTE COMP_0009 1 100 0 199.21875 ECU_ADDRESS 0xFFFF0CB3 READ_WRITE /end MEASUREMENT
/begin MEASUREMENT vKITAEGR1 "RAM value vKITAEGR1" UBYTE COMP_0009 1 100 0 199.21875 ECU_ADDRESS 0xFFFF0CB4 READ_WRITE /end MEASUREMENT
/begin MEASUREMENT vKITAEGR2 "RAM value vKITAEGR2" UBYTE COMP_0009 1 100 0 199.21875 ECU_ADDRESS 0xFFFF0CB5 READ_WRITE /end MEASUREMENT
/begin MEASUREMENT vKITAEGR_S "RAM value vKITAEGR_S" UBYTE COMP_0009 1 100 0 199.21875 ECU_ADDRESS 0xFFFF14AE READ_WRITE /end MEASUREMENT
/begin MEASUREMENT vKMFd "RAM value vKMFd" UBYTE COMP_0258 1 100 0 12.451171875 ECU_ADDRESS 0xFFFF0CB6 READ_WRITE /end MEASUREMENT
/begin MEASUREMENT vKMKTW "RAM value vKMKTW" UBYTE COMP_0063 1 100 0 0.99609375 ECU_ADDRESS 0xFFFF0CB7 READ_WRITE /end MEASUREMENT
/begin MEASUREMENT vKMKTW0 "RAM value vKMKTW0" UBYTE COMP_0068 1 100 0 255 ECU_ADDRESS 0xFFFF0CB8 READ_WRITE /end MEASUREMENT
/begin MEASUREMENT vKMRLBT "RAM value vKMRLBT" UBYTE COMP_0017 1 100 0 255 ECU_ADDRESS 0xFFFF0CB9 READ_WRITE /end MEASUREMENT
/begin MEASUREMENT vKMRM "RAM value vKMRM" UBYTE COMP_0044 1 100 0 1.9921875 ECU_ADDRESS 0xFFFF0CBA READ_WRITE /end MEASUREMENT
/begin MEASUREMENT vKMRM2 "RAM value vKMRM2" UWORD COMP_0057 1 100 0 3.999941832 ECU_ADDRESS 0xFFFF0CBC READ_WRITE /end MEASUREMENT
/begin MEASUREMENT vKMRMLBT "RAM value vKMRMLBT" UBYTE COMP_0045 1 100 0 1.9921875 ECU_ADDRESS 0xFFFF285C READ_WRITE /end MEASUREMENT
/begin MEASUREMENT vKMRRTD "RAM value vKMRRTD" UBYTE COMP_0017 1 100 0 255 ECU_ADDRESS 0xFFFF0CBE READ_WRITE /end MEASUREMENT
/begin MEASUREMENT vKMRSTP "RAM value vKMRSTP" UWORD COMP_0217 1 100 0 3.999941832 ECU_ADDRESS 0xFFFF0CC0 READ_WRITE /end MEASUREMENT
/begin MEASUREMENT vKMRTP "RAM value vKMRTP" UBYTE COMP_0009 1 100 0 199.21875 ECU_ADDRESS 0xFFFF0CC2 READ_WRITE /end MEASUREMENT
/begin MEASUREMENT vKMRTRG "RAM value vKMRTRG" UWORD COMP_0453 1 100 0 131.07 ECU_ADDRESS 0xFFFF285E READ_WRITE /end MEASUREMENT
/begin MEASUREMENT vKMRTRG1 "RAM value vKMRTRG1" UWORD COMP_0453 1 100 0 131.07 ECU_ADDRESS 0xFFFF2862 READ_WRITE /end MEASUREMENT
/begin MEASUREMENT vKMRTRG2 "RAM value vKMRTRG2" UWORD COMP_0453 1 100 0 131.07 ECU_ADDRESS 0xFFFF2864 READ_WRITE /end MEASUREMENT
/begin MEASUREMENT vKMRTRQ "RAM value vKMRTRQ" UBYTE COMP_0017 1 100 0 255 ECU_ADDRESS 0xFFFF0CC3 READ_WRITE /end MEASUREMENT
/begin MEASUREMENT vKNCKIN "RAM value vKNCKIN" UBYTE COMP_0068 1 100 0 255 ECU_ADDRESS 0xFFFF3A20 READ_WRITE /end MEASUREMENT
/begin MEASUREMENT vKNCKINZ "RAM value vKNCKINZ" UBYTE COMP_0068 1 100 0 255 ECU_ADDRESS 0xFFFF3A21 READ_WRITE /end MEASUREMENT
/begin MEASUREMENT vKNCNT "RAM value vKNCNT" UBYTE COMP_0030 1 100 0 255 ECU_ADDRESS 0xFFFF186E READ_WRITE /end MEASUREMENT
/begin MEASUREMENT vKNCNTA "RAM value vKNCNTA" UBYTE COMP_0545_S 1 100 0 255 ECU_ADDRESS 0xFFFF2866 READ_WRITE /end MEASUREMENT
/begin MEASUREMENT vKNCYLC "RAM value vKNCYLC" UBYTE COMP_0068 1 100 0 255 ECU_ADDRESS 0xFFFF186F READ_WRITE /end MEASUREMENT
/begin MEASUREMENT vKNFIL1 "RAM value vKNFIL1" UBYTE COMP_0054 1 100 0 5100 ECU_ADDRESS 0xFFFF20F3 READ_WRITE /end MEASUREMENT
/begin MEASUREMENT vKNFILR1 "RAM value vKNFILR1" UBYTE COMP_0054 1 100 0 5100 ECU_ADDRESS 0xFFFF3A22 READ_WRITE /end MEASUREMENT
/begin MEASUREMENT vKNKCPRT "RAM value vKNKCPRT" UBYTE COMP_0045 1 100 0 1.9921875 ECU_ADDRESS 0xFFFF0CC4 READ_WRITE /end MEASUREMENT
/begin MEASUREMENT vKNKFB "RAM value vKNKFB" SWORD COMP_0078 1 100 -128 127.99609375 ECU_ADDRESS 0xFFFF3B70 READ_WRITE /end MEASUREMENT
/begin MEASUREMENT vKNKIN1 "RAM value vKNKIN1" SWORD COMP_0018 1 100 -32768 32767 ECU_ADDRESS 0xFFFF1870 READ_WRITE /end MEASUREMENT
/begin MEASUREMENT vKNKIN2 "RAM value vKNKIN2" SWORD COMP_0018 1 100 -32768 32767 ECU_ADDRESS 0xFFFF1872 READ_WRITE /end MEASUREMENT
/begin MEASUREMENT vKNKITAC "RAM value vKNKITAC" UBYTE COMP_0009 1 100 0 199.21875 ECU_ADDRESS 0xFFFF0CC5 READ_WRITE /end MEASUREMENT
/begin MEASUREMENT vKNKSL "RAM value vKNKSL" UWORD COMP_0032 1 100 0 255.99609375 ECU_ADDRESS 0xFFFF1874 READ_WRITE /end MEASUREMENT
/begin MEASUREMENT vKNKSL0 "RAM value vKNKSL0" UWORD COMP_0063 1 100 0 255.99609375 ECU_ADDRESS 0xFFFF3A24 READ_WRITE /end MEASUREMENT
/begin MEASUREMENT vKNKSL1 "RAM value vKNKSL1" UWORD COMP_0063 1 100 0 255.99609375 ECU_ADDRESS 0xFFFF3A2C READ_WRITE /end MEASUREMENT
/begin MEASUREMENT vKNOCKCYL "RAM value vKNOCKCYL" UBYTE COMP_0004 1 100 0 255 ECU_ADDRESS 0xFFFF187C READ_WRITE /end MEASUREMENT
/begin MEASUREMENT vKNRPM "RAM value vKNRPM" UWORD COMP_0064 1 100 0 102398.4375 ECU_ADDRESS 0xFFFF0958 READ_WRITE /end MEASUREMENT
/begin MEASUREMENT vKNRPMQ "RAM value vKNRPMQ" UWORD COMP_0064 1 100 0 102398.4375 ECU_ADDRESS 0xFFFF2066 READ_WRITE /end MEASUREMENT
/begin MEASUREMENT vKNRPM_S "RAM value vKNRPM_S" UWORD COMP_0064 1 100 0 102398.4375 ECU_ADDRESS 0xFFFF1A22 READ_WRITE /end MEASUREMENT
/begin MEASUREMENT vKNSCNT "RAM value vKNSCNT" UWORD COMP_0030 1 100 0 65535 ECU_ADDRESS 0xFFFF187E READ_WRITE /end MEASUREMENT
/begin MEASUREMENT vKNSEQ "RAM value vKNSEQ" UBYTE COMP_0030 1 100 0 255 ECU_ADDRESS 0xFFFF1880 READ_WRITE /end MEASUREMENT
/begin MEASUREMENT vKP "RAM value vKP" SLONG COMP_0415 1 100 -8388608 8388607.99609375 ECU_ADDRESS 0xFFFF1884 READ_WRITE /end MEASUREMENT
/begin MEASUREMENT vKPB "RAM value vKPB" UBYTE COMP_0246 1 100 0 1593.75 ECU_ADDRESS 0xFFFF0CC6 READ_WRITE /end MEASUREMENT
/begin MEASUREMENT vKPCDN "RAM value vKPCDN" UBYTE COMP_0045 1 100 0 1.9921875 ECU_ADDRESS 0xFFFF0CC7 READ_WRITE /end MEASUREMENT
/begin MEASUREMENT vKPCDTP "RAM value vKPCDTP" UBYTE COMP_0045 1 100 0 1.9921875 ECU_ADDRESS 0xFFFF0CC8 READ_WRITE /end MEASUREMENT
/begin MEASUREMENT vKPGAIN1 "RAM value vKPGAIN1" UWORD COMP_0576_S 1 100 0 255.99609375 ECU_ADDRESS 0xFFFF0CCA READ_WRITE /end MEASUREMENT
/begin MEASUREMENT vKPIP "RAM value vKPIP" UBYTE COMP_0027 1 100 0 255 ECU_ADDRESS 0xFFFF3A5C READ_WRITE /end MEASUREMENT
/begin MEASUREMENT vKPRTCD2 "RAM value vKPRTCD2" UBYTE COMP_0009 1 100 0 199.21875 ECU_ADDRESS 0xFFFF0CCC READ_WRITE /end MEASUREMENT
/begin MEASUREMENT vKPRTWOT "RAM value vKPRTWOT" UBYTE COMP_0009 1 100 0 199.21875 ECU_ADDRESS 0xFFFF0CCD READ_WRITE /end MEASUREMENT
/begin MEASUREMENT vKPSBGL "RAM value vKPSBGL" UWORD COMP_0032 1 100 0 255.99609375 ECU_ADDRESS 0xFFFF18A4 READ_WRITE /end MEASUREMENT
/begin MEASUREMENT vKPTBP "RAM value vKPTBP" UWORD COMP_0311_S 1 100 -0.262144 0.262136 ECU_ADDRESS 0xFFFF2868 READ_WRITE /end MEASUREMENT
/begin MEASUREMENT vKPTYTMP "RAM value vKPTYTMP" ULONG COMP_0068 1 100 0 4294967295 ECU_ADDRESS 0xFFFF286C READ_WRITE /end MEASUREMENT
/begin MEASUREMENT vKPWOTN "RAM value vKPWOTN" UBYTE COMP_0045 1 100 0 1.9921875 ECU_ADDRESS 0xFFFF0CCE READ_WRITE /end MEASUREMENT
/begin MEASUREMENT vKPWOTTP "RAM value vKPWOTTP" UBYTE COMP_0045 1 100 0 1.9921875 ECU_ADDRESS 0xFFFF0CCF READ_WRITE /end MEASUREMENT
/begin MEASUREMENT vKQEGR "RAM value vKQEGR" UWORD COMP_0057 1 100 0 3.999941832 ECU_ADDRESS 0xFFFF0CD0 READ_WRITE /end MEASUREMENT
/begin MEASUREMENT vKROMDIV "RAM value vKROMDIV" ULONG COMP_0068 1 100 0 4294967295 ECU_ADDRESS 0xFFFF2870 READ_WRITE /end MEASUREMENT
/begin MEASUREMENT vKRPM10 "RAM value vKRPM10" UWORD COMP_0064 1 100 0 102398.4375 ECU_ADDRESS 0xFFFF163C READ_WRITE /end MEASUREMENT
/begin MEASUREMENT vKS "RAM value vKS" ULONG COMP_0454 1 100 -8388608 8388607.99609375 ECU_ADDRESS 0xFFFF18E4 READ_WRITE /end MEASUREMENT
/begin MEASUREMENT vKSR "RAM value vKSR" SLONG COMP_0415 1 100 -8388608 8388607.99609375 ECU_ADDRESS 0xFFFF1904 READ_WRITE /end MEASUREMENT
/begin MEASUREMENT vKSTB "RAM value vKSTB" SLONG COMP_0455 1 100 -131072.09395241 131072.093891374 ECU_ADDRESS 0xFFFF0CD4 READ_WRITE /end MEASUREMENT
/begin MEASUREMENT vKSTBA "RAM value vKSTBA" UWORD COMP_0217 1 100 0 3.999941832 ECU_ADDRESS 0xFFFF0CD8 READ_WRITE /end MEASUREMENT
/begin MEASUREMENT vKSTBAST "RAM value vKSTBAST" UWORD COMP_0217 1 100 0 3.999941832 ECU_ADDRESS 0xFFFF0CDA READ_WRITE /end MEASUREMENT
/begin MEASUREMENT vKSTBC "RAM value vKSTBC" SWORD COMP_0455 1 100 -2.0000014336 1.9999403984 ECU_ADDRESS 0xFFFF0CDC READ_WRITE /end MEASUREMENT
/begin MEASUREMENT vKSTBCST "RAM value vKSTBCST" SWORD COMP_0455 1 100 -2.0000014336 1.9999403984 ECU_ADDRESS 0xFFFF0CDE READ_WRITE /end MEASUREMENT
/begin MEASUREMENT vKSTBLMD2 "RAM value vKSTBLMD2" SWORD COMP_0577_S 1 100 -256 255.9921875 ECU_ADDRESS 0xFFFF0CE0 READ_WRITE /end MEASUREMENT
/begin MEASUREMENT vKSTBTW "RAM value vKSTBTW" UBYTE COMP_0045 1 100 0 1.9921875 ECU_ADDRESS 0xFFFF0CE2 READ_WRITE /end MEASUREMENT
/begin MEASUREMENT vKSTBTWST "RAM value vKSTBTWST" UBYTE COMP_0045 1 100 0 1.9921875 ECU_ADDRESS 0xFFFF0CE3 READ_WRITE /end MEASUREMENT
/begin MEASUREMENT vKSUMTMP "RAM value vKSUMTMP" ULONG COMP_0068 1 100 0 4294967295 ECU_ADDRESS 0xFFFF2874 READ_WRITE /end MEASUREMENT
/begin MEASUREMENT vKTARTD "RAM value vKTARTD" UBYTE COMP_0183_S 1 100 0 3.984375 ECU_ADDRESS 0xFFFF0CE4 READ_WRITE /end MEASUREMENT
/begin MEASUREMENT vKTEXDY "RAM value vKTEXDY" UBYTE COMP_0096 1 100 0 2550 ECU_ADDRESS 0xFFFF2878 READ_WRITE /end MEASUREMENT
/begin MEASUREMENT vKTNT "RAM value vKTNT" UWORD COMP_0456 1 100 0 1.999970916 ECU_ADDRESS 0xFFFF3184 READ_WRITE /end MEASUREMENT
/begin MEASUREMENT vKTRM "RAM value vKTRM" UBYTE COMP_0044 1 100 0 1.9921875 ECU_ADDRESS 0xFFFF37A2 READ_WRITE /end MEASUREMENT
/begin MEASUREMENT vKTRQREF "RAM value vKTRQREF" UWORD COMP_0290 1 100 0 0.999985458 ECU_ADDRESS 0xFFFF0CE6 READ_WRITE /end MEASUREMENT
/begin MEASUREMENT vKTST "RAM value vKTST" UWORD COMP_0290 1 100 0 0.999985458 ECU_ADDRESS 0xFFFF0CE8 READ_WRITE /end MEASUREMENT
/begin MEASUREMENT vKUBDTW "RAM value vKUBDTW" UBYTE COMP_0063 1 100 0 0.99609375 ECU_ADDRESS 0xFFFF0CEA READ_WRITE /end MEASUREMENT
/begin MEASUREMENT vKUPDTYT "RAM value vKUPDTYT" UWORD COMP_0184_S 1 100 0 6553.5 ECU_ADDRESS 0xFFFF37A4 READ_WRITE /end MEASUREMENT
/begin MEASUREMENT vKVAFADJ "RAM value vKVAFADJ" SWORD COMP_0353 1 100 -163840 163835 ECU_ADDRESS 0xFFFF4F26 READ_WRITE /end MEASUREMENT
/begin MEASUREMENT vKVBHOS "RAM value vKVBHOS" UBYTE COMP_0373 1 100 0 2.55 ECU_ADDRESS 0xFFFF37A6 READ_WRITE /end MEASUREMENT
/begin MEASUREMENT vKVC "RAM value vKVC" UBYTE COMP_0341 1 100 0 0.99705 ECU_ADDRESS 0xFFFF0CEB READ_WRITE /end MEASUREMENT
/begin MEASUREMENT vKVCC2 "RAM value vKVCC2" UWORD COMP_0069 1 100 0 1.999970916 ECU_ADDRESS 0xFFFF4708 READ_WRITE /end MEASUREMENT
/begin MEASUREMENT vKVTCME1 "RAM value vKVTCME1" UWORD COMP_0456 1 100 0 1.999970916 ECU_ADDRESS 0xFFFF470A READ_WRITE /end MEASUREMENT
/begin MEASUREMENT vKVTCMI1 "RAM value vKVTCMI1" UWORD COMP_0069 1 100 0 1.999970916 ECU_ADDRESS 0xFFFF470C READ_WRITE /end MEASUREMENT
/begin MEASUREMENT vKWCT1 "RAM value vKWCT1" UWORD COMP_0410 1 100 0 99.9985458 ECU_ADDRESS 0xFFFF287A READ_WRITE /end MEASUREMENT
/begin MEASUREMENT vKWCT2 "RAM value vKWCT2" UWORD COMP_0410 1 100 0 99.9985458 ECU_ADDRESS 0xFFFF287C READ_WRITE /end MEASUREMENT
/begin MEASUREMENT vL2PFMINH "RAM value vL2PFMINH" UWORD COMP_0031_S 1 100 0 39.97635 ECU_ADDRESS 0xFFFF287E READ_WRITE /end MEASUREMENT
/begin MEASUREMENT vLAONf "RAM value vLAONf" UBYTE COMP_0004 1 100 0 255 ECU_ADDRESS 0xFFFF37A7 READ_WRITE /end MEASUREMENT
/begin MEASUREMENT vLCOUNT "RAM value vLCOUNT" UBYTE COMP_0016 1 100 0 255 ECU_ADDRESS 0xFFFF2880 READ_WRITE /end MEASUREMENT
/begin MEASUREMENT vLDCONT "RAM value vLDCONT" UWORD COMP_0063_S 1 100 0 257.00008995 ECU_ADDRESS 0xFFFF2882 READ_WRITE /end MEASUREMENT
/begin MEASUREMENT vLEAKCNT "RAM value vLEAKCNT" UWORD COMP_0016 1 100 0 65535 ECU_ADDRESS 0xFFFF5208 READ_WRITE /end MEASUREMENT
/begin MEASUREMENT vLEAKTRP "RAM value vLEAKTRP" UWORD COMP_0016 1 100 0 65535 ECU_ADDRESS 0xFFFF520A READ_WRITE /end MEASUREMENT
/begin MEASUREMENT vLECFRMCT "RAM value vLECFRMCT" UBYTE COMP_0016 1 100 0 255 ECU_ADDRESS 0xFFFF3A34 READ_WRITE /end MEASUREMENT
/begin MEASUREMENT vLEDCNT "RAM value vLEDCNT" UBYTE COMP_0008 1 100 0 25500 ECU_ADDRESS 0xFFFF2884 READ_WRITE /end MEASUREMENT
/begin MEASUREMENT vLEDPAT "RAM value vLEDPAT" UWORD COMP_0092 1 100 0 65535 ECU_ADDRESS 0xFFFF163E READ_WRITE /end MEASUREMENT
/begin MEASUREMENT vLEDSTG "RAM value vLEDSTG" UBYTE COMP_0068 1 100 0 255 ECU_ADDRESS 0xFFFF1646 READ_WRITE /end MEASUREMENT
/begin MEASUREMENT vLEKCNT2 "RAM value vLEKCNT2" UWORD COMP_0016 1 100 0 65535 ECU_ADDRESS 0xFFFF470E READ_WRITE /end MEASUREMENT
/begin MEASUREMENT vLEKCNT3 "RAM value vLEKCNT3" UWORD COMP_0016 1 100 0 65535 ECU_ADDRESS 0xFFFF4710 READ_WRITE /end MEASUREMENT
/begin MEASUREMENT vLEKCNTS "RAM value vLEKCNTS" UWORD COMP_0016 1 100 0 65535 ECU_ADDRESS 0xFFFF4712 READ_WRITE /end MEASUREMENT
/begin MEASUREMENT vLEKTRP2 "RAM value vLEKTRP2" UWORD COMP_0016 1 100 0 65535 ECU_ADDRESS 0xFFFF4714 READ_WRITE /end MEASUREMENT
/begin MEASUREMENT vLESTCT "RAM value vLESTCT" UBYTE COMP_0004_S 1 100 -50 205 ECU_ADDRESS 0xFFFF2885 READ_WRITE /end MEASUREMENT
/begin MEASUREMENT vLFSPREK "RAM value vLFSPREK" UWORD COMP_0578_S 1 100 0 65.535 ECU_ADDRESS 0xFFFF37A8 READ_WRITE /end MEASUREMENT
/begin MEASUREMENT vLFSPRES "RAM value vLFSPRES" UBYTE COMP_0010 1 100 0 0.765 ECU_ADDRESS 0xFFFF2068 READ_WRITE /end MEASUREMENT
/begin MEASUREMENT vLFSPREV "RAM value vLFSPREV" UWORD COMP_0023 1 100 0 327675 ECU_ADDRESS 0xFFFF37AA READ_WRITE /end MEASUREMENT
/begin MEASUREMENT vLGLNIENDf "RAM value vLGLNIENDf" UBYTE COMP_0004 1 100 0 255 ECU_ADDRESS 0xFFFF2886 READ_WRITE /end MEASUREMENT
/begin MEASUREMENT vLGLNPENDf "RAM value vLGLNPENDf" UBYTE COMP_0004 1 100 0 255 ECU_ADDRESS 0xFFFF2887 READ_WRITE /end MEASUREMENT
/begin MEASUREMENT vLHOLD "RAM value vLHOLD" UWORD COMP_0453 1 100 0 131.07 ECU_ADDRESS 0xFFFF2888 READ_WRITE /end MEASUREMENT
/begin MEASUREMENT vLHPDLLMT "RAM value vLHPDLLMT" UWORD COMP_0032_S 1 100 0 8191.875 ECU_ADDRESS 0xFFFF288C READ_WRITE /end MEASUREMENT
/begin MEASUREMENT vLHPDLSP "RAM value vLHPDLSP" UWORD COMP_0032_S 1 100 0 8191.875 ECU_ADDRESS 0xFFFF288E READ_WRITE /end MEASUREMENT
/begin MEASUREMENT vLHPDLS_S "RAM value vLHPDLS_S" UWORD COMP_0032_S 1 100 0 8191.875 ECU_ADDRESS 0xFFFF304C READ_WRITE /end MEASUREMENT
/begin MEASUREMENT vLIMEX2f "RAM value vLIMEX2f" UBYTE COMP_0004 1 100 0 255 ECU_ADDRESS 0xFFFF2890 READ_WRITE /end MEASUREMENT
/begin MEASUREMENT vLIMEXf "RAM value vLIMEXf" UBYTE COMP_0004 1 100 0 255 ECU_ADDRESS 0xFFFF2891 READ_WRITE /end MEASUREMENT
/begin MEASUREMENT vLINRXERR "RAM value vLINRXERR" UBYTE COMP_0068 1 100 0 255 ECU_ADDRESS 0xFFFF3A35 READ_WRITE /end MEASUREMENT
/begin MEASUREMENT vLINTVL "RAM value vLINTVL" UWORD COMP_0017_S 1 100 0 655.35 ECU_ADDRESS 0xFFFF2892 READ_WRITE /end MEASUREMENT
/begin MEASUREMENT vLJUDGEf "RAM value vLJUDGEf" UBYTE COMP_0004 1 100 0 255 ECU_ADDRESS 0xFFFF2896 READ_WRITE /end MEASUREMENT
/begin MEASUREMENT vLJUONEf "RAM value vLJUONEf" UBYTE COMP_0004 1 100 0 255 ECU_ADDRESS 0xFFFF2897 READ_WRITE /end MEASUREMENT
/begin MEASUREMENT vLJUONHf "RAM value vLJUONHf" UBYTE COMP_0004 1 100 0 255 ECU_ADDRESS 0xFFFF2898 READ_WRITE /end MEASUREMENT
/begin MEASUREMENT vLLPEAK "RAM value vLLPEAK" UWORD COMP_0023 1 100 0 327675 ECU_ADDRESS 0xFFFF289A READ_WRITE /end MEASUREMENT
/begin MEASUREMENT vLMBTTRM "RAM value vLMBTTRM" UBYTE COMP_0245 1 100 -64 191 ECU_ADDRESS 0xFFFF0CEC READ_WRITE /end MEASUREMENT
/begin MEASUREMENT vLMCSTTW "RAM value vLMCSTTW" UBYTE COMP_0035 1 100 -50 205 ECU_ADDRESS 0xFFFF0CED READ_WRITE /end MEASUREMENT
/begin MEASUREMENT vLMDCLPf "RAM value vLMDCLPf" UBYTE COMP_0004 1 100 0 255 ECU_ADDRESS 0xFFFF097C READ_WRITE /end MEASUREMENT
/begin MEASUREMENT vLMDCNT "RAM value vLMDCNT" UWORD COMP_0016 1 100 0 65535 ECU_ADDRESS 0xFFFF4716 READ_WRITE /end MEASUREMENT
/begin MEASUREMENT vLMDCPMf "RAM value vLMDCPMf" UBYTE COMP_0004 1 100 0 255 ECU_ADDRESS 0xFFFF0CEE READ_WRITE /end MEASUREMENT
/begin MEASUREMENT vLMNR10R "RAM value vLMNR10R" UBYTE COMP_0000 1 100 0 6375 ECU_ADDRESS 0xFFFF289E READ_WRITE /end MEASUREMENT
/begin MEASUREMENT vLMRPMSL "RAM value vLMRPMSL" UBYTE COMP_0006 1 100 0 3187.5 ECU_ADDRESS 0xFFFF1924 READ_WRITE /end MEASUREMENT
/begin MEASUREMENT vLMTTVOL "RAM value vLMTTVOL" UWORD COMP_0005 1 100 0 7208.85 ECU_ADDRESS 0xFFFF28A0 READ_WRITE /end MEASUREMENT
/begin MEASUREMENT vLMTTVOU "RAM value vLMTTVOU" UWORD COMP_0005 1 100 0 7208.85 ECU_ADDRESS 0xFFFF28A2 READ_WRITE /end MEASUREMENT
/begin MEASUREMENT vLNCNDOKf "RAM value vLNCNDOKf" UBYTE COMP_0004 1 100 0 255 ECU_ADDRESS 0xFFFF0CEF READ_WRITE /end MEASUREMENT
/begin MEASUREMENT vLNCNLGIf "RAM value vLNCNLGIf" UBYTE COMP_0004 1 100 0 255 ECU_ADDRESS 0xFFFF28A4 READ_WRITE /end MEASUREMENT
/begin MEASUREMENT vLNCNLGPf "RAM value vLNCNLGPf" UBYTE COMP_0004 1 100 0 255 ECU_ADDRESS 0xFFFF28A5 READ_WRITE /end MEASUREMENT
/begin MEASUREMENT vLNRPM "RAM value vLNRPM" UBYTE COMP_0006 1 100 0 3187.5 ECU_ADDRESS 0xFFFF095A READ_WRITE /end MEASUREMENT
/begin MEASUREMENT vLNRPMUP "RAM value vLNRPMUP" UBYTE COMP_0068 1 100 0 255 ECU_ADDRESS 0xFFFF1925 READ_WRITE /end MEASUREMENT
/begin MEASUREMENT vLNRSETf "RAM value vLNRSETf" UBYTE COMP_0004 1 100 0 255 ECU_ADDRESS 0xFFFF28A6 READ_WRITE /end MEASUREMENT
/begin MEASUREMENT vLNRSETzf "RAM value vLNRSETzf" UBYTE COMP_0004 1 100 0 255 ECU_ADDRESS 0xFFFF28A7 READ_WRITE /end MEASUREMENT
/begin MEASUREMENT vLOFBPSL "RAM value vLOFBPSL" SWORD COMP_0277 1 100 -32768 32767 ECU_ADDRESS 0xFFFF1926 READ_WRITE /end MEASUREMENT
/begin MEASUREMENT vLOWESTAT "RAM value vLOWESTAT" UBYTE COMP_0004_S 1 100 -50 205 ECU_ADDRESS 0xFFFF28A8 READ_WRITE /end MEASUREMENT
/begin MEASUREMENT vLPEAK "RAM value vLPEAK" UWORD COMP_0453 1 100 0 131.07 ECU_ADDRESS 0xFFFF28AA READ_WRITE /end MEASUREMENT
/begin MEASUREMENT vLRCQBAK "RAM value vLRCQBAK" UBYTE COMP_0068 1 100 0 255 ECU_ADDRESS 0xFFFF28AE READ_WRITE /end MEASUREMENT
/begin MEASUREMENT vLRDIFF "RAM value vLRDIFF" UWORD COMP_0453 1 100 0 131.07 ECU_ADDRESS 0xFFFF28B0 READ_WRITE /end MEASUREMENT
/begin MEASUREMENT vLRDNGZf "RAM value vLRDNGZf" UBYTE COMP_0004 1 100 0 255 ECU_ADDRESS 0xFFFF28B4 READ_WRITE /end MEASUREMENT
/begin MEASUREMENT vLRDOKZf "RAM value vLRDOKZf" UBYTE COMP_0004 1 100 0 255 ECU_ADDRESS 0xFFFF28B5 READ_WRITE /end MEASUREMENT
/begin MEASUREMENT vLRDSUM "RAM value vLRDSUM" ULONG COMP_0453 1 100 0 8589934.59 ECU_ADDRESS 0xFFFF28B8 READ_WRITE /end MEASUREMENT
/begin MEASUREMENT vLRFO2f "RAM value vLRFO2f" UBYTE COMP_0004 1 100 0 255 ECU_ADDRESS 0xFFFF28C0 READ_WRITE /end MEASUREMENT
/begin MEASUREMENT vLRNKAI "RAM value vLRNKAI" UBYTE COMP_0401_S 1 100 0 510 ECU_ADDRESS 0xFFFF318A READ_WRITE /end MEASUREMENT
/begin MEASUREMENT vLRNNEH "RAM value vLRNNEH" SWORD COMP_0078 1 100 -128 127.99609375 ECU_ADDRESS 0xFFFF28C2 READ_WRITE /end MEASUREMENT
/begin MEASUREMENT vLRNNEL "RAM value vLRNNEL" SWORD COMP_0078 1 100 -128 127.99609375 ECU_ADDRESS 0xFFFF28C4 READ_WRITE /end MEASUREMENT
/begin MEASUREMENT vLRPEAK "RAM value vLRPEAK" UWORD COMP_0023 1 100 0 327675 ECU_ADDRESS 0xFFFF28C6 READ_WRITE /end MEASUREMENT
/begin MEASUREMENT vLRVSP "RAM value vLRVSP" UWORD COMP_0436 1 100 0 6553.5 ECU_ADDRESS 0xFFFF08E8 READ_WRITE /end MEASUREMENT
/begin MEASUREMENT vLRXERCNT "RAM value vLRXERCNT" UBYTE COMP_0016 1 100 0 255 ECU_ADDRESS 0xFFFF3A36 READ_WRITE /end MEASUREMENT
/begin MEASUREMENT vLRXFRMCT "RAM value vLRXFRMCT" UBYTE COMP_0016 1 100 0 255 ECU_ADDRESS 0xFFFF3A37 READ_WRITE /end MEASUREMENT
/begin MEASUREMENT vLSCHTBCT "RAM value vLSCHTBCT" UBYTE COMP_0016 1 100 0 255 ECU_ADDRESS 0xFFFF3351 READ_WRITE /end MEASUREMENT
/begin MEASUREMENT vLSENCNT "RAM value vLSENCNT" UWORD COMP_0016 1 100 0 65535 ECU_ADDRESS 0xFFFF4718 READ_WRITE /end MEASUREMENT
/begin MEASUREMENT vLSLICE "RAM value vLSLICE" UWORD COMP_0023 1 100 0 327675 ECU_ADDRESS 0xFFFF28CA READ_WRITE /end MEASUREMENT
/begin MEASUREMENT vLSNDCNT "RAM value vLSNDCNT" UBYTE COMP_0016 1 100 0 255 ECU_ADDRESS 0xFFFF37AC READ_WRITE /end MEASUREMENT
/begin MEASUREMENT vLSNDCNTE "RAM value vLSNDCNTE" UBYTE COMP_0068 1 100 0 255 ECU_ADDRESS 0xFFFF37AD READ_WRITE /end MEASUREMENT
/begin MEASUREMENT vLSNOKHP "RAM value vLSNOKHP" UBYTE COMP_0030 1 100 0 255 ECU_ADDRESS 0xFFFF28CE READ_WRITE /end MEASUREMENT
/begin MEASUREMENT vLSNOKJD "RAM value vLSNOKJD" UBYTE COMP_0030 1 100 0 255 ECU_ADDRESS 0xFFFF28CF READ_WRITE /end MEASUREMENT
/begin MEASUREMENT vLSOSQ "RAM value vLSOSQ" SLONG COMP_0148_S 1 100 -21474836.48 21474836.47 ECU_ADDRESS 0xFFFF2114 READ_WRITE /end MEASUREMENT
/begin MEASUREMENT vLTIST "RAM value vLTIST" UWORD COMP_0125 1 100 0 255.99609375 ECU_ADDRESS 0xFFFF0CF0 READ_WRITE /end MEASUREMENT
/begin MEASUREMENT vLTP10R "RAM value vLTP10R" UBYTE COMP_0001 1 100 0 31.875 ECU_ADDRESS 0xFFFF28D0 READ_WRITE /end MEASUREMENT
/begin MEASUREMENT vLTVO10R "RAM value vLTVO10R" UBYTE COMP_0002 1 100 0 89.25 ECU_ADDRESS 0xFFFF28D1 READ_WRITE /end MEASUREMENT
/begin MEASUREMENT vLTVOS1 "RAM value vLTVOS1" UBYTE COMP_0002 1 100 0 89.25 ECU_ADDRESS 0xFFFF1647 READ_WRITE /end MEASUREMENT
/begin MEASUREMENT vLTVOS2 "RAM value vLTVOS2" UBYTE COMP_0002 1 100 0 89.25 ECU_ADDRESS 0xFFFF1648 READ_WRITE /end MEASUREMENT
/begin MEASUREMENT vLTXFRMCT "RAM value vLTXFRMCT" UBYTE COMP_0016 1 100 0 255 ECU_ADDRESS 0xFFFF3A38 READ_WRITE /end MEASUREMENT
/begin MEASUREMENT vLUOFFNB "RAM value vLUOFFNB" UBYTE COMP_0443 1 100 0 255 ECU_ADDRESS 0xFFFF0CF2 READ_WRITE /end MEASUREMENT
/begin MEASUREMENT vLUOFFNE "RAM value vLUOFFNE" UBYTE COMP_0443 1 100 0 255 ECU_ADDRESS 0xFFFF0CF3 READ_WRITE /end MEASUREMENT
/begin MEASUREMENT vLUREQSF "RAM value vLUREQSF" UBYTE COMP_0068 1 100 0 255 ECU_ADDRESS 0xFFFF37AE READ_WRITE /end MEASUREMENT
/begin MEASUREMENT vM4TQLIM "RAM value vM4TQLIM" UBYTE COMP_0337 1 100 0 204 ECU_ADDRESS 0xFFFF37AF READ_WRITE /end MEASUREMENT
/begin MEASUREMENT vM96GO "RAM value vM96GO" UBYTE COMP_0004 1 100 0 255 ECU_ADDRESS 0xFFFF4406 READ_WRITE /end MEASUREMENT
/begin MEASUREMENT vMABFSFTW "RAM value vMABFSFTW" UWORD COMP_0327_S 1 100 -65.536 65.534 ECU_ADDRESS 0xFFFF28D2 READ_WRITE /end MEASUREMENT
/begin MEASUREMENT vMACYL "RAM value vMACYL" ULONG COMP_0579_S 1 100 0 59652.3712635255 ECU_ADDRESS 0xFFFF318C READ_WRITE /end MEASUREMENT
/begin MEASUREMENT vMACYL0 "RAM value vMACYL0" ULONG COMP_0579_S 1 100 0 59652.3712635255 ECU_ADDRESS 0xFFFF3190 READ_WRITE /end MEASUREMENT
/begin MEASUREMENT vMAFDGCT "RAM value vMAFDGCT" UWORD COMP_0016 1 100 0 65535 ECU_ADDRESS 0xFFFF471A READ_WRITE /end MEASUREMENT
/begin MEASUREMENT vMALPHA "RAM value vMALPHA" UWORD COMP_0031 1 100 0 255.99609375 ECU_ADDRESS 0xFFFF0CF4 READ_WRITE /end MEASUREMENT
/begin MEASUREMENT vMALPHA2 "RAM value vMALPHA2" UWORD COMP_0031 1 100 0 255.99609375 ECU_ADDRESS 0xFFFF0CF8 READ_WRITE /end MEASUREMENT
/begin MEASUREMENT vMALPHADT "RAM value vMALPHADT" UWORD COMP_0031 1 100 0 255.99609375 ECU_ADDRESS 0xFFFF0CFC READ_WRITE /end MEASUREMENT
/begin MEASUREMENT vMAMANI "RAM value vMAMANI" ULONG COMP_0579_S 1 100 0 59652.3712635255 ECU_ADDRESS 0xFFFF3194 READ_WRITE /end MEASUREMENT
/begin MEASUREMENT vMANGTM "RAM value vMANGTM" UBYTE COMP_0017 1 100 0 255 ECU_ADDRESS 0xFFFF0CFE READ_WRITE /end MEASUREMENT
/begin MEASUREMENT vMAPSLCT "RAM value vMAPSLCT" UBYTE COMP_0068 1 100 0 255 ECU_ADDRESS 0xFFFF28D6 READ_WRITE /end MEASUREMENT
/begin MEASUREMENT vMARKET "RAM value vMARKET" UBYTE COMP_0068 1 100 0 255 ECU_ADDRESS 0xFFFF37B0 READ_WRITE /end MEASUREMENT
/begin MEASUREMENT vMASSC "RAM value vMASSC" UWORD COMP_0460 1 100 0 49.999207365 ECU_ADDRESS 0xFFFF0D00 READ_WRITE /end MEASUREMENT
/begin MEASUREMENT vMATGK "RAM value vMATGK" UBYTE COMP_0580_S 1 100 -128 127 ECU_ADDRESS 0xFFFF28D7 READ_WRITE /end MEASUREMENT
/begin MEASUREMENT vMATH1 "RAM value vMATH1" UBYTE COMP_0580_S 1 100 -128 127 ECU_ADDRESS 0xFFFF28D8 READ_WRITE /end MEASUREMENT
/begin MEASUREMENT vMATH2 "RAM value vMATH2" UBYTE COMP_0580_S 1 100 -128 127 ECU_ADDRESS 0xFFFF3198 READ_WRITE /end MEASUREMENT
/begin MEASUREMENT vMATH3 "RAM value vMATH3" UBYTE COMP_0580_S 1 100 -128 127 ECU_ADDRESS 0xFFFF28D9 READ_WRITE /end MEASUREMENT
/begin MEASUREMENT vMATH5 "RAM value vMATH5" UBYTE COMP_0580_S 1 100 -128 127 ECU_ADDRESS 0xFFFF28DA READ_WRITE /end MEASUREMENT
/begin MEASUREMENT vMATH6 "RAM value vMATH6" UBYTE COMP_0580_S 1 100 -128 127 ECU_ADDRESS 0xFFFF28DB READ_WRITE /end MEASUREMENT
/begin MEASUREMENT vMAXAPP "RAM value vMAXAPP" ULONG COMP_0376 1 100 0 429496729.5 ECU_ADDRESS 0xFFFF28DC READ_WRITE /end MEASUREMENT
/begin MEASUREMENT vMAXAVFAC "RAM value vMAXAVFAC" UWORD COMP_0334_S 1 100 0 1599.9780435 ECU_ADDRESS 0xFFFF28E0 READ_WRITE /end MEASUREMENT
/begin MEASUREMENT vMAXAVTQ "RAM value vMAXAVTQ" SWORD COMP_0228 1 100 -3276.8 3276.7 ECU_ADDRESS 0xFFFF28E2 READ_WRITE /end MEASUREMENT
/begin MEASUREMENT vMAXPOSTQ "RAM value vMAXPOSTQ" SWORD COMP_0228 1 100 -3276.8 3276.7 ECU_ADDRESS 0xFFFF28E4 READ_WRITE /end MEASUREMENT
/begin MEASUREMENT vMAXTMPTA "RAM value vMAXTMPTA" UBYTE COMP_0004_S 1 100 -50 205 ECU_ADDRESS 0xFFFF28E6 READ_WRITE /end MEASUREMENT
/begin MEASUREMENT vMAXTMPTF "RAM value vMAXTMPTF" UBYTE COMP_0004_S 1 100 -50 205 ECU_ADDRESS 0xFFFF28E7 READ_WRITE /end MEASUREMENT
/begin MEASUREMENT vMAXTMPTH "RAM value vMAXTMPTH" UBYTE COMP_0004_S 1 100 -50 205 ECU_ADDRESS 0xFFFF28E8 READ_WRITE /end MEASUREMENT
/begin MEASUREMENT vMAXTMPTO "RAM value vMAXTMPTO" UBYTE COMP_0004_S 1 100 -50 205 ECU_ADDRESS 0xFFFF28E9 READ_WRITE /end MEASUREMENT
/begin MEASUREMENT vMAXTMPTW "RAM value vMAXTMPTW" UBYTE COMP_0004_S 1 100 -50 205 ECU_ADDRESS 0xFFFF28EA READ_WRITE /end MEASUREMENT
/begin MEASUREMENT vMAXTP "RAM value vMAXTP" UWORD COMP_0144 1 100 0 31.999495335 ECU_ADDRESS 0xFFFF0D02 READ_WRITE /end MEASUREMENT
/begin MEASUREMENT vMBT "RAM value vMBT" SBYTE COMP_0018 1 100 -128 127 ECU_ADDRESS 0xFFFF1B34 READ_WRITE /end MEASUREMENT
/begin MEASUREMENT vMBTCAL "RAM value vMBTCAL" SBYTE COMP_0018 1 100 -128 127 ECU_ADDRESS 0xFFFF1B35 READ_WRITE /end MEASUREMENT
/begin MEASUREMENT vMBTCPRE "RAM value vMBTCPRE" UBYTE COMP_0365_S 1 100 0 63.75 ECU_ADDRESS 0xFFFF28EB READ_WRITE /end MEASUREMENT
/begin MEASUREMENT vMBTCPRT "RAM value vMBTCPRT" UBYTE COMP_0045 1 100 0 1.9921875 ECU_ADDRESS 0xFFFF0D04 READ_WRITE /end MEASUREMENT
/begin MEASUREMENT vMBTCPTG "RAM value vMBTCPTG" UBYTE COMP_0365_S 1 100 0 63.75 ECU_ADDRESS 0xFFFF0D05 READ_WRITE /end MEASUREMENT
/begin MEASUREMENT vMBTRMVOF "RAM value vMBTRMVOF" UBYTE COMP_0245 1 100 -64 191 ECU_ADDRESS 0xFFFF28EC READ_WRITE /end MEASUREMENT
/begin MEASUREMENT vMBTTENG "RAM value vMBTTENG" SBYTE COMP_0018 1 100 -128 127 ECU_ADDRESS 0xFFFF28ED READ_WRITE /end MEASUREMENT
/begin MEASUREMENT vMBTTRM "RAM value vMBTTRM" UBYTE COMP_0245 1 100 -64 191 ECU_ADDRESS 0xFFFF0D06 READ_WRITE /end MEASUREMENT
/begin MEASUREMENT vMBTTRM0 "RAM value vMBTTRM0" UBYTE COMP_0245 1 100 -64 191 ECU_ADDRESS 0xFFFF0D07 READ_WRITE /end MEASUREMENT
/begin MEASUREMENT vMBTTRM1 "RAM value vMBTTRM1" UBYTE COMP_0245 1 100 -64 191 ECU_ADDRESS 0xFFFF0D08 READ_WRITE /end MEASUREMENT
/begin MEASUREMENT vMBTTRMAP "RAM value vMBTTRMAP" UBYTE COMP_0245 1 100 -64 191 ECU_ADDRESS 0xFFFF0D09 READ_WRITE /end MEASUREMENT
/begin MEASUREMENT vMBTTRMBS "RAM value vMBTTRMBS" UBYTE COMP_0245 1 100 -64 191 ECU_ADDRESS 0xFFFF28EE READ_WRITE /end MEASUREMENT
/begin MEASUREMENT vMBTZURE "RAM value vMBTZURE" UBYTE COMP_0017 1 100 0 255 ECU_ADDRESS 0xFFFF1928 READ_WRITE /end MEASUREMENT
/begin MEASUREMENT vMCLPEKBUf "RAM value vMCLPEKBUf" UBYTE COMP_0004 1 100 0 255 ECU_ADDRESS 0xFFFF28F0 READ_WRITE /end MEASUREMENT
/begin MEASUREMENT vMCLPEKBf "RAM value vMCLPEKBf" UBYTE COMP_0004 1 100 0 255 ECU_ADDRESS 0xFFFF28EF READ_WRITE /end MEASUREMENT
/begin MEASUREMENT vMCLRL "RAM value vMCLRL" UBYTE COMP_0068 1 100 0 255 ECU_ADDRESS 0xFFFF471C READ_WRITE /end MEASUREMENT
/begin MEASUREMENT vMCLRR "RAM value vMCLRR" UBYTE COMP_0068 1 100 0 255 ECU_ADDRESS 0xFFFF475C READ_WRITE /end MEASUREMENT
/begin MEASUREMENT vMCMEEPA "RAM value vMCMEEPA" UWORD COMP_0068 1 100 0 65535 ECU_ADDRESS 0xFFFF28F2 READ_WRITE /end MEASUREMENT
/begin MEASUREMENT vMCMEEPC "RAM value vMCMEEPC" UBYTE COMP_0068 1 100 0 255 ECU_ADDRESS 0xFFFF28F4 READ_WRITE /end MEASUREMENT
/begin MEASUREMENT vMCMEEPC2 "RAM value vMCMEEPC2" UWORD COMP_0068 1 100 0 65535 ECU_ADDRESS 0xFFFF28F6 READ_WRITE /end MEASUREMENT
/begin MEASUREMENT vMCMEEPC3 "RAM value vMCMEEPC3" UWORD COMP_0068 1 100 0 65535 ECU_ADDRESS 0xFFFF28F8 READ_WRITE /end MEASUREMENT
/begin MEASUREMENT vMCMEEPCHK "RAM value vMCMEEPCHK" UBYTE COMP_0068 1 100 0 255 ECU_ADDRESS 0xFFFF28FA READ_WRITE /end MEASUREMENT
/begin MEASUREMENT vMCMEEPCLR "RAM value vMCMEEPCLR" UWORD COMP_0068 1 100 0 65535 ECU_ADDRESS 0xFFFF291A READ_WRITE /end MEASUREMENT
/begin MEASUREMENT vMCMEEPCNT "RAM value vMCMEEPCNT" UBYTE COMP_0068 1 100 0 255 ECU_ADDRESS 0xFFFF291C READ_WRITE /end MEASUREMENT
/begin MEASUREMENT vMCMEEPD "RAM value vMCMEEPD" UWORD COMP_0068 1 100 0 65535 ECU_ADDRESS 0xFFFF291E READ_WRITE /end MEASUREMENT
/begin MEASUREMENT vMCMEEPD32 "RAM value vMCMEEPD32" UBYTE COMP_0068 1 100 0 255 ECU_ADDRESS 0xFFFF2920 READ_WRITE /end MEASUREMENT
/begin MEASUREMENT vMCMEEPM32 "RAM value vMCMEEPM32" UBYTE COMP_0068 1 100 0 255 ECU_ADDRESS 0xFFFF2940 READ_WRITE /end MEASUREMENT
/begin MEASUREMENT vMCMEPCLR2 "RAM value vMCMEPCLR2" UWORD COMP_0068 1 100 0 65535 ECU_ADDRESS 0xFFFF2960 READ_WRITE /end MEASUREMENT
/begin MEASUREMENT vMCMEPCNT2 "RAM value vMCMEPCNT2" UBYTE COMP_0068 1 100 0 255 ECU_ADDRESS 0xFFFF2962 READ_WRITE /end MEASUREMENT
/begin MEASUREMENT vMCMRAMA "RAM value vMCMRAMA" ULONG COMP_0068 1 100 0 4294967295 ECU_ADDRESS 0xFFFF2964 READ_WRITE /end MEASUREMENT
/begin MEASUREMENT vMCMTACNT "RAM value vMCMTACNT" UWORD COMP_0016 1 100 0 65535 ECU_ADDRESS 0xFFFF479C READ_WRITE /end MEASUREMENT
/begin MEASUREMENT vMCMTATRP "RAM value vMCMTATRP" UWORD COMP_0016 1 100 0 65535 ECU_ADDRESS 0xFFFF479E READ_WRITE /end MEASUREMENT
/begin MEASUREMENT vMCMTFCNT "RAM value vMCMTFCNT" UWORD COMP_0016 1 100 0 65535 ECU_ADDRESS 0xFFFF47A0 READ_WRITE /end MEASUREMENT
/begin MEASUREMENT vMCMTFTRP "RAM value vMCMTFTRP" UWORD COMP_0016 1 100 0 65535 ECU_ADDRESS 0xFFFF47A2 READ_WRITE /end MEASUREMENT
/begin MEASUREMENT vMCMTHCNT "RAM value vMCMTHCNT" UWORD COMP_0016 1 100 0 65535 ECU_ADDRESS 0xFFFF47A4 READ_WRITE /end MEASUREMENT
/begin MEASUREMENT vMCMTHTRP "RAM value vMCMTHTRP" UWORD COMP_0016 1 100 0 65535 ECU_ADDRESS 0xFFFF47A6 READ_WRITE /end MEASUREMENT
/begin MEASUREMENT vMCMTOCNT "RAM value vMCMTOCNT" UWORD COMP_0016 1 100 0 65535 ECU_ADDRESS 0xFFFF47A8 READ_WRITE /end MEASUREMENT
/begin MEASUREMENT vMCMTOTRP "RAM value vMCMTOTRP" UWORD COMP_0016 1 100 0 65535 ECU_ADDRESS 0xFFFF47AA READ_WRITE /end MEASUREMENT
/begin MEASUREMENT vMCMTWCNT "RAM value vMCMTWCNT" UWORD COMP_0016 1 100 0 65535 ECU_ADDRESS 0xFFFF47AC READ_WRITE /end MEASUREMENT
/begin MEASUREMENT vMCMTWTRP "RAM value vMCMTWTRP" UWORD COMP_0016 1 100 0 65535 ECU_ADDRESS 0xFFFF47AE READ_WRITE /end MEASUREMENT
/begin MEASUREMENT vMCNCNT "RAM value vMCNCNT" UBYTE COMP_0030 1 100 0 255 ECU_ADDRESS 0xFFFF2968 READ_WRITE /end MEASUREMENT
/begin MEASUREMENT vMCRNTAVE "RAM value vMCRNTAVE" UBYTE COMP_0249_S 1 100 0 25.5 ECU_ADDRESS 0xFFFF37B1 READ_WRITE /end MEASUREMENT
/begin MEASUREMENT vMCTH1 "RAM value vMCTH1" UBYTE COMP_0580_S 1 100 -128 127 ECU_ADDRESS 0xFFFF2969 READ_WRITE /end MEASUREMENT
/begin MEASUREMENT vMCTH2 "RAM value vMCTH2" UBYTE COMP_0580_S 1 100 -128 127 ECU_ADDRESS 0xFFFF296A READ_WRITE /end MEASUREMENT
/begin MEASUREMENT vMCTH3 "RAM value vMCTH3" UBYTE COMP_0580_S 1 100 -128 127 ECU_ADDRESS 0xFFFF296B READ_WRITE /end MEASUREMENT
/begin MEASUREMENT vMCTH5 "RAM value vMCTH5" UBYTE COMP_0580_S 1 100 -128 127 ECU_ADDRESS 0xFFFF296C READ_WRITE /end MEASUREMENT
/begin MEASUREMENT vMCTH6 "RAM value vMCTH6" UBYTE COMP_0580_S 1 100 -128 127 ECU_ADDRESS 0xFFFF296D READ_WRITE /end MEASUREMENT
/begin MEASUREMENT vMCTH7 "RAM value vMCTH7" UBYTE COMP_0580_S 1 100 -128 127 ECU_ADDRESS 0xFFFF296E READ_WRITE /end MEASUREMENT
/begin MEASUREMENT vMCYLGATE "RAM value vMCYLGATE" UBYTE COMP_0522_S 1 100 0 255 ECU_ADDRESS 0xFFFF0D0A READ_WRITE /end MEASUREMENT
/begin MEASUREMENT vMCYL_PM "RAM value vMCYL_PM" ULONG COMP_0579_S 1 100 0 59652.3712635255 ECU_ADDRESS 0xFFFF319C READ_WRITE /end MEASUREMENT
/begin MEASUREMENT vMCYL_PMF "RAM value vMCYL_PMF" ULONG COMP_0579_S 1 100 0 59652.3712635255 ECU_ADDRESS 0xFFFF31A0 READ_WRITE /end MEASUREMENT
/begin MEASUREMENT vMDE_TW "RAM value vMDE_TW" UBYTE COMP_0068 1 100 0 255 ECU_ADDRESS 0xFFFF0D0B READ_WRITE /end MEASUREMENT
/begin MEASUREMENT vMDI "RAM value vMDI" UBYTE COMP_0004 1 100 0 255 ECU_ADDRESS 0xFFFF2069 READ_WRITE /end MEASUREMENT
/begin MEASUREMENT vMDIEL "RAM value vMDIEL" UBYTE COMP_0068 1 100 0 255 ECU_ADDRESS 0xFFFF08EA READ_WRITE /end MEASUREMENT
/begin MEASUREMENT vMDL "RAM value vMDL" UWORD COMP_0581_S 1 100 0 64.001481 ECU_ADDRESS 0xFFFF2970 READ_WRITE /end MEASUREMENT
/begin MEASUREMENT vME1000 "RAM value vME1000" UBYTE COMP_0016 1 100 0 255 ECU_ADDRESS 0xFFFF47B0 READ_WRITE /end MEASUREMENT
/begin MEASUREMENT vMEMHH "RAM value vMEMHH" UBYTE COMP_0004 1 100 0 255 ECU_ADDRESS 0xFFFF3352 READ_WRITE /end MEASUREMENT
/begin MEASUREMENT vMEMHL "RAM value vMEMHL" UBYTE COMP_0004 1 100 0 255 ECU_ADDRESS 0xFFFF3353 READ_WRITE /end MEASUREMENT
/begin MEASUREMENT vMEMLH "RAM value vMEMLH" UBYTE COMP_0004 1 100 0 255 ECU_ADDRESS 0xFFFF3354 READ_WRITE /end MEASUREMENT
/begin MEASUREMENT vMEMLL "RAM value vMEMLL" UBYTE COMP_0004 1 100 0 255 ECU_ADDRESS 0xFFFF3355 READ_WRITE /end MEASUREMENT
/begin MEASUREMENT vMEMSIZE "RAM value vMEMSIZE" UWORD COMP_0004 1 100 0 65535 ECU_ADDRESS 0xFFFF3356 READ_WRITE /end MEASUREMENT
/begin MEASUREMENT vMETH1 "RAM value vMETH1" UBYTE COMP_0580_S 1 100 -128 127 ECU_ADDRESS 0xFFFF31A4 READ_WRITE /end MEASUREMENT
/begin MEASUREMENT vMETMSG2T "RAM value vMETMSG2T" UBYTE COMP_0014 1 100 0 2550 ECU_ADDRESS 0xFFFF206A READ_WRITE /end MEASUREMENT
/begin MEASUREMENT vMETRQ "RAM value vMETRQ" UBYTE COMP_0497_S 1 100 -100 410 ECU_ADDRESS 0xFFFF37B2 READ_WRITE /end MEASUREMENT
/begin MEASUREMENT vMF "RAM value vMF" ULONG COMP_0144 1 100 0 2097150.9257699 ECU_ADDRESS 0xFFFF0D0C READ_WRITE /end MEASUREMENT
/begin MEASUREMENT vMFA200 "RAM value vMFA200" UBYTE COMP_0016 1 100 0 255 ECU_ADDRESS 0xFFFF47B5 READ_WRITE /end MEASUREMENT
/begin MEASUREMENT vMFACC "RAM value vMFACC" UWORD COMP_0016 1 100 0 65535 ECU_ADDRESS 0xFFFF520C READ_WRITE /end MEASUREMENT
/begin MEASUREMENT vMFAIA "RAM value vMFAIA" UWORD COMP_0016 1 100 0 65535 ECU_ADDRESS 0xFFFF31A6 READ_WRITE /end MEASUREMENT
/begin MEASUREMENT vMFAID "RAM value vMFAID" UWORD COMP_0016 1 100 0 65535 ECU_ADDRESS 0xFFFF31A8 READ_WRITE /end MEASUREMENT
/begin MEASUREMENT vMFAIT "RAM value vMFAIT" UWORD COMP_0016 1 100 0 65535 ECU_ADDRESS 0xFFFF31B2 READ_WRITE /end MEASUREMENT
/begin MEASUREMENT vMFALL "RAM value vMFALL" UWORD COMP_0016 1 100 0 65535 ECU_ADDRESS 0xFFFF31BC READ_WRITE /end MEASUREMENT
/begin MEASUREMENT vMFC200 "RAM value vMFC200" UBYTE COMP_0016 1 100 0 255 ECU_ADDRESS 0xFFFF47BA READ_WRITE /end MEASUREMENT
/begin MEASUREMENT vMFCAT "RAM value vMFCAT" UWORD COMP_0016 1 100 0 65535 ECU_ADDRESS 0xFFFF31C6 READ_WRITE /end MEASUREMENT
/begin MEASUREMENT vMFCAV "RAM value vMFCAV" UWORD COMP_0016 1 100 0 65535 ECU_ADDRESS 0xFFFF5216 READ_WRITE /end MEASUREMENT
/begin MEASUREMENT vMFCAVZ "RAM value vMFCAVZ" UWORD COMP_0016 1 100 0 65535 ECU_ADDRESS 0xFFFF2974 READ_WRITE /end MEASUREMENT
/begin MEASUREMENT vMFCEM "RAM value vMFCEM" UWORD COMP_0016 1 100 0 65535 ECU_ADDRESS 0xFFFF31D0 READ_WRITE /end MEASUREMENT
/begin MEASUREMENT vMFCIGN "RAM value vMFCIGN" UBYTE COMP_0030 1 100 0 255 ECU_ADDRESS 0xFFFF1E0A READ_WRITE /end MEASUREMENT
/begin MEASUREMENT vMFCIGNC "RAM value vMFCIGNC" UBYTE COMP_0030 1 100 0 255 ECU_ADDRESS 0xFFFF1E0B READ_WRITE /end MEASUREMENT
/begin MEASUREMENT vMFCIGND "RAM value vMFCIGND" UBYTE COMP_0030 1 100 0 255 ECU_ADDRESS 0xFFFF1E0C READ_WRITE /end MEASUREMENT
/begin MEASUREMENT vMFCIGNE "RAM value vMFCIGNE" UBYTE COMP_0030 1 100 0 255 ECU_ADDRESS 0xFFFF1E0D READ_WRITE /end MEASUREMENT
/begin MEASUREMENT vMFCIGNG "RAM value vMFCIGNG" UBYTE COMP_0030 1 100 0 255 ECU_ADDRESS 0xFFFF1E0E READ_WRITE /end MEASUREMENT
/begin MEASUREMENT vMFCLVA "RAM value vMFCLVA" UBYTE COMP_0463 1 100 0 99.99999981 ECU_ADDRESS 0xFFFF47BF READ_WRITE /end MEASUREMENT
/begin MEASUREMENT vMFCLVB "RAM value vMFCLVB" UBYTE COMP_0463 1 100 0 99.99999981 ECU_ADDRESS 0xFFFF47C0 READ_WRITE /end MEASUREMENT
/begin MEASUREMENT vMFCLVC "RAM value vMFCLVC" UBYTE COMP_0463 1 100 0 99.99999981 ECU_ADDRESS 0xFFFF47C1 READ_WRITE /end MEASUREMENT
/begin MEASUREMENT vMFCSTSW "RAM value vMFCSTSW" UWORD COMP_0016 1 100 0 65535 ECU_ADDRESS 0xFFFF4E3C READ_WRITE /end MEASUREMENT
/begin MEASUREMENT vMFCYLN "RAM value vMFCYLN" UBYTE COMP_0068 1 100 0 255 ECU_ADDRESS 0xFFFF297E READ_WRITE /end MEASUREMENT
/begin MEASUREMENT vMFCYMX "RAM value vMFCYMX" UBYTE COMP_0027 1 100 0 255 ECU_ADDRESS 0xFFFF47C2 READ_WRITE /end MEASUREMENT
/begin MEASUREMENT vMFDTY "RAM value vMFDTY" UBYTE COMP_0027 1 100 0 255 ECU_ADDRESS 0xFFFF3B72 READ_WRITE /end MEASUREMENT
/begin MEASUREMENT vMFDVC "RAM value vMFDVC" UBYTE COMP_0030 1 100 0 255 ECU_ADDRESS 0xFFFF47C3 READ_WRITE /end MEASUREMENT
/begin MEASUREMENT vMFDVCA "RAM value vMFDVCA" UBYTE COMP_0016 1 100 0 255 ECU_ADDRESS 0xFFFF47C4 READ_WRITE /end MEASUREMENT
/begin MEASUREMENT vMFDVCB "RAM value vMFDVCB" UBYTE COMP_0016 1 100 0 255 ECU_ADDRESS 0xFFFF47C5 READ_WRITE /end MEASUREMENT
/begin MEASUREMENT vMFDVCC "RAM value vMFDVCC" UBYTE COMP_0016 1 100 0 255 ECU_ADDRESS 0xFFFF47C6 READ_WRITE /end MEASUREMENT
/begin MEASUREMENT vMFEXGS "RAM value vMFEXGS" UWORD COMP_0304_S 1 100 0 1.04856 ECU_ADDRESS 0xFFFF2980 READ_WRITE /end MEASUREMENT
/begin MEASUREMENT vMFEXGTD "RAM value vMFEXGTD" UWORD COMP_0304_S 1 100 0 1.04856 ECU_ADDRESS 0xFFFF2982 READ_WRITE /end MEASUREMENT
/begin MEASUREMENT vMFFUEL "RAM value vMFFUEL" UWORD COMP_0304_S 1 100 0 1.04856 ECU_ADDRESS 0xFFFF2984 READ_WRITE /end MEASUREMENT
/begin MEASUREMENT vMFGSTCNT "RAM value vMFGSTCNT" UBYTE COMP_0068 1 100 0 255 ECU_ADDRESS 0xFFFF2986 READ_WRITE /end MEASUREMENT
/begin MEASUREMENT vMFHIVTCA "RAM value vMFHIVTCA" UBYTE COMP_0063 1 100 0 0.99609375 ECU_ADDRESS 0xFFFF0D12 READ_WRITE /end MEASUREMENT
/begin MEASUREMENT vMFHIVTCD "RAM value vMFHIVTCD" UBYTE COMP_0063 1 100 0 0.99609375 ECU_ADDRESS 0xFFFF0D13 READ_WRITE /end MEASUREMENT
/begin MEASUREMENT vMFHTVOd "RAM value vMFHTVOd" UWORD COMP_0328 1 100 0 399.99392106 ECU_ADDRESS 0xFFFF0D14 READ_WRITE /end MEASUREMENT
/begin MEASUREMENT vMFHd "RAM value vMFHd" UWORD COMP_0176 1 100 0 1023.984375 ECU_ADDRESS 0xFFFF0D10 READ_WRITE /end MEASUREMENT
/begin MEASUREMENT vMFN11 "RAM value vMFN11" ULONG COMP_0030 1 100 0 4294967295 ECU_ADDRESS 0xFFFF47C8 READ_WRITE /end MEASUREMENT
/begin MEASUREMENT vMFN12 "RAM value vMFN12" ULONG COMP_0030 1 100 0 4294967295 ECU_ADDRESS 0xFFFF47CC READ_WRITE /end MEASUREMENT
/begin MEASUREMENT vMFN13 "RAM value vMFN13" ULONG COMP_0030 1 100 0 4294967295 ECU_ADDRESS 0xFFFF47D0 READ_WRITE /end MEASUREMENT
/begin MEASUREMENT vMFN14 "RAM value vMFN14" ULONG COMP_0030 1 100 0 4294967295 ECU_ADDRESS 0xFFFF47D4 READ_WRITE /end MEASUREMENT
/begin MEASUREMENT vMFN21 "RAM value vMFN21" ULONG COMP_0030 1 100 0 4294967295 ECU_ADDRESS 0xFFFF47D8 READ_WRITE /end MEASUREMENT
/begin MEASUREMENT vMFN22 "RAM value vMFN22" ULONG COMP_0030 1 100 0 4294967295 ECU_ADDRESS 0xFFFF47DC READ_WRITE /end MEASUREMENT
/begin MEASUREMENT vMFN23 "RAM value vMFN23" ULONG COMP_0030 1 100 0 4294967295 ECU_ADDRESS 0xFFFF47E0 READ_WRITE /end MEASUREMENT
/begin MEASUREMENT vMFN24 "RAM value vMFN24" ULONG COMP_0030 1 100 0 4294967295 ECU_ADDRESS 0xFFFF47E4 READ_WRITE /end MEASUREMENT
/begin MEASUREMENT vMFNAC "RAM value vMFNAC" UBYTE COMP_0016 1 100 0 255 ECU_ADDRESS 0xFFFF2987 READ_WRITE /end MEASUREMENT
/begin MEASUREMENT vMFNAE "RAM value vMFNAE" UBYTE COMP_0016 1 100 0 255 ECU_ADDRESS 0xFFFF2988 READ_WRITE /end MEASUREMENT
/begin MEASUREMENT vMFNCT "RAM value vMFNCT" UBYTE COMP_0016 1 100 0 255 ECU_ADDRESS 0xFFFF2989 READ_WRITE /end MEASUREMENT
/begin MEASUREMENT vMFNEM "RAM value vMFNEM" UBYTE COMP_0016 1 100 0 255 ECU_ADDRESS 0xFFFF298A READ_WRITE /end MEASUREMENT
/begin MEASUREMENT vMFREQ "RAM value vMFREQ" UBYTE COMP_0027 1 100 0 255 ECU_ADDRESS 0xFFFF298B READ_WRITE /end MEASUREMENT
/begin MEASUREMENT vMFRPMA "RAM value vMFRPMA" UWORD COMP_0006 1 100 0 819187.5 ECU_ADDRESS 0xFFFF47E8 READ_WRITE /end MEASUREMENT
/begin MEASUREMENT vMFRPMB "RAM value vMFRPMB" UWORD COMP_0006 1 100 0 819187.5 ECU_ADDRESS 0xFFFF47EA READ_WRITE /end MEASUREMENT
/begin MEASUREMENT vMFRPMC "RAM value vMFRPMC" UWORD COMP_0006 1 100 0 819187.5 ECU_ADDRESS 0xFFFF47EC READ_WRITE /end MEASUREMENT
/begin MEASUREMENT vMFS "RAM value vMFS" UBYTE COMP_0016 1 100 0 255 ECU_ADDRESS 0xFFFF47EE READ_WRITE /end MEASUREMENT
/begin MEASUREMENT vMFSDMI "RAM value vMFSDMI" UWORD COMP_0016 1 100 0 65535 ECU_ADDRESS 0xFFFF47F0 READ_WRITE /end MEASUREMENT
/begin MEASUREMENT vMFSDNG "RAM value vMFSDNG" UWORD COMP_0016 1 100 0 65535 ECU_ADDRESS 0xFFFF47F2 READ_WRITE /end MEASUREMENT
/begin MEASUREMENT vMFSDOK "RAM value vMFSDOK" UWORD COMP_0016 1 100 0 65535 ECU_ADDRESS 0xFFFF47F4 READ_WRITE /end MEASUREMENT
/begin MEASUREMENT vMFSEM "RAM value vMFSEM" UWORD COMP_0016 1 100 0 65535 ECU_ADDRESS 0xFFFF47F6 READ_WRITE /end MEASUREMENT
/begin MEASUREMENT vMFSKM "RAM value vMFSKM" UWORD COMP_0582_S 1 100 0 1684249.5 ECU_ADDRESS 0xFFFF4806 READ_WRITE /end MEASUREMENT
/begin MEASUREMENT vMFSMN "RAM value vMFSMN" UBYTE COMP_0000 1 100 0 6375 ECU_ADDRESS 0xFFFF4816 READ_WRITE /end MEASUREMENT
/begin MEASUREMENT vMFSTA "RAM value vMFSTA" UBYTE COMP_0035 1 100 -50 205 ECU_ADDRESS 0xFFFF481E READ_WRITE /end MEASUREMENT
/begin MEASUREMENT vMFSTP "RAM value vMFSTP" UBYTE COMP_0001 1 100 0 31.875 ECU_ADDRESS 0xFFFF4826 READ_WRITE /end MEASUREMENT
/begin MEASUREMENT vMFSTW "RAM value vMFSTW" UBYTE COMP_0035 1 100 -50 205 ECU_ADDRESS 0xFFFF482E READ_WRITE /end MEASUREMENT
/begin MEASUREMENT vMFSVS "RAM value vMFSVS" UBYTE COMP_0007 1 100 0 510 ECU_ADDRESS 0xFFFF4836 READ_WRITE /end MEASUREMENT
/begin MEASUREMENT vMFTL "RAM value vMFTL" UWORD COMP_0016 1 100 0 65535 ECU_ADDRESS 0xFFFF4E3E READ_WRITE /end MEASUREMENT
/begin MEASUREMENT vMFTLIN "RAM value vMFTLIN" UWORD COMP_0016 1 100 0 65535 ECU_ADDRESS 0xFFFF298C READ_WRITE /end MEASUREMENT
/begin MEASUREMENT vMFTLINT "RAM value vMFTLINT" UWORD COMP_0016 1 100 0 65535 ECU_ADDRESS 0xFFFF31DA READ_WRITE /end MEASUREMENT
/begin MEASUREMENT vMFTLOUT "RAM value vMFTLOUT" UWORD COMP_0016 1 100 0 65535 ECU_ADDRESS 0xFFFF298E READ_WRITE /end MEASUREMENT
/begin MEASUREMENT vMFTWA "RAM value vMFTWA" UBYTE COMP_0468 1 100 -40 215 ECU_ADDRESS 0xFFFF483E READ_WRITE /end MEASUREMENT
/begin MEASUREMENT vMFTWB "RAM value vMFTWB" UBYTE COMP_0468 1 100 -40 215 ECU_ADDRESS 0xFFFF483F READ_WRITE /end MEASUREMENT
/begin MEASUREMENT vMFTWC "RAM value vMFTWC" UBYTE COMP_0468 1 100 -40 215 ECU_ADDRESS 0xFFFF4840 READ_WRITE /end MEASUREMENT
/begin MEASUREMENT vMFX "RAM value vMFX" UBYTE COMP_0068 1 100 0 255 ECU_ADDRESS 0xFFFF2990 READ_WRITE /end MEASUREMENT
/begin MEASUREMENT vMFXQS11 "RAM value vMFXQS11" ULONG COMP_0068 1 100 0 4294967295 ECU_ADDRESS 0xFFFF4844 READ_WRITE /end MEASUREMENT
/begin MEASUREMENT vMFXQS12 "RAM value vMFXQS12" ULONG COMP_0068 1 100 0 4294967295 ECU_ADDRESS 0xFFFF4848 READ_WRITE /end MEASUREMENT
/begin MEASUREMENT vMFXQS13 "RAM value vMFXQS13" ULONG COMP_0068 1 100 0 4294967295 ECU_ADDRESS 0xFFFF484C READ_WRITE /end MEASUREMENT
/begin MEASUREMENT vMFXQS14 "RAM value vMFXQS14" ULONG COMP_0068 1 100 0 4294967295 ECU_ADDRESS 0xFFFF4850 READ_WRITE /end MEASUREMENT
/begin MEASUREMENT vMFXQS21 "RAM value vMFXQS21" ULONG COMP_0068 1 100 0 4294967295 ECU_ADDRESS 0xFFFF4854 READ_WRITE /end MEASUREMENT
/begin MEASUREMENT vMFXQS22 "RAM value vMFXQS22" ULONG COMP_0068 1 100 0 4294967295 ECU_ADDRESS 0xFFFF4858 READ_WRITE /end MEASUREMENT
/begin MEASUREMENT vMFXQS23 "RAM value vMFXQS23" ULONG COMP_0068 1 100 0 4294967295 ECU_ADDRESS 0xFFFF485C READ_WRITE /end MEASUREMENT
/begin MEASUREMENT vMFXQS24 "RAM value vMFXQS24" ULONG COMP_0068 1 100 0 4294967295 ECU_ADDRESS 0xFFFF4860 READ_WRITE /end MEASUREMENT
/begin MEASUREMENT vMFXS11 "RAM value vMFXS11" ULONG COMP_0016 1 100 0 4294967295 ECU_ADDRESS 0xFFFF4864 READ_WRITE /end MEASUREMENT
/begin MEASUREMENT vMFXS12 "RAM value vMFXS12" ULONG COMP_0016 1 100 0 4294967295 ECU_ADDRESS 0xFFFF4868 READ_WRITE /end MEASUREMENT
/begin MEASUREMENT vMFXS13 "RAM value vMFXS13" ULONG COMP_0016 1 100 0 4294967295 ECU_ADDRESS 0xFFFF486C READ_WRITE /end MEASUREMENT
/begin MEASUREMENT vMFXS14 "RAM value vMFXS14" ULONG COMP_0016 1 100 0 4294967295 ECU_ADDRESS 0xFFFF4870 READ_WRITE /end MEASUREMENT
/begin MEASUREMENT vMFXS21 "RAM value vMFXS21" ULONG COMP_0016 1 100 0 4294967295 ECU_ADDRESS 0xFFFF4874 READ_WRITE /end MEASUREMENT
/begin MEASUREMENT vMFXS22 "RAM value vMFXS22" ULONG COMP_0016 1 100 0 4294967295 ECU_ADDRESS 0xFFFF4878 READ_WRITE /end MEASUREMENT
/begin MEASUREMENT vMFXS23 "RAM value vMFXS23" ULONG COMP_0016 1 100 0 4294967295 ECU_ADDRESS 0xFFFF487C READ_WRITE /end MEASUREMENT
/begin MEASUREMENT vMFXS24 "RAM value vMFXS24" ULONG COMP_0016 1 100 0 4294967295 ECU_ADDRESS 0xFFFF4880 READ_WRITE /end MEASUREMENT
/begin MEASUREMENT vMIJOFH "RAM value vMIJOFH" UBYTE COMP_0004 1 100 0 255 ECU_ADDRESS 0xFFFF1929 READ_WRITE /end MEASUREMENT
/begin MEASUREMENT vMIJOFHZ "RAM value vMIJOFHZ" UBYTE COMP_0004 1 100 0 255 ECU_ADDRESS 0xFFFF192A READ_WRITE /end MEASUREMENT
/begin MEASUREMENT vMIJOFS "RAM value vMIJOFS" UBYTE COMP_0068 1 100 0 255 ECU_ADDRESS 0xFFFF192B READ_WRITE /end MEASUREMENT
/begin MEASUREMENT vMIL1MAX "RAM value vMIL1MAX" UBYTE COMP_0030 1 100 0 255 ECU_ADDRESS 0xFFFF4884 READ_WRITE /end MEASUREMENT
/begin MEASUREMENT vMIL2MAX "RAM value vMIL2MAX" UBYTE COMP_0030 1 100 0 255 ECU_ADDRESS 0xFFFF4885 READ_WRITE /end MEASUREMENT
/begin MEASUREMENT vMILBL1 "RAM value vMILBL1" UBYTE COMP_0014 1 100 0 2550 ECU_ADDRESS 0xFFFF2991 READ_WRITE /end MEASUREMENT
/begin MEASUREMENT vMILBL10 "RAM value vMILBL10" UBYTE COMP_0049 1 100 0 255 ECU_ADDRESS 0xFFFF2992 READ_WRITE /end MEASUREMENT
/begin MEASUREMENT vMILCNG1 "RAM value vMILCNG1" UBYTE COMP_0030 1 100 0 255 ECU_ADDRESS 0xFFFF2993 READ_WRITE /end MEASUREMENT
/begin MEASUREMENT vMILCNG2 "RAM value vMILCNG2" UBYTE COMP_0030 1 100 0 255 ECU_ADDRESS 0xFFFF2994 READ_WRITE /end MEASUREMENT
/begin MEASUREMENT vMILEG1 "RAM value vMILEG1" ULONG COMP_0389 1 100 0 1685624.33943218 ECU_ADDRESS 0xFFFF4F28 READ_WRITE /end MEASUREMENT
/begin MEASUREMENT vMILEG2 "RAM value vMILEG2" ULONG COMP_0389 1 100 0 1685624.33943218 ECU_ADDRESS 0xFFFF4F2C READ_WRITE /end MEASUREMENT
/begin MEASUREMENT vMILEGSEN "RAM value vMILEGSEN" ULONG COMP_0389 1 100 0 1685624.33943218 ECU_ADDRESS 0xFFFF4F30 READ_WRITE /end MEASUREMENT
/begin MEASUREMENT vMILNGCN "RAM value vMILNGCN" UBYTE COMP_0194_S 1 100 0 255 ECU_ADDRESS 0xFFFF4886 READ_WRITE /end MEASUREMENT
/begin MEASUREMENT vMILTIME "RAM value vMILTIME" UWORD COMP_0467_S 1 100 0 65535 ECU_ADDRESS 0xFFFF5220 READ_WRITE /end MEASUREMENT
/begin MEASUREMENT vMINAVTQ "RAM value vMINAVTQ" SWORD COMP_0228 1 100 -3276.8 3276.7 ECU_ADDRESS 0xFFFF2996 READ_WRITE /end MEASUREMENT
/begin MEASUREMENT vMINCYLH "RAM value vMINCYLH" UBYTE COMP_0004 1 100 0 255 ECU_ADDRESS 0xFFFF192C READ_WRITE /end MEASUREMENT
/begin MEASUREMENT vMINTMPTA "RAM value vMINTMPTA" UBYTE COMP_0004_S 1 100 -50 205 ECU_ADDRESS 0xFFFF2998 READ_WRITE /end MEASUREMENT
/begin MEASUREMENT vMINTMPTF "RAM value vMINTMPTF" UBYTE COMP_0004_S 1 100 -50 205 ECU_ADDRESS 0xFFFF2999 READ_WRITE /end MEASUREMENT
/begin MEASUREMENT vMINTMPTH "RAM value vMINTMPTH" UBYTE COMP_0004_S 1 100 -50 205 ECU_ADDRESS 0xFFFF299A READ_WRITE /end MEASUREMENT
/begin MEASUREMENT vMINTMPTO "RAM value vMINTMPTO" UBYTE COMP_0004_S 1 100 -50 205 ECU_ADDRESS 0xFFFF299B READ_WRITE /end MEASUREMENT
/begin MEASUREMENT vMINTMPTW "RAM value vMINTMPTW" UBYTE COMP_0004_S 1 100 -50 205 ECU_ADDRESS 0xFFFF299C READ_WRITE /end MEASUREMENT
/begin MEASUREMENT vMIN_50 "RAM value vMIN_50" UBYTE COMP_0068 1 100 0 255 ECU_ADDRESS 0xFFFF37B3 READ_WRITE /end MEASUREMENT
/begin MEASUREMENT vMIONKM "RAM value vMIONKM" UWORD COMP_0470 1 100 0 65535 ECU_ADDRESS 0xFFFF4F34 READ_WRITE /end MEASUREMENT
/begin MEASUREMENT vMISA "RAM value vMISA" UBYTE COMP_0580_S 1 100 -128 127 ECU_ADDRESS 0xFFFF31DC READ_WRITE /end MEASUREMENT
/begin MEASUREMENT vMISB "RAM value vMISB" UBYTE COMP_0580_S 1 100 -128 127 ECU_ADDRESS 0xFFFF31E0 READ_WRITE /end MEASUREMENT
/begin MEASUREMENT vMISBHOS "RAM value vMISBHOS" UBYTE COMP_0373 1 100 0 2.55 ECU_ADDRESS 0xFFFF3B73 READ_WRITE /end MEASUREMENT
/begin MEASUREMENT vMISC "RAM value vMISC" UBYTE COMP_0580_S 1 100 -128 127 ECU_ADDRESS 0xFFFF31E4 READ_WRITE /end MEASUREMENT
/begin MEASUREMENT vMISCV "RAM value vMISCV" UBYTE COMP_0054 1 100 0 5100 ECU_ADDRESS 0xFFFF0D16 READ_WRITE /end MEASUREMENT
/begin MEASUREMENT vMISE "RAM value vMISE" UBYTE COMP_0580_S 1 100 -128 127 ECU_ADDRESS 0xFFFF31E5 READ_WRITE /end MEASUREMENT
/begin MEASUREMENT vMKADV0 "RAM value vMKADV0" UBYTE COMP_0471 1 100 0 15.9375 ECU_ADDRESS 0xFFFF0D17 READ_WRITE /end MEASUREMENT
/begin MEASUREMENT vMKAVN "RAM value vMKAVN" UBYTE COMP_0044 1 100 0 1.9921875 ECU_ADDRESS 0xFFFF0D18 READ_WRITE /end MEASUREMENT
/begin MEASUREMENT vMKAVP "RAM value vMKAVP" UBYTE COMP_0254 1 100 0 15.9375 ECU_ADDRESS 0xFFFF0D19 READ_WRITE /end MEASUREMENT
/begin MEASUREMENT vMKCNG1 "RAM value vMKCNG1" UBYTE COMP_0108 1 100 0 0.99609375 ECU_ADDRESS 0xFFFF0D1A READ_WRITE /end MEASUREMENT
/begin MEASUREMENT vMKCNG2 "RAM value vMKCNG2" UBYTE COMP_0108 1 100 0 0.99609375 ECU_ADDRESS 0xFFFF0D1B READ_WRITE /end MEASUREMENT
/begin MEASUREMENT vMKIDL "RAM value vMKIDL" UBYTE COMP_0063 1 100 0 0.99609375 ECU_ADDRESS 0xFFFF0D1C READ_WRITE /end MEASUREMENT
/begin MEASUREMENT vMKINJ "RAM value vMKINJ" UWORD COMP_0217 1 100 0 3.999941832 ECU_ADDRESS 0xFFFF0D1E READ_WRITE /end MEASUREMENT
/begin MEASUREMENT vMKTNT "RAM value vMKTNT" UWORD COMP_0456 1 100 0 1.999970916 ECU_ADDRESS 0xFFFF31E6 READ_WRITE /end MEASUREMENT
/begin MEASUREMENT vMKTW "RAM value vMKTW" SBYTE COMP_0472 1 100 -2 1.984375 ECU_ADDRESS 0xFFFF0D20 READ_WRITE /end MEASUREMENT
/begin MEASUREMENT vMLRCL "RAM value vMLRCL" UWORD COMP_0031 1 100 0 255.99609375 ECU_ADDRESS 0xFFFF4888 READ_WRITE /end MEASUREMENT
/begin MEASUREMENT vMLRCR "RAM value vMLRCR" UWORD COMP_0031 1 100 0 255.99609375 ECU_ADDRESS 0xFFFF4908 READ_WRITE /end MEASUREMENT
/begin MEASUREMENT vMLTRP "RAM value vMLTRP" UBYTE COMP_0030 1 100 0 255 ECU_ADDRESS 0xFFFF4988 READ_WRITE /end MEASUREMENT
/begin MEASUREMENT vMLTRPS1 "RAM value vMLTRPS1" UBYTE COMP_0030 1 100 0 255 ECU_ADDRESS 0xFFFF4989 READ_WRITE /end MEASUREMENT
/begin MEASUREMENT vMLTRPS2 "RAM value vMLTRPS2" UBYTE COMP_0030 1 100 0 255 ECU_ADDRESS 0xFFFF498A READ_WRITE /end MEASUREMENT
/begin MEASUREMENT vMLTRPS3 "RAM value vMLTRPS3" UBYTE COMP_0030 1 100 0 255 ECU_ADDRESS 0xFFFF498B READ_WRITE /end MEASUREMENT
/begin MEASUREMENT vMLTRPS4 "RAM value vMLTRPS4" UBYTE COMP_0030 1 100 0 255 ECU_ADDRESS 0xFFFF498C READ_WRITE /end MEASUREMENT
/begin MEASUREMENT vMLTRPS5 "RAM value vMLTRPS5" UBYTE COMP_0030 1 100 0 255 ECU_ADDRESS 0xFFFF498D READ_WRITE /end MEASUREMENT
/begin MEASUREMENT vMLTRPS6 "RAM value vMLTRPS6" UBYTE COMP_0030 1 100 0 255 ECU_ADDRESS 0xFFFF498E READ_WRITE /end MEASUREMENT
/begin MEASUREMENT vMLTRPS7 "RAM value vMLTRPS7" UBYTE COMP_0030 1 100 0 255 ECU_ADDRESS 0xFFFF498F READ_WRITE /end MEASUREMENT
/begin MEASUREMENT vMLTRTFG "RAM value vMLTRTFG" UBYTE COMP_0030 1 100 0 255 ECU_ADDRESS 0xFFFF4990 READ_WRITE /end MEASUREMENT
/begin MEASUREMENT vMMALPH "RAM value vMMALPH" UWORD COMP_0031 1 100 0 255.99609375 ECU_ADDRESS 0xFFFF299E READ_WRITE /end MEASUREMENT
/begin MEASUREMENT vMMBTTRM "RAM value vMMBTTRM" UBYTE COMP_0245 1 100 -64 191 ECU_ADDRESS 0xFFFF0D21 READ_WRITE /end MEASUREMENT
/begin MEASUREMENT vMMTQUPTM "RAM value vMMTQUPTM" UBYTE COMP_0014 1 100 0 2550 ECU_ADDRESS 0xFFFF29A2 READ_WRITE /end MEASUREMENT
/begin MEASUREMENT vMNAVTQ_S "RAM value vMNAVTQ_S" SWORD COMP_0228 1 100 -3276.8 3276.7 ECU_ADDRESS 0xFFFF304E READ_WRITE /end MEASUREMENT
/begin MEASUREMENT vMNDAFMX "RAM value vMNDAFMX" UWORD COMP_0556_S 1 100 0 262.14 ECU_ADDRESS 0xFFFF4992 READ_WRITE /end MEASUREMENT
/begin MEASUREMENT vMNDNL "RAM value vMNDNL" UBYTE COMP_0006 1 100 0 3187.5 ECU_ADDRESS 0xFFFF49B2 READ_WRITE /end MEASUREMENT
/begin MEASUREMENT vMNDNR "RAM value vMNDNR" UBYTE COMP_0006 1 100 0 3187.5 ECU_ADDRESS 0xFFFF49C2 READ_WRITE /end MEASUREMENT
/begin MEASUREMENT vMNDQL "RAM value vMNDQL" UWORD COMP_0068 1 100 0 65535 ECU_ADDRESS 0xFFFF49D2 READ_WRITE /end MEASUREMENT
/begin MEASUREMENT vMNDQR "RAM value vMNDQR" UWORD COMP_0068 1 100 0 65535 ECU_ADDRESS 0xFFFF49F2 READ_WRITE /end MEASUREMENT
/begin MEASUREMENT vMNHOL "RAM value vMNHOL" UWORD COMP_0017_S 1 100 0 655.35 ECU_ADDRESS 0xFFFF4A12 READ_WRITE /end MEASUREMENT
/begin MEASUREMENT vMNHOR "RAM value vMNHOR" UWORD COMP_0017_S 1 100 0 655.35 ECU_ADDRESS 0xFFFF4A32 READ_WRITE /end MEASUREMENT
/begin MEASUREMENT vMNLPL "RAM value vMNLPL" UWORD COMP_0453 1 100 0 131.07 ECU_ADDRESS 0xFFFF4A52 READ_WRITE /end MEASUREMENT
/begin MEASUREMENT vMNLPR "RAM value vMNLPR" UWORD COMP_0453 1 100 0 131.07 ECU_ADDRESS 0xFFFF4A72 READ_WRITE /end MEASUREMENT
/begin MEASUREMENT vMNLRD "RAM value vMNLRD" UWORD COMP_0453 1 100 0 131.07 ECU_ADDRESS 0xFFFF4A92 READ_WRITE /end MEASUREMENT
/begin MEASUREMENT vMNNL "RAM value vMNNL" UWORD COMP_0006 1 100 0 819187.5 ECU_ADDRESS 0xFFFF4AB2 READ_WRITE /end MEASUREMENT
/begin MEASUREMENT vMNNR "RAM value vMNNR" UWORD COMP_0006 1 100 0 819187.5 ECU_ADDRESS 0xFFFF4AD2 READ_WRITE /end MEASUREMENT
/begin MEASUREMENT vMNQL "RAM value vMNQL" UWORD COMP_0068 1 100 0 65535 ECU_ADDRESS 0xFFFF4AF2 READ_WRITE /end MEASUREMENT
/begin MEASUREMENT vMNQR "RAM value vMNQR" UWORD COMP_0068 1 100 0 65535 ECU_ADDRESS 0xFFFF4B12 READ_WRITE /end MEASUREMENT
/begin MEASUREMENT vMNRLD "RAM value vMNRLD" UWORD COMP_0453 1 100 0 131.07 ECU_ADDRESS 0xFFFF4B32 READ_WRITE /end MEASUREMENT
/begin MEASUREMENT vMNRPL "RAM value vMNRPL" UWORD COMP_0453 1 100 0 131.07 ECU_ADDRESS 0xFFFF4B52 READ_WRITE /end MEASUREMENT
/begin MEASUREMENT vMNRPM "RAM value vMNRPM" UBYTE COMP_0000 1 100 0 6375 ECU_ADDRESS 0xFFFF095B READ_WRITE /end MEASUREMENT
/begin MEASUREMENT vMNRPMz1 "RAM value vMNRPMz1" UBYTE COMP_0000 1 100 0 6375 ECU_ADDRESS 0xFFFF192D READ_WRITE /end MEASUREMENT
/begin MEASUREMENT vMNRPMz10 "RAM value vMNRPMz10" UBYTE COMP_0000 1 100 0 6375 ECU_ADDRESS 0xFFFF095C READ_WRITE /end MEASUREMENT
/begin MEASUREMENT vMNRPMz2 "RAM value vMNRPMz2" UBYTE COMP_0000 1 100 0 6375 ECU_ADDRESS 0xFFFF192E READ_WRITE /end MEASUREMENT
/begin MEASUREMENT vMNRPMz3 "RAM value vMNRPMz3" UBYTE COMP_0000 1 100 0 6375 ECU_ADDRESS 0xFFFF192F READ_WRITE /end MEASUREMENT
/begin MEASUREMENT vMNRPMz4 "RAM value vMNRPMz4" UBYTE COMP_0000 1 100 0 6375 ECU_ADDRESS 0xFFFF1930 READ_WRITE /end MEASUREMENT
/begin MEASUREMENT vMNRPMz5 "RAM value vMNRPMz5" UBYTE COMP_0000 1 100 0 6375 ECU_ADDRESS 0xFFFF1931 READ_WRITE /end MEASUREMENT
/begin MEASUREMENT vMNRPMz6 "RAM value vMNRPMz6" UBYTE COMP_0000 1 100 0 6375 ECU_ADDRESS 0xFFFF1932 READ_WRITE /end MEASUREMENT
/begin MEASUREMENT vMNRPMz7 "RAM value vMNRPMz7" UBYTE COMP_0000 1 100 0 6375 ECU_ADDRESS 0xFFFF1933 READ_WRITE /end MEASUREMENT
/begin MEASUREMENT vMNRPMz8 "RAM value vMNRPMz8" UBYTE COMP_0000 1 100 0 6375 ECU_ADDRESS 0xFFFF1934 READ_WRITE /end MEASUREMENT
/begin MEASUREMENT vMNRPMz9 "RAM value vMNRPMz9" UBYTE COMP_0000 1 100 0 6375 ECU_ADDRESS 0xFFFF1935 READ_WRITE /end MEASUREMENT
/begin MEASUREMENT vMNRPR "RAM value vMNRPR" UWORD COMP_0453 1 100 0 131.07 ECU_ADDRESS 0xFFFF4B72 READ_WRITE /end MEASUREMENT
/begin MEASUREMENT vMNTCNTAf "RAM value vMNTCNTAf" UBYTE COMP_0004 1 100 0 255 ECU_ADDRESS 0xFFFF29A3 READ_WRITE /end MEASUREMENT
/begin MEASUREMENT vMOCYLH "RAM value vMOCYLH" UBYTE COMP_0004 1 100 0 255 ECU_ADDRESS 0xFFFF1936 READ_WRITE /end MEASUREMENT
/begin MEASUREMENT vMOCYLS "RAM value vMOCYLS" UBYTE COMP_0004 1 100 0 255 ECU_ADDRESS 0xFFFF1937 READ_WRITE /end MEASUREMENT
/begin MEASUREMENT vMODDEC "RAM value vMODDEC" UBYTE COMP_0300_S 1 100 0 127.5 ECU_ADDRESS 0xFFFF29A4 READ_WRITE /end MEASUREMENT
/begin MEASUREMENT vMODDECE "RAM value vMODDECE" UBYTE COMP_0300_S 1 100 0 127.5 ECU_ADDRESS 0xFFFF29A5 READ_WRITE /end MEASUREMENT
/begin MEASUREMENT vMODECNT "RAM value vMODECNT" UBYTE COMP_0030 1 100 0 255 ECU_ADDRESS 0xFFFF29A6 READ_WRITE /end MEASUREMENT
/begin MEASUREMENT vMODEJDG "RAM value vMODEJDG" UBYTE COMP_0068 1 100 0 255 ECU_ADDRESS 0xFFFF29A7 READ_WRITE /end MEASUREMENT
/begin MEASUREMENT vMODINC "RAM value vMODINC" UBYTE COMP_0300_S 1 100 0 127.5 ECU_ADDRESS 0xFFFF29A8 READ_WRITE /end MEASUREMENT
/begin MEASUREMENT vMODINCE "RAM value vMODINCE" UBYTE COMP_0300_S 1 100 0 127.5 ECU_ADDRESS 0xFFFF29A9 READ_WRITE /end MEASUREMENT
/begin MEASUREMENT vMODTM "RAM value vMODTM" UBYTE COMP_0189 1 100 0 816 ECU_ADDRESS 0xFFFF0D22 READ_WRITE /end MEASUREMENT
/begin MEASUREMENT vMONDLY "RAM value vMONDLY" UWORD COMP_0014 1 100 0 655350 ECU_ADDRESS 0xFFFF29AA READ_WRITE /end MEASUREMENT
/begin MEASUREMENT vMONFS1 "RAM value vMONFS1" UBYTE COMP_0068 1 100 0 255 ECU_ADDRESS 0xFFFF4B92 READ_WRITE /end MEASUREMENT
/begin MEASUREMENT vMONFS2 "RAM value vMONFS2" UBYTE COMP_0068 1 100 0 255 ECU_ADDRESS 0xFFFF4B93 READ_WRITE /end MEASUREMENT
/begin MEASUREMENT vMONFSL "RAM value vMONFSL" UWORD COMP_0068 1 100 0 65535 ECU_ADDRESS 0xFFFF29AE READ_WRITE /end MEASUREMENT
/begin MEASUREMENT vMONFSMEM "RAM value vMONFSMEM" UBYTE COMP_0008 1 100 0 25500 ECU_ADDRESS 0xFFFF29B0 READ_WRITE /end MEASUREMENT
/begin MEASUREMENT vMONGR "RAM value vMONGR" UBYTE COMP_0068 1 100 0 255 ECU_ADDRESS 0xFFFF0D23 READ_WRITE /end MEASUREMENT
/begin MEASUREMENT vMONI1MN "RAM value vMONI1MN" UBYTE COMP_0068 1 100 0 255 ECU_ADDRESS 0xFFFF4B94 READ_WRITE /end MEASUREMENT
/begin MEASUREMENT vMONI1MX "RAM value vMONI1MX" UBYTE COMP_0068 1 100 0 255 ECU_ADDRESS 0xFFFF4BA4 READ_WRITE /end MEASUREMENT
/begin MEASUREMENT vMONI2MN "RAM value vMONI2MN" UWORD COMP_0068 1 100 0 65535 ECU_ADDRESS 0xFFFF4BB4 READ_WRITE /end MEASUREMENT
/begin MEASUREMENT vMONI2MX "RAM value vMONI2MX" UWORD COMP_0068 1 100 0 65535 ECU_ADDRESS 0xFFFF4BD4 READ_WRITE /end MEASUREMENT
/begin MEASUREMENT vMONMEM1 "RAM value vMONMEM1" UBYTE COMP_0068 1 100 0 255 ECU_ADDRESS 0xFFFF4BF4 READ_WRITE /end MEASUREMENT
/begin MEASUREMENT vMONMEM2 "RAM value vMONMEM2" UBYTE COMP_0068 1 100 0 255 ECU_ADDRESS 0xFFFF4BF5 READ_WRITE /end MEASUREMENT
/begin MEASUREMENT vMONMEML "RAM value vMONMEML" UWORD COMP_0068 1 100 0 65535 ECU_ADDRESS 0xFFFF29B2 READ_WRITE /end MEASUREMENT
/begin MEASUREMENT vMONTCLPf "RAM value vMONTCLPf" UBYTE COMP_0004 1 100 0 255 ECU_ADDRESS 0xFFFF29B4 READ_WRITE /end MEASUREMENT
/begin MEASUREMENT vMOPS "RAM value vMOPS" UWORD COMP_0065_S 1 100 0 1023.984375 ECU_ADDRESS 0xFFFF29B6 READ_WRITE /end MEASUREMENT
/begin MEASUREMENT vMPCYL "RAM value vMPCYL" UWORD COMP_0579_S 1 100 0 0.9102090615 ECU_ADDRESS 0xFFFF37B4 READ_WRITE /end MEASUREMENT
/begin MEASUREMENT vMPLMD "RAM value vMPLMD" UWORD COMP_0031 1 100 0 255.99609375 ECU_ADDRESS 0xFFFF0D24 READ_WRITE /end MEASUREMENT
/begin MEASUREMENT vMPMANI "RAM value vMPMANI" ULONG COMP_0579_S 1 100 0 59652.3712635255 ECU_ADDRESS 0xFFFF37B8 READ_WRITE /end MEASUREMENT
/begin MEASUREMENT vMPR "RAM value vMPR" UWORD COMP_0523_S 1 100 0 64.001481 ECU_ADDRESS 0xFFFF29B8 READ_WRITE /end MEASUREMENT
/begin MEASUREMENT vMPRC "RAM value vMPRC" UWORD COMP_0198_S 1 100 0 63.999056205 ECU_ADDRESS 0xFFFF29BA READ_WRITE /end MEASUREMENT
/begin MEASUREMENT vMPRK "RAM value vMPRK" UWORD COMP_0523_S 1 100 0 64.001481 ECU_ADDRESS 0xFFFF29BC READ_WRITE /end MEASUREMENT
/begin MEASUREMENT vMPRKR "RAM value vMPRKR" UWORD COMP_0523_S 1 100 0 64.001481 ECU_ADDRESS 0xFFFF29BE READ_WRITE /end MEASUREMENT
/begin MEASUREMENT vMPXDIS "RAM value vMPXDIS" UBYTE COMP_0283 1 100 0 255 ECU_ADDRESS 0xFFFF0D29 READ_WRITE /end MEASUREMENT
/begin MEASUREMENT vMPXDIS10 "RAM value vMPXDIS10" UBYTE COMP_0283 1 100 0 255 ECU_ADDRESS 0xFFFF0D2A READ_WRITE /end MEASUREMENT
/begin MEASUREMENT vMPXDISRLY "RAM value vMPXDISRLY" UBYTE COMP_0068 1 100 0 255 ECU_ADDRESS 0xFFFF0D2B READ_WRITE /end MEASUREMENT
/begin MEASUREMENT vMPX_CNT "RAM value vMPX_CNT" UBYTE COMP_0068 1 100 0 255 ECU_ADDRESS 0xFFFF0D28 READ_WRITE /end MEASUREMENT
/begin MEASUREMENT vMRDEL "RAM value vMRDEL" UBYTE COMP_0030 1 100 0 255 ECU_ADDRESS 0xFFFF4BF6 READ_WRITE /end MEASUREMENT
/begin MEASUREMENT vMRDER "RAM value vMRDER" UBYTE COMP_0030 1 100 0 255 ECU_ADDRESS 0xFFFF4BF7 READ_WRITE /end MEASUREMENT
/begin MEASUREMENT vMRDVCL "RAM value vMRDVCL" UBYTE COMP_0030 1 100 0 255 ECU_ADDRESS 0xFFFF4BF8 READ_WRITE /end MEASUREMENT
/begin MEASUREMENT vMRDVCR "RAM value vMRDVCR" UBYTE COMP_0030 1 100 0 255 ECU_ADDRESS 0xFFFF4BF9 READ_WRITE /end MEASUREMENT
/begin MEASUREMENT vMRGKJKf "RAM value vMRGKJKf" UBYTE COMP_0004 1 100 0 255 ECU_ADDRESS 0xFFFF37BC READ_WRITE /end MEASUREMENT
/begin MEASUREMENT vMRLCLV "RAM value vMRLCLV" UBYTE COMP_0425 1 100 0 99.99999981 ECU_ADDRESS 0xFFFF4BFA READ_WRITE /end MEASUREMENT
/begin MEASUREMENT vMRLRPM "RAM value vMRLRPM" UWORD COMP_0427 1 100 0 16383.75 ECU_ADDRESS 0xFFFF4BFC READ_WRITE /end MEASUREMENT
/begin MEASUREMENT vMRLTW "RAM value vMRLTW" UBYTE COMP_0428 1 100 -40 215 ECU_ADDRESS 0xFFFF4BFE READ_WRITE /end MEASUREMENT
/begin MEASUREMENT vMRRCLV "RAM value vMRRCLV" UBYTE COMP_0425 1 100 0 99.99999981 ECU_ADDRESS 0xFFFF4BFF READ_WRITE /end MEASUREMENT
/begin MEASUREMENT vMRRRPM "RAM value vMRRRPM" UWORD COMP_0427 1 100 0 16383.75 ECU_ADDRESS 0xFFFF4C00 READ_WRITE /end MEASUREMENT
/begin MEASUREMENT vMRRTW "RAM value vMRRTW" UBYTE COMP_0428 1 100 -40 215 ECU_ADDRESS 0xFFFF4C02 READ_WRITE /end MEASUREMENT
/begin MEASUREMENT vMRTRPL "RAM value vMRTRPL" UBYTE COMP_0030 1 100 0 255 ECU_ADDRESS 0xFFFF4C03 READ_WRITE /end MEASUREMENT
/begin MEASUREMENT vMRTRPR "RAM value vMRTRPR" UBYTE COMP_0030 1 100 0 255 ECU_ADDRESS 0xFFFF4C04 READ_WRITE /end MEASUREMENT
/begin MEASUREMENT vMSACNT "RAM value vMSACNT" UBYTE COMP_0016 1 100 0 255 ECU_ADDRESS 0xFFFF31EC READ_WRITE /end MEASUREMENT
/begin MEASUREMENT vMSACNT2 "RAM value vMSACNT2" UBYTE COMP_0016 1 100 0 255 ECU_ADDRESS 0xFFFF31ED READ_WRITE /end MEASUREMENT
/begin MEASUREMENT vMSACNT3 "RAM value vMSACNT3" UBYTE COMP_0016 1 100 0 255 ECU_ADDRESS 0xFFFF31EE READ_WRITE /end MEASUREMENT
/begin MEASUREMENT vMSATH "RAM value vMSATH" UBYTE COMP_0583_S 1 100 0 255 ECU_ADDRESS 0xFFFF29C0 READ_WRITE /end MEASUREMENT
/begin MEASUREMENT vMSATHA "RAM value vMSATHA" UBYTE COMP_0583_S 1 100 0 255 ECU_ADDRESS 0xFFFF29C1 READ_WRITE /end MEASUREMENT
/begin MEASUREMENT vMSMODE "RAM value vMSMODE" UBYTE COMP_0068 1 100 0 255 ECU_ADDRESS 0xFFFF29C2 READ_WRITE /end MEASUREMENT
/begin MEASUREMENT vMSRTQRQ "RAM value vMSRTQRQ" UBYTE COMP_0497_S 1 100 -100 410 ECU_ADDRESS 0xFFFF37BD READ_WRITE /end MEASUREMENT
/begin MEASUREMENT vMSTRACE "RAM value vMSTRACE" UBYTE COMP_0245 1 100 -64 191 ECU_ADDRESS 0xFFFF097D READ_WRITE /end MEASUREMENT
/begin MEASUREMENT vMSTRACEE "RAM value vMSTRACEE" UBYTE COMP_0245 1 100 -64 191 ECU_ADDRESS 0xFFFF0D2C READ_WRITE /end MEASUREMENT
/begin MEASUREMENT vMSTRACEW "RAM value vMSTRACEW" UBYTE COMP_0245 1 100 -64 191 ECU_ADDRESS 0xFFFF0D2D READ_WRITE /end MEASUREMENT
/begin MEASUREMENT vMSTRG "RAM value vMSTRG" UBYTE COMP_0062_S 1 100 0 255 ECU_ADDRESS 0xFFFF29C3 READ_WRITE /end MEASUREMENT
/begin MEASUREMENT vMTCURGP "RAM value vMTCURGP" UBYTE COMP_0068 1 100 0 255 ECU_ADDRESS 0xFFFF0D2E READ_WRITE /end MEASUREMENT
/begin MEASUREMENT vMTICHFUL "RAM value vMTICHFUL" UBYTE COMP_0009 1 100 0 199.21875 ECU_ADDRESS 0xFFFF29C5 READ_WRITE /end MEASUREMENT
/begin MEASUREMENT vMTINAFUL "RAM value vMTINAFUL" UBYTE COMP_0009 1 100 0 199.21875 ECU_ADDRESS 0xFFFF29C6 READ_WRITE /end MEASUREMENT
/begin MEASUREMENT vMTISTH "RAM value vMTISTH" UWORD COMP_0474 1 100 0 6246940377 ECU_ADDRESS 0xFFFF0D30 READ_WRITE /end MEASUREMENT
/begin MEASUREMENT vMTKAS "RAM value vMTKAS" UBYTE COMP_0186 1 100 0 3.984375 ECU_ADDRESS 0xFFFF0D38 READ_WRITE /end MEASUREMENT
/begin MEASUREMENT vMTKASST "RAM value vMTKASST" UBYTE COMP_0186 1 100 0 3.984375 ECU_ADDRESS 0xFFFF0D39 READ_WRITE /end MEASUREMENT
/begin MEASUREMENT vMTMPCAT "RAM value vMTMPCAT" UBYTE COMP_0062 1 100 0 1020 ECU_ADDRESS 0xFFFF29C7 READ_WRITE /end MEASUREMENT
/begin MEASUREMENT vMTPIDL "RAM value vMTPIDL" UBYTE COMP_0001 1 100 0 31.875 ECU_ADDRESS 0xFFFF4E4E READ_WRITE /end MEASUREMENT
/begin MEASUREMENT vMTPIDLW "RAM value vMTPIDLW" UWORD COMP_0144 1 100 0 31.999495335 ECU_ADDRESS 0xFFFF4E50 READ_WRITE /end MEASUREMENT
/begin MEASUREMENT vMTTE "RAM value vMTTE" UWORD COMP_0226 1 100 -3276.8 3276.7 ECU_ADDRESS 0xFFFF0D3A READ_WRITE /end MEASUREMENT
/begin MEASUREMENT vMVSLOPE "RAM value vMVSLOPE" UWORD COMP_0428_S 1 100 -327.68 327.67 ECU_ADDRESS 0xFFFF206C READ_WRITE /end MEASUREMENT
/begin MEASUREMENT vMVSLOP_5 "RAM value vMVSLOP_5" UWORD COMP_0428_S 1 100 -327.68 327.67 ECU_ADDRESS 0xFFFF37BE READ_WRITE /end MEASUREMENT
/begin MEASUREMENT vMXAVT5TH "RAM value vMXAVT5TH" SWORD COMP_0228 1 100 -3276.8 3276.7 ECU_ADDRESS 0xFFFF29C8 READ_WRITE /end MEASUREMENT
/begin MEASUREMENT vMXPR "RAM value vMXPR" UWORD COMP_0523_S 1 100 0 64.001481 ECU_ADDRESS 0xFFFF29CA READ_WRITE /end MEASUREMENT
/begin MEASUREMENT vNACMAX "RAM value vNACMAX" UBYTE COMP_0006 1 100 0 3187.5 ECU_ADDRESS 0xFFFF0D41 READ_WRITE /end MEASUREMENT
/begin MEASUREMENT vNACSTS "RAM value vNACSTS" UBYTE COMP_0068 1 100 0 255 ECU_ADDRESS 0xFFFF0D42 READ_WRITE /end MEASUREMENT
/begin MEASUREMENT vNACUP "RAM value vNACUP" UBYTE COMP_0006 1 100 0 3187.5 ECU_ADDRESS 0xFFFF0D43 READ_WRITE /end MEASUREMENT
/begin MEASUREMENT vNADDQFBI "RAM value vNADDQFBI" UWORD COMP_0030 1 100 0 65535 ECU_ADDRESS 0xFFFF0D44 READ_WRITE /end MEASUREMENT
/begin MEASUREMENT vNBASE "RAM value vNBASE" UBYTE COMP_0006 1 100 0 3187.5 ECU_ADDRESS 0xFFFF0D46 READ_WRITE /end MEASUREMENT
/begin MEASUREMENT vNCAMIN "RAM value vNCAMIN" ULONG COMP_0189 1 100 0 13743895344 ECU_ADDRESS 0xFFFF1938 READ_WRITE /end MEASUREMENT
/begin MEASUREMENT vNDCTMR "RAM value vNDCTMR" UBYTE COMP_0202 1 100 0 2550 ECU_ADDRESS 0xFFFF0D47 READ_WRITE /end MEASUREMENT
/begin MEASUREMENT vNDWLL "RAM value vNDWLL" UBYTE COMP_0017 1 100 0 255 ECU_ADDRESS 0xFFFF193C READ_WRITE /end MEASUREMENT
/begin MEASUREMENT vNE "RAM value vNE" UWORD COMP_0065 1 100 0 204796.875 ECU_ADDRESS 0xFFFF095E READ_WRITE /end MEASUREMENT
/begin MEASUREMENT vNEALT "RAM value vNEALT" UBYTE COMP_0006 1 100 0 3187.5 ECU_ADDRESS 0xFFFF0D48 READ_WRITE /end MEASUREMENT
/begin MEASUREMENT vNEDCNT "RAM value vNEDCNT" UBYTE COMP_0068 1 100 0 255 ECU_ADDRESS 0xFFFF0D49 READ_WRITE /end MEASUREMENT
/begin MEASUREMENT vNEIDLE "RAM value vNEIDLE" UWORD COMP_0065 1 100 0 204796.875 ECU_ADDRESS 0xFFFF0D4A READ_WRITE /end MEASUREMENT
/begin MEASUREMENT vNEJIRITM "RAM value vNEJIRITM" UBYTE COMP_0014 1 100 0 2550 ECU_ADDRESS 0xFFFF0D4C READ_WRITE /end MEASUREMENT
/begin MEASUREMENT vNENRATIO "RAM value vNENRATIO" UWORD COMP_0450 1 100 0 63.999056205 ECU_ADDRESS 0xFFFF3310 READ_WRITE /end MEASUREMENT
/begin MEASUREMENT vNEREF0 "RAM value vNEREF0" UWORD COMP_0476 1 100 0 12799.8046875 ECU_ADDRESS 0xFFFF090E READ_WRITE /end MEASUREMENT
/begin MEASUREMENT vNEREF01 "RAM value vNEREF01" UWORD COMP_0476 1 100 0 12799.8046875 ECU_ADDRESS 0xFFFF193E READ_WRITE /end MEASUREMENT
/begin MEASUREMENT vNEREF125 "RAM value vNEREF125" UWORD COMP_0006 1 100 0 819187.5 ECU_ADDRESS 0xFFFF0960 READ_WRITE /end MEASUREMENT
/begin MEASUREMENT vNETARGET "RAM value vNETARGET" UWORD COMP_0476 1 100 0 12799.8046875 ECU_ADDRESS 0xFFFF0962 READ_WRITE /end MEASUREMENT
/begin MEASUREMENT vNETARGETZ "RAM value vNETARGETZ" UWORD COMP_0476 1 100 0 12799.8046875 ECU_ADDRESS 0xFFFF1940 READ_WRITE /end MEASUREMENT
/begin MEASUREMENT vNETBAI "RAM value vNETBAI" UBYTE COMP_0063 1 100 0 0.99609375 ECU_ADDRESS 0xFFFF1942 READ_WRITE /end MEASUREMENT
/begin MEASUREMENT vNETPLUS "RAM value vNETPLUS" UWORD COMP_0530_S 1 100 0 3199.951171875 ECU_ADDRESS 0xFFFF1944 READ_WRITE /end MEASUREMENT
/begin MEASUREMENT vNEUTCNT "RAM value vNEUTCNT" UWORD COMP_0049 1 100 0 65535 ECU_ADDRESS 0xFFFF4C06 READ_WRITE /end MEASUREMENT
/begin MEASUREMENT vNEUTMAX "RAM value vNEUTMAX" UWORD COMP_0049 1 100 0 65535 ECU_ADDRESS 0xFFFF4C08 READ_WRITE /end MEASUREMENT
/begin MEASUREMENT vNEXTCYL "RAM value vNEXTCYL" UBYTE COMP_0068 1 100 0 255 ECU_ADDRESS 0xFFFF3312 READ_WRITE /end MEASUREMENT
/begin MEASUREMENT vNEXTGP "RAM value vNEXTGP" UBYTE COMP_0068 1 100 0 255 ECU_ADDRESS 0xFFFF085F READ_WRITE /end MEASUREMENT
/begin MEASUREMENT vNEXTGP0 "RAM value vNEXTGP0" UBYTE COMP_0068 1 100 0 255 ECU_ADDRESS 0xFFFF1E55 READ_WRITE /end MEASUREMENT
/begin MEASUREMENT vNEXTPDL "RAM value vNEXTPDL" UWORD COMP_0032_S 1 100 0 8191.875 ECU_ADDRESS 0xFFFF29CC READ_WRITE /end MEASUREMENT
/begin MEASUREMENT vNEXTREV "RAM value vNEXTREV" UWORD COMP_0443 1 100 0 65535 ECU_ADDRESS 0xFFFF0D4E READ_WRITE /end MEASUREMENT
/begin MEASUREMENT vNEZ1 "RAM value vNEZ1" UWORD COMP_0065 1 100 0 204796.875 ECU_ADDRESS 0xFFFF0D50 READ_WRITE /end MEASUREMENT
/begin MEASUREMENT vNEZ10 "RAM value vNEZ10" UWORD COMP_0065 1 100 0 204796.875 ECU_ADDRESS 0xFFFF0D52 READ_WRITE /end MEASUREMENT
/begin MEASUREMENT vNEZ2 "RAM value vNEZ2" UWORD COMP_0065 1 100 0 204796.875 ECU_ADDRESS 0xFFFF0D54 READ_WRITE /end MEASUREMENT
/begin MEASUREMENT vNEZ20 "RAM value vNEZ20" UWORD COMP_0065 1 100 0 204796.875 ECU_ADDRESS 0xFFFF0D56 READ_WRITE /end MEASUREMENT
/begin MEASUREMENT vNEZ3 "RAM value vNEZ3" UWORD COMP_0065 1 100 0 204796.875 ECU_ADDRESS 0xFFFF0D58 READ_WRITE /end MEASUREMENT
/begin MEASUREMENT vNEZ30 "RAM value vNEZ30" UWORD COMP_0065 1 100 0 204796.875 ECU_ADDRESS 0xFFFF0D5A READ_WRITE /end MEASUREMENT
/begin MEASUREMENT vNEZ4 "RAM value vNEZ4" UWORD COMP_0065 1 100 0 204796.875 ECU_ADDRESS 0xFFFF0D5C READ_WRITE /end MEASUREMENT
/begin MEASUREMENT vNEZ40 "RAM value vNEZ40" UWORD COMP_0065 1 100 0 204796.875 ECU_ADDRESS 0xFFFF0D5E READ_WRITE /end MEASUREMENT
/begin MEASUREMENT vNE_S "RAM value vNE_S" UWORD COMP_0065 1 100 0 204796.875 ECU_ADDRESS 0xFFFF0972 READ_WRITE /end MEASUREMENT
/begin MEASUREMENT vNFCUT "RAM value vNFCUT" UBYTE COMP_0584_S 1 100 0 255 ECU_ADDRESS 0xFFFF0D60 READ_WRITE /end MEASUREMENT
/begin MEASUREMENT vNFCUTAT "RAM value vNFCUTAT" UBYTE COMP_0584_S 1 100 0 255 ECU_ADDRESS 0xFFFF0D61 READ_WRITE /end MEASUREMENT
/begin MEASUREMENT vNGBUW "RAM value vNGBUW" UBYTE COMP_0004 1 100 0 255 ECU_ADDRESS 0xFFFF4C0A READ_WRITE /end MEASUREMENT
/begin MEASUREMENT vNGCNT1 "RAM value vNGCNT1" UWORD COMP_0016 1 100 0 65535 ECU_ADDRESS 0xFFFF4C0C READ_WRITE /end MEASUREMENT
/begin MEASUREMENT vNGCNT2 "RAM value vNGCNT2" UWORD COMP_0016 1 100 0 65535 ECU_ADDRESS 0xFFFF4C0E READ_WRITE /end MEASUREMENT
/begin MEASUREMENT vNGCNT3 "RAM value vNGCNT3" UWORD COMP_0016 1 100 0 65535 ECU_ADDRESS 0xFFFF4C10 READ_WRITE /end MEASUREMENT
/begin MEASUREMENT vNGCNT4 "RAM value vNGCNT4" UWORD COMP_0016 1 100 0 65535 ECU_ADDRESS 0xFFFF4C12 READ_WRITE /end MEASUREMENT
/begin MEASUREMENT vNGCNT5 "RAM value vNGCNT5" UWORD COMP_0016 1 100 0 65535 ECU_ADDRESS 0xFFFF4C14 READ_WRITE /end MEASUREMENT
/begin MEASUREMENT vNGCNT6 "RAM value vNGCNT6" UWORD COMP_0016 1 100 0 65535 ECU_ADDRESS 0xFFFF4C16 READ_WRITE /end MEASUREMENT
/begin MEASUREMENT vNGDMAX "RAM value vNGDMAX" SWORD COMP_0072_S 1 100 -131.072 131.068 ECU_ADDRESS 0xFFFF4C18 READ_WRITE /end MEASUREMENT
/begin MEASUREMENT vNGDMIN "RAM value vNGDMIN" SWORD COMP_0072_S 1 100 -131.072 131.068 ECU_ADDRESS 0xFFFF4C1A READ_WRITE /end MEASUREMENT
/begin MEASUREMENT vNGDPS11B "RAM value vNGDPS11B" SWORD COMP_0002_S 1 100 -32768 32767 ECU_ADDRESS 0xFFFF4C1C READ_WRITE /end MEASUREMENT
/begin MEASUREMENT vNGDPS12B "RAM value vNGDPS12B" SWORD COMP_0002_S 1 100 -32768 32767 ECU_ADDRESS 0xFFFF4C1E READ_WRITE /end MEASUREMENT
/begin MEASUREMENT vNGDPS21B "RAM value vNGDPS21B" SWORD COMP_0002_S 1 100 -32768 32767 ECU_ADDRESS 0xFFFF4C20 READ_WRITE /end MEASUREMENT
/begin MEASUREMENT vNGDPS22B "RAM value vNGDPS22B" SWORD COMP_0002_S 1 100 -32768 32767 ECU_ADDRESS 0xFFFF4C22 READ_WRITE /end MEASUREMENT
/begin MEASUREMENT vNGEVPRS "RAM value vNGEVPRS" UWORD COMP_0039_S 1 100 60000 125535 ECU_ADDRESS 0xFFFF37CA READ_WRITE /end MEASUREMENT
/begin MEASUREMENT vNGFGE1 "RAM value vNGFGE1" UWORD COMP_0050 1 100 0 5119.921875 ECU_ADDRESS 0xFFFF4C24 READ_WRITE /end MEASUREMENT
/begin MEASUREMENT vNGFGE2 "RAM value vNGFGE2" UWORD COMP_0050 1 100 0 5119.921875 ECU_ADDRESS 0xFFFF4C26 READ_WRITE /end MEASUREMENT
/begin MEASUREMENT vNGFGTP1 "RAM value vNGFGTP1" UWORD COMP_0050 1 100 0 5119.921875 ECU_ADDRESS 0xFFFF4C28 READ_WRITE /end MEASUREMENT
/begin MEASUREMENT vNGFGTP2 "RAM value vNGFGTP2" UWORD COMP_0050 1 100 0 5119.921875 ECU_ADDRESS 0xFFFF4C2A READ_WRITE /end MEASUREMENT
/begin MEASUREMENT vNGHZNTP "RAM value vNGHZNTP" UWORD COMP_0565_S 1 100 0 12799.8046875 ECU_ADDRESS 0xFFFF4C2C READ_WRITE /end MEASUREMENT
/begin MEASUREMENT vNGMEMW "RAM value vNGMEMW" UBYTE COMP_0004 1 100 0 255 ECU_ADDRESS 0xFFFF4C2E READ_WRITE /end MEASUREMENT
/begin MEASUREMENT vNGOKf "RAM value vNGOKf" UBYTE COMP_0004 1 100 0 255 ECU_ADDRESS 0xFFFF29CE READ_WRITE /end MEASUREMENT
/begin MEASUREMENT vNGSLMX "RAM value vNGSLMX" UBYTE COMP_0016 1 100 0 255 ECU_ADDRESS 0xFFFF4C2F READ_WRITE /end MEASUREMENT
/begin MEASUREMENT vNGSLSH "RAM value vNGSLSH" UBYTE COMP_0016 1 100 0 255 ECU_ADDRESS 0xFFFF29CF READ_WRITE /end MEASUREMENT
/begin MEASUREMENT vNGTFA1 "RAM value vNGTFA1" UBYTE COMP_0035 1 100 -50 205 ECU_ADDRESS 0xFFFF4C30 READ_WRITE /end MEASUREMENT
/begin MEASUREMENT vNGTFA2 "RAM value vNGTFA2" UBYTE COMP_0035 1 100 -50 205 ECU_ADDRESS 0xFFFF4C31 READ_WRITE /end MEASUREMENT
/begin MEASUREMENT vNGVSP1 "RAM value vNGVSP1" UBYTE COMP_0007 1 100 0 510 ECU_ADDRESS 0xFFFF4C32 READ_WRITE /end MEASUREMENT
/begin MEASUREMENT vNGVSP2 "RAM value vNGVSP2" UBYTE COMP_0007 1 100 0 510 ECU_ADDRESS 0xFFFF4C33 READ_WRITE /end MEASUREMENT
/begin MEASUREMENT vNGWLPR1 "RAM value vNGWLPR1" UWORD COMP_0039_S 1 100 60000 125535 ECU_ADDRESS 0xFFFF4C34 READ_WRITE /end MEASUREMENT
/begin MEASUREMENT vNGWLPR2 "RAM value vNGWLPR2" UWORD COMP_0039_S 1 100 60000 125535 ECU_ADDRESS 0xFFFF4C36 READ_WRITE /end MEASUREMENT
/begin MEASUREMENT vNIDLADV "RAM value vNIDLADV" UBYTE COMP_0017 1 100 0 255 ECU_ADDRESS 0xFFFF0D62 READ_WRITE /end MEASUREMENT
/begin MEASUREMENT vNIEMNE "RAM value vNIEMNE" UBYTE COMP_0006 1 100 0 3187.5 ECU_ADDRESS 0xFFFF0D63 READ_WRITE /end MEASUREMENT
/begin MEASUREMENT vNINPAT "RAM value vNINPAT" UWORD COMP_0065 1 100 0 204796.875 ECU_ADDRESS 0xFFFF29D0 READ_WRITE /end MEASUREMENT
/begin MEASUREMENT vNISCBC "RAM value vNISCBC" UBYTE COMP_0006 1 100 0 3187.5 ECU_ADDRESS 0xFFFF0D64 READ_WRITE /end MEASUREMENT
/begin MEASUREMENT vNKANBAKU "RAM value vNKANBAKU" UBYTE COMP_0006 1 100 0 3187.5 ECU_ADDRESS 0xFFFF1649 READ_WRITE /end MEASUREMENT
/begin MEASUREMENT vNLCNT "RAM value vNLCNT" UWORD COMP_0016 1 100 0 65535 ECU_ADDRESS 0xFFFF0D66 READ_WRITE /end MEASUREMENT
/begin MEASUREMENT vNMV "RAM value vNMV" UWORD COMP_0479 1 100 0 20479687.5 ECU_ADDRESS 0xFFFF164A READ_WRITE /end MEASUREMENT
/begin MEASUREMENT vNR "RAM value vNR" UBYTE COMP_0000 1 100 0 6375 ECU_ADDRESS 0xFFFF0D68 READ_WRITE /end MEASUREMENT
/begin MEASUREMENT vNRMVCT "RAM value vNRMVCT" UWORD COMP_0030 1 100 0 65535 ECU_ADDRESS 0xFFFF29D2 READ_WRITE /end MEASUREMENT
/begin MEASUREMENT vNRPM "RAM value vNRPM" UWORD COMP_0006 1 100 0 819187.5 ECU_ADDRESS 0xFFFF0964 READ_WRITE /end MEASUREMENT
/begin MEASUREMENT vNRPM100 "RAM value vNRPM100" UWORD COMP_0006 1 100 0 819187.5 ECU_ADDRESS 0xFFFF29D4 READ_WRITE /end MEASUREMENT
/begin MEASUREMENT vNRPM1000 "RAM value vNRPM1000" UWORD COMP_0006 1 100 0 819187.5 ECU_ADDRESS 0xFFFF37CC READ_WRITE /end MEASUREMENT
/begin MEASUREMENT vNRPM2 "RAM value vNRPM2" UWORD COMP_0480 1 100 0 409593.75 ECU_ADDRESS 0xFFFF1946 READ_WRITE /end MEASUREMENT
/begin MEASUREMENT vNRPMAVE "RAM value vNRPMAVE" UWORD COMP_0006 1 100 0 819187.5 ECU_ADDRESS 0xFFFF4C38 READ_WRITE /end MEASUREMENT
/begin MEASUREMENT vNRPMEND "RAM value vNRPMEND" UWORD COMP_0006 1 100 0 819187.5 ECU_ADDRESS 0xFFFF4C3A READ_WRITE /end MEASUREMENT
/begin MEASUREMENT vNRPMMAX "RAM value vNRPMMAX" UWORD COMP_0006 1 100 0 819187.5 ECU_ADDRESS 0xFFFF4C3C READ_WRITE /end MEASUREMENT
/begin MEASUREMENT vNRPMMIN "RAM value vNRPMMIN" UWORD COMP_0006 1 100 0 819187.5 ECU_ADDRESS 0xFFFF4C3E READ_WRITE /end MEASUREMENT
/begin MEASUREMENT vNRPMz1 "RAM value vNRPMz1" UWORD COMP_0006 1 100 0 819187.5 ECU_ADDRESS 0xFFFF1948 READ_WRITE /end MEASUREMENT
/begin MEASUREMENT vNRPMz2 "RAM value vNRPMz2" UWORD COMP_0006 1 100 0 819187.5 ECU_ADDRESS 0xFFFF194A READ_WRITE /end MEASUREMENT
/begin MEASUREMENT vNRPMz3 "RAM value vNRPMz3" UWORD COMP_0006 1 100 0 819187.5 ECU_ADDRESS 0xFFFF194C READ_WRITE /end MEASUREMENT
/begin MEASUREMENT vNRPMz4 "RAM value vNRPMz4" UWORD COMP_0006 1 100 0 819187.5 ECU_ADDRESS 0xFFFF194E READ_WRITE /end MEASUREMENT
/begin MEASUREMENT vNRPMz5 "RAM value vNRPMz5" UWORD COMP_0006 1 100 0 819187.5 ECU_ADDRESS 0xFFFF0966 READ_WRITE /end MEASUREMENT
/begin MEASUREMENT vNRPSUML "RAM value vNRPSUML" ULONG COMP_0006 1 100 0 53687091187.5 ECU_ADDRESS 0xFFFF29D8 READ_WRITE /end MEASUREMENT
/begin MEASUREMENT vNRPSUMR "RAM value vNRPSUMR" ULONG COMP_0006 1 100 0 53687091187.5 ECU_ADDRESS 0xFFFF29E0 READ_WRITE /end MEASUREMENT
/begin MEASUREMENT vNSET00D "RAM value vNSET00D" UBYTE COMP_0006 1 100 0 3187.5 ECU_ADDRESS 0xFFFF0D69 READ_WRITE /end MEASUREMENT
/begin MEASUREMENT vNSET00N "RAM value vNSET00N" UBYTE COMP_0006 1 100 0 3187.5 ECU_ADDRESS 0xFFFF0D6A READ_WRITE /end MEASUREMENT
/begin MEASUREMENT vNSET0QZ "RAM value vNSET0QZ" UBYTE COMP_0006 1 100 0 3187.5 ECU_ADDRESS 0xFFFF1950 READ_WRITE /end MEASUREMENT
/begin MEASUREMENT vNSET3 "RAM value vNSET3" UBYTE COMP_0009 1 100 0 199.21875 ECU_ADDRESS 0xFFFF0D6B READ_WRITE /end MEASUREMENT
/begin MEASUREMENT vNSET4 "RAM value vNSET4" UBYTE COMP_0006 1 100 0 3187.5 ECU_ADDRESS 0xFFFF5222 READ_WRITE /end MEASUREMENT
/begin MEASUREMENT vNSETAC "RAM value vNSETAC" UBYTE COMP_0006 1 100 0 3187.5 ECU_ADDRESS 0xFFFF0D6C READ_WRITE /end MEASUREMENT
/begin MEASUREMENT vNSETB "RAM value vNSETB" UBYTE COMP_0006 1 100 0 3187.5 ECU_ADDRESS 0xFFFF0D6D READ_WRITE /end MEASUREMENT
/begin MEASUREMENT vNSETCK "RAM value vNSETCK" UBYTE COMP_0006 1 100 0 3187.5 ECU_ADDRESS 0xFFFF0D6E READ_WRITE /end MEASUREMENT
/begin MEASUREMENT vNSETDDL "RAM value vNSETDDL" UBYTE COMP_0006 1 100 0 3187.5 ECU_ADDRESS 0xFFFF29E8 READ_WRITE /end MEASUREMENT
/begin MEASUREMENT vNSETDT "RAM value vNSETDT" UBYTE COMP_0006 1 100 0 3187.5 ECU_ADDRESS 0xFFFF0D6F READ_WRITE /end MEASUREMENT
/begin MEASUREMENT vNSETINJH "RAM value vNSETINJH" UBYTE COMP_0006 1 100 0 3187.5 ECU_ADDRESS 0xFFFF29E9 READ_WRITE /end MEASUREMENT
/begin MEASUREMENT vNSETPIG0 "RAM value vNSETPIG0" UBYTE COMP_0006 1 100 0 3187.5 ECU_ADDRESS 0xFFFF0D70 READ_WRITE /end MEASUREMENT
/begin MEASUREMENT vNSETTBL "RAM value vNSETTBL" UBYTE COMP_0006 1 100 0 3187.5 ECU_ADDRESS 0xFFFF0D71 READ_WRITE /end MEASUREMENT
/begin MEASUREMENT vNSETVB "RAM value vNSETVB" UBYTE COMP_0006 1 100 0 3187.5 ECU_ADDRESS 0xFFFF29EA READ_WRITE /end MEASUREMENT
/begin MEASUREMENT vNSLPRT "RAM value vNSLPRT" UWORD COMP_0585_S 1 100 0 1.06664766 ECU_ADDRESS 0xFFFF0D72 READ_WRITE /end MEASUREMENT
/begin MEASUREMENT vNSLPRT_S "RAM value vNSLPRT_S" UWORD COMP_0585_S 1 100 0 1.06664766 ECU_ADDRESS 0xFFFF14B0 READ_WRITE /end MEASUREMENT
/begin MEASUREMENT vNSTEPN "RAM value vNSTEPN" UBYTE COMP_0006 1 100 0 3187.5 ECU_ADDRESS 0xFFFF29EB READ_WRITE /end MEASUREMENT
/begin MEASUREMENT vNSTTBLCK "RAM value vNSTTBLCK" UBYTE COMP_0006 1 100 0 3187.5 ECU_ADDRESS 0xFFFF0D74 READ_WRITE /end MEASUREMENT
/begin MEASUREMENT vNSTTBLD "RAM value vNSTTBLD" UBYTE COMP_0006 1 100 0 3187.5 ECU_ADDRESS 0xFFFF0D75 READ_WRITE /end MEASUREMENT
/begin MEASUREMENT vNTDGCNT "RAM value vNTDGCNT" UWORD COMP_0016 1 100 0 65535 ECU_ADDRESS 0xFFFF4C40 READ_WRITE /end MEASUREMENT
/begin MEASUREMENT vNTPCANf "RAM value vNTPCANf" UBYTE COMP_0004 1 100 0 255 ECU_ADDRESS 0xFFFF29EC READ_WRITE /end MEASUREMENT
/begin MEASUREMENT vNTPLMAX "RAM value vNTPLMAX" UWORD COMP_0565_S 1 100 0 12799.8046875 ECU_ADDRESS 0xFFFF29EE READ_WRITE /end MEASUREMENT
/begin MEASUREMENT vNTPMAX "RAM value vNTPMAX" UWORD COMP_0565_S 1 100 0 12799.8046875 ECU_ADDRESS 0xFFFF29F0 READ_WRITE /end MEASUREMENT
/begin MEASUREMENT vNTPMIN "RAM value vNTPMIN" UWORD COMP_0565_S 1 100 0 12799.8046875 ECU_ADDRESS 0xFFFF29F2 READ_WRITE /end MEASUREMENT
/begin MEASUREMENT vNTPST "RAM value vNTPST" UWORD COMP_0565_S 1 100 0 12799.8046875 ECU_ADDRESS 0xFFFF29F4 READ_WRITE /end MEASUREMENT
/begin MEASUREMENT vNTPSTf "RAM value vNTPSTf" UBYTE COMP_0004 1 100 0 255 ECU_ADDRESS 0xFFFF29F6 READ_WRITE /end MEASUREMENT
/begin MEASUREMENT vNUMSTG "RAM value vNUMSTG" UBYTE COMP_0016 1 100 0 255 ECU_ADDRESS 0xFFFF29F7 READ_WRITE /end MEASUREMENT
/begin MEASUREMENT vNUMSTGV "RAM value vNUMSTGV" UBYTE COMP_0016 1 100 0 255 ECU_ADDRESS 0xFFFF29F9 READ_WRITE /end MEASUREMENT
/begin MEASUREMENT vNVOLTM "RAM value vNVOLTM" UWORD COMP_0014 1 100 0 655350 ECU_ADDRESS 0xFFFF37CE READ_WRITE /end MEASUREMENT
/begin MEASUREMENT vNWTONI "RAM value vNWTONI" SWORD COMP_0277 1 100 -32768 32767 ECU_ADDRESS 0xFFFF29FC READ_WRITE /end MEASUREMENT
/begin MEASUREMENT vN_ID0 "RAM value vN_ID0" SBYTE COMP_0264 1 100 -128 127 ECU_ADDRESS 0xFFFF0D3C READ_WRITE /end MEASUREMENT
/begin MEASUREMENT vN_ID1 "RAM value vN_ID1" SBYTE COMP_0264 1 100 -128 127 ECU_ADDRESS 0xFFFF0D3D READ_WRITE /end MEASUREMENT
/begin MEASUREMENT vN_IN0 "RAM value vN_IN0" SBYTE COMP_0264 1 100 -128 127 ECU_ADDRESS 0xFFFF0D3E READ_WRITE /end MEASUREMENT
/begin MEASUREMENT vN_IN1 "RAM value vN_IN1" SBYTE COMP_0264 1 100 -128 127 ECU_ADDRESS 0xFFFF0D3F READ_WRITE /end MEASUREMENT
/begin MEASUREMENT vN_IN2 "RAM value vN_IN2" SBYTE COMP_0264 1 100 -128 127 ECU_ADDRESS 0xFFFF0D40 READ_WRITE /end MEASUREMENT
/begin MEASUREMENT vO2CNT "RAM value vO2CNT" UBYTE COMP_0030 1 100 0 255 ECU_ADDRESS 0xFFFF0D76 READ_WRITE /end MEASUREMENT
/begin MEASUREMENT vO2DTYINI "RAM value vO2DTYINI" UBYTE COMP_0200_S 1 100 0 2550 ECU_ADDRESS 0xFFFF0D77 READ_WRITE /end MEASUREMENT
/begin MEASUREMENT vO2HCHKf "RAM value vO2HCHKf" UBYTE COMP_0004 1 100 0 255 ECU_ADDRESS 0xFFFF37D0 READ_WRITE /end MEASUREMENT
/begin MEASUREMENT vO2HCR0 "RAM value vO2HCR0" UBYTE COMP_0022 1 100 0 5100 ECU_ADDRESS 0xFFFF37D1 READ_WRITE /end MEASUREMENT
/begin MEASUREMENT vO2HCR1 "RAM value vO2HCR1" UBYTE COMP_0022 1 100 0 5100 ECU_ADDRESS 0xFFFF37D2 READ_WRITE /end MEASUREMENT
/begin MEASUREMENT vO2HCR2 "RAM value vO2HCR2" UBYTE COMP_0022 1 100 0 5100 ECU_ADDRESS 0xFFFF37D3 READ_WRITE /end MEASUREMENT
/begin MEASUREMENT vO2HCR3 "RAM value vO2HCR3" UBYTE COMP_0022 1 100 0 5100 ECU_ADDRESS 0xFFFF37D4 READ_WRITE /end MEASUREMENT
/begin MEASUREMENT vO2HCUR "RAM value vO2HCUR" UBYTE COMP_0054 1 100 0 5100 ECU_ADDRESS 0xFFFF206E READ_WRITE /end MEASUREMENT
/begin MEASUREMENT vO2HCURA "RAM value vO2HCURA" UBYTE COMP_0022 1 100 0 5100 ECU_ADDRESS 0xFFFF37D5 READ_WRITE /end MEASUREMENT
/begin MEASUREMENT vO2HDCNT "RAM value vO2HDCNT" UBYTE COMP_0030 1 100 0 255 ECU_ADDRESS 0xFFFF0D78 READ_WRITE /end MEASUREMENT
/begin MEASUREMENT vO2HDTY "RAM value vO2HDTY" UWORD COMP_0187_S 1 100 0 2559.9609375 ECU_ADDRESS 0xFFFF0D7A READ_WRITE /end MEASUREMENT
/begin MEASUREMENT vO2HDTYMON "RAM value vO2HDTYMON" UBYTE COMP_0200_S 1 100 0 2550 ECU_ADDRESS 0xFFFF0D7C READ_WRITE /end MEASUREMENT
/begin MEASUREMENT vO2HIRLf "RAM value vO2HIRLf" UBYTE COMP_0004 1 100 0 255 ECU_ADDRESS 0xFFFF29FE READ_WRITE /end MEASUREMENT
/begin MEASUREMENT vO2SPL "RAM value vO2SPL" UBYTE COMP_0163 1 100 0 15.9375 ECU_ADDRESS 0xFFFF37D6 READ_WRITE /end MEASUREMENT
/begin MEASUREMENT vO2SPR "RAM value vO2SPR" UBYTE COMP_0163 1 100 0 15.9375 ECU_ADDRESS 0xFFFF37D7 READ_WRITE /end MEASUREMENT
/begin MEASUREMENT vO2TMRCNT1 "RAM value vO2TMRCNT1" UBYTE COMP_0030 1 100 0 255 ECU_ADDRESS 0xFFFF29FF READ_WRITE /end MEASUREMENT
/begin MEASUREMENT vO2VBHOS "RAM value vO2VBHOS" UBYTE COMP_0009 1 100 0 199.21875 ECU_ADDRESS 0xFFFF0D7D READ_WRITE /end MEASUREMENT
/begin MEASUREMENT vOBCDCV "RAM value vOBCDCV" UBYTE COMP_0014 1 100 0 2550 ECU_ADDRESS 0xFFFF37D8 READ_WRITE /end MEASUREMENT
/begin MEASUREMENT vOBDCNT "RAM value vOBDCNT" UWORD COMP_0030 1 100 0 65535 ECU_ADDRESS 0xFFFF37DA READ_WRITE /end MEASUREMENT
/begin MEASUREMENT vOBDEG "RAM value vOBDEG" SWORD COMP_0586_S 1 100 -101.00146176 100.99837944 ECU_ADDRESS 0xFFFF31F0 READ_WRITE /end MEASUREMENT
/begin MEASUREMENT vOERROR "RAM value vOERROR" UBYTE COMP_0256 1 100 -64 63.5 ECU_ADDRESS 0xFFFF0D7E READ_WRITE /end MEASUREMENT
/begin MEASUREMENT vOERRORE "RAM value vOERRORE" UBYTE COMP_0256 1 100 -64 63.5 ECU_ADDRESS 0xFFFF0D80 READ_WRITE /end MEASUREMENT
/begin MEASUREMENT vOFABSAD "RAM value vOFABSAD" SWORD COMP_0078 1 100 -128 127.99609375 ECU_ADDRESS 0xFFFF1952 READ_WRITE /end MEASUREMENT
/begin MEASUREMENT vOFABSADA "RAM value vOFABSADA" SWORD COMP_0078 1 100 -128 127.99609375 ECU_ADDRESS 0xFFFF1954 READ_WRITE /end MEASUREMENT
/begin MEASUREMENT vOFF5 "RAM value vOFF5" UBYTE COMP_0068 1 100 0 255 ECU_ADDRESS 0xFFFF206F READ_WRITE /end MEASUREMENT
/begin MEASUREMENT vOFFADV "RAM value vOFFADV" SWORD COMP_0078 1 100 -128 127.99609375 ECU_ADDRESS 0xFFFF1956 READ_WRITE /end MEASUREMENT
/begin MEASUREMENT vOFFADVAT "RAM value vOFFADVAT" SWORD COMP_0078 1 100 -128 127.99609375 ECU_ADDRESS 0xFFFF1958 READ_WRITE /end MEASUREMENT
/begin MEASUREMENT vOFMILE "RAM value vOFMILE" ULONG COMP_0385 1 100 0 6906307410.36 ECU_ADDRESS 0xFFFF4408 READ_WRITE /end MEASUREMENT
/begin MEASUREMENT vOFRELAD "RAM value vOFRELAD" SWORD COMP_0078 1 100 -128 127.99609375 ECU_ADDRESS 0xFFFF195A READ_WRITE /end MEASUREMENT
/begin MEASUREMENT vOILJDG1 "RAM value vOILJDG1" UWORD COMP_0013 1 100 0 65535 ECU_ADDRESS 0xFFFF2A00 READ_WRITE /end MEASUREMENT
/begin MEASUREMENT vOILJDG4 "RAM value vOILJDG4" UWORD COMP_0013 1 100 0 65535 ECU_ADDRESS 0xFFFF2A02 READ_WRITE /end MEASUREMENT
/begin MEASUREMENT vOILJDG5 "RAM value vOILJDG5" UWORD COMP_0013 1 100 0 65535 ECU_ADDRESS 0xFFFF2A04 READ_WRITE /end MEASUREMENT
/begin MEASUREMENT vOKCNT1 "RAM value vOKCNT1" UWORD COMP_0016 1 100 0 65535 ECU_ADDRESS 0xFFFF4C42 READ_WRITE /end MEASUREMENT
/begin MEASUREMENT vOKCNT2 "RAM value vOKCNT2" UWORD COMP_0016 1 100 0 65535 ECU_ADDRESS 0xFFFF4C44 READ_WRITE /end MEASUREMENT
/begin MEASUREMENT vOKCNT3 "RAM value vOKCNT3" UWORD COMP_0016 1 100 0 65535 ECU_ADDRESS 0xFFFF4C46 READ_WRITE /end MEASUREMENT
/begin MEASUREMENT vOKCNT4 "RAM value vOKCNT4" UWORD COMP_0016 1 100 0 65535 ECU_ADDRESS 0xFFFF4C48 READ_WRITE /end MEASUREMENT
/begin MEASUREMENT vOKCNT5 "RAM value vOKCNT5" UWORD COMP_0016 1 100 0 65535 ECU_ADDRESS 0xFFFF4C4A READ_WRITE /end MEASUREMENT
/begin MEASUREMENT vOKCNT6 "RAM value vOKCNT6" UWORD COMP_0016 1 100 0 65535 ECU_ADDRESS 0xFFFF4C4C READ_WRITE /end MEASUREMENT
/begin MEASUREMENT vOKDMAX "RAM value vOKDMAX" SWORD COMP_0072_S 1 100 -131.072 131.068 ECU_ADDRESS 0xFFFF4C4E READ_WRITE /end MEASUREMENT
/begin MEASUREMENT vOKDMIN "RAM value vOKDMIN" SWORD COMP_0072_S 1 100 -131.072 131.068 ECU_ADDRESS 0xFFFF4C50 READ_WRITE /end MEASUREMENT
/begin MEASUREMENT vOKHZNTP "RAM value vOKHZNTP" UWORD COMP_0565_S 1 100 0 12799.8046875 ECU_ADDRESS 0xFFFF4C52 READ_WRITE /end MEASUREMENT
/begin MEASUREMENT vOKURI "RAM value vOKURI" UWORD COMP_0004 1 100 0 65535 ECU_ADDRESS 0xFFFF3314 READ_WRITE /end MEASUREMENT
/begin MEASUREMENT vOKURI_2 "RAM value vOKURI_2" UWORD COMP_0068 1 100 0 65535 ECU_ADDRESS 0xFFFF31F2 READ_WRITE /end MEASUREMENT
/begin MEASUREMENT vON5 "RAM value vON5" UBYTE COMP_0068 1 100 0 255 ECU_ADDRESS 0xFFFF2070 READ_WRITE /end MEASUREMENT
/begin MEASUREMENT vONABSAD "RAM value vONABSAD" SWORD COMP_0078 1 100 -128 127.99609375 ECU_ADDRESS 0xFFFF195C READ_WRITE /end MEASUREMENT
/begin MEASUREMENT vONABSADA "RAM value vONABSADA" SWORD COMP_0078 1 100 -128 127.99609375 ECU_ADDRESS 0xFFFF195E READ_WRITE /end MEASUREMENT
/begin MEASUREMENT vONABSMR "RAM value vONABSMR" UBYTE COMP_0009 1 100 0 199.21875 ECU_ADDRESS 0xFFFF1960 READ_WRITE /end MEASUREMENT
/begin MEASUREMENT vONABSPE "RAM value vONABSPE" UBYTE COMP_0009 1 100 0 199.21875 ECU_ADDRESS 0xFFFF1961 READ_WRITE /end MEASUREMENT
/begin MEASUREMENT vONADV "RAM value vONADV" SWORD COMP_0078 1 100 -128 127.99609375 ECU_ADDRESS 0xFFFF1962 READ_WRITE /end MEASUREMENT
/begin MEASUREMENT vONADVAT "RAM value vONADVAT" SWORD COMP_0078 1 100 -128 127.99609375 ECU_ADDRESS 0xFFFF1964 READ_WRITE /end MEASUREMENT
/begin MEASUREMENT vONMR "RAM value vONMR" UBYTE COMP_0009 1 100 0 199.21875 ECU_ADDRESS 0xFFFF1966 READ_WRITE /end MEASUREMENT
/begin MEASUREMENT vONPEADV "RAM value vONPEADV" UBYTE COMP_0009 1 100 0 199.21875 ECU_ADDRESS 0xFFFF1967 READ_WRITE /end MEASUREMENT
/begin MEASUREMENT vONRELAD "RAM value vONRELAD" SWORD COMP_0078 1 100 -128 127.99609375 ECU_ADDRESS 0xFFFF1968 READ_WRITE /end MEASUREMENT
/begin MEASUREMENT vONRELMR "RAM value vONRELMR" UBYTE COMP_0009 1 100 0 199.21875 ECU_ADDRESS 0xFFFF196A READ_WRITE /end MEASUREMENT
/begin MEASUREMENT vONRELPA "RAM value vONRELPA" UBYTE COMP_0009 1 100 0 199.21875 ECU_ADDRESS 0xFFFF196B READ_WRITE /end MEASUREMENT
/begin MEASUREMENT vONRELPE "RAM value vONRELPE" UBYTE COMP_0009 1 100 0 199.21875 ECU_ADDRESS 0xFFFF196C READ_WRITE /end MEASUREMENT
/begin MEASUREMENT vOOFPTf "RAM value vOOFPTf" UBYTE COMP_0004 1 100 0 255 ECU_ADDRESS 0xFFFF2A06 READ_WRITE /end MEASUREMENT
/begin MEASUREMENT vOPDADPMX "RAM value vOPDADPMX" SBYTE COMP_0018 1 100 -128 127 ECU_ADDRESS 0xFFFF2A07 READ_WRITE /end MEASUREMENT
/begin MEASUREMENT vOPDADV "RAM value vOPDADV" SBYTE COMP_0018 1 100 -128 127 ECU_ADDRESS 0xFFFF3B74 READ_WRITE /end MEASUREMENT
/begin MEASUREMENT vOPDRET "RAM value vOPDRET" UBYTE COMP_0017 1 100 0 255 ECU_ADDRESS 0xFFFF2A08 READ_WRITE /end MEASUREMENT
/begin MEASUREMENT vOPFFD "RAM value vOPFFD" UBYTE COMP_0068 1 100 0 255 ECU_ADDRESS 0xFFFF4C54 READ_WRITE /end MEASUREMENT
/begin MEASUREMENT vOPS "RAM value vOPS" UWORD COMP_0065_S 1 100 0 1023.984375 ECU_ADDRESS 0xFFFF2A0A READ_WRITE /end MEASUREMENT
/begin MEASUREMENT vOPSM "RAM value vOPSM" UBYTE COMP_0482_S 1 100 -0.098 0.882985 ECU_ADDRESS 0xFFFF3B75 READ_WRITE /end MEASUREMENT
/begin MEASUREMENT vOPTAVTO "RAM value vOPTAVTO" UBYTE COMP_0483 1 100 0 2040 ECU_ADDRESS 0xFFFF2A0C READ_WRITE /end MEASUREMENT
/begin MEASUREMENT vOPTAVTOS "RAM value vOPTAVTOS" UBYTE COMP_0483 1 100 0 2040 ECU_ADDRESS 0xFFFF2A0D READ_WRITE /end MEASUREMENT
/begin MEASUREMENT vOPTKBLRCA "RAM value vOPTKBLRCA" UBYTE COMP_0423 1 100 -50 49.609375 ECU_ADDRESS 0xFFFF2A0E READ_WRITE /end MEASUREMENT
/begin MEASUREMENT vOPTKBLRCB "RAM value vOPTKBLRCB" UBYTE COMP_0423 1 100 -50 49.609375 ECU_ADDRESS 0xFFFF2A10 READ_WRITE /end MEASUREMENT
/begin MEASUREMENT vOPTPHOSA "RAM value vOPTPHOSA" UWORD COMP_0265 1 100 -8.000012288 7.999768147 ECU_ADDRESS 0xFFFF2A12 READ_WRITE /end MEASUREMENT
/begin MEASUREMENT vOSCIDLT "RAM value vOSCIDLT" UBYTE COMP_0049 1 100 0 255 ECU_ADDRESS 0xFFFF2A16 READ_WRITE /end MEASUREMENT
/begin MEASUREMENT vOSCONf "RAM value vOSCONf" UBYTE COMP_0004 1 100 0 255 ECU_ADDRESS 0xFFFF2A17 READ_WRITE /end MEASUREMENT
/begin MEASUREMENT vOURC1 "RAM value vOURC1" UBYTE COMP_0068 1 100 0 255 ECU_ADDRESS 0xFFFF2071 READ_WRITE /end MEASUREMENT
/begin MEASUREMENT vOURC2 "RAM value vOURC2" UBYTE COMP_0068 1 100 0 255 ECU_ADDRESS 0xFFFF2072 READ_WRITE /end MEASUREMENT
/begin MEASUREMENT vOURC3 "RAM value vOURC3" UBYTE COMP_0068 1 100 0 255 ECU_ADDRESS 0xFFFF2073 READ_WRITE /end MEASUREMENT
/begin MEASUREMENT vOURC4 "RAM value vOURC4" UBYTE COMP_0068 1 100 0 255 ECU_ADDRESS 0xFFFF2074 READ_WRITE /end MEASUREMENT
/begin MEASUREMENT vOURC5 "RAM value vOURC5" UBYTE COMP_0068 1 100 0 255 ECU_ADDRESS 0xFFFF2075 READ_WRITE /end MEASUREMENT
/begin MEASUREMENT vOURC6 "RAM value vOURC6" UBYTE COMP_0068 1 100 0 255 ECU_ADDRESS 0xFFFF2076 READ_WRITE /end MEASUREMENT
/begin MEASUREMENT vOURCNG1 "RAM value vOURCNG1" UBYTE COMP_0068 1 100 0 255 ECU_ADDRESS 0xFFFF164C READ_WRITE /end MEASUREMENT
/begin MEASUREMENT vOURCNG2 "RAM value vOURCNG2" UBYTE COMP_0068 1 100 0 255 ECU_ADDRESS 0xFFFF164D READ_WRITE /end MEASUREMENT
/begin MEASUREMENT vOURCNG3 "RAM value vOURCNG3" UBYTE COMP_0068 1 100 0 255 ECU_ADDRESS 0xFFFF164E READ_WRITE /end MEASUREMENT
/begin MEASUREMENT vOURCNG4 "RAM value vOURCNG4" UBYTE COMP_0068 1 100 0 255 ECU_ADDRESS 0xFFFF164F READ_WRITE /end MEASUREMENT
/begin MEASUREMENT vOURCNG5 "RAM value vOURCNG5" UBYTE COMP_0068 1 100 0 255 ECU_ADDRESS 0xFFFF1650 READ_WRITE /end MEASUREMENT
/begin MEASUREMENT vOURCNG6 "RAM value vOURCNG6" UBYTE COMP_0068 1 100 0 255 ECU_ADDRESS 0xFFFF1651 READ_WRITE /end MEASUREMENT
/begin MEASUREMENT vOUTPUTTM "RAM value vOUTPUTTM" UWORD COMP_0189 1 100 0 209712 ECU_ADDRESS 0xFFFF0D82 READ_WRITE /end MEASUREMENT
/begin MEASUREMENT vOUTREV "RAM value vOUTREV" UWORD COMP_0443 1 100 0 65535 ECU_ADDRESS 0xFFFF08EC READ_WRITE /end MEASUREMENT
/begin MEASUREMENT vOUTREV1 "RAM value vOUTREV1" UWORD COMP_0443 1 100 0 65535 ECU_ADDRESS 0xFFFF1652 READ_WRITE /end MEASUREMENT
/begin MEASUREMENT vOUTREV2 "RAM value vOUTREV2" UWORD COMP_0443 1 100 0 65535 ECU_ADDRESS 0xFFFF1654 READ_WRITE /end MEASUREMENT
/begin MEASUREMENT vOUTREV3 "RAM value vOUTREV3" UWORD COMP_0443 1 100 0 65535 ECU_ADDRESS 0xFFFF1656 READ_WRITE /end MEASUREMENT
/begin MEASUREMENT vOUTREV4 "RAM value vOUTREV4" UWORD COMP_0443 1 100 0 65535 ECU_ADDRESS 0xFFFF1658 READ_WRITE /end MEASUREMENT
/begin MEASUREMENT vOUTREV5 "RAM value vOUTREV5" UWORD COMP_0443 1 100 0 65535 ECU_ADDRESS 0xFFFF165A READ_WRITE /end MEASUREMENT
/begin MEASUREMENT vOUTREVES "RAM value vOUTREVES" UWORD COMP_0443 1 100 0 65535 ECU_ADDRESS 0xFFFF165C READ_WRITE /end MEASUREMENT
/begin MEASUREMENT vOUTREVFL "RAM value vOUTREVFL" UWORD COMP_0443 1 100 0 65535 ECU_ADDRESS 0xFFFF08EE READ_WRITE /end MEASUREMENT
/begin MEASUREMENT vOVCHGCUR "RAM value vOVCHGCUR" SWORD COMP_0204_S 1 100 -3276800 3276700 ECU_ADDRESS 0xFFFF2A18 READ_WRITE /end MEASUREMENT
/begin MEASUREMENT vOVLTPO "RAM value vOVLTPO" UWORD COMP_0005 1 100 0 7208.85 ECU_ADDRESS 0xFFFF2A1A READ_WRITE /end MEASUREMENT
/begin MEASUREMENT vOVUTPO "RAM value vOVUTPO" UWORD COMP_0005 1 100 0 7208.85 ECU_ADDRESS 0xFFFF2A1C READ_WRITE /end MEASUREMENT
/begin MEASUREMENT vOXYGEN "RAM value vOXYGEN" SWORD COMP_0587_S 1 100 -327.68 327.67 ECU_ADDRESS 0xFFFF2A1E READ_WRITE /end MEASUREMENT
/begin MEASUREMENT vPABF "RAM value vPABF" UWORD COMP_0588_S 1 100 0 127.989855 ECU_ADDRESS 0xFFFF2A22 READ_WRITE /end MEASUREMENT
/begin MEASUREMENT vPABFERR "RAM value vPABFERR" UWORD COMP_0018_S 1 100 0 127.998046875 ECU_ADDRESS 0xFFFF2A24 READ_WRITE /end MEASUREMENT
/begin MEASUREMENT vPALP "RAM value vPALP" UWORD COMP_0031 1 100 0 255.99609375 ECU_ADDRESS 0xFFFF0D84 READ_WRITE /end MEASUREMENT
/begin MEASUREMENT vPAMB "RAM value vPAMB" UWORD COMP_0486 1 100 0 5119.921875 ECU_ADDRESS 0xFFFF440C READ_WRITE /end MEASUREMENT
/begin MEASUREMENT vPAMBA "RAM value vPAMBA" UWORD COMP_0486 1 100 0 5119.921875 ECU_ADDRESS 0xFFFF4F36 READ_WRITE /end MEASUREMENT
/begin MEASUREMENT vPAMBAT "RAM value vPAMBAT" UBYTE COMP_0054 1 100 0 5100 ECU_ADDRESS 0xFFFF37DC READ_WRITE /end MEASUREMENT
/begin MEASUREMENT vPAMBAVE "RAM value vPAMBAVE" UWORD COMP_0486 1 100 0 5119.921875 ECU_ADDRESS 0xFFFF4C5E READ_WRITE /end MEASUREMENT
/begin MEASUREMENT vPAMBEND "RAM value vPAMBEND" UWORD COMP_0486 1 100 0 5119.921875 ECU_ADDRESS 0xFFFF4C60 READ_WRITE /end MEASUREMENT
/begin MEASUREMENT vPAMBFAC "RAM value vPAMBFAC" UWORD COMP_0334_S 1 100 0 1599.9780435 ECU_ADDRESS 0xFFFF2A26 READ_WRITE /end MEASUREMENT
/begin MEASUREMENT vPAMBMAX "RAM value vPAMBMAX" UWORD COMP_0486 1 100 0 5119.921875 ECU_ADDRESS 0xFFFF4C62 READ_WRITE /end MEASUREMENT
/begin MEASUREMENT vPAMBMIN "RAM value vPAMBMIN" UWORD COMP_0486 1 100 0 5119.921875 ECU_ADDRESS 0xFFFF4C64 READ_WRITE /end MEASUREMENT
/begin MEASUREMENT vPAMBO "RAM value vPAMBO" UWORD COMP_0050 1 100 0 5119.921875 ECU_ADDRESS 0xFFFF37DE READ_WRITE /end MEASUREMENT
/begin MEASUREMENT vPAMVM1 "RAM value vPAMVM1" UWORD COMP_0050 1 100 0 5119.921875 ECU_ADDRESS 0xFFFF2A28 READ_WRITE /end MEASUREMENT
/begin MEASUREMENT vPARAMONI "RAM value vPARAMONI" UWORD COMP_0283 1 100 0 65535 ECU_ADDRESS 0xFFFF2A2A READ_WRITE /end MEASUREMENT
/begin MEASUREMENT vPARGEQA "RAM value vPARGEQA" UWORD COMP_0068 1 100 0 65535 ECU_ADDRESS 0xFFFF3B76 READ_WRITE /end MEASUREMENT
/begin MEASUREMENT vPARGEQD "RAM value vPARGEQD" UWORD COMP_0092_S 1 100 0 1638.375 ECU_ADDRESS 0xFFFF37E0 READ_WRITE /end MEASUREMENT
/begin MEASUREMENT vPAS "RAM value vPAS" UWORD COMP_0265 1 100 -8.000012288 7.999768147 ECU_ADDRESS 0xFFFF0D88 READ_WRITE /end MEASUREMENT
/begin MEASUREMENT vPASNOK "RAM value vPASNOK" UBYTE COMP_0022 1 100 0 5100 ECU_ADDRESS 0xFFFF0D8C READ_WRITE /end MEASUREMENT
/begin MEASUREMENT vPAT "RAM value vPAT" UBYTE COMP_0068 1 100 0 255 ECU_ADDRESS 0xFFFF165E READ_WRITE /end MEASUREMENT
/begin MEASUREMENT vPBADNW "RAM value vPBADNW" UWORD COMP_0023 1 100 0 327675 ECU_ADDRESS 0xFFFF082A READ_WRITE /end MEASUREMENT
/begin MEASUREMENT vPBAV "RAM value vPBAV" UWORD COMP_0023 1 100 0 327675 ECU_ADDRESS 0xFFFF082C READ_WRITE /end MEASUREMENT
/begin MEASUREMENT vPBAVKPA "RAM value vPBAVKPA" UWORD COMP_0120_S 1 100 0 16383.75 ECU_ADDRESS 0xFFFF1588 READ_WRITE /end MEASUREMENT
/begin MEASUREMENT vPBAVMAX "RAM value vPBAVMAX" UWORD COMP_0120_S 1 100 0 16383.75 ECU_ADDRESS 0xFFFF08F0 READ_WRITE /end MEASUREMENT
/begin MEASUREMENT vPBAVOLD "RAM value vPBAVOLD" UWORD COMP_0023 1 100 0 327675 ECU_ADDRESS 0xFFFF158A READ_WRITE /end MEASUREMENT
/begin MEASUREMENT vPBFCNT1 "RAM value vPBFCNT1" UBYTE COMP_0030 1 100 0 255 ECU_ADDRESS 0xFFFF2A2C READ_WRITE /end MEASUREMENT
/begin MEASUREMENT vPBMAXAVE "RAM value vPBMAXAVE" UWORD COMP_0120_S 1 100 0 16383.75 ECU_ADDRESS 0xFFFF2A2E READ_WRITE /end MEASUREMENT
/begin MEASUREMENT vPBOOST "RAM value vPBOOST" UWORD COMP_0050 1 100 0 5119.921875 ECU_ADDRESS 0xFFFF0D8E READ_WRITE /end MEASUREMENT
/begin MEASUREMENT vPBS "RAM value vPBS" UBYTE COMP_0054 1 100 0 5100 ECU_ADDRESS 0xFFFF165F READ_WRITE /end MEASUREMENT
/begin MEASUREMENT vPBSTEST "RAM value vPBSTEST" SWORD COMP_0531_S 1 100 -128 127.99609375 ECU_ADDRESS 0xFFFF31F4 READ_WRITE /end MEASUREMENT
/begin MEASUREMENT vPCAMPHCT "RAM value vPCAMPHCT" UBYTE COMP_0068 1 100 0 255 ECU_ADDRESS 0xFFFF196D READ_WRITE /end MEASUREMENT
/begin MEASUREMENT vPCAMPHTM "RAM value vPCAMPHTM" UWORD COMP_0057_S 1 100 0 6553.5 ECU_ADDRESS 0xFFFF196E READ_WRITE /end MEASUREMENT
/begin MEASUREMENT vPCAMPOS "RAM value vPCAMPOS" UBYTE COMP_0068 1 100 0 255 ECU_ADDRESS 0xFFFF1970 READ_WRITE /end MEASUREMENT
/begin MEASUREMENT vPCAMTDC "RAM value vPCAMTDC" UWORD COMP_0057_S 1 100 0 6553.5 ECU_ADDRESS 0xFFFF0D90 READ_WRITE /end MEASUREMENT
/begin MEASUREMENT vPCAMTDCB "RAM value vPCAMTDCB" UWORD COMP_0057_S 1 100 0 6553.5 ECU_ADDRESS 0xFFFF0D92 READ_WRITE /end MEASUREMENT
/begin MEASUREMENT vPCATLR "RAM value vPCATLR" UBYTE COMP_0163 1 100 0 15.9375 ECU_ADDRESS 0xFFFF2A30 READ_WRITE /end MEASUREMENT
/begin MEASUREMENT vPCATRL "RAM value vPCATRL" UBYTE COMP_0163 1 100 0 15.9375 ECU_ADDRESS 0xFFFF2A31 READ_WRITE /end MEASUREMENT
/begin MEASUREMENT vPCHD "RAM value vPCHD" UWORD COMP_0034_S 1 100 0 255.99609375 ECU_ADDRESS 0xFFFF2A32 READ_WRITE /end MEASUREMENT
/begin MEASUREMENT vPCHS "RAM value vPCHS" UWORD COMP_0034_S 1 100 0 255.99609375 ECU_ADDRESS 0xFFFF2A34 READ_WRITE /end MEASUREMENT
/begin MEASUREMENT vPCNASN "RAM value vPCNASN" UBYTE COMP_0054 1 100 0 5100 ECU_ADDRESS 0xFFFF0D94 READ_WRITE /end MEASUREMENT
/begin MEASUREMENT vPCTAGCT "RAM value vPCTAGCT" UBYTE COMP_0390 1 100 0 2550 ECU_ADDRESS 0xFFFF1971 READ_WRITE /end MEASUREMENT
/begin MEASUREMENT vPCTAGTM "RAM value vPCTAGTM" UWORD COMP_0057_S 1 100 0 6553.5 ECU_ADDRESS 0xFFFF1972 READ_WRITE /end MEASUREMENT
/begin MEASUREMENT vPCVOLM "RAM value vPCVOLM" UBYTE COMP_0008 1 100 0 25500 ECU_ADDRESS 0xFFFF2A36 READ_WRITE /end MEASUREMENT
/begin MEASUREMENT vPCYCLCNT "RAM value vPCYCLCNT" UBYTE COMP_0068 1 100 0 255 ECU_ADDRESS 0xFFFF1974 READ_WRITE /end MEASUREMENT
/begin MEASUREMENT vPDACOF "RAM value vPDACOF" UBYTE COMP_0011 1 100 0 5.1 ECU_ADDRESS 0xFFFF08F2 READ_WRITE /end MEASUREMENT
/begin MEASUREMENT vPDACON "RAM value vPDACON" UBYTE COMP_0011 1 100 0 5.1 ECU_ADDRESS 0xFFFF08F3 READ_WRITE /end MEASUREMENT
/begin MEASUREMENT vPDATA1 "RAM value vPDATA1" ULONG COMP_0004 1 100 0 4294967295 ECU_ADDRESS 0xFFFF31F8 READ_WRITE /end MEASUREMENT
/begin MEASUREMENT vPDE "RAM value vPDE" UBYTE COMP_0027 1 100 0 255 ECU_ADDRESS 0xFFFF2A37 READ_WRITE /end MEASUREMENT
/begin MEASUREMENT vPDLBASE "RAM value vPDLBASE" UWORD COMP_0032_S 1 100 0 8191.875 ECU_ADDRESS 0xFFFF2A38 READ_WRITE /end MEASUREMENT
/begin MEASUREMENT vPDLECO "RAM value vPDLECO" UWORD COMP_0032_S 1 100 0 8191.875 ECU_ADDRESS 0xFFFF2A3A READ_WRITE /end MEASUREMENT
/begin MEASUREMENT vPDLFMFAC "RAM value vPDLFMFAC" UWORD COMP_0209_S 1 100 0 199.996894995 ECU_ADDRESS 0xFFFF2A3C READ_WRITE /end MEASUREMENT
/begin MEASUREMENT vPDLFMF_S "RAM value vPDLFMF_S" UWORD COMP_0209_S 1 100 0 199.996894995 ECU_ADDRESS 0xFFFF3050 READ_WRITE /end MEASUREMENT
/begin MEASUREMENT vPDLSNOW "RAM value vPDLSNOW" UWORD COMP_0032_S 1 100 0 8191.875 ECU_ADDRESS 0xFFFF2A3E READ_WRITE /end MEASUREMENT
/begin MEASUREMENT vPDLSPORT "RAM value vPDLSPORT" UWORD COMP_0032_S 1 100 0 8191.875 ECU_ADDRESS 0xFFFF2A40 READ_WRITE /end MEASUREMENT
/begin MEASUREMENT vPDMAX "RAM value vPDMAX" UWORD COMP_0010 1 100 0 196.605 ECU_ADDRESS 0xFFFF0D96 READ_WRITE /end MEASUREMENT
/begin MEASUREMENT vPDMIN "RAM value vPDMIN" UWORD COMP_0010 1 100 0 196.605 ECU_ADDRESS 0xFFFF0D98 READ_WRITE /end MEASUREMENT
/begin MEASUREMENT vPDNSLIM "RAM value vPDNSLIM" UWORD COMP_0523_S 1 100 0 64.001481 ECU_ADDRESS 0xFFFF2A42 READ_WRITE /end MEASUREMENT
/begin MEASUREMENT vPDOPN "RAM value vPDOPN" UWORD COMP_0269 1 100 0 127.998046875 ECU_ADDRESS 0xFFFF2A44 READ_WRITE /end MEASUREMENT
/begin MEASUREMENT vPDPREN "RAM value vPDPREN" UBYTE COMP_0011 1 100 0 5.1 ECU_ADDRESS 0xFFFF2077 READ_WRITE /end MEASUREMENT
/begin MEASUREMENT vPDPREN1 "RAM value vPDPREN1" UWORD COMP_0010 1 100 0 196.605 ECU_ADDRESS 0xFFFF1660 READ_WRITE /end MEASUREMENT
/begin MEASUREMENT vPDPRES "RAM value vPDPRES" UWORD COMP_0023 1 100 0 327675 ECU_ADDRESS 0xFFFF37E2 READ_WRITE /end MEASUREMENT
/begin MEASUREMENT vPDTCCL "RAM value vPDTCCL" UBYTE COMP_0004 1 100 0 255 ECU_ADDRESS 0xFFFF2A46 READ_WRITE /end MEASUREMENT
/begin MEASUREMENT vPDTCCNT "RAM value vPDTCCNT" UBYTE COMP_0068 1 100 0 255 ECU_ADDRESS 0xFFFF30C0 READ_WRITE /end MEASUREMENT
/begin MEASUREMENT vPDTCNOC "RAM value vPDTCNOC" UBYTE COMP_0004 1 100 0 255 ECU_ADDRESS 0xFFFF30C1 READ_WRITE /end MEASUREMENT
/begin MEASUREMENT vPDTCST "RAM value vPDTCST" UBYTE COMP_0068 1 100 0 255 ECU_ADDRESS 0xFFFF5223 READ_WRITE /end MEASUREMENT
/begin MEASUREMENT vPDUTYG "RAM value vPDUTYG" UWORD COMP_0589_S 1 100 -102.4 102.396875 ECU_ADDRESS 0xFFFF37E4 READ_WRITE /end MEASUREMENT
/begin MEASUREMENT vPENDPR9 "RAM value vPENDPR9" UBYTE COMP_0068 1 100 0 255 ECU_ADDRESS 0xFFFF3B78 READ_WRITE /end MEASUREMENT
/begin MEASUREMENT vPENDREQ "RAM value vPENDREQ" UBYTE COMP_0068 1 100 0 255 ECU_ADDRESS 0xFFFF30C2 READ_WRITE /end MEASUREMENT
/begin MEASUREMENT vPENDREQ9 "RAM value vPENDREQ9" UBYTE COMP_0068 1 100 0 255 ECU_ADDRESS 0xFFFF30C3 READ_WRITE /end MEASUREMENT
/begin MEASUREMENT vPENDTMP "RAM value vPENDTMP" UBYTE COMP_0068 1 100 0 255 ECU_ADDRESS 0xFFFF30C4 READ_WRITE /end MEASUREMENT
/begin MEASUREMENT vPERG "RAM value vPERG" UBYTE COMP_0130_S 1 100 0 0.255 ECU_ADDRESS 0xFFFF2A47 READ_WRITE /end MEASUREMENT
/begin MEASUREMENT vPERR "RAM value vPERR" UBYTE COMP_0256 1 100 -64 63.5 ECU_ADDRESS 0xFFFF097E READ_WRITE /end MEASUREMENT
/begin MEASUREMENT vPERR3E "RAM value vPERR3E" UBYTE COMP_0256 1 100 -64 63.5 ECU_ADDRESS 0xFFFF097F READ_WRITE /end MEASUREMENT
/begin MEASUREMENT vPERR3N "RAM value vPERR3N" UWORD COMP_0108_S 1 100 -16384 16383.5 ECU_ADDRESS 0xFFFF0982 READ_WRITE /end MEASUREMENT
/begin MEASUREMENT vPERR3NE "RAM value vPERR3NE" UWORD COMP_0108_S 1 100 -16384 16383.5 ECU_ADDRESS 0xFFFF0986 READ_WRITE /end MEASUREMENT
/begin MEASUREMENT vPERTRQ "RAM value vPERTRQ" UBYTE COMP_0131_S 1 100 0 127.5 ECU_ADDRESS 0xFFFF2A48 READ_WRITE /end MEASUREMENT
/begin MEASUREMENT vPERTRQAL "RAM value vPERTRQAL" UBYTE COMP_0131_S 1 100 0 127.5 ECU_ADDRESS 0xFFFF2A49 READ_WRITE /end MEASUREMENT
/begin MEASUREMENT vPERTRQFB "RAM value vPERTRQFB" UBYTE COMP_0210_S 1 100 -64 63.5 ECU_ADDRESS 0xFFFF2A4A READ_WRITE /end MEASUREMENT
/begin MEASUREMENT vPERTRQFF "RAM value vPERTRQFF" UBYTE COMP_0131_S 1 100 0 127.5 ECU_ADDRESS 0xFFFF2A4B READ_WRITE /end MEASUREMENT
/begin MEASUREMENT vPEVAP "RAM value vPEVAP" UWORD COMP_0050 1 100 0 5119.921875 ECU_ADDRESS 0xFFFF1662 READ_WRITE /end MEASUREMENT
/begin MEASUREMENT vPFJDGCR "RAM value vPFJDGCR" UBYTE COMP_0068 1 100 0 255 ECU_ADDRESS 0xFFFF1975 READ_WRITE /end MEASUREMENT
/begin MEASUREMENT vPFUEL "RAM value vPFUEL" UWORD COMP_0164 1 100 0 19.988175 ECU_ADDRESS 0xFFFF1E10 READ_WRITE /end MEASUREMENT
/begin MEASUREMENT vPFUELBU "RAM value vPFUELBU" UWORD COMP_0164 1 100 0 19.988175 ECU_ADDRESS 0xFFFF4E40 READ_WRITE /end MEASUREMENT
/begin MEASUREMENT vPFUELH "RAM value vPFUELH" UWORD COMP_0031_S 1 100 0 39.97635 ECU_ADDRESS 0xFFFF1E12 READ_WRITE /end MEASUREMENT
/begin MEASUREMENT vPFUELINT "RAM value vPFUELINT" UWORD COMP_0164 1 100 0 19.988175 ECU_ADDRESS 0xFFFF31FC READ_WRITE /end MEASUREMENT
/begin MEASUREMENT vPGAIN1 "RAM value vPGAIN1" SWORD COMP_0195_S 1 100 -3276.8 3276.7 ECU_ADDRESS 0xFFFF0D9A READ_WRITE /end MEASUREMENT
/begin MEASUREMENT vPGRTCYL "RAM value vPGRTCYL" UWORD COMP_0198_S 1 100 0 63.999056205 ECU_ADDRESS 0xFFFF2078 READ_WRITE /end MEASUREMENT
/begin MEASUREMENT vPHASECEZ "RAM value vPHASECEZ" UBYTE COMP_0068 1 100 0 255 ECU_ADDRESS 0xFFFF0D9C READ_WRITE /end MEASUREMENT
/begin MEASUREMENT vPHASECNE "RAM value vPHASECNE" UBYTE COMP_0068 1 100 0 255 ECU_ADDRESS 0xFFFF1976 READ_WRITE /end MEASUREMENT
/begin MEASUREMENT vPHASECNT "RAM value vPHASECNT" UBYTE COMP_0068 1 100 0 255 ECU_ADDRESS 0xFFFF1978 READ_WRITE /end MEASUREMENT
/begin MEASUREMENT vPHASECTZ "RAM value vPHASECTZ" UBYTE COMP_0068 1 100 0 255 ECU_ADDRESS 0xFFFF0D9E READ_WRITE /end MEASUREMENT
/begin MEASUREMENT vPHOS "RAM value vPHOS" UWORD COMP_0265 1 100 -8.000012288 7.999768147 ECU_ADDRESS 0xFFFF0DA0 READ_WRITE /end MEASUREMENT
/begin MEASUREMENT vPHOS1OKf "RAM value vPHOS1OKf" UBYTE COMP_0004 1 100 0 255 ECU_ADDRESS 0xFFFF0DA4 READ_WRITE /end MEASUREMENT
/* COMPU_METHOD --------------------------------------------------------- */
/begin COMPU_METHOD COMP_0017 "1deg" RAT_FUNC "%8.2" "deg" COEFFS 0 1 0 0 0 1 /end COMPU_METHOD
/begin COMPU_METHOD COMP_0004 "1－" RAT_FUNC "%8.2" "－" COEFFS 0 1 0 0 0 1 /end COMPU_METHOD
/begin COMPU_METHOD COMP_0068 "1-" RAT_FUNC "%8.2" "-" COEFFS 0 1 0 0 0 1 /end COMPU_METHOD
/begin COMPU_METHOD COMP_0001_S "1Pa" RAT_FUNC "%8.2" "Pa" COEFFS 0 1 0 0 0 1 /end COMPU_METHOD
/begin COMPU_METHOD COMP_0002_S "1Pa" RAT_FUNC "%8.2" "Pa" COEFFS 0 1 0 0 0 1 /end COMPU_METHOD
/begin COMPU_METHOD COMP_0013 "1s" RAT_FUNC "%8.2" "s" COEFFS 0 1 0 0 0 1 /end COMPU_METHOD
/begin COMPU_METHOD COMP_0014 "10ms" RAT_FUNC "%8.2" "ms" COEFFS 0 1 0 0 0 10 /end COMPU_METHOD
/begin COMPU_METHOD COMP_0045 "1/128-" RAT_FUNC "%8.4" "-" COEFFS 0 1 0 0 0 0.0078125 /end COMPU_METHOD
/begin COMPU_METHOD COMP_0009 "100/128%" RAT_FUNC "%8.2" "%" COEFFS 0 1 0 0 0 0.78125 /end COMPU_METHOD
/begin COMPU_METHOD COMP_0000 "25rpm" RAT_FUNC "%8.2" "rpm" COEFFS 0 1 0 0 0 25 /end COMPU_METHOD
/begin COMPU_METHOD COMP_0186 "1/64-" RAT_FUNC "%8.3" "-" COEFFS 0 1 0 0 0 0.015625 /end COMPU_METHOD
/begin COMPU_METHOD COMP_0001 "1/8ms" RAT_FUNC "%8.2" "ms" COEFFS 0 1 0 0 0 0.125 /end COMPU_METHOD
/begin COMPU_METHOD COMP_0020 "50rpm" RAT_FUNC "%8.2" "rpm" COEFFS 0 1 0 0 0 50 /end COMPU_METHOD
/begin COMPU_METHOD COMP_0004_S "X-50degC" RAT_FUNC "%8.2" "degC" COEFFS 0 1 50 0 0 1 /end COMPU_METHOD
/begin COMPU_METHOD COMP_0388 "0.1-" RAT_FUNC "%8.2" "-" COEFFS 0 1 0 0 0 0.1 /end COMPU_METHOD
/begin COMPU_METHOD COMP_0373 "1/100-" RAT_FUNC "%8.3" "-" COEFFS 0 1 0 0 0 0.01 /end COMPU_METHOD
/begin COMPU_METHOD COMP_0002 "0.35deg" RAT_FUNC "%8.2" "deg" COEFFS 0 1 0 0 0 0.35 /end COMPU_METHOD
/begin COMPU_METHOD COMP_0035 "X-50℃" RAT_FUNC "%8.2" "℃" COEFFS 0 1 50 0 0 1 /end COMPU_METHOD
/begin COMPU_METHOD COMP_0453 "0.002-" RAT_FUNC "%8.4" "-" COEFFS 0 1 0 0 0 0.002 /end COMPU_METHOD
/begin COMPU_METHOD COMP_0005 "0.11deg" RAT_FUNC "%8.2" "deg" COEFFS 0 1 0 0 0 0.11 /end COMPU_METHOD
/begin COMPU_METHOD COMP_0006 "12.5rpm" RAT_FUNC "%8.2" "rpm" COEFFS 0 1 0 0 0 12.5 /end COMPU_METHOD
/begin COMPU_METHOD COMP_0008 "100ms" RAT_FUNC "%8.2" "ms" COEFFS 0 1 0 0 0 100 /end COMPU_METHOD
/begin COMPU_METHOD COMP_0010 "0.003MPa" RAT_FUNC "%8.4" "MPa" COEFFS 0 1 0 0 0 0.003 /end COMPU_METHOD
/begin COMPU_METHOD COMP_0011 "0.02MPa" RAT_FUNC "%8.3" "MPa" COEFFS 0 1 0 0 0 0.02 /end COMPU_METHOD
/begin COMPU_METHOD COMP_0007 "2km/h" RAT_FUNC "%8.2" "km/h" COEFFS 0 1 0 0 0 2 /end COMPU_METHOD
/begin COMPU_METHOD COMP_0047 "0.5%" RAT_FUNC "%8.2" "%" COEFFS 0 1 0 0 0 0.5 /end COMPU_METHOD
/begin COMPU_METHOD COMP_0163 "1/16%" RAT_FUNC "%8.3" "%" COEFFS 0 1 0 0 0 0.0625 /end COMPU_METHOD
/begin COMPU_METHOD COMP_0486 "20/256mv" RAT_FUNC "%8.3" "mv" COEFFS 0 1 0 0 0 0.078125 /end COMPU_METHOD
/begin COMPU_METHOD COMP_0353 "5mV" RAT_FUNC "%8.2" "mV" COEFFS 0 1 0 0 0 5 /end COMPU_METHOD
/begin COMPU_METHOD COMP_0018 "1deg" RAT_FUNC "%8.2" "deg" COEFFS 0 1 0 0 0 1 /end COMPU_METHOD
/begin COMPU_METHOD COMP_0081 "1/256deg" RAT_FUNC "%8.4" "deg" COEFFS 0 1 0 0 0 0.00390625 /end COMPU_METHOD
/begin COMPU_METHOD COMP_0217 "1/16384-" RAT_FUNC "%8.6" "-" COEFFS 0 1 0 0 0 0.0000610352 /end COMPU_METHOD
/begin COMPU_METHOD COMP_0023 "5mV" RAT_FUNC "%8.2" "mV" COEFFS 0 1 0 0 0 5 /end COMPU_METHOD
/begin COMPU_METHOD COMP_0033 "80mV" RAT_FUNC "%8.2" "mV" COEFFS 0 1 0 0 0 80 /end COMPU_METHOD
/begin COMPU_METHOD COMP_0027 "1%" RAT_FUNC "%8.2" "%" COEFFS 0 1 0 0 0 1 /end COMPU_METHOD
/begin COMPU_METHOD COMP_0017_S "0.01sec" RAT_FUNC "%8.3" "sec" COEFFS 0 1 0 0 0 0.01 /end COMPU_METHOD
/begin COMPU_METHOD COMP_0061 "5mv" RAT_FUNC "%8.2" "mv" COEFFS 0 1 0 0 0 5 /end COMPU_METHOD
/begin COMPU_METHOD COMP_0049 "1sec" RAT_FUNC "%8.2" "sec" COEFFS 0 1 0 0 0 1 /end COMPU_METHOD
/begin COMPU_METHOD COMP_0032 "1/256－" RAT_FUNC "%8.4" "－" COEFFS 0 1 0 0 0 0.00390625 /end COMPU_METHOD
/begin COMPU_METHOD COMP_0018_S "0.5/256-" RAT_FUNC "%8.4" "-" COEFFS 0 1 0 0 0 0.001953125 /end COMPU_METHOD
/begin COMPU_METHOD COMP_0063 "1/256-" RAT_FUNC "%8.4" "-" COEFFS 0 1 0 0 0 0.00390625 /end COMPU_METHOD
/begin COMPU_METHOD COMP_0030 "1回" RAT_FUNC "%8.2" "回" COEFFS 0 1 0 0 0 1 /end COMPU_METHOD
/begin COMPU_METHOD COMP_0016 "1count" RAT_FUNC "%8.2" "count" COEFFS 0 1 0 0 0 1 /end COMPU_METHOD
/begin COMPU_METHOD COMP_0202 "10msec" RAT_FUNC "%8.2" "msec" COEFFS 0 1 0 0 0 10 /end COMPU_METHOD
/begin COMPU_METHOD COMP_0443 "1rpm" RAT_FUNC "%8.2" "rpm" COEFFS 0 1 0 0 0 1 /end COMPU_METHOD
/begin COMPU_METHOD COMP_0228 "0.1Nm" RAT_FUNC "%8.2" "Nm" COEFFS 0 1 0 0 0 0.1 /end COMPU_METHOD
/begin COMPU_METHOD COMP_0436 "0.1km/h" RAT_FUNC "%8.2" "km/h" COEFFS 0 1 0 0 0 0.1 /end COMPU_METHOD
/begin COMPU_METHOD COMP_0256 "64/128degCA" RAT_FUNC "%8.2" "degCA" COEFFS 0 1 64 0 0 0.5 /end COMPU_METHOD
/begin COMPU_METHOD COMP_0031 "1/256%" RAT_FUNC "%8.4" "%" COEFFS 0 1 0 0 0 0.00390625 /end COMPU_METHOD
/begin COMPU_METHOD COMP_0065 "3.125rpm" RAT_FUNC "%8.2" "rpm" COEFFS 0 1 0 0 0 3.125 /end COMPU_METHOD
/begin COMPU_METHOD COMP_0031_S "0.00061MPa" RAT_FUNC "%8.5" "MPa" COEFFS 0 1 0 0 0 0.00061 /end COMPU_METHOD
/begin COMPU_METHOD COMP_0032_S "0.125%" RAT_FUNC "%8.2" "%" COEFFS 0 1 0 0 0 0.125 /end COMPU_METHOD
/begin COMPU_METHOD COMP_0034_S "2^-8kPa" RAT_FUNC "%8.4" "kPa" COEFFS 0 1 0 0 0 0.00390625 /end COMPU_METHOD
/begin COMPU_METHOD COMP_0039_S "1Pa" RAT_FUNC "%8.2" "Pa" COEFFS 0 1 -60000 0 0 1 /end COMPU_METHOD
/begin COMPU_METHOD COMP_0042 "0.0008cm**2" RAT_FUNC "%8.5" "cm**2" COEFFS 0 1 0 0 0 0.0008 /end COMPU_METHOD
/begin COMPU_METHOD COMP_0044 "1/128－" RAT_FUNC "%8.4" "－" COEFFS 0 1 0 0 0 0.0078125 /end COMPU_METHOD
/begin COMPU_METHOD COMP_0046_S "1/256A" RAT_FUNC "%8.4" "A" COEFFS 0 1 0 0 0 0.00390625 /end COMPU_METHOD
/begin COMPU_METHOD COMP_0054 "20mV" RAT_FUNC "%8.2" "mV" COEFFS 0 1 0 0 0 20 /end COMPU_METHOD
/begin COMPU_METHOD COMP_0450 "1/1024-" RAT_FUNC "%8.5" "-" COEFFS 0 1 0 0 0 0.000976563 /end COMPU_METHOD
/begin COMPU_METHOD COMP_0057_S "0.1deg" RAT_FUNC "%8.2" "deg" COEFFS 0 1 0 0 0 0.1 /end COMPU_METHOD
/begin COMPU_METHOD COMP_0290 "1/65536-" RAT_FUNC "%8.6" "-" COEFFS 0 1 0 0 0 0.0000152588 /end COMPU_METHOD
/begin COMPU_METHOD COMP_0144 "1/2048ms" RAT_FUNC "%8.5" "ms" COEFFS 0 1 0 0 0 0.000488281 /end COMPU_METHOD
/begin COMPU_METHOD COMP_0062_S "1ms/2^(ST" RAT_FUNC "%8.2" "ms/2^(ST" COEFFS 0 1 0 0 0 1 /end COMPU_METHOD
/begin COMPU_METHOD COMP_0063_S "1/255count" RAT_FUNC "%8.4" "count" COEFFS 0 1 0 0 0 0.00392157 /end COMPU_METHOD
/begin COMPU_METHOD COMP_0064_S "1N" RAT_FUNC "%8.2" "N" COEFFS 0 1 0 0 0 1 /end COMPU_METHOD
/begin COMPU_METHOD COMP_0065_S "1/64kPa" RAT_FUNC "%8.3" "kPa" COEFFS 0 1 0 0 0 0.015625 /end COMPU_METHOD
/begin COMPU_METHOD COMP_0066_S "0.1degC" RAT_FUNC "%8.2" "degC" COEFFS 0 1 0 0 0 0.1 /end COMPU_METHOD
/begin COMPU_METHOD COMP_0072_S "0.004-" RAT_FUNC "%8.4" "-" COEFFS 0 1 0 0 0 0.004 /end COMPU_METHOD
/begin COMPU_METHOD COMP_0021 "100/256%" RAT_FUNC "%8.2" "%" COEFFS 0 1 0 0 0 0.390625 /end COMPU_METHOD
/begin COMPU_METHOD COMP_0078 "1/256deg" RAT_FUNC "%8.4" "deg" COEFFS 0 1 0 0 0 0.00390625 /end COMPU_METHOD
/begin COMPU_METHOD COMP_0081_S "100/256%/100ms" RAT_FUNC "%8.2" "%/100ms" COEFFS 0 1 0 0 0 0.390625 /end COMPU_METHOD
/begin COMPU_METHOD COMP_0095 "400/256%" RAT_FUNC "%8.2" "%" COEFFS 0 1 0 0 0 1.5625 /end COMPU_METHOD
/begin COMPU_METHOD COMP_0096 "10s" RAT_FUNC "%8.2" "s" COEFFS 0 1 0 0 0 10 /end COMPU_METHOD
/begin COMPU_METHOD COMP_0051 "1L/min" RAT_FUNC "%8.2" "L/min" COEFFS 0 1 0 0 0 1 /end COMPU_METHOD
/begin COMPU_METHOD COMP_0456 "1/(256×128)-" RAT_FUNC "%8.6" "-" COEFFS 0 1 0 0 0 0.0000305176 /end COMPU_METHOD
/begin COMPU_METHOD COMP_0090_S "0.2%" RAT_FUNC "%8.2" "%" COEFFS 0 1 0 0 0 0.2 /end COMPU_METHOD
/begin COMPU_METHOD COMP_0092_S "0.025kg/h" RAT_FUNC "%8.3" "kg/h" COEFFS 0 1 0 0 0 0.025 /end COMPU_METHOD
/begin COMPU_METHOD COMP_0050 "5/64mV" RAT_FUNC "%8.3" "mV" COEFFS 0 1 0 0 0 0.078125 /end COMPU_METHOD
/begin COMPU_METHOD COMP_0069 "1/(128*256)－" RAT_FUNC "%8.6" "－" COEFFS 0 1 0 0 0 0.0000305176 /end COMPU_METHOD
/begin COMPU_METHOD COMP_0283 "1flag" RAT_FUNC "%8.2" "flag" COEFFS 0 1 0 0 0 1 /end COMPU_METHOD
/begin COMPU_METHOD COMP_0196 "0.1Nm" RAT_FUNC "%8.2" "Nm" COEFFS 0 1 0 0 0 0.1 /end COMPU_METHOD
/begin COMPU_METHOD COMP_0057 "1/16384－" RAT_FUNC "%8.6" "－" COEFFS 0 1 0 0 0 0.0000610352 /end COMPU_METHOD
/begin COMPU_METHOD COMP_0104 "10mV" RAT_FUNC "%8.2" "mV" COEFFS 0 1 0 0 0 10 /end COMPU_METHOD
/begin COMPU_METHOD COMP_0190 "2deg" RAT_FUNC "%8.2" "deg" COEFFS 0 1 0 0 0 2 /end COMPU_METHOD
/begin COMPU_METHOD COMP_0108_S "64/128degCA" RAT_FUNC "%8.2" "degCA" COEFFS 0 1 16384 0 0 0.5 /end COMPU_METHOD
/begin COMPU_METHOD COMP_0295 "100msec" RAT_FUNC "%8.2" "msec" COEFFS 0 1 0 0 0 100 /end COMPU_METHOD
/begin COMPU_METHOD COMP_0108 "1/256/10ms" RAT_FUNC "%8.4" "/10ms" COEFFS 0 1 0 0 0 0.00390625 /end COMPU_METHOD
/begin COMPU_METHOD COMP_0120_S "0.25kPa" RAT_FUNC "%8.2" "kPa" COEFFS 0 1 0 0 0 0.25 /end COMPU_METHOD
/begin COMPU_METHOD COMP_0277 "1L/min" RAT_FUNC "%8.2" "L/min" COEFFS 0 1 0 0 0 1 /end COMPU_METHOD
/begin COMPU_METHOD COMP_0064 "1.5625rpm" RAT_FUNC "%8.2" "rpm" COEFFS 0 1 0 0 0 1.5625 /end COMPU_METHOD
/begin COMPU_METHOD COMP_0164 "0.000305MPa" RAT_FUNC "%8.5" "MPa" COEFFS 0 1 0 0 0 0.000305 /end COMPU_METHOD
/begin COMPU_METHOD COMP_0130_S "0.001G" RAT_FUNC "%8.4" "G" COEFFS 0 1 0 0 0 0.001 /end COMPU_METHOD
/begin COMPU_METHOD COMP_0131_S "0.5Nm" RAT_FUNC "%8.2" "Nm" COEFFS 0 1 0 0 0 0.5 /end COMPU_METHOD
/begin COMPU_METHOD COMP_0134_S "11/(L/min" RAT_FUNC "%8.2" "1/(L/min" COEFFS 0 1 0 0 0 1 /end COMPU_METHOD
/begin COMPU_METHOD COMP_0136_S "0.0037(X-511)G" RAT_FUNC "%8.4" "G" COEFFS 0 1 1.8907 0 0 0.0037 /end COMPU_METHOD
/begin COMPU_METHOD COMP_0144_S "3.6_*_2^-22km/h" RAT_FUNC "%8.6" "km/h" COEFFS 0 1 0 0 0 0.000000858307 /end COMPU_METHOD
/begin COMPU_METHOD COMP_0328 "100/(64*256)%" RAT_FUNC "%8.4" "%" COEFFS 0 1 0 0 0 0.006103516 /end COMPU_METHOD
/begin COMPU_METHOD COMP_0148_S "0.01mg" RAT_FUNC "%8.3" "mg" COEFFS 0 1 0 0 0 0.01 /end COMPU_METHOD
/begin COMPU_METHOD COMP_0149_S "0.2A" RAT_FUNC "%8.2" "A" COEFFS 0 1 0 0 0 0.2 /end COMPU_METHOD
/begin COMPU_METHOD COMP_0150_S "0.2A" RAT_FUNC "%8.2" "A" COEFFS 0 1 -0.4 0 0 0.2 /end COMPU_METHOD
/begin COMPU_METHOD COMP_0151_S "400μs" RAT_FUNC "%8.2" "μs" COEFFS 0 1 0 0 0 400 /end COMPU_METHOD
/begin COMPU_METHOD COMP_0125 "1/256ms" RAT_FUNC "%8.4" "ms" COEFFS 0 1 0 0 0 0.00390625 /end COMPU_METHOD
/begin COMPU_METHOD COMP_0157_S "1.6μs" RAT_FUNC "%8.2" "μs" COEFFS 0 1 0 0 0 1.6 /end COMPU_METHOD
/begin COMPU_METHOD COMP_0158_S "0.125X-50℃" RAT_FUNC "%8.2" "℃" COEFFS 0 1 50 0 0 0.125 /end COMPU_METHOD
/begin COMPU_METHOD COMP_0160_S "0.1/32%" RAT_FUNC "%8.4" "%" COEFFS 0 1 0 0 0 0.003125 /end COMPU_METHOD
/begin COMPU_METHOD COMP_0162_S "0.78125rpm" RAT_FUNC "%8.2" "rpm" COEFFS 0 1 0 0 0 0.78125 /end COMPU_METHOD
/begin COMPU_METHOD COMP_0165_S "4μs" RAT_FUNC "%8.2" "μs" COEFFS 0 1 -4 0 0 4 /end COMPU_METHOD
/begin COMPU_METHOD COMP_0166_S "0.25μs" RAT_FUNC "%8.2" "μs" COEFFS 0 1 -0.5 0 0 0.25 /end COMPU_METHOD
/begin COMPU_METHOD COMP_0189 "3.2μS" RAT_FUNC "%8.2" "μS" COEFFS 0 1 0 0 0 3.2 /end COMPU_METHOD
/begin COMPU_METHOD COMP_0167_S "40μs" RAT_FUNC "%8.2" "μs" COEFFS 0 1 0 0 0 40 /end COMPU_METHOD
/begin COMPU_METHOD COMP_0168_S "0.2A" RAT_FUNC "%8.2" "A" COEFFS 0 1 -4.4 0 0 0.2 /end COMPU_METHOD
/begin COMPU_METHOD COMP_0169_S "4μs" RAT_FUNC "%8.2" "μs" COEFFS 0 1 0 0 0 4 /end COMPU_METHOD
/begin COMPU_METHOD COMP_0170_S "20μs" RAT_FUNC "%8.2" "μs" COEFFS 0 1 0 0 0 20 /end COMPU_METHOD
/begin COMPU_METHOD COMP_0025 "0.5step" RAT_FUNC "%8.2" "step" COEFFS 0 1 0 0 0 0.5 /end COMPU_METHOD
/begin COMPU_METHOD COMP_0172_S "2^-1degCA" RAT_FUNC "%8.2" "degCA" COEFFS 0 1 0 0 0 0.5 /end COMPU_METHOD
/begin COMPU_METHOD COMP_0028 "1/(100*256)-" RAT_FUNC "%8.6" "-" COEFFS 0 1 0 0 0 0.0000390625 /end COMPU_METHOD
/begin COMPU_METHOD COMP_0447 "100/1024%" RAT_FUNC "%8.3" "%" COEFFS 0 1 0 0 0 0.09765625 /end COMPU_METHOD
/begin COMPU_METHOD COMP_0174_S "1deg/50rp" RAT_FUNC "%8.2" "deg/50rp" COEFFS 0 1 0 0 0 1 /end COMPU_METHOD
/begin COMPU_METHOD COMP_0062 "4℃" RAT_FUNC "%8.2" "℃" COEFFS 0 1 0 0 0 4 /end COMPU_METHOD
/begin COMPU_METHOD COMP_0183_S "1/64deg/10℃" RAT_FUNC "%8.3" "deg/10℃" COEFFS 0 1 0 0 0 0.015625 /end COMPU_METHOD
/begin COMPU_METHOD COMP_0184_S "0.1%/100ms" RAT_FUNC "%8.2" "%/100ms" COEFFS 0 1 0 0 0 0.1 /end COMPU_METHOD
/begin COMPU_METHOD COMP_0187_S "10/256%" RAT_FUNC "%8.3" "%" COEFFS 0 1 0 0 0 0.0390625 /end COMPU_METHOD
/begin COMPU_METHOD COMP_0472 "1/64-" RAT_FUNC "%8.3" "-" COEFFS 0 1 0 0 0 0.015625 /end COMPU_METHOD
/begin COMPU_METHOD COMP_0389 "1/2548km" RAT_FUNC "%8.5" "km" COEFFS 0 1 0 0 0 0.000392465 /end COMPU_METHOD
/begin COMPU_METHOD COMP_0194_S "1TRIP" RAT_FUNC "%8.2" "TRIP" COEFFS 0 1 0 0 0 1 /end COMPU_METHOD
/begin COMPU_METHOD COMP_0254 "1/16deg/%" RAT_FUNC "%8.3" "deg/%" COEFFS 0 1 0 0 0 0.0625 /end COMPU_METHOD
/begin COMPU_METHOD COMP_0195_S "0.1deg" RAT_FUNC "%8.2" "deg" COEFFS 0 1 0 0 0 0.1 /end COMPU_METHOD
/begin COMPU_METHOD COMP_0198_S "2^-10%" RAT_FUNC "%8.5" "%" COEFFS 0 1 0 0 0 0.000976563 /end COMPU_METHOD
/begin COMPU_METHOD COMP_0200_S "10%" RAT_FUNC "%8.2" "%" COEFFS 0 1 0 0 0 10 /end COMPU_METHOD
/begin COMPU_METHOD COMP_0022 "20mv" RAT_FUNC "%8.2" "mv" COEFFS 0 1 0 0 0 20 /end COMPU_METHOD
/begin COMPU_METHOD COMP_0204_S "100A100ms" RAT_FUNC "%8.2" "A100ms" COEFFS 0 1 0 0 0 100 /end COMPU_METHOD
/begin COMPU_METHOD COMP_0209_S "100/32768%" RAT_FUNC "%8.4" "%" COEFFS 0 1 0 0 0 0.003051757 /end COMPU_METHOD
/begin COMPU_METHOD COMP_0210_S "0.5Nm" RAT_FUNC "%8.2" "Nm" COEFFS 0 1 64 0 0 0.5 /end COMPU_METHOD
/begin COMPU_METHOD COMP_0293 "2L/min" RAT_FUNC "%8.2" "L/min" COEFFS 0 1 0 0 0 2 /end COMPU_METHOD
/begin COMPU_METHOD COMP_0092 "1bit" RAT_FUNC "%8.2" "bit" COEFFS 0 1 0 0 0 1 /end COMPU_METHOD
/begin COMPU_METHOD COMP_0425 "100/255%" RAT_FUNC "%8.2" "%" COEFFS 0 1 0 0 0 0.392156862 /end COMPU_METHOD
/begin COMPU_METHOD COMP_0476 "12.5/64rpm" RAT_FUNC "%8.2" "rpm" COEFFS 0 1 0 0 0 0.1953125 /end COMPU_METHOD
/begin COMPU_METHOD COMP_0470 "1km" RAT_FUNC "%8.2" "km" COEFFS 0 1 0 0 0 1 /end COMPU_METHOD
/begin COMPU_METHOD COMP_0238_S "0.01km/h" RAT_FUNC "%8.3" "km/h" COEFFS 0 1 0 0 0 0.01 /end COMPU_METHOD
/begin COMPU_METHOD COMP_0249_S "0.1A" RAT_FUNC "%8.2" "A" COEFFS 0 1 0 0 0 0.1 /end COMPU_METHOD
/begin COMPU_METHOD COMP_0314 "X-128deg" RAT_FUNC "%8.2" "deg" COEFFS 0 1 128 0 0 1 /end COMPU_METHOD
/begin COMPU_METHOD COMP_0073 "3.2us" RAT_FUNC "%8.2" "us" COEFFS 0 1 0 0 0 3.2 /end COMPU_METHOD
/begin COMPU_METHOD COMP_0320 "1.6μS" RAT_FUNC "%8.2" "μS" COEFFS 0 1 0 0 0 1.6 /end COMPU_METHOD
/begin COMPU_METHOD COMP_0265_S "0.005-" RAT_FUNC "%8.4" "-" COEFFS 0 1 0 0 0 0.005 /end COMPU_METHOD
/begin COMPU_METHOD COMP_0410 "100/256/256%" RAT_FUNC "%8.4" "%" COEFFS 0 1 0 0 0 0.00152588 /end COMPU_METHOD
/begin COMPU_METHOD COMP_0245 "X-64deg" RAT_FUNC "%8.2" "deg" COEFFS 0 1 64 0 0 1 /end COMPU_METHOD
/begin COMPU_METHOD COMP_0300_S "0.5degCA/se" RAT_FUNC "%8.2" "degCA/se" COEFFS 0 1 0 0 0 0.5 /end COMPU_METHOD
/begin COMPU_METHOD COMP_0304_S "0.000016kg/s" RAT_FUNC "%8.6" "kg/s" COEFFS 0 1 0 0 0 0.000016 /end COMPU_METHOD
/begin COMPU_METHOD COMP_0226 "0.1Nm" RAT_FUNC "%8.2" "Nm" COEFFS 0 1 3276.8 0 0 0.1 /end COMPU_METHOD
/begin COMPU_METHOD COMP_0309_S "0.5X-27.5%" RAT_FUNC "%8.2" "%" COEFFS 0 1 27.5 0 0 0.5 /end COMPU_METHOD
/begin COMPU_METHOD COMP_0311_S "0.000008kg/s" RAT_FUNC "%8.6" "kg/s" COEFFS 0 1 0.262144 0 0 0.000008 /end COMPU_METHOD
/begin COMPU_METHOD COMP_0246 "100/16%" RAT_FUNC "%8.2" "%" COEFFS 0 1 0 0 0 6.25 /end COMPU_METHOD
/begin COMPU_METHOD COMP_0327_S "0.002-" RAT_FUNC "%8.4" "-" COEFFS 0 1 65.536 0 0 0.002 /end COMPU_METHOD
/begin COMPU_METHOD COMP_0258 "100/2048%" RAT_FUNC "%8.3" "%" COEFFS 0 1 0 0 0 0.048828125 /end COMPU_METHOD
/begin COMPU_METHOD COMP_0334_S "100/4096%" RAT_FUNC "%8.3" "%" COEFFS 0 1 0 0 0 0.0244141 /end COMPU_METHOD
/begin COMPU_METHOD COMP_0341 "1/256-" RAT_FUNC "%8.4" "-" COEFFS 0 1 0 0 0 0.00391 /end COMPU_METHOD
/begin COMPU_METHOD COMP_0365_S "64/256deg" RAT_FUNC "%8.2" "deg" COEFFS 0 1 0 0 0 0.25 /end COMPU_METHOD
/begin COMPU_METHOD COMP_0401_S "fixed axis ms" RAT_FUNC "%8.2" "ms" COEFFS 0 1 0 0 0 2 /end COMPU_METHOD
/begin COMPU_METHOD COMP_0428_S "0.01%" RAT_FUNC "%8.3" "%" COEFFS 0 1 327.68 0 0 0.01 /end COMPU_METHOD
/begin COMPU_METHOD COMP_0429_S "1/50-" RAT_FUNC "%8.3" "-" COEFFS 0 1 0 0 0 0.02 /end COMPU_METHOD
/begin COMPU_METHOD COMP_0323 "1.25X-200℃" RAT_FUNC "%8.2" "℃" COEFFS 0 1 200 0 0 1.25 /end COMPU_METHOD
/begin COMPU_METHOD COMP_0457_S "1.28*10^6mV^2" RAT_FUNC "%8.2" "mV^2" COEFFS 0 1 0 0 0 1280000 /end COMPU_METHOD
/begin COMPU_METHOD COMP_0324 "2/256L/min" RAT_FUNC "%8.4" "L/min" COEFFS 0 1 0 0 0 0.0078125 /end COMPU_METHOD
/begin COMPU_METHOD COMP_0467_S "minmin" RAT_FUNC "%8.2" "min" COEFFS 0 1 0 0 0 1 /end COMPU_METHOD
/begin COMPU_METHOD COMP_0427 "0.25rpm" RAT_FUNC "%8.2" "rpm" COEFFS 0 1 0 0 0 0.25 /end COMPU_METHOD
/begin COMPU_METHOD COMP_0428 "X-40℃" RAT_FUNC "%8.2" "℃" COEFFS 0 1 40 0 0 1 /end COMPU_METHOD
/begin COMPU_METHOD COMP_0480_S "11" RAT_FUNC "%8.2" "1" COEFFS 0 1 0 0 0 1 /end COMPU_METHOD
/begin COMPU_METHOD COMP_0482_S "MPaMPa" RAT_FUNC "%8.4" "MPa" COEFFS 0 1 0.098 0 0 0.003847 /end COMPU_METHOD
/begin COMPU_METHOD COMP_0483_S "%%" RAT_FUNC "%8.4" "%" COEFFS 0 1 0 0 0 0.00305176 /end COMPU_METHOD
/begin COMPU_METHOD COMP_0421 "1気筒" RAT_FUNC "%8.2" "気筒" COEFFS 0 1 0 0 0 1 /end COMPU_METHOD
/begin COMPU_METHOD COMP_0264 "1－" RAT_FUNC "%8.2" "－" COEFFS 0 1 0 0 0 1 /end COMPU_METHOD
/begin COMPU_METHOD COMP_0376 "0.1μS" RAT_FUNC "%8.2" "μS" COEFFS 0 1 0 0 0 0.1 /end COMPU_METHOD
/begin COMPU_METHOD COMP_0497_S "NmNm" RAT_FUNC "%8.2" "Nm" COEFFS 0 1 100 0 0 2 /end COMPU_METHOD
/begin COMPU_METHOD COMP_0269 "0.5/256%" RAT_FUNC "%8.4" "%" COEFFS 0 1 0 0 0 0.001953125 /end COMPU_METHOD
/begin COMPU_METHOD COMP_0499_S "%%" RAT_FUNC "%8.4" "%" COEFFS 0 1 0 0 0 0.00305176 /end COMPU_METHOD
/begin COMPU_METHOD COMP_0390 "10deg" RAT_FUNC "%8.2" "deg" COEFFS 0 1 0 0 0 10 /end COMPU_METHOD
/begin COMPU_METHOD COMP_0521_S "μsμs" RAT_FUNC "%8.2" "μs" COEFFS 0 1 0 0 0 0.1 /end COMPU_METHOD
/begin COMPU_METHOD COMP_0522_S "cyl(BIT位置)cyl(BIT" RAT_FUNC "%8.2" "cyl(BIT" COEFFS 0 1 0 0 0 1 /end COMPU_METHOD
/begin COMPU_METHOD COMP_0523_S "%%" RAT_FUNC "%8.5" "%" COEFFS 0 1 0 0 0 0.0009766 /end COMPU_METHOD
/begin COMPU_METHOD COMP_0525_S "kjkj" RAT_FUNC "%8.5" "kj" COEFFS 0 1 0 0 0 0.0001 /end COMPU_METHOD
/begin COMPU_METHOD COMP_0438 "1/256%" RAT_FUNC "%8.4" "%" COEFFS 0 1 0 0 0 0.00390625 /end COMPU_METHOD
/begin COMPU_METHOD COMP_0530_S "rpmrpm" RAT_FUNC "%8.3" "rpm" COEFFS 0 1 0 0 0 0.048828125 /end COMPU_METHOD
/begin COMPU_METHOD COMP_0531_S "kPakPa" RAT_FUNC "%8.4" "kPa" COEFFS 0 1 0 0 0 0.00390625 /end COMPU_METHOD
/begin COMPU_METHOD COMP_0545_S "timestimes" RAT_FUNC "%8.2" "times" COEFFS 0 1 0 0 0 1 /end COMPU_METHOD
/begin COMPU_METHOD COMP_0415 "1/256－" RAT_FUNC "%8.4" "－" COEFFS 0 1 0 0 0 0.00390625 /end COMPU_METHOD
/begin COMPU_METHOD COMP_0556_S "--" RAT_FUNC "%8.4" "-" COEFFS 0 1 0 0 0 0.004 /end COMPU_METHOD
/begin COMPU_METHOD COMP_0559_S "1/rpm・cc1/rpm・c" RAT_FUNC "%8.6" "1/rpm・c" COEFFS 0 1 0 0 0 0.0000000002218 /end COMPU_METHOD
/begin COMPU_METHOD COMP_0560_S "GG" RAT_FUNC "%8.6" "G" COEFFS 0 1 1.89069934592 0 0 0.0000000564575 /end COMPU_METHOD
/begin COMPU_METHOD COMP_0433 "0.1μS" RAT_FUNC "%8.2" "μS" COEFFS 0 1 0 0 0 0.1 /end COMPU_METHOD
/begin COMPU_METHOD COMP_0397 "20mV" RAT_FUNC "%8.2" "mV" COEFFS 0 1 0 0 0 20 /end COMPU_METHOD
/begin COMPU_METHOD COMP_0561_S "AA" RAT_FUNC "%8.2" "A" COEFFS 0 1 0 0 0 0.1 /end COMPU_METHOD
/begin COMPU_METHOD COMP_0562_S "km/hkm/h" RAT_FUNC "%8.6" "km/h" COEFFS 0 1 0 0 0 0.00000152588 /end COMPU_METHOD
/begin COMPU_METHOD COMP_0563_S "℃℃" RAT_FUNC "%8.4" "℃" COEFFS 0 1 50 0 0 0.00391 /end COMPU_METHOD
/begin COMPU_METHOD COMP_0564_S "mV^2*4msmV^2*4ms" RAT_FUNC "%8.2" "mV^2*4ms" COEFFS 0 1 0 0 0 1280 /end COMPU_METHOD
/begin COMPU_METHOD COMP_0565_S "rpm*msrpm*ms" RAT_FUNC "%8.2" "rpm*ms" COEFFS 0 1 0 0 0 0.1953125 /end COMPU_METHOD
/begin COMPU_METHOD COMP_0566_S "AA" RAT_FUNC "%8.6" "A" COEFFS 0 1 0 0 0 0.000007629 /end COMPU_METHOD
/begin COMPU_METHOD COMP_0567_S "AA" RAT_FUNC "%8.6" "A" COEFFS 0 1 0 0 0 0.0000038147 /end COMPU_METHOD
/begin COMPU_METHOD COMP_0568_S "AA" RAT_FUNC "%8.4" "A" COEFFS 0 1 0 0 0 0.001 /end COMPU_METHOD
/begin COMPU_METHOD COMP_0569_S "msms" RAT_FUNC "%8.5" "ms" COEFFS 0 1 0 0 0 0.000488282 /end COMPU_METHOD
/begin COMPU_METHOD COMP_0570_S "degdeg" RAT_FUNC "%8.4" "deg" COEFFS 0 1 128 0 0 0.00390625 /end COMPU_METHOD
/begin COMPU_METHOD COMP_0571_S "--" RAT_FUNC "%8.5" "-" COEFFS 0 1 15.999991808 0 0 0.000488281 /end COMPU_METHOD
/begin COMPU_METHOD COMP_0444 "1/256L/min" RAT_FUNC "%8.4" "L/min" COEFFS 0 1 0 0 0 0.00390625 /end COMPU_METHOD
/begin COMPU_METHOD COMP_0572_S "L/minL/min" RAT_FUNC "%8.6" "L/min" COEFFS 0 1 0 0 0 0.000015258 /end COMPU_METHOD
/begin COMPU_METHOD COMP_0573_S "L/minL/min" RAT_FUNC "%8.4" "L/min" COEFFS 0 1 0 0 0 0.00390625 /end COMPU_METHOD
/begin COMPU_METHOD COMP_0408 "5mv" RAT_FUNC "%8.2" "mv" COEFFS 0 1 0 0 0 5 /end COMPU_METHOD
/begin COMPU_METHOD COMP_0574_S "rad/ssrad/ss" RAT_FUNC "%8.3" "rad/ss" COEFFS 0 1 0 0 0 0.015625 /end COMPU_METHOD
/begin COMPU_METHOD COMP_0575_S "mVmV" RAT_FUNC "%8.2" "mV" COEFFS 0 1 0 0 0 0.4 /end COMPU_METHOD
/begin COMPU_METHOD COMP_0576_S "deg/Mpadeg/Mpa" RAT_FUNC "%8.4" "deg/Mpa" COEFFS 0 1 0 0 0 0.00390625 /end COMPU_METHOD
/begin COMPU_METHOD COMP_0454 "(1/256)X-2147483648－" RAT_FUNC "%8.4" "－" COEFFS 0 1 8388608 0 0 0.00390625 /end COMPU_METHOD
/begin COMPU_METHOD COMP_0455 "1/(64*256)-" RAT_FUNC "%8.6" "-" COEFFS 0 1 0 0 0 0.0000610352 /end COMPU_METHOD
/begin COMPU_METHOD COMP_0577_S "--" RAT_FUNC "%8.4" "-" COEFFS 0 1 0 0 0 0.0078125 /end COMPU_METHOD
/begin COMPU_METHOD COMP_0578_S "MPaMPa" RAT_FUNC "%8.4" "MPa" COEFFS 0 1 0 0 0 0.001 /end COMPU_METHOD
/begin COMPU_METHOD COMP_0337 "0.8Nm" RAT_FUNC "%8.2" "Nm" COEFFS 0 1 0 0 0 0.8 /end COMPU_METHOD
/begin COMPU_METHOD COMP_0579_S "gg" RAT_FUNC "%8.6" "g" COEFFS 0 1 0 0 0 0.0000138889 /end COMPU_METHOD
/begin COMPU_METHOD COMP_0460 "50/65536－" RAT_FUNC "%8.5" "－" COEFFS 0 1 0 0 0 0.000762939 /end COMPU_METHOD
/begin COMPU_METHOD COMP_0580_S "(μS)^-2(ms)^-1(μS)^-2" RAT_FUNC "%8.2" "(μS)^-2" COEFFS 0 1 128 0 0 1 /end COMPU_METHOD
/begin COMPU_METHOD COMP_0581_S "%/100ms%/100ms" RAT_FUNC "%8.5" "%/100ms" COEFFS 0 1 0 0 0 0.0009766 /end COMPU_METHOD
/begin COMPU_METHOD COMP_0463 "1/256-" RAT_FUNC "%8.2" "-" COEFFS 0 1 0 0 0 0.392156862 /end COMPU_METHOD
/begin COMPU_METHOD COMP_0176 "1/64ms" RAT_FUNC "%8.3" "ms" COEFFS 0 1 0 0 0 0.015625 /end COMPU_METHOD
/begin COMPU_METHOD COMP_0582_S "kmkm" RAT_FUNC "%8.2" "km" COEFFS 0 1 0 0 0 25.7 /end COMPU_METHOD
/begin COMPU_METHOD COMP_0468 "1ﾟC" RAT_FUNC "%8.2" "ﾟC" COEFFS 0 1 40 0 0 1 /end COMPU_METHOD
/begin COMPU_METHOD COMP_0471 "1/16deg" RAT_FUNC "%8.3" "deg" COEFFS 0 1 0 0 0 0.0625 /end COMPU_METHOD
/begin COMPU_METHOD COMP_0583_S "(μS)^-2(ms)^-1(μS)^-2" RAT_FUNC "%8.2" "(μS)^-2" COEFFS 0 1 0 0 0 1 /end COMPU_METHOD
/begin COMPU_METHOD COMP_0474 "1.4545*65536μS" RAT_FUNC "%8.2" "μS" COEFFS 0 1 0 0 0 95322.2 /end COMPU_METHOD
/begin COMPU_METHOD COMP_0584_S "CYLCYL" RAT_FUNC "%8.2" "CYL" COEFFS 0 1 0 0 0 1 /end COMPU_METHOD
/begin COMPU_METHOD COMP_0479 "312.5rpm・cc" RAT_FUNC "%8.2" "rpm・cc" COEFFS 0 1 0 0 0 312.5 /end COMPU_METHOD
/begin COMPU_METHOD COMP_0480 "6.25rpm" RAT_FUNC "%8.2" "rpm" COEFFS 0 1 0 0 0 6.25 /end COMPU_METHOD
/begin COMPU_METHOD COMP_0585_S "--" RAT_FUNC "%8.6" "-" COEFFS 0 1 0 0 0 0.000016276 /end COMPU_METHOD
/begin COMPU_METHOD COMP_0586_S "degdeg" RAT_FUNC "%8.4" "deg" COEFFS 0 1 0 0 0 0.00308232 /end COMPU_METHOD
/begin COMPU_METHOD COMP_0385 "1.608km" RAT_FUNC "%8.2" "km" COEFFS 0 1 0 0 0 1.608 /end COMPU_METHOD
/begin COMPU_METHOD COMP_0483 "8ms" RAT_FUNC "%8.2" "ms" COEFFS 0 1 0 0 0 8 /end COMPU_METHOD
/begin COMPU_METHOD COMP_0423 "100/128%" RAT_FUNC "%8.2" "%" COEFFS 0 1 50 0 0 0.390625 /end COMPU_METHOD
/begin COMPU_METHOD COMP_0265 "1/4096%" RAT_FUNC "%8.5" "%" COEFFS 0 1 8.000012288 0 0 0.000244141 /end COMPU_METHOD
/begin COMPU_METHOD COMP_0587_S "mg/10msmg/10ms" RAT_FUNC "%8.3" "mg/10ms" COEFFS 0 1 0 0 0 0.01 /end COMPU_METHOD
/begin COMPU_METHOD COMP_0588_S "--" RAT_FUNC "%8.4" "-" COEFFS 0 1 0 0 0 0.001953 /end COMPU_METHOD
/begin COMPU_METHOD COMP_0589_S "%%" RAT_FUNC "%8.4" "%" COEFFS 0 1 102.4 0 0 0.003125 /end COMPU_METHOD
/end MODULE
/end PROJECT
