/begin PROJECT X12C_KH3DT_DI_NAM_R/C ""
/begin HEADER "" /* key HEADER ++ "comment" に Par.scomment */ PROJECT_NO X12C_KH3DT_DI_NAM_R/C /* key PROJECT_NO ++ project number に car_eng_desti_lot */ VERSION "0KHDCFDZ7" /* key VERSION ++ version number に mProgver */ /end HEADER
/begin MODULE DIM ""
/begin MOD_COMMON "" ALIGNMENT_BYTE 1 ALIGNMENT_WORD 2 ALIGNMENT_LONG 4 ALIGNMENT_FLOAT32_IEEE 4 ALIGNMENT_FLOAT64_IEEE 4 DEPOSIT ABSOLUTE BYTE_ORDER MSB_FIRST /* ﾊﾞｲﾄｵｰﾀﾞｰがﾘﾌﾟﾚｰｽされる */ /end MOD_COMMON
/begin MEASUREMENT wvDNE019FL "RAM value wvDNE019FL" SBYTE COMP_0533_S 1 100 -25 24.8046875 ECU_ADDRESS 0xFFFF20E0 READ_WRITE /end MEASUREMENT
/begin MEASUREMENT wvDNEREF "RAM value wvDNEREF" SWORD COMP_0534_S 1 100 -102400 102396.875 ECU_ADDRESS 0xFFFF091E READ_WRITE /end MEASUREMENT
/begin MEASUREMENT wvDNEREFFL "RAM value wvDNEREFFL" SWORD COMP_0534_S 1 100 -102400 102396.875 ECU_ADDRESS 0xFFFF0920 READ_WRITE /end MEASUREMENT
/begin MEASUREMENT wvDPAMB "RAM value wvDPAMB" UWORD COMP_0050 1 100 0 5119.921875 ECU_ADDRESS 0xFFFF1EFA READ_WRITE /end MEASUREMENT
/begin MEASUREMENT wvDRIVMCAN "RAM value wvDRIVMCAN" UBYTE COMP_0068 1 100 0 255 ECU_ADDRESS 0xFFFF1EFC READ_WRITE /end MEASUREMENT
/begin MEASUREMENT wvDSP "RAM value wvDSP" UWORD COMP_0436 1 100 0 6553.5 ECU_ADDRESS 0xFFFF1EFE READ_WRITE /end MEASUREMENT
/begin MEASUREMENT wvDSPDISP "RAM value wvDSPDISP" UWORD COMP_0238_S 1 100 0 655.35 ECU_ADDRESS 0xFFFF1F00 READ_WRITE /end MEASUREMENT
/begin MEASUREMENT wvDSPDISP0 "RAM value wvDSPDISP0" UWORD COMP_0238_S 1 100 0 655.35 ECU_ADDRESS 0xFFFF1F02 READ_WRITE /end MEASUREMENT
/begin MEASUREMENT wvDTVO30 "RAM value wvDTVO30" UBYTE COMP_0127 1 100 -44.8 44.45 ECU_ADDRESS 0xFFFF1F04 READ_WRITE /end MEASUREMENT
/begin MEASUREMENT wvDTVOP "RAM value wvDTVOP" UBYTE COMP_0026_S 1 100 0 89.25 ECU_ADDRESS 0xFFFF087A READ_WRITE /end MEASUREMENT
/begin MEASUREMENT wvDTWF "RAM value wvDTWF" UBYTE COMP_0044 1 100 0 1.9921875 ECU_ADDRESS 0xFFFF087B READ_WRITE /end MEASUREMENT
/begin MEASUREMENT wvDVLRX "RAM value wvDVLRX" UBYTE COMP_0541_S 1 100 0 2550 ECU_ADDRESS 0xFFFF1F05 READ_WRITE /end MEASUREMENT
/begin MEASUREMENT wvDVRLX "RAM value wvDVRLX" UBYTE COMP_0541_S 1 100 0 2550 ECU_ADDRESS 0xFFFF1F06 READ_WRITE /end MEASUREMENT
/begin MEASUREMENT wvEGT12 "RAM value wvEGT12" UWORD COMP_0405_S 1 100 0 1310.7 ECU_ADDRESS 0xFFFF1F08 READ_WRITE /end MEASUREMENT
/begin MEASUREMENT wvENGSTRT "RAM value wvENGSTRT" ULONG COMP_0008 1 100 0 429496729500 ECU_ADDRESS 0xFFFF087C READ_WRITE /end MEASUREMENT
/begin MEASUREMENT wvESPTQTYP "RAM value wvESPTQTYP" UBYTE COMP_0068 1 100 0 255 ECU_ADDRESS 0xFFFF1F0C READ_WRITE /end MEASUREMENT
/begin MEASUREMENT wvETQETSC "RAM value wvETQETSC" SWORD COMP_0228 1 100 -3276.8 3276.7 ECU_ADDRESS 0xFFFF1F0E READ_WRITE /end MEASUREMENT
/begin MEASUREMENT wvETSTQCTT "RAM value wvETSTQCTT" UBYTE COMP_0014 1 100 0 2550 ECU_ADDRESS 0xFFFF1F10 READ_WRITE /end MEASUREMENT
/begin MEASUREMENT wvEVPRES "RAM value wvEVPRES" UWORD COMP_0050 1 100 0 5119.921875 ECU_ADDRESS 0xFFFF0880 READ_WRITE /end MEASUREMENT
/begin MEASUREMENT wvEVPRES2 "RAM value wvEVPRES2" UWORD COMP_0050 1 100 0 5119.921875 ECU_ADDRESS 0xFFFF0882 READ_WRITE /end MEASUREMENT
/begin MEASUREMENT wvEVPSMAX "RAM value wvEVPSMAX" UBYTE COMP_0047 1 100 0 127.5 ECU_ADDRESS 0xFFFF0922 READ_WRITE /end MEASUREMENT
/begin MEASUREMENT wvFADV "RAM value wvFADV" UBYTE COMP_0017 1 100 0 255 ECU_ADDRESS 0xFFFF0923 READ_WRITE /end MEASUREMENT
/begin MEASUREMENT wvFAFSACTf "RAM value wvFAFSACTf" UBYTE COMP_0004 1 100 0 255 ECU_ADDRESS 0xFFFF1F11 READ_WRITE /end MEASUREMENT
/begin MEASUREMENT wvFGAGE2 "RAM value wvFGAGE2" UWORD COMP_0050 1 100 0 5119.921875 ECU_ADDRESS 0xFFFF1F12 READ_WRITE /end MEASUREMENT
/begin MEASUREMENT wvFGAGE3 "RAM value wvFGAGE3" UWORD COMP_0050 1 100 0 5119.921875 ECU_ADDRESS 0xFFFF1F14 READ_WRITE /end MEASUREMENT
/begin MEASUREMENT wvFGEND "RAM value wvFGEND" UWORD COMP_0050 1 100 0 5119.921875 ECU_ADDRESS 0xFFFF43D2 READ_WRITE /end MEASUREMENT
/begin MEASUREMENT wvFGN "RAM value wvFGN" UWORD COMP_0050 1 100 0 5119.921875 ECU_ADDRESS 0xFFFF1F16 READ_WRITE /end MEASUREMENT
/begin MEASUREMENT wvFMAD "RAM value wvFMAD" UWORD COMP_0023 1 100 0 327675 ECU_ADDRESS 0xFFFF1F18 READ_WRITE /end MEASUREMENT
/begin MEASUREMENT wvFMRCPC1f "RAM value wvFMRCPC1f" UBYTE COMP_0004 1 100 0 255 ECU_ADDRESS 0xFFFF1F1A READ_WRITE /end MEASUREMENT
/begin MEASUREMENT wvFMRCPC2f "RAM value wvFMRCPC2f" UBYTE COMP_0004 1 100 0 255 ECU_ADDRESS 0xFFFF1F1B READ_WRITE /end MEASUREMENT
/begin MEASUREMENT wvFNRPM "RAM value wvFNRPM" UWORD COMP_0006 1 100 0 819187.5 ECU_ADDRESS 0xFFFF0884 READ_WRITE /end MEASUREMENT
/begin MEASUREMENT wvFNRPM2 "RAM value wvFNRPM2" UBYTE COMP_0006 1 100 0 3187.5 ECU_ADDRESS 0xFFFF1F1C READ_WRITE /end MEASUREMENT
/begin MEASUREMENT wvFRWIP "RAM value wvFRWIP" UBYTE COMP_0068 1 100 0 255 ECU_ADDRESS 0xFFFF1E51 READ_WRITE /end MEASUREMENT
/begin MEASUREMENT wvFSO2Sf "RAM value wvFSO2Sf" UBYTE COMP_0004 1 100 0 255 ECU_ADDRESS 0xFFFF0924 READ_WRITE /end MEASUREMENT
/begin MEASUREMENT wvFSTDREF "RAM value wvFSTDREF" UBYTE COMP_0068 1 100 0 255 ECU_ADDRESS 0xFFFF0925 READ_WRITE /end MEASUREMENT
/begin MEASUREMENT wvFWSPFT "RAM value wvFWSPFT" UBYTE COMP_0014 1 100 0 2550 ECU_ADDRESS 0xFFFF1F1D READ_WRITE /end MEASUREMENT
/begin MEASUREMENT wvGLRNOK "RAM value wvGLRNOK" UBYTE COMP_0068 1 100 0 255 ECU_ADDRESS 0xFFFF43D4 READ_WRITE /end MEASUREMENT
/begin MEASUREMENT wvGOFFSET "RAM value wvGOFFSET" UWORD COMP_0136_S 1 100 -1.8907 240.5888 ECU_ADDRESS 0xFFFF43D6 READ_WRITE /end MEASUREMENT
/begin MEASUREMENT wvGOFSDEP "RAM value wvGOFSDEP" UWORD COMP_0136_S 1 100 -1.8907 240.5888 ECU_ADDRESS 0xFFFF43D8 READ_WRITE /end MEASUREMENT
/begin MEASUREMENT wvGSENVAL "RAM value wvGSENVAL" UWORD COMP_0136_S 1 100 -1.8907 240.5888 ECU_ADDRESS 0xFFFF1F1E READ_WRITE /end MEASUREMENT
/begin MEASUREMENT wvHNRPM "RAM value wvHNRPM" UBYTE COMP_0020 1 100 0 12750 ECU_ADDRESS 0xFFFF0926 READ_WRITE /end MEASUREMENT
/begin MEASUREMENT wvHNRPM10 "RAM value wvHNRPM10" UBYTE COMP_0020 1 100 0 12750 ECU_ADDRESS 0xFFFF0886 READ_WRITE /end MEASUREMENT
/begin MEASUREMENT wvHNRPM10Z "RAM value wvHNRPM10Z" UBYTE COMP_0020 1 100 0 12750 ECU_ADDRESS 0xFFFF0887 READ_WRITE /end MEASUREMENT
/begin MEASUREMENT wvHOTIDCNT "RAM value wvHOTIDCNT" UBYTE COMP_0016 1 100 0 255 ECU_ADDRESS 0xFFFF0804 READ_WRITE /end MEASUREMENT
/begin MEASUREMENT wvHRVSP "RAM value wvHRVSP" UWORD COMP_0436 1 100 0 6553.5 ECU_ADDRESS 0xFFFF1F20 READ_WRITE /end MEASUREMENT
/begin MEASUREMENT wvHT "RAM value wvHT" UBYTE COMP_0068 1 100 0 255 ECU_ADDRESS 0xFFFF1F22 READ_WRITE /end MEASUREMENT
/begin MEASUREMENT wvHTARTDR "RAM value wvHTARTDR" UBYTE COMP_0017 1 100 0 255 ECU_ADDRESS 0xFFFF0927 READ_WRITE /end MEASUREMENT
/begin MEASUREMENT wvICOM2 "RAM value wvICOM2" ULONG COMP_0566_S 1 100 0 32766.305493555 ECU_ADDRESS 0xFFFF1DD0 READ_WRITE /end MEASUREMENT
/begin MEASUREMENT wvICTMP1 "RAM value wvICTMP1" UWORD COMP_0023 1 100 0 327675 ECU_ADDRESS 0xFFFF1F28 READ_WRITE /end MEASUREMENT
/begin MEASUREMENT wvICTMP2 "RAM value wvICTMP2" UWORD COMP_0023 1 100 0 327675 ECU_ADDRESS 0xFFFF1F2A READ_WRITE /end MEASUREMENT
/begin MEASUREMENT wvICTMPN1 "RAM value wvICTMPN1" UWORD COMP_0158_S 1 100 -50 8141.875 ECU_ADDRESS 0xFFFF1F2C READ_WRITE /end MEASUREMENT
/begin MEASUREMENT wvICTMPN2 "RAM value wvICTMPN2" UWORD COMP_0158_S 1 100 -50 8141.875 ECU_ADDRESS 0xFFFF1F2E READ_WRITE /end MEASUREMENT
/begin MEASUREMENT wvIDUTY "RAM value wvIDUTY" UWORD COMP_0090_S 1 100 0 13107 ECU_ADDRESS 0xFFFF1DD4 READ_WRITE /end MEASUREMENT
/begin MEASUREMENT wvINDGP "RAM value wvINDGP" UBYTE COMP_0068 1 100 0 255 ECU_ADDRESS 0xFFFF0888 READ_WRITE /end MEASUREMENT
/begin MEASUREMENT wvINPREV "RAM value wvINPREV" UWORD COMP_0443 1 100 0 65535 ECU_ADDRESS 0xFFFF088A READ_WRITE /end MEASUREMENT
/begin MEASUREMENT wvINPREVFL "RAM value wvINPREVFL" UWORD COMP_0443 1 100 0 65535 ECU_ADDRESS 0xFFFF088C READ_WRITE /end MEASUREMENT
/begin MEASUREMENT wvISCV "RAM value wvISCV" UBYTE COMP_0054 1 100 0 5100 ECU_ADDRESS 0xFFFF088E READ_WRITE /end MEASUREMENT
/begin MEASUREMENT wvITAC "RAM value wvITAC" UBYTE COMP_0009 1 100 0 199.21875 ECU_ADDRESS 0xFFFF080C READ_WRITE /end MEASUREMENT
/begin MEASUREMENT wvITAC_F "RAM value wvITAC_F" UBYTE COMP_0009 1 100 0 199.21875 ECU_ADDRESS 0xFFFF080D READ_WRITE /end MEASUREMENT
/begin MEASUREMENT wvITAN "RAM value wvITAN" UBYTE COMP_0009 1 100 0 199.21875 ECU_ADDRESS 0xFFFF088F READ_WRITE /end MEASUREMENT
/begin MEASUREMENT wvITAN_F "RAM value wvITAN_F" UBYTE COMP_0009 1 100 0 199.21875 ECU_ADDRESS 0xFFFF0890 READ_WRITE /end MEASUREMENT
/begin MEASUREMENT wvKAJYU1 "RAM value wvKAJYU1" UWORD COMP_0069 1 100 0 1.999970916 ECU_ADDRESS 0xFFFF0892 READ_WRITE /end MEASUREMENT
/begin MEASUREMENT wvKDSP "RAM value wvKDSP" UWORD COMP_0436 1 100 0 6553.5 ECU_ADDRESS 0xFFFF1F30 READ_WRITE /end MEASUREMENT
/begin MEASUREMENT wvKNFIL1 "RAM value wvKNFIL1" UBYTE COMP_0054 1 100 0 5100 ECU_ADDRESS 0xFFFF20EB READ_WRITE /end MEASUREMENT
/begin MEASUREMENT wvKNRPM "RAM value wvKNRPM" UWORD COMP_0064 1 100 0 102398.4375 ECU_ADDRESS 0xFFFF0928 READ_WRITE /end MEASUREMENT
/begin MEASUREMENT wvKNRPMQ "RAM value wvKNRPMQ" UWORD COMP_0064 1 100 0 102398.4375 ECU_ADDRESS 0xFFFF1F32 READ_WRITE /end MEASUREMENT
/begin MEASUREMENT wvLFSPRES "RAM value wvLFSPRES" UBYTE COMP_0010 1 100 0 0.765 ECU_ADDRESS 0xFFFF1F34 READ_WRITE /end MEASUREMENT
/begin MEASUREMENT wvLNRPM "RAM value wvLNRPM" UBYTE COMP_0006 1 100 0 3187.5 ECU_ADDRESS 0xFFFF092A READ_WRITE /end MEASUREMENT
/begin MEASUREMENT wvLRVSP "RAM value wvLRVSP" UWORD COMP_0436 1 100 0 6553.5 ECU_ADDRESS 0xFFFF0894 READ_WRITE /end MEASUREMENT
/begin MEASUREMENT wvM96GO "RAM value wvM96GO" UBYTE COMP_0004 1 100 0 255 ECU_ADDRESS 0xFFFF43DA READ_WRITE /end MEASUREMENT
/begin MEASUREMENT wvMDI "RAM value wvMDI" UBYTE COMP_0004 1 100 0 255 ECU_ADDRESS 0xFFFF1F35 READ_WRITE /end MEASUREMENT
/begin MEASUREMENT wvMDIEL "RAM value wvMDIEL" UBYTE COMP_0068 1 100 0 255 ECU_ADDRESS 0xFFFF0896 READ_WRITE /end MEASUREMENT
/begin MEASUREMENT wvMETMSG2T "RAM value wvMETMSG2T" UBYTE COMP_0014 1 100 0 2550 ECU_ADDRESS 0xFFFF1F36 READ_WRITE /end MEASUREMENT
/begin MEASUREMENT wvMFCIGN "RAM value wvMFCIGN" UBYTE COMP_0030 1 100 0 255 ECU_ADDRESS 0xFFFF1DD6 READ_WRITE /end MEASUREMENT
/begin MEASUREMENT wvMFCIGNC "RAM value wvMFCIGNC" UBYTE COMP_0030 1 100 0 255 ECU_ADDRESS 0xFFFF1DD7 READ_WRITE /end MEASUREMENT
/begin MEASUREMENT wvMFCIGND "RAM value wvMFCIGND" UBYTE COMP_0030 1 100 0 255 ECU_ADDRESS 0xFFFF1DD8 READ_WRITE /end MEASUREMENT
/begin MEASUREMENT wvMFCIGNE "RAM value wvMFCIGNE" UBYTE COMP_0030 1 100 0 255 ECU_ADDRESS 0xFFFF1DD9 READ_WRITE /end MEASUREMENT
/begin MEASUREMENT wvMFCIGNG "RAM value wvMFCIGNG" UBYTE COMP_0030 1 100 0 255 ECU_ADDRESS 0xFFFF1DDA READ_WRITE /end MEASUREMENT
/begin MEASUREMENT wvMNRPM "RAM value wvMNRPM" UBYTE COMP_0000 1 100 0 6375 ECU_ADDRESS 0xFFFF092B READ_WRITE /end MEASUREMENT
/begin MEASUREMENT wvMNRPMz10 "RAM value wvMNRPMz10" UBYTE COMP_0000 1 100 0 6375 ECU_ADDRESS 0xFFFF092C READ_WRITE /end MEASUREMENT
/begin MEASUREMENT wvMVSLOPE "RAM value wvMVSLOPE" UWORD COMP_0428_S 1 100 -327.68 327.67 ECU_ADDRESS 0xFFFF1F38 READ_WRITE /end MEASUREMENT
/begin MEASUREMENT wvNE "RAM value wvNE" UWORD COMP_0065 1 100 0 204796.875 ECU_ADDRESS 0xFFFF092E READ_WRITE /end MEASUREMENT
/begin MEASUREMENT wvNEREF0 "RAM value wvNEREF0" UWORD COMP_0476 1 100 0 12799.8046875 ECU_ADDRESS 0xFFFF090C READ_WRITE /end MEASUREMENT
/begin MEASUREMENT wvNEREF125 "RAM value wvNEREF125" UWORD COMP_0006 1 100 0 819187.5 ECU_ADDRESS 0xFFFF0930 READ_WRITE /end MEASUREMENT
/begin MEASUREMENT wvNETARGET "RAM value wvNETARGET" UWORD COMP_0476 1 100 0 12799.8046875 ECU_ADDRESS 0xFFFF0932 READ_WRITE /end MEASUREMENT
/begin MEASUREMENT wvNEXTGP "RAM value wvNEXTGP" UBYTE COMP_0068 1 100 0 255 ECU_ADDRESS 0xFFFF085D READ_WRITE /end MEASUREMENT
/begin MEASUREMENT wvNEXTGP0 "RAM value wvNEXTGP0" UBYTE COMP_0068 1 100 0 255 ECU_ADDRESS 0xFFFF1E52 READ_WRITE /end MEASUREMENT
/begin MEASUREMENT wvNE_S "RAM value wvNE_S" UWORD COMP_0065 1 100 0 204796.875 ECU_ADDRESS 0xFFFF0942 READ_WRITE /end MEASUREMENT
/begin MEASUREMENT wvNRPM "RAM value wvNRPM" UWORD COMP_0006 1 100 0 819187.5 ECU_ADDRESS 0xFFFF0934 READ_WRITE /end MEASUREMENT
/begin MEASUREMENT wvNRPMz5 "RAM value wvNRPMz5" UWORD COMP_0006 1 100 0 819187.5 ECU_ADDRESS 0xFFFF0936 READ_WRITE /end MEASUREMENT
/begin MEASUREMENT wvO2HCUR "RAM value wvO2HCUR" UBYTE COMP_0054 1 100 0 5100 ECU_ADDRESS 0xFFFF1F3A READ_WRITE /end MEASUREMENT
/begin MEASUREMENT wvOFF5 "RAM value wvOFF5" UBYTE COMP_0068 1 100 0 255 ECU_ADDRESS 0xFFFF1F3B READ_WRITE /end MEASUREMENT
/begin MEASUREMENT wvOFMILE "RAM value wvOFMILE" ULONG COMP_0385 1 100 0 6906307410.36 ECU_ADDRESS 0xFFFF43DC READ_WRITE /end MEASUREMENT
/begin MEASUREMENT wvON5 "RAM value wvON5" UBYTE COMP_0068 1 100 0 255 ECU_ADDRESS 0xFFFF1F3C READ_WRITE /end MEASUREMENT
/begin MEASUREMENT wvOURC1 "RAM value wvOURC1" UBYTE COMP_0068 1 100 0 255 ECU_ADDRESS 0xFFFF1F3D READ_WRITE /end MEASUREMENT
/begin MEASUREMENT wvOURC2 "RAM value wvOURC2" UBYTE COMP_0068 1 100 0 255 ECU_ADDRESS 0xFFFF1F3E READ_WRITE /end MEASUREMENT
/begin MEASUREMENT wvOURC3 "RAM value wvOURC3" UBYTE COMP_0068 1 100 0 255 ECU_ADDRESS 0xFFFF1F3F READ_WRITE /end MEASUREMENT
/begin MEASUREMENT wvOURC4 "RAM value wvOURC4" UBYTE COMP_0068 1 100 0 255 ECU_ADDRESS 0xFFFF1F40 READ_WRITE /end MEASUREMENT
/begin MEASUREMENT wvOURC5 "RAM value wvOURC5" UBYTE COMP_0068 1 100 0 255 ECU_ADDRESS 0xFFFF1F41 READ_WRITE /end MEASUREMENT
/begin MEASUREMENT wvOURC6 "RAM value wvOURC6" UBYTE COMP_0068 1 100 0 255 ECU_ADDRESS 0xFFFF1F42 READ_WRITE /end MEASUREMENT
/begin MEASUREMENT wvOUTREV "RAM value wvOUTREV" UWORD COMP_0443 1 100 0 65535 ECU_ADDRESS 0xFFFF0898 READ_WRITE /end MEASUREMENT
/begin MEASUREMENT wvOUTREVFL "RAM value wvOUTREVFL" UWORD COMP_0443 1 100 0 65535 ECU_ADDRESS 0xFFFF089A READ_WRITE /end MEASUREMENT
/begin MEASUREMENT wvPAMB "RAM value wvPAMB" UWORD COMP_0050 1 100 0 5119.921875 ECU_ADDRESS 0xFFFF43E0 READ_WRITE /end MEASUREMENT
/begin MEASUREMENT wvPBADNW "RAM value wvPBADNW" UWORD COMP_0023 1 100 0 327675 ECU_ADDRESS 0xFFFF080E READ_WRITE /end MEASUREMENT
/begin MEASUREMENT wvPBAV "RAM value wvPBAV" UWORD COMP_0023 1 100 0 327675 ECU_ADDRESS 0xFFFF0810 READ_WRITE /end MEASUREMENT
/begin MEASUREMENT wvPBAVMAX "RAM value wvPBAVMAX" UWORD COMP_0120_S 1 100 0 16383.75 ECU_ADDRESS 0xFFFF089C READ_WRITE /end MEASUREMENT
/begin MEASUREMENT wvPDACOF "RAM value wvPDACOF" UBYTE COMP_0011 1 100 0 5.1 ECU_ADDRESS 0xFFFF089E READ_WRITE /end MEASUREMENT
/begin MEASUREMENT wvPDACON "RAM value wvPDACON" UBYTE COMP_0011 1 100 0 5.1 ECU_ADDRESS 0xFFFF089F READ_WRITE /end MEASUREMENT
/begin MEASUREMENT wvPDPREN "RAM value wvPDPREN" UBYTE COMP_0011 1 100 0 5.1 ECU_ADDRESS 0xFFFF1F43 READ_WRITE /end MEASUREMENT
/begin MEASUREMENT wvPFUEL "RAM value wvPFUEL" UWORD COMP_0164 1 100 0 19.988175 ECU_ADDRESS 0xFFFF1DDC READ_WRITE /end MEASUREMENT
/begin MEASUREMENT wvPFUELH "RAM value wvPFUELH" UWORD COMP_0031_S 1 100 0 39.97635 ECU_ADDRESS 0xFFFF1DDE READ_WRITE /end MEASUREMENT
/begin MEASUREMENT wvPGRTCYL "RAM value wvPGRTCYL" UWORD COMP_0198_S 1 100 0 63.999056205 ECU_ADDRESS 0xFFFF1F44 READ_WRITE /end MEASUREMENT
/begin MEASUREMENT wvPMANI "RAM value wvPMANI" UWORD COMP_0034_S 1 100 0 255.99609375 ECU_ADDRESS 0xFFFF1DE0 READ_WRITE /end MEASUREMENT
/begin MEASUREMENT wvPMANI_N "RAM value wvPMANI_N" UWORD COMP_0034_S 1 100 0 255.99609375 ECU_ADDRESS 0xFFFF1DE2 READ_WRITE /end MEASUREMENT
/begin MEASUREMENT wvPPBAV_B "RAM value wvPPBAV_B" UWORD COMP_0120_S 1 100 0 16383.75 ECU_ADDRESS 0xFFFF0812 READ_WRITE /end MEASUREMENT
/begin MEASUREMENT wvPRESS "RAM value wvPRESS" UWORD COMP_0050 1 100 0 5119.921875 ECU_ADDRESS 0xFFFF08A0 READ_WRITE /end MEASUREMENT
/begin MEASUREMENT wvPTDAPOSL "RAM value wvPTDAPOSL" UWORD COMP_0032_S 1 100 0 8191.875 ECU_ADDRESS 0xFFFF1F46 READ_WRITE /end MEASUREMENT
/begin MEASUREMENT wvPTDPWTSP "RAM value wvPTDPWTSP" UWORD COMP_0032_S 1 100 0 8191.875 ECU_ADDRESS 0xFFFF1F48 READ_WRITE /end MEASUREMENT
/begin MEASUREMENT wvPTNHIC "RAM value wvPTNHIC" UBYTE COMP_0020 1 100 0 12750 ECU_ADDRESS 0xFFFF1F4A READ_WRITE /end MEASUREMENT
/begin MEASUREMENT wvQ0TRM "RAM value wvQ0TRM" UWORD COMP_0092_S 1 100 0 1638.375 ECU_ADDRESS 0xFFFF1DE4 READ_WRITE /end MEASUREMENT
/begin MEASUREMENT wvQA4 "RAM value wvQA4" UWORD COMP_0004 1 100 0 65535 ECU_ADDRESS 0xFFFF1E30 READ_WRITE /end MEASUREMENT
/begin MEASUREMENT wvQEXSTPM "RAM value wvQEXSTPM" ULONG COMP_0019_S 1 100 0 16843010.6000859 ECU_ADDRESS 0xFFFF20EC READ_WRITE /end MEASUREMENT
/begin MEASUREMENT wvQH0 "RAM value wvQH0" UBYTE COMP_0032 1 100 0 0.99609375 ECU_ADDRESS 0xFFFF1F4B READ_WRITE /end MEASUREMENT
/begin MEASUREMENT wvQH0QL "RAM value wvQH0QL" UWORD COMP_0146 1 100 0 99.998480265 ECU_ADDRESS 0xFFFF1F4C READ_WRITE /end MEASUREMENT
/begin MEASUREMENT wvQM "RAM value wvQM" UWORD COMP_0004 1 100 0 65535 ECU_ADDRESS 0xFFFF0816 READ_WRITE /end MEASUREMENT
/begin MEASUREMENT wvQSE "RAM value wvQSE" UWORD COMP_0004 1 100 0 65535 ECU_ADDRESS 0xFFFF1F4E READ_WRITE /end MEASUREMENT
/begin MEASUREMENT wvQS_B "RAM value wvQS_B" ULONG COMP_0004 1 100 0 4294967295 ECU_ADDRESS 0xFFFF0818 READ_WRITE /end MEASUREMENT
/begin MEASUREMENT wvRATIO0 "RAM value wvRATIO0" UWORD COMP_0028 1 100 0 2.5599609375 ECU_ADDRESS 0xFFFF0846 READ_WRITE /end MEASUREMENT
/begin MEASUREMENT wvRATIOMT "RAM value wvRATIOMT" UWORD COMP_0450 1 100 0 63.999056205 ECU_ADDRESS 0xFFFF1F50 READ_WRITE /end MEASUREMENT
/begin MEASUREMENT wvRCNTRIP "RAM value wvRCNTRIP" ULONG COMP_0389 1 100 0 1685624.33943218 ECU_ADDRESS 0xFFFF43E4 READ_WRITE /end MEASUREMENT
/begin MEASUREMENT wvREALTP "RAM value wvREALTP" UWORD COMP_0144 1 100 0 31.999495335 ECU_ADDRESS 0xFFFF0820 READ_WRITE /end MEASUREMENT
/begin MEASUREMENT wvREALTPL "RAM value wvREALTPL" ULONG COMP_0144 1 100 0 2097150.9257699 ECU_ADDRESS 0xFFFF0824 READ_WRITE /end MEASUREMENT
/begin MEASUREMENT wvREFAPP "RAM value wvREFAPP" UBYTE COMP_0004 1 100 0 255 ECU_ADDRESS 0xFFFF0938 READ_WRITE /end MEASUREMENT
/begin MEASUREMENT wvREFCNTS "RAM value wvREFCNTS" UBYTE COMP_0030 1 100 0 255 ECU_ADDRESS 0xFFFF4420 READ_WRITE /end MEASUREMENT
/begin MEASUREMENT wvREVXFL "RAM value wvREVXFL" UWORD COMP_0443 1 100 0 65535 ECU_ADDRESS 0xFFFF08A2 READ_WRITE /end MEASUREMENT
/begin MEASUREMENT wvROHCR "RAM value wvROHCR" UBYTE COMP_0054 1 100 0 5100 ECU_ADDRESS 0xFFFF1F52 READ_WRITE /end MEASUREMENT
/begin MEASUREMENT wvROXMN "RAM value wvROXMN" UBYTE COMP_0104 1 100 0 2550 ECU_ADDRESS 0xFFFF1F53 READ_WRITE /end MEASUREMENT
/begin MEASUREMENT wvROXMX "RAM value wvROXMX" UBYTE COMP_0104 1 100 0 2550 ECU_ADDRESS 0xFFFF1F54 READ_WRITE /end MEASUREMENT
/begin MEASUREMENT wvSFTVCTR "RAM value wvSFTVCTR" UBYTE COMP_0068 1 100 0 255 ECU_ADDRESS 0xFFFF1F55 READ_WRITE /end MEASUREMENT
/begin MEASUREMENT wvSPCEND "RAM value wvSPCEND" UWORD COMP_0312 1 100 0 127.998046875 ECU_ADDRESS 0xFFFF43E8 READ_WRITE /end MEASUREMENT
/begin MEASUREMENT wvSPCENDB "RAM value wvSPCENDB" UWORD COMP_0078_S 1 100 0 255.99609375 ECU_ADDRESS 0xFFFF43EA READ_WRITE /end MEASUREMENT
/begin MEASUREMENT wvSPCINT "RAM value wvSPCINT" UWORD COMP_0312 1 100 0 127.998046875 ECU_ADDRESS 0xFFFF1F56 READ_WRITE /end MEASUREMENT
/begin MEASUREMENT wvSPCINTB "RAM value wvSPCINTB" UWORD COMP_0078_S 1 100 0 255.99609375 ECU_ADDRESS 0xFFFF1F58 READ_WRITE /end MEASUREMENT
/begin MEASUREMENT wvSPCV "RAM value wvSPCV" UWORD COMP_0312 1 100 0 127.998046875 ECU_ADDRESS 0xFFFF1F5A READ_WRITE /end MEASUREMENT
/begin MEASUREMENT wvSPCVB "RAM value wvSPCVB" UWORD COMP_0078_S 1 100 0 255.99609375 ECU_ADDRESS 0xFFFF1F5C READ_WRITE /end MEASUREMENT
/begin MEASUREMENT wvSPINGCT "RAM value wvSPINGCT" UBYTE COMP_0030 1 100 0 255 ECU_ADDRESS 0xFFFF1F5E READ_WRITE /end MEASUREMENT
/begin MEASUREMENT wvSPINGP "RAM value wvSPINGP" UBYTE COMP_0068 1 100 0 255 ECU_ADDRESS 0xFFFF1F5F READ_WRITE /end MEASUREMENT
/begin MEASUREMENT wvSSGMDREQ "RAM value wvSSGMDREQ" UBYTE COMP_0068 1 100 0 255 ECU_ADDRESS 0xFFFF1E5C READ_WRITE /end MEASUREMENT
/begin MEASUREMENT wvSSGRPM "RAM value wvSSGRPM" UBYTE COMP_0607_S 1 100 0 19125 ECU_ADDRESS 0xFFFF1F60 READ_WRITE /end MEASUREMENT
/begin MEASUREMENT wvSUMVSP "RAM value wvSUMVSP" ULONG COMP_0389 1 100 0 1685624.33943218 ECU_ADDRESS 0xFFFF43EC READ_WRITE /end MEASUREMENT
/begin MEASUREMENT wvTA "RAM value wvTA" UWORD COMP_0023 1 100 0 327675 ECU_ADDRESS 0xFFFF1F62 READ_WRITE /end MEASUREMENT
/begin MEASUREMENT wvTAEND "RAM value wvTAEND" UBYTE COMP_0035 1 100 -50 205 ECU_ADDRESS 0xFFFF43F0 READ_WRITE /end MEASUREMENT
/begin MEASUREMENT wvTAG "RAM value wvTAG" UBYTE COMP_0428 1 100 -40 215 ECU_ADDRESS 0xFFFF1F64 READ_WRITE /end MEASUREMENT
/begin MEASUREMENT wvTAINT "RAM value wvTAINT" UBYTE COMP_0035 1 100 -50 205 ECU_ADDRESS 0xFFFF43F1 READ_WRITE /end MEASUREMENT
/begin MEASUREMENT wvTAK "RAM value wvTAK" UBYTE COMP_0356 1 100 -40 119.375 ECU_ADDRESS 0xFFFF08A4 READ_WRITE /end MEASUREMENT
/begin MEASUREMENT wvTAN "RAM value wvTAN" UBYTE COMP_0035 1 100 -50 205 ECU_ADDRESS 0xFFFF1F65 READ_WRITE /end MEASUREMENT
/begin MEASUREMENT wvTANBMN "RAM value wvTANBMN" UBYTE COMP_0035 1 100 -50 205 ECU_ADDRESS 0xFFFF1F66 READ_WRITE /end MEASUREMENT
/begin MEASUREMENT wvTANMIN "RAM value wvTANMIN" UBYTE COMP_0035 1 100 -50 205 ECU_ADDRESS 0xFFFF1F67 READ_WRITE /end MEASUREMENT
/begin MEASUREMENT wvTANMNFS "RAM value wvTANMNFS" UBYTE COMP_0035 1 100 -50 205 ECU_ADDRESS 0xFFFF1F68 READ_WRITE /end MEASUREMENT
/begin MEASUREMENT wvTANST "RAM value wvTANST" UBYTE COMP_0035 1 100 -50 205 ECU_ADDRESS 0xFFFF1F69 READ_WRITE /end MEASUREMENT
/begin MEASUREMENT wvTANTH "RAM value wvTANTH" UBYTE COMP_0035 1 100 -50 205 ECU_ADDRESS 0xFFFF1F6A READ_WRITE /end MEASUREMENT
/begin MEASUREMENT wvTANTHG "RAM value wvTANTHG" UBYTE COMP_0428 1 100 -40 215 ECU_ADDRESS 0xFFFF1F6B READ_WRITE /end MEASUREMENT
/begin MEASUREMENT wvTAOUT "RAM value wvTAOUT" UBYTE COMP_0035 1 100 -50 205 ECU_ADDRESS 0xFFFF1F6C READ_WRITE /end MEASUREMENT
/begin MEASUREMENT wvTATH "RAM value wvTATH" UWORD COMP_0023 1 100 0 327675 ECU_ADDRESS 0xFFFF1F6E READ_WRITE /end MEASUREMENT
/begin MEASUREMENT wvTCVV "RAM value wvTCVV" UBYTE COMP_0023 1 100 0 1275 ECU_ADDRESS 0xFFFF1F70 READ_WRITE /end MEASUREMENT
/begin MEASUREMENT wvTDRTACAN "RAM value wvTDRTACAN" UBYTE COMP_0063 1 100 0 0.99609375 ECU_ADDRESS 0xFFFF1F71 READ_WRITE /end MEASUREMENT
/begin MEASUREMENT wvTEGR "RAM value wvTEGR" UBYTE COMP_0035 1 100 -50 205 ECU_ADDRESS 0xFFFF1F72 READ_WRITE /end MEASUREMENT
/begin MEASUREMENT wvTF "RAM value wvTF" UBYTE COMP_0054 1 100 0 5100 ECU_ADDRESS 0xFFFF1F73 READ_WRITE /end MEASUREMENT
/begin MEASUREMENT wvTFA "RAM value wvTFA" UBYTE COMP_0035 1 100 -50 205 ECU_ADDRESS 0xFFFF08A5 READ_WRITE /end MEASUREMENT
/begin MEASUREMENT wvTFEND "RAM value wvTFEND" UBYTE COMP_0035 1 100 -50 205 ECU_ADDRESS 0xFFFF43F2 READ_WRITE /end MEASUREMENT
/begin MEASUREMENT wvTFINT "RAM value wvTFINT" UBYTE COMP_0035 1 100 -50 205 ECU_ADDRESS 0xFFFF0856 READ_WRITE /end MEASUREMENT
/begin MEASUREMENT wvTFINTD "RAM value wvTFINTD" UBYTE COMP_0035 1 100 -50 205 ECU_ADDRESS 0xFFFF1F74 READ_WRITE /end MEASUREMENT
/begin MEASUREMENT wvTFK "RAM value wvTFK" UBYTE COMP_0356 1 100 -40 119.375 ECU_ADDRESS 0xFFFF08A6 READ_WRITE /end MEASUREMENT
/begin MEASUREMENT wvTFKK "RAM value wvTFKK" UWORD COMP_0259_S 1 100 -50 13057 ECU_ADDRESS 0xFFFF1F76 READ_WRITE /end MEASUREMENT
/begin MEASUREMENT wvTFN "RAM value wvTFN" UBYTE COMP_0035 1 100 -50 205 ECU_ADDRESS 0xFFFF1E5D READ_WRITE /end MEASUREMENT
/begin MEASUREMENT wvTHCHGCNT "RAM value wvTHCHGCNT" UBYTE COMP_0016 1 100 0 255 ECU_ADDRESS 0xFFFF0805 READ_WRITE /end MEASUREMENT
/begin MEASUREMENT wvTO "RAM value wvTO" UBYTE COMP_0054 1 100 0 5100 ECU_ADDRESS 0xFFFF08A7 READ_WRITE /end MEASUREMENT
/begin MEASUREMENT wvTOEND "RAM value wvTOEND" UBYTE COMP_0035 1 100 -50 205 ECU_ADDRESS 0xFFFF43F3 READ_WRITE /end MEASUREMENT
/begin MEASUREMENT wvTOINT "RAM value wvTOINT" UBYTE COMP_0035 1 100 -50 205 ECU_ADDRESS 0xFFFF08A8 READ_WRITE /end MEASUREMENT
/begin MEASUREMENT wvTP "RAM value wvTP" UWORD COMP_0144 1 100 0 31.999495335 ECU_ADDRESS 0xFFFF1E32 READ_WRITE /end MEASUREMENT
/begin MEASUREMENT wvTP4 "RAM value wvTP4" ULONG COMP_0144 1 100 0 2097150.9257699 ECU_ADDRESS 0xFFFF1E34 READ_WRITE /end MEASUREMENT
/begin MEASUREMENT wvTPAA "RAM value wvTPAA" UWORD COMP_0042 1 100 0 52.428 ECU_ADDRESS 0xFFFF1F78 READ_WRITE /end MEASUREMENT
/begin MEASUREMENT wvTPO "RAM value wvTPO" UWORD COMP_0005 1 100 0 7208.85 ECU_ADDRESS 0xFFFF1F7A READ_WRITE /end MEASUREMENT
/begin MEASUREMENT wvTPO1 "RAM value wvTPO1" UWORD COMP_0005 1 100 0 7208.85 ECU_ADDRESS 0xFFFF1F7C READ_WRITE /end MEASUREMENT
/begin MEASUREMENT wvTPO1OV "RAM value wvTPO1OV" UWORD COMP_0625_S 1 100 -14.08205 98.55623125 ECU_ADDRESS 0xFFFF1DEC READ_WRITE /end MEASUREMENT
/begin MEASUREMENT wvTPO2 "RAM value wvTPO2" UWORD COMP_0005 1 100 0 7208.85 ECU_ADDRESS 0xFFFF1F7E READ_WRITE /end MEASUREMENT
/begin MEASUREMENT wvTPO4OV "RAM value wvTPO4OV" UWORD COMP_0625_S 1 100 -14.08205 98.55623125 ECU_ADDRESS 0xFFFF1DEE READ_WRITE /end MEASUREMENT
/begin MEASUREMENT wvTPOK "RAM value wvTPOK" UBYTE COMP_0002 1 100 0 89.25 ECU_ADDRESS 0xFFFF1F80 READ_WRITE /end MEASUREMENT
/begin MEASUREMENT wvTPS1OF "RAM value wvTPS1OF" SWORD COMP_0377 1 100 -3604.48 3604.37 ECU_ADDRESS 0xFFFF1F82 READ_WRITE /end MEASUREMENT
/begin MEASUREMENT wvTPS1V "RAM value wvTPS1V" UWORD COMP_0061 1 100 0 327675 ECU_ADDRESS 0xFFFF1F84 READ_WRITE /end MEASUREMENT
/begin MEASUREMENT wvTPS2OF "RAM value wvTPS2OF" SWORD COMP_0377 1 100 -3604.48 3604.37 ECU_ADDRESS 0xFFFF1F86 READ_WRITE /end MEASUREMENT
/begin MEASUREMENT wvTPS2V "RAM value wvTPS2V" UWORD COMP_0061 1 100 0 327675 ECU_ADDRESS 0xFFFF1F88 READ_WRITE /end MEASUREMENT
/begin MEASUREMENT wvTPSK "RAM value wvTPSK" SWORD COMP_0515 1 100 -15.999991808 15.999503527 ECU_ADDRESS 0xFFFF1E38 READ_WRITE /end MEASUREMENT
/begin MEASUREMENT wvTP_F "RAM value wvTP_F" ULONG COMP_0144 1 100 0 2097150.9257699 ECU_ADDRESS 0xFFFF1DE8 READ_WRITE /end MEASUREMENT
/begin MEASUREMENT wvTQCTLTYP "RAM value wvTQCTLTYP" UBYTE COMP_0068 1 100 0 255 ECU_ADDRESS 0xFFFF1F8A READ_WRITE /end MEASUREMENT
/begin MEASUREMENT wvTQRET "RAM value wvTQRET" SBYTE COMP_0018 1 100 -128 127 ECU_ADDRESS 0xFFFF0939 READ_WRITE /end MEASUREMENT
/begin MEASUREMENT wvTQRETAT "RAM value wvTQRETAT" SBYTE COMP_0018 1 100 -128 127 ECU_ADDRESS 0xFFFF093A READ_WRITE /end MEASUREMENT
/begin MEASUREMENT wvTQRQASRF "RAM value wvTQRQASRF" SWORD COMP_0228 1 100 -3276.8 3276.7 ECU_ADDRESS 0xFFFF1F8C READ_WRITE /end MEASUREMENT
/begin MEASUREMENT wvTQRQASRS "RAM value wvTQRQASRS" SWORD COMP_0228 1 100 -3276.8 3276.7 ECU_ADDRESS 0xFFFF1F8E READ_WRITE /end MEASUREMENT
/begin MEASUREMENT wvTQRQMSR "RAM value wvTQRQMSR" SWORD COMP_0228 1 100 -3276.8 3276.7 ECU_ADDRESS 0xFFFF1F90 READ_WRITE /end MEASUREMENT
/begin MEASUREMENT wvTQTMDYNC "RAM value wvTQTMDYNC" UBYTE COMP_0497_S 1 100 -100 410 ECU_ADDRESS 0xFFFF1F92 READ_WRITE /end MEASUREMENT
/begin MEASUREMENT wvTQTMSTAC "RAM value wvTQTMSTAC" UBYTE COMP_0497_S 1 100 -100 410 ECU_ADDRESS 0xFFFF1F93 READ_WRITE /end MEASUREMENT
/begin MEASUREMENT wvTRAITAC "RAM value wvTRAITAC" UBYTE COMP_0009 1 100 0 199.21875 ECU_ADDRESS 0xFFFF1E3A READ_WRITE /end MEASUREMENT
/begin MEASUREMENT wvTRANRPM "RAM value wvTRANRPM" UWORD COMP_0006 1 100 0 819187.5 ECU_ADDRESS 0xFFFF1E3C READ_WRITE /end MEASUREMENT
/begin MEASUREMENT wvTRDLITC "RAM value wvTRDLITC" SBYTE COMP_0238 1 100 -100 99.21875 ECU_ADDRESS 0xFFFF1E3E READ_WRITE /end MEASUREMENT
/begin MEASUREMENT wvTREF "RAM value wvTREF" ULONG COMP_0073 1 100 0 13743895344 ECU_ADDRESS 0xFFFF093C READ_WRITE /end MEASUREMENT
/begin MEASUREMENT wvTRQAGBF "RAM value wvTRQAGBF" SWORD COMP_0228 1 100 -3276.8 3276.7 ECU_ADDRESS 0xFFFF1F94 READ_WRITE /end MEASUREMENT
/begin MEASUREMENT wvTRQAGBS "RAM value wvTRQAGBS" SWORD COMP_0228 1 100 -3276.8 3276.7 ECU_ADDRESS 0xFFFF1F96 READ_WRITE /end MEASUREMENT
/begin MEASUREMENT wvTSQH0 "RAM value wvTSQH0" UBYTE COMP_0045 1 100 0 1.9921875 ECU_ADDRESS 0xFFFF08A9 READ_WRITE /end MEASUREMENT
/begin MEASUREMENT wvTTEACC "RAM value wvTTEACC" SWORD COMP_0228 1 100 -3276.8 3276.7 ECU_ADDRESS 0xFFFF08AA READ_WRITE /end MEASUREMENT
/begin MEASUREMENT wvTTEACC_S "RAM value wvTTEACC_S" SWORD COMP_0228 1 100 -3276.8 3276.7 ECU_ADDRESS 0xFFFF08B4 READ_WRITE /end MEASUREMENT
/begin MEASUREMENT wvTVO "RAM value wvTVO" UBYTE COMP_0002 1 100 0 89.25 ECU_ADDRESS 0xFFFF0857 READ_WRITE /end MEASUREMENT
/begin MEASUREMENT wvTVOV "RAM value wvTVOV" UWORD COMP_0061 1 100 0 327675 ECU_ADDRESS 0xFFFF08AC READ_WRITE /end MEASUREMENT
/begin MEASUREMENT wvTVOz10 "RAM value wvTVOz10" UBYTE COMP_0002 1 100 0 89.25 ECU_ADDRESS 0xFFFF0848 READ_WRITE /end MEASUREMENT
/begin MEASUREMENT wvTVOz15 "RAM value wvTVOz15" UBYTE COMP_0002 1 100 0 89.25 ECU_ADDRESS 0xFFFF08AE READ_WRITE /end MEASUREMENT
/begin MEASUREMENT wvTVOz3 "RAM value wvTVOz3" UBYTE COMP_0002 1 100 0 89.25 ECU_ADDRESS 0xFFFF08AF READ_WRITE /end MEASUREMENT
/begin MEASUREMENT wvTVTOIL "RAM value wvTVTOIL" UBYTE COMP_0035 1 100 -50 205 ECU_ADDRESS 0xFFFF08B0 READ_WRITE /end MEASUREMENT
/begin MEASUREMENT wvTW "RAM value wvTW" UBYTE COMP_0054 1 100 0 5100 ECU_ADDRESS 0xFFFF1F98 READ_WRITE /end MEASUREMENT
/begin MEASUREMENT wvTWINT "RAM value wvTWINT" UBYTE COMP_0035 1 100 -50 205 ECU_ADDRESS 0xFFFF1E5E READ_WRITE /end MEASUREMENT
/begin MEASUREMENT wvTWINTES "RAM value wvTWINTES" UBYTE COMP_0035 1 100 -50 205 ECU_ADDRESS 0xFFFF1F99 READ_WRITE /end MEASUREMENT
/begin MEASUREMENT wvTWINTR "RAM value wvTWINTR" UBYTE COMP_0035 1 100 -50 205 ECU_ADDRESS 0xFFFF1E5F READ_WRITE /end MEASUREMENT
/begin MEASUREMENT wvTWK "RAM value wvTWK" UBYTE COMP_0356 1 100 -40 119.375 ECU_ADDRESS 0xFFFF1F9A READ_WRITE /end MEASUREMENT
/begin MEASUREMENT wvTWKINT "RAM value wvTWKINT" UBYTE COMP_0356 1 100 -40 119.375 ECU_ADDRESS 0xFFFF1E60 READ_WRITE /end MEASUREMENT
/begin MEASUREMENT wvTWN "RAM value wvTWN" UBYTE COMP_0035 1 100 -50 205 ECU_ADDRESS 0xFFFF1E61 READ_WRITE /end MEASUREMENT
/begin MEASUREMENT wvTWNNEW "RAM value wvTWNNEW" UBYTE COMP_0035 1 100 -50 205 ECU_ADDRESS 0xFFFF1F9B READ_WRITE /end MEASUREMENT
/begin MEASUREMENT wvUS "RAM value wvUS" UWORD COMP_0023 1 100 0 327675 ECU_ADDRESS 0xFFFF1DF0 READ_WRITE /end MEASUREMENT
/begin MEASUREMENT wvVASCDDTM "RAM value wvVASCDDTM" UBYTE COMP_0024 1 100 0 12750 ECU_ADDRESS 0xFFFF1F9C READ_WRITE /end MEASUREMENT
/begin MEASUREMENT wvVB "RAM value wvVB" UBYTE COMP_0033 1 100 0 20400 ECU_ADDRESS 0xFFFF1F9D READ_WRITE /end MEASUREMENT
/begin MEASUREMENT wvVBAVE2 "RAM value wvVBAVE2" UBYTE COMP_0033 1 100 0 20400 ECU_ADDRESS 0xFFFF1E62 READ_WRITE /end MEASUREMENT
/begin MEASUREMENT wvVFPCMSD "RAM value wvVFPCMSD" UBYTE COMP_0033 1 100 0 20400 ECU_ADDRESS 0xFFFF1F9E READ_WRITE /end MEASUREMENT
/begin MEASUREMENT wvVFUEL "RAM value wvVFUEL" UWORD COMP_0023 1 100 0 327675 ECU_ADDRESS 0xFFFF1DC0 READ_WRITE /end MEASUREMENT
/begin MEASUREMENT wvVMOT "RAM value wvVMOT" UBYTE COMP_0033 1 100 0 20400 ECU_ADDRESS 0xFFFF1F9F READ_WRITE /end MEASUREMENT
/begin MEASUREMENT wvVMVABAV1 "RAM value wvVMVABAV1" UWORD COMP_0050 1 100 0 5119.921875 ECU_ADDRESS 0xFFFF1FA0 READ_WRITE /end MEASUREMENT
/begin MEASUREMENT wvVO2 "RAM value wvVO2" UBYTE COMP_0104 1 100 0 2550 ECU_ADDRESS 0xFFFF0940 READ_WRITE /end MEASUREMENT
/begin MEASUREMENT wvVPRES "RAM value wvVPRES" UWORD COMP_0050 1 100 0 5119.921875 ECU_ADDRESS 0xFFFF08B2 READ_WRITE /end MEASUREMENT
/begin MEASUREMENT wvVRO2 "RAM value wvVRO2" UBYTE COMP_0104 1 100 0 2550 ECU_ADDRESS 0xFFFF1FA2 READ_WRITE /end MEASUREMENT
/begin MEASUREMENT wvVRO2T "RAM value wvVRO2T" UBYTE COMP_0104 1 100 0 2550 ECU_ADDRESS 0xFFFF1FA4 READ_WRITE /end MEASUREMENT
/begin MEASUREMENT wvVSP "RAM value wvVSP" UBYTE COMP_0007 1 100 0 510 ECU_ADDRESS 0xFFFF1FA5 READ_WRITE /end MEASUREMENT
/begin MEASUREMENT wvVSPS "RAM value wvVSPS" UBYTE COMP_0007 1 100 0 510 ECU_ADDRESS 0xFFFF1DF2 READ_WRITE /end MEASUREMENT
/begin MEASUREMENT wvVSPX "RAM value wvVSPX" UWORD COMP_0236 1 100 0 16383.75 ECU_ADDRESS 0xFFFF0806 READ_WRITE /end MEASUREMENT
/begin MEASUREMENT wvVSSTATE "RAM value wvVSSTATE" UBYTE COMP_0068 1 100 0 255 ECU_ADDRESS 0xFFFF1FA6 READ_WRITE /end MEASUREMENT
/begin MEASUREMENT wvVTCDTY1E "RAM value wvVTCDTY1E" UWORD COMP_0146 1 100 0 99.998480265 ECU_ADDRESS 0xFFFF1DF4 READ_WRITE /end MEASUREMENT
/begin MEASUREMENT wvVTCDUTY1 "RAM value wvVTCDUTY1" UWORD COMP_0146 1 100 0 99.998480265 ECU_ADDRESS 0xFFFF1DF8 READ_WRITE /end MEASUREMENT
/begin MEASUREMENT wvWSPRL "RAM value wvWSPRL" UBYTE COMP_0016 1 100 0 255 ECU_ADDRESS 0xFFFF1FA7 READ_WRITE /end MEASUREMENT
/begin MEASUREMENT wvWSPRR "RAM value wvWSPRR" UBYTE COMP_0016 1 100 0 255 ECU_ADDRESS 0xFFFF1FA8 READ_WRITE /end MEASUREMENT
/begin MEASUREMENT vCANDAT000 "RAM value vCANDAT000" UBYTE COMP_0068 1 100 0 255 ECU_ADDRESS 0xFFFF3478 READ_WRITE /end MEASUREMENT
/begin MEASUREMENT vCANDAT001 "RAM value vCANDAT001" UBYTE COMP_0068 1 100 0 255 ECU_ADDRESS 0xFFFF3479 READ_WRITE /end MEASUREMENT
/begin MEASUREMENT vCANDAT002 "RAM value vCANDAT002" UBYTE COMP_0068 1 100 0 255 ECU_ADDRESS 0xFFFF347A READ_WRITE /end MEASUREMENT
/begin MEASUREMENT vCANDAT003 "RAM value vCANDAT003" UBYTE COMP_0068 1 100 0 255 ECU_ADDRESS 0xFFFF347B READ_WRITE /end MEASUREMENT
/begin MEASUREMENT vCANDAT004 "RAM value vCANDAT004" UBYTE COMP_0068 1 100 0 255 ECU_ADDRESS 0xFFFF347C READ_WRITE /end MEASUREMENT
/begin MEASUREMENT vCANDAT005 "RAM value vCANDAT005" UBYTE COMP_0068 1 100 0 255 ECU_ADDRESS 0xFFFF347D READ_WRITE /end MEASUREMENT
/begin MEASUREMENT vCANDAT006 "RAM value vCANDAT006" UBYTE COMP_0068 1 100 0 255 ECU_ADDRESS 0xFFFF347E READ_WRITE /end MEASUREMENT
/begin MEASUREMENT vCANDAT007 "RAM value vCANDAT007" UBYTE COMP_0068 1 100 0 255 ECU_ADDRESS 0xFFFF347F READ_WRITE /end MEASUREMENT
/begin MEASUREMENT vCANDAT008 "RAM value vCANDAT008" UBYTE COMP_0068 1 100 0 255 ECU_ADDRESS 0xFFFF3480 READ_WRITE /end MEASUREMENT
/begin MEASUREMENT vCANDAT009 "RAM value vCANDAT009" UBYTE COMP_0068 1 100 0 255 ECU_ADDRESS 0xFFFF3481 READ_WRITE /end MEASUREMENT
/begin MEASUREMENT vCANDAT010 "RAM value vCANDAT010" UBYTE COMP_0068 1 100 0 255 ECU_ADDRESS 0xFFFF3482 READ_WRITE /end MEASUREMENT
/begin MEASUREMENT vCANDAT011 "RAM value vCANDAT011" UBYTE COMP_0068 1 100 0 255 ECU_ADDRESS 0xFFFF3483 READ_WRITE /end MEASUREMENT
/begin MEASUREMENT vCANDAT012 "RAM value vCANDAT012" UBYTE COMP_0068 1 100 0 255 ECU_ADDRESS 0xFFFF3484 READ_WRITE /end MEASUREMENT
/begin MEASUREMENT vCANDAT013 "RAM value vCANDAT013" UBYTE COMP_0068 1 100 0 255 ECU_ADDRESS 0xFFFF3485 READ_WRITE /end MEASUREMENT
/begin MEASUREMENT vCANDAT014 "RAM value vCANDAT014" UBYTE COMP_0068 1 100 0 255 ECU_ADDRESS 0xFFFF3486 READ_WRITE /end MEASUREMENT
/begin MEASUREMENT vCANDAT015 "RAM value vCANDAT015" UBYTE COMP_0068 1 100 0 255 ECU_ADDRESS 0xFFFF3487 READ_WRITE /end MEASUREMENT
/begin MEASUREMENT vCANDAT016 "RAM value vCANDAT016" UBYTE COMP_0068 1 100 0 255 ECU_ADDRESS 0xFFFF3488 READ_WRITE /end MEASUREMENT
/begin MEASUREMENT vCANDAT017 "RAM value vCANDAT017" UBYTE COMP_0068 1 100 0 255 ECU_ADDRESS 0xFFFF3489 READ_WRITE /end MEASUREMENT
/begin MEASUREMENT vCANDAT018 "RAM value vCANDAT018" UBYTE COMP_0068 1 100 0 255 ECU_ADDRESS 0xFFFF348A READ_WRITE /end MEASUREMENT
/begin MEASUREMENT vCANDAT019 "RAM value vCANDAT019" UBYTE COMP_0068 1 100 0 255 ECU_ADDRESS 0xFFFF348B READ_WRITE /end MEASUREMENT
/begin MEASUREMENT vCANDAT020 "RAM value vCANDAT020" UBYTE COMP_0068 1 100 0 255 ECU_ADDRESS 0xFFFF348C READ_WRITE /end MEASUREMENT
/begin MEASUREMENT vCANDAT021 "RAM value vCANDAT021" UBYTE COMP_0068 1 100 0 255 ECU_ADDRESS 0xFFFF348D READ_WRITE /end MEASUREMENT
/begin MEASUREMENT vCANDAT022 "RAM value vCANDAT022" UBYTE COMP_0068 1 100 0 255 ECU_ADDRESS 0xFFFF348E READ_WRITE /end MEASUREMENT
/begin MEASUREMENT vCANDAT023 "RAM value vCANDAT023" UBYTE COMP_0068 1 100 0 255 ECU_ADDRESS 0xFFFF348F READ_WRITE /end MEASUREMENT
/begin MEASUREMENT vCANDAT024 "RAM value vCANDAT024" UBYTE COMP_0068 1 100 0 255 ECU_ADDRESS 0xFFFF3490 READ_WRITE /end MEASUREMENT
/begin MEASUREMENT vCANDAT025 "RAM value vCANDAT025" UBYTE COMP_0068 1 100 0 255 ECU_ADDRESS 0xFFFF3491 READ_WRITE /end MEASUREMENT
/begin MEASUREMENT vCANDAT026 "RAM value vCANDAT026" UBYTE COMP_0068 1 100 0 255 ECU_ADDRESS 0xFFFF3492 READ_WRITE /end MEASUREMENT
/begin MEASUREMENT vCANDAT027 "RAM value vCANDAT027" UBYTE COMP_0068 1 100 0 255 ECU_ADDRESS 0xFFFF3493 READ_WRITE /end MEASUREMENT
/begin MEASUREMENT vCANDAT028 "RAM value vCANDAT028" UBYTE COMP_0068 1 100 0 255 ECU_ADDRESS 0xFFFF3494 READ_WRITE /end MEASUREMENT
/begin MEASUREMENT vCANDAT029 "RAM value vCANDAT029" UBYTE COMP_0068 1 100 0 255 ECU_ADDRESS 0xFFFF3495 READ_WRITE /end MEASUREMENT
/begin MEASUREMENT vCANDAT030 "RAM value vCANDAT030" UBYTE COMP_0068 1 100 0 255 ECU_ADDRESS 0xFFFF3496 READ_WRITE /end MEASUREMENT
/begin MEASUREMENT vCANDAT031 "RAM value vCANDAT031" UBYTE COMP_0068 1 100 0 255 ECU_ADDRESS 0xFFFF3497 READ_WRITE /end MEASUREMENT
/begin MEASUREMENT vCANDAT032 "RAM value vCANDAT032" UBYTE COMP_0068 1 100 0 255 ECU_ADDRESS 0xFFFF3498 READ_WRITE /end MEASUREMENT
/begin MEASUREMENT vCANDAT033 "RAM value vCANDAT033" UBYTE COMP_0068 1 100 0 255 ECU_ADDRESS 0xFFFF3499 READ_WRITE /end MEASUREMENT
/begin MEASUREMENT vCANDAT034 "RAM value vCANDAT034" UBYTE COMP_0068 1 100 0 255 ECU_ADDRESS 0xFFFF349A READ_WRITE /end MEASUREMENT
/begin MEASUREMENT vCANDAT035 "RAM value vCANDAT035" UBYTE COMP_0068 1 100 0 255 ECU_ADDRESS 0xFFFF349B READ_WRITE /end MEASUREMENT
/begin MEASUREMENT vCANDAT036 "RAM value vCANDAT036" UBYTE COMP_0068 1 100 0 255 ECU_ADDRESS 0xFFFF349C READ_WRITE /end MEASUREMENT
/begin MEASUREMENT vCANDAT037 "RAM value vCANDAT037" UBYTE COMP_0068 1 100 0 255 ECU_ADDRESS 0xFFFF349D READ_WRITE /end MEASUREMENT
/begin MEASUREMENT vCANDAT038 "RAM value vCANDAT038" UBYTE COMP_0068 1 100 0 255 ECU_ADDRESS 0xFFFF349E READ_WRITE /end MEASUREMENT
/begin MEASUREMENT vCANDAT039 "RAM value vCANDAT039" UBYTE COMP_0068 1 100 0 255 ECU_ADDRESS 0xFFFF349F READ_WRITE /end MEASUREMENT
/begin MEASUREMENT vCANDAT040 "RAM value vCANDAT040" UBYTE COMP_0068 1 100 0 255 ECU_ADDRESS 0xFFFF34A0 READ_WRITE /end MEASUREMENT
/begin MEASUREMENT vCANDAT041 "RAM value vCANDAT041" UBYTE COMP_0068 1 100 0 255 ECU_ADDRESS 0xFFFF34A1 READ_WRITE /end MEASUREMENT
/begin MEASUREMENT vCANDAT042 "RAM value vCANDAT042" UBYTE COMP_0068 1 100 0 255 ECU_ADDRESS 0xFFFF34A2 READ_WRITE /end MEASUREMENT
/begin MEASUREMENT vCANDAT043 "RAM value vCANDAT043" UBYTE COMP_0068 1 100 0 255 ECU_ADDRESS 0xFFFF34A3 READ_WRITE /end MEASUREMENT
/begin MEASUREMENT vCANDAT044 "RAM value vCANDAT044" UBYTE COMP_0068 1 100 0 255 ECU_ADDRESS 0xFFFF34A4 READ_WRITE /end MEASUREMENT
/begin MEASUREMENT vCANDAT045 "RAM value vCANDAT045" UBYTE COMP_0068 1 100 0 255 ECU_ADDRESS 0xFFFF34A5 READ_WRITE /end MEASUREMENT
/begin MEASUREMENT vCANDAT046 "RAM value vCANDAT046" UBYTE COMP_0068 1 100 0 255 ECU_ADDRESS 0xFFFF34A6 READ_WRITE /end MEASUREMENT
/begin MEASUREMENT vCANDAT047 "RAM value vCANDAT047" UBYTE COMP_0068 1 100 0 255 ECU_ADDRESS 0xFFFF34A7 READ_WRITE /end MEASUREMENT
/begin MEASUREMENT vCANDAT048 "RAM value vCANDAT048" UBYTE COMP_0068 1 100 0 255 ECU_ADDRESS 0xFFFF34A8 READ_WRITE /end MEASUREMENT
/begin MEASUREMENT vCANDAT049 "RAM value vCANDAT049" UBYTE COMP_0068 1 100 0 255 ECU_ADDRESS 0xFFFF34A9 READ_WRITE /end MEASUREMENT
/begin MEASUREMENT vCANDAT050 "RAM value vCANDAT050" UBYTE COMP_0068 1 100 0 255 ECU_ADDRESS 0xFFFF34AA READ_WRITE /end MEASUREMENT
/begin MEASUREMENT vCANDAT051 "RAM value vCANDAT051" UBYTE COMP_0068 1 100 0 255 ECU_ADDRESS 0xFFFF34AB READ_WRITE /end MEASUREMENT
/begin MEASUREMENT vCANDAT052 "RAM value vCANDAT052" UBYTE COMP_0068 1 100 0 255 ECU_ADDRESS 0xFFFF34AC READ_WRITE /end MEASUREMENT
/begin MEASUREMENT vCANDAT053 "RAM value vCANDAT053" UBYTE COMP_0068 1 100 0 255 ECU_ADDRESS 0xFFFF34AD READ_WRITE /end MEASUREMENT
/begin MEASUREMENT vCANDAT054 "RAM value vCANDAT054" UBYTE COMP_0068 1 100 0 255 ECU_ADDRESS 0xFFFF34AE READ_WRITE /end MEASUREMENT
/begin MEASUREMENT vCANDAT055 "RAM value vCANDAT055" UBYTE COMP_0068 1 100 0 255 ECU_ADDRESS 0xFFFF34AF READ_WRITE /end MEASUREMENT
/begin MEASUREMENT vCANDAT056 "RAM value vCANDAT056" UBYTE COMP_0068 1 100 0 255 ECU_ADDRESS 0xFFFF34B0 READ_WRITE /end MEASUREMENT
/begin MEASUREMENT vCANDAT057 "RAM value vCANDAT057" UBYTE COMP_0068 1 100 0 255 ECU_ADDRESS 0xFFFF34B1 READ_WRITE /end MEASUREMENT
/begin MEASUREMENT vCANDAT058 "RAM value vCANDAT058" UBYTE COMP_0068 1 100 0 255 ECU_ADDRESS 0xFFFF34B2 READ_WRITE /end MEASUREMENT
/begin MEASUREMENT vCANDAT059 "RAM value vCANDAT059" UBYTE COMP_0068 1 100 0 255 ECU_ADDRESS 0xFFFF34B3 READ_WRITE /end MEASUREMENT
/begin MEASUREMENT vCANDAT060 "RAM value vCANDAT060" UBYTE COMP_0068 1 100 0 255 ECU_ADDRESS 0xFFFF34B4 READ_WRITE /end MEASUREMENT
/begin MEASUREMENT vCANDAT061 "RAM value vCANDAT061" UBYTE COMP_0068 1 100 0 255 ECU_ADDRESS 0xFFFF34B5 READ_WRITE /end MEASUREMENT
/begin MEASUREMENT vCANDAT062 "RAM value vCANDAT062" UBYTE COMP_0068 1 100 0 255 ECU_ADDRESS 0xFFFF34B6 READ_WRITE /end MEASUREMENT
/begin MEASUREMENT vCANDAT063 "RAM value vCANDAT063" UBYTE COMP_0068 1 100 0 255 ECU_ADDRESS 0xFFFF34B7 READ_WRITE /end MEASUREMENT
/begin MEASUREMENT vCANDAT064 "RAM value vCANDAT064" UBYTE COMP_0068 1 100 0 255 ECU_ADDRESS 0xFFFF34B8 READ_WRITE /end MEASUREMENT
/begin MEASUREMENT vCANDAT065 "RAM value vCANDAT065" UBYTE COMP_0068 1 100 0 255 ECU_ADDRESS 0xFFFF34B9 READ_WRITE /end MEASUREMENT
/begin MEASUREMENT vCANDAT066 "RAM value vCANDAT066" UBYTE COMP_0068 1 100 0 255 ECU_ADDRESS 0xFFFF34BA READ_WRITE /end MEASUREMENT
/begin MEASUREMENT vCANDAT067 "RAM value vCANDAT067" UBYTE COMP_0068 1 100 0 255 ECU_ADDRESS 0xFFFF34BB READ_WRITE /end MEASUREMENT
/begin MEASUREMENT vCANDAT068 "RAM value vCANDAT068" UBYTE COMP_0068 1 100 0 255 ECU_ADDRESS 0xFFFF34BC READ_WRITE /end MEASUREMENT
/begin MEASUREMENT vCANDAT069 "RAM value vCANDAT069" UBYTE COMP_0068 1 100 0 255 ECU_ADDRESS 0xFFFF34BD READ_WRITE /end MEASUREMENT
/begin MEASUREMENT vCANDAT070 "RAM value vCANDAT070" UBYTE COMP_0068 1 100 0 255 ECU_ADDRESS 0xFFFF34BE READ_WRITE /end MEASUREMENT
/begin MEASUREMENT vCANDAT071 "RAM value vCANDAT071" UBYTE COMP_0068 1 100 0 255 ECU_ADDRESS 0xFFFF34BF READ_WRITE /end MEASUREMENT
/begin MEASUREMENT vCANDAT072 "RAM value vCANDAT072" UBYTE COMP_0068 1 100 0 255 ECU_ADDRESS 0xFFFF34C0 READ_WRITE /end MEASUREMENT
/begin MEASUREMENT vCANDAT073 "RAM value vCANDAT073" UBYTE COMP_0068 1 100 0 255 ECU_ADDRESS 0xFFFF34C1 READ_WRITE /end MEASUREMENT
/begin MEASUREMENT vCANDAT074 "RAM value vCANDAT074" UBYTE COMP_0068 1 100 0 255 ECU_ADDRESS 0xFFFF34C2 READ_WRITE /end MEASUREMENT
/begin MEASUREMENT vCANDAT075 "RAM value vCANDAT075" UBYTE COMP_0068 1 100 0 255 ECU_ADDRESS 0xFFFF34C3 READ_WRITE /end MEASUREMENT
/begin MEASUREMENT vCANDAT076 "RAM value vCANDAT076" UBYTE COMP_0068 1 100 0 255 ECU_ADDRESS 0xFFFF34C4 READ_WRITE /end MEASUREMENT
/begin MEASUREMENT vCANDAT077 "RAM value vCANDAT077" UBYTE COMP_0068 1 100 0 255 ECU_ADDRESS 0xFFFF34C5 READ_WRITE /end MEASUREMENT
/begin MEASUREMENT vCANDAT078 "RAM value vCANDAT078" UBYTE COMP_0068 1 100 0 255 ECU_ADDRESS 0xFFFF34C6 READ_WRITE /end MEASUREMENT
/begin MEASUREMENT vCANDAT079 "RAM value vCANDAT079" UBYTE COMP_0068 1 100 0 255 ECU_ADDRESS 0xFFFF34C7 READ_WRITE /end MEASUREMENT
/begin MEASUREMENT vCANDAT080 "RAM value vCANDAT080" UBYTE COMP_0068 1 100 0 255 ECU_ADDRESS 0xFFFF34C8 READ_WRITE /end MEASUREMENT
/begin MEASUREMENT vCANDAT081 "RAM value vCANDAT081" UBYTE COMP_0068 1 100 0 255 ECU_ADDRESS 0xFFFF34C9 READ_WRITE /end MEASUREMENT
/begin MEASUREMENT vCANDAT082 "RAM value vCANDAT082" UBYTE COMP_0068 1 100 0 255 ECU_ADDRESS 0xFFFF34CA READ_WRITE /end MEASUREMENT
/begin MEASUREMENT vCANDAT083 "RAM value vCANDAT083" UBYTE COMP_0068 1 100 0 255 ECU_ADDRESS 0xFFFF34CB READ_WRITE /end MEASUREMENT
/begin MEASUREMENT vCANDAT084 "RAM value vCANDAT084" UBYTE COMP_0068 1 100 0 255 ECU_ADDRESS 0xFFFF34CC READ_WRITE /end MEASUREMENT
/begin MEASUREMENT vCANDAT085 "RAM value vCANDAT085" UBYTE COMP_0068 1 100 0 255 ECU_ADDRESS 0xFFFF34CD READ_WRITE /end MEASUREMENT
/begin MEASUREMENT vCANDAT086 "RAM value vCANDAT086" UBYTE COMP_0068 1 100 0 255 ECU_ADDRESS 0xFFFF34CE READ_WRITE /end MEASUREMENT
/begin MEASUREMENT vCANDAT087 "RAM value vCANDAT087" UBYTE COMP_0068 1 100 0 255 ECU_ADDRESS 0xFFFF34CF READ_WRITE /end MEASUREMENT
/begin MEASUREMENT vCANDAT088 "RAM value vCANDAT088" UBYTE COMP_0068 1 100 0 255 ECU_ADDRESS 0xFFFF34D0 READ_WRITE /end MEASUREMENT
/begin MEASUREMENT vCANDAT089 "RAM value vCANDAT089" UBYTE COMP_0068 1 100 0 255 ECU_ADDRESS 0xFFFF34D1 READ_WRITE /end MEASUREMENT
/begin MEASUREMENT vCANDAT090 "RAM value vCANDAT090" UBYTE COMP_0068 1 100 0 255 ECU_ADDRESS 0xFFFF34D2 READ_WRITE /end MEASUREMENT
/begin MEASUREMENT vCANDAT091 "RAM value vCANDAT091" UBYTE COMP_0068 1 100 0 255 ECU_ADDRESS 0xFFFF34D3 READ_WRITE /end MEASUREMENT
/begin MEASUREMENT vCANDAT092 "RAM value vCANDAT092" UBYTE COMP_0068 1 100 0 255 ECU_ADDRESS 0xFFFF34D4 READ_WRITE /end MEASUREMENT
/begin MEASUREMENT vCANDAT093 "RAM value vCANDAT093" UBYTE COMP_0068 1 100 0 255 ECU_ADDRESS 0xFFFF34D5 READ_WRITE /end MEASUREMENT
/begin MEASUREMENT vCANDAT094 "RAM value vCANDAT094" UBYTE COMP_0068 1 100 0 255 ECU_ADDRESS 0xFFFF34D6 READ_WRITE /end MEASUREMENT
/begin MEASUREMENT vCANDAT095 "RAM value vCANDAT095" UBYTE COMP_0068 1 100 0 255 ECU_ADDRESS 0xFFFF34D7 READ_WRITE /end MEASUREMENT
/begin MEASUREMENT vCANDAT096 "RAM value vCANDAT096" UBYTE COMP_0068 1 100 0 255 ECU_ADDRESS 0xFFFF34D8 READ_WRITE /end MEASUREMENT
/begin MEASUREMENT vCANDAT097 "RAM value vCANDAT097" UBYTE COMP_0068 1 100 0 255 ECU_ADDRESS 0xFFFF34D9 READ_WRITE /end MEASUREMENT
/begin MEASUREMENT vCANDAT098 "RAM value vCANDAT098" UBYTE COMP_0068 1 100 0 255 ECU_ADDRESS 0xFFFF34DA READ_WRITE /end MEASUREMENT
/begin MEASUREMENT vCANDAT099 "RAM value vCANDAT099" UBYTE COMP_0068 1 100 0 255 ECU_ADDRESS 0xFFFF34DB READ_WRITE /end MEASUREMENT
/begin MEASUREMENT vCANDAT0A0 "RAM value vCANDAT0A0" UBYTE COMP_0068 1 100 0 255 ECU_ADDRESS 0xFFFF34DC READ_WRITE /end MEASUREMENT
/begin MEASUREMENT vCANDAT0A1 "RAM value vCANDAT0A1" UBYTE COMP_0068 1 100 0 255 ECU_ADDRESS 0xFFFF34DD READ_WRITE /end MEASUREMENT
/begin MEASUREMENT vCANDAT0A2 "RAM value vCANDAT0A2" UBYTE COMP_0068 1 100 0 255 ECU_ADDRESS 0xFFFF34DE READ_WRITE /end MEASUREMENT
/begin MEASUREMENT vCANDAT0A3 "RAM value vCANDAT0A3" UBYTE COMP_0068 1 100 0 255 ECU_ADDRESS 0xFFFF34DF READ_WRITE /end MEASUREMENT
/begin MEASUREMENT vCANDAT0A4 "RAM value vCANDAT0A4" UBYTE COMP_0068 1 100 0 255 ECU_ADDRESS 0xFFFF34E0 READ_WRITE /end MEASUREMENT
/begin MEASUREMENT vCANDAT0A5 "RAM value vCANDAT0A5" UBYTE COMP_0068 1 100 0 255 ECU_ADDRESS 0xFFFF34E1 READ_WRITE /end MEASUREMENT
/begin MEASUREMENT vCANDAT0A6 "RAM value vCANDAT0A6" UBYTE COMP_0068 1 100 0 255 ECU_ADDRESS 0xFFFF34E2 READ_WRITE /end MEASUREMENT
/begin MEASUREMENT vCANDAT0A7 "RAM value vCANDAT0A7" UBYTE COMP_0068 1 100 0 255 ECU_ADDRESS 0xFFFF34E3 READ_WRITE /end MEASUREMENT
/begin MEASUREMENT vCANDAT0A8 "RAM value vCANDAT0A8" UBYTE COMP_0068 1 100 0 255 ECU_ADDRESS 0xFFFF34E4 READ_WRITE /end MEASUREMENT
/begin MEASUREMENT vCANDAT0A9 "RAM value vCANDAT0A9" UBYTE COMP_0068 1 100 0 255 ECU_ADDRESS 0xFFFF34E5 READ_WRITE /end MEASUREMENT
/begin MEASUREMENT vCANDAT0B0 "RAM value vCANDAT0B0" UBYTE COMP_0068 1 100 0 255 ECU_ADDRESS 0xFFFF34E6 READ_WRITE /end MEASUREMENT
/begin MEASUREMENT vCANDAT0B1 "RAM value vCANDAT0B1" UBYTE COMP_0068 1 100 0 255 ECU_ADDRESS 0xFFFF34E7 READ_WRITE /end MEASUREMENT
/begin MEASUREMENT vCANDAT0B2 "RAM value vCANDAT0B2" UBYTE COMP_0068 1 100 0 255 ECU_ADDRESS 0xFFFF34E8 READ_WRITE /end MEASUREMENT
/begin MEASUREMENT vCANDAT0B3 "RAM value vCANDAT0B3" UBYTE COMP_0068 1 100 0 255 ECU_ADDRESS 0xFFFF34E9 READ_WRITE /end MEASUREMENT
/begin MEASUREMENT vCANDAT0B4 "RAM value vCANDAT0B4" UBYTE COMP_0068 1 100 0 255 ECU_ADDRESS 0xFFFF34EA READ_WRITE /end MEASUREMENT
/begin MEASUREMENT vCANDAT0B5 "RAM value vCANDAT0B5" UBYTE COMP_0068 1 100 0 255 ECU_ADDRESS 0xFFFF34EB READ_WRITE /end MEASUREMENT
/begin MEASUREMENT vCANDAT0B6 "RAM value vCANDAT0B6" UBYTE COMP_0068 1 100 0 255 ECU_ADDRESS 0xFFFF34EC READ_WRITE /end MEASUREMENT
/begin MEASUREMENT vCANDAT0B7 "RAM value vCANDAT0B7" UBYTE COMP_0068 1 100 0 255 ECU_ADDRESS 0xFFFF34ED READ_WRITE /end MEASUREMENT
/begin MEASUREMENT vCANDAT0B8 "RAM value vCANDAT0B8" UBYTE COMP_0068 1 100 0 255 ECU_ADDRESS 0xFFFF34EE READ_WRITE /end MEASUREMENT
/begin MEASUREMENT vCANDAT0B9 "RAM value vCANDAT0B9" UBYTE COMP_0068 1 100 0 255 ECU_ADDRESS 0xFFFF34EF READ_WRITE /end MEASUREMENT
/begin MEASUREMENT vCANDAT0C0 "RAM value vCANDAT0C0" UBYTE COMP_0068 1 100 0 255 ECU_ADDRESS 0xFFFF34F0 READ_WRITE /end MEASUREMENT
/begin MEASUREMENT vCANDAT0C1 "RAM value vCANDAT0C1" UBYTE COMP_0068 1 100 0 255 ECU_ADDRESS 0xFFFF34F1 READ_WRITE /end MEASUREMENT
/begin MEASUREMENT vCANDAT0C2 "RAM value vCANDAT0C2" UBYTE COMP_0068 1 100 0 255 ECU_ADDRESS 0xFFFF34F2 READ_WRITE /end MEASUREMENT
/begin MEASUREMENT vCANDAT0C3 "RAM value vCANDAT0C3" UBYTE COMP_0068 1 100 0 255 ECU_ADDRESS 0xFFFF34F3 READ_WRITE /end MEASUREMENT
/begin MEASUREMENT vCANDAT0C4 "RAM value vCANDAT0C4" UBYTE COMP_0068 1 100 0 255 ECU_ADDRESS 0xFFFF34F4 READ_WRITE /end MEASUREMENT
/begin MEASUREMENT vCANDAT0C5 "RAM value vCANDAT0C5" UBYTE COMP_0068 1 100 0 255 ECU_ADDRESS 0xFFFF34F5 READ_WRITE /end MEASUREMENT
/begin MEASUREMENT vCANDAT0C6 "RAM value vCANDAT0C6" UBYTE COMP_0068 1 100 0 255 ECU_ADDRESS 0xFFFF34F6 READ_WRITE /end MEASUREMENT
/begin MEASUREMENT vCANDAT0C7 "RAM value vCANDAT0C7" UBYTE COMP_0068 1 100 0 255 ECU_ADDRESS 0xFFFF34F7 READ_WRITE /end MEASUREMENT
/begin MEASUREMENT vCANDAT0C8 "RAM value vCANDAT0C8" UBYTE COMP_0068 1 100 0 255 ECU_ADDRESS 0xFFFF34F8 READ_WRITE /end MEASUREMENT
/begin MEASUREMENT vCANDAT0C9 "RAM value vCANDAT0C9" UBYTE COMP_0068 1 100 0 255 ECU_ADDRESS 0xFFFF34F9 READ_WRITE /end MEASUREMENT
/begin MEASUREMENT vCANDAT0D0 "RAM value vCANDAT0D0" UBYTE COMP_0068 1 100 0 255 ECU_ADDRESS 0xFFFF34FA READ_WRITE /end MEASUREMENT
/begin MEASUREMENT vCANDAT0D1 "RAM value vCANDAT0D1" UBYTE COMP_0068 1 100 0 255 ECU_ADDRESS 0xFFFF34FB READ_WRITE /end MEASUREMENT
/begin MEASUREMENT vCANDAT0D2 "RAM value vCANDAT0D2" UBYTE COMP_0068 1 100 0 255 ECU_ADDRESS 0xFFFF34FC READ_WRITE /end MEASUREMENT
/begin MEASUREMENT vCANDAT0D3 "RAM value vCANDAT0D3" UBYTE COMP_0068 1 100 0 255 ECU_ADDRESS 0xFFFF34FD READ_WRITE /end MEASUREMENT
/begin MEASUREMENT vCANDAT0D4 "RAM value vCANDAT0D4" UBYTE COMP_0068 1 100 0 255 ECU_ADDRESS 0xFFFF34FE READ_WRITE /end MEASUREMENT
/begin MEASUREMENT vCANDAT0D5 "RAM value vCANDAT0D5" UBYTE COMP_0068 1 100 0 255 ECU_ADDRESS 0xFFFF34FF READ_WRITE /end MEASUREMENT
/begin MEASUREMENT vCANDAT0D6 "RAM value vCANDAT0D6" UBYTE COMP_0068 1 100 0 255 ECU_ADDRESS 0xFFFF3500 READ_WRITE /end MEASUREMENT
/begin MEASUREMENT vCANDAT0D7 "RAM value vCANDAT0D7" UBYTE COMP_0068 1 100 0 255 ECU_ADDRESS 0xFFFF3501 READ_WRITE /end MEASUREMENT
/begin MEASUREMENT vCANDAT0D8 "RAM value vCANDAT0D8" UBYTE COMP_0068 1 100 0 255 ECU_ADDRESS 0xFFFF3502 READ_WRITE /end MEASUREMENT
/begin MEASUREMENT vCANDAT0D9 "RAM value vCANDAT0D9" UBYTE COMP_0068 1 100 0 255 ECU_ADDRESS 0xFFFF3503 READ_WRITE /end MEASUREMENT
/begin MEASUREMENT vCANDAT0E0 "RAM value vCANDAT0E0" UBYTE COMP_0068 1 100 0 255 ECU_ADDRESS 0xFFFF3504 READ_WRITE /end MEASUREMENT
/begin MEASUREMENT vCANDAT0E1 "RAM value vCANDAT0E1" UBYTE COMP_0068 1 100 0 255 ECU_ADDRESS 0xFFFF3505 READ_WRITE /end MEASUREMENT
/begin MEASUREMENT vCANDAT0E2 "RAM value vCANDAT0E2" UBYTE COMP_0068 1 100 0 255 ECU_ADDRESS 0xFFFF3506 READ_WRITE /end MEASUREMENT
/begin MEASUREMENT vCANDAT0E3 "RAM value vCANDAT0E3" UBYTE COMP_0068 1 100 0 255 ECU_ADDRESS 0xFFFF3507 READ_WRITE /end MEASUREMENT
/begin MEASUREMENT vCANDAT0E4 "RAM value vCANDAT0E4" UBYTE COMP_0068 1 100 0 255 ECU_ADDRESS 0xFFFF3508 READ_WRITE /end MEASUREMENT
/begin MEASUREMENT vCANDAT0E5 "RAM value vCANDAT0E5" UBYTE COMP_0068 1 100 0 255 ECU_ADDRESS 0xFFFF3509 READ_WRITE /end MEASUREMENT
/begin MEASUREMENT vCANDAT0E6 "RAM value vCANDAT0E6" UBYTE COMP_0068 1 100 0 255 ECU_ADDRESS 0xFFFF350A READ_WRITE /end MEASUREMENT
/begin MEASUREMENT vCANDAT0E7 "RAM value vCANDAT0E7" UBYTE COMP_0068 1 100 0 255 ECU_ADDRESS 0xFFFF350B READ_WRITE /end MEASUREMENT
/begin MEASUREMENT vCANDAT0E8 "RAM value vCANDAT0E8" UBYTE COMP_0068 1 100 0 255 ECU_ADDRESS 0xFFFF350C READ_WRITE /end MEASUREMENT
/begin MEASUREMENT vCANDAT0E9 "RAM value vCANDAT0E9" UBYTE COMP_0068 1 100 0 255 ECU_ADDRESS 0xFFFF350D READ_WRITE /end MEASUREMENT
/begin MEASUREMENT vCANDAT0F0 "RAM value vCANDAT0F0" UBYTE COMP_0068 1 100 0 255 ECU_ADDRESS 0xFFFF350E READ_WRITE /end MEASUREMENT
/begin MEASUREMENT vCANDAT0F1 "RAM value vCANDAT0F1" UBYTE COMP_0068 1 100 0 255 ECU_ADDRESS 0xFFFF350F READ_WRITE /end MEASUREMENT
/begin MEASUREMENT vCANDAT0F2 "RAM value vCANDAT0F2" UBYTE COMP_0068 1 100 0 255 ECU_ADDRESS 0xFFFF3510 READ_WRITE /end MEASUREMENT
/begin MEASUREMENT vCANDAT0F3 "RAM value vCANDAT0F3" UBYTE COMP_0068 1 100 0 255 ECU_ADDRESS 0xFFFF3511 READ_WRITE /end MEASUREMENT
/begin MEASUREMENT vCANDAT0F4 "RAM value vCANDAT0F4" UBYTE COMP_0068 1 100 0 255 ECU_ADDRESS 0xFFFF3512 READ_WRITE /end MEASUREMENT
/begin MEASUREMENT vCANDAT0F5 "RAM value vCANDAT0F5" UBYTE COMP_0068 1 100 0 255 ECU_ADDRESS 0xFFFF3513 READ_WRITE /end MEASUREMENT
/begin MEASUREMENT vCANDAT0F6 "RAM value vCANDAT0F6" UBYTE COMP_0068 1 100 0 255 ECU_ADDRESS 0xFFFF3514 READ_WRITE /end MEASUREMENT
/begin MEASUREMENT vCANDAT0F7 "RAM value vCANDAT0F7" UBYTE COMP_0068 1 100 0 255 ECU_ADDRESS 0xFFFF3515 READ_WRITE /end MEASUREMENT
/begin MEASUREMENT vCANDAT0F8 "RAM value vCANDAT0F8" UBYTE COMP_0068 1 100 0 255 ECU_ADDRESS 0xFFFF3516 READ_WRITE /end MEASUREMENT
/begin MEASUREMENT vCANDAT0F9 "RAM value vCANDAT0F9" UBYTE COMP_0068 1 100 0 255 ECU_ADDRESS 0xFFFF3517 READ_WRITE /end MEASUREMENT
/begin MEASUREMENT vCANDAT100 "RAM value vCANDAT100" UBYTE COMP_0068 1 100 0 255 ECU_ADDRESS 0xFFFF3518 READ_WRITE /end MEASUREMENT
/begin MEASUREMENT vCANDAT101 "RAM value vCANDAT101" UBYTE COMP_0068 1 100 0 255 ECU_ADDRESS 0xFFFF3519 READ_WRITE /end MEASUREMENT
/begin MEASUREMENT vCANDAT102 "RAM value vCANDAT102" UBYTE COMP_0068 1 100 0 255 ECU_ADDRESS 0xFFFF351A READ_WRITE /end MEASUREMENT
/begin MEASUREMENT vCANDAT103 "RAM value vCANDAT103" UBYTE COMP_0068 1 100 0 255 ECU_ADDRESS 0xFFFF351B READ_WRITE /end MEASUREMENT
/begin MEASUREMENT vCANDAT104 "RAM value vCANDAT104" UBYTE COMP_0068 1 100 0 255 ECU_ADDRESS 0xFFFF351C READ_WRITE /end MEASUREMENT
/begin MEASUREMENT vCANDAT105 "RAM value vCANDAT105" UBYTE COMP_0068 1 100 0 255 ECU_ADDRESS 0xFFFF351D READ_WRITE /end MEASUREMENT
/begin MEASUREMENT vCANDAT106 "RAM value vCANDAT106" UBYTE COMP_0068 1 100 0 255 ECU_ADDRESS 0xFFFF351E READ_WRITE /end MEASUREMENT
/begin MEASUREMENT vCANDAT107 "RAM value vCANDAT107" UBYTE COMP_0068 1 100 0 255 ECU_ADDRESS 0xFFFF351F READ_WRITE /end MEASUREMENT
/begin MEASUREMENT vCANDAT108 "RAM value vCANDAT108" UBYTE COMP_0068 1 100 0 255 ECU_ADDRESS 0xFFFF3520 READ_WRITE /end MEASUREMENT
/begin MEASUREMENT vCANDAT109 "RAM value vCANDAT109" UBYTE COMP_0068 1 100 0 255 ECU_ADDRESS 0xFFFF3521 READ_WRITE /end MEASUREMENT
/begin MEASUREMENT vCANDAT110 "RAM value vCANDAT110" UBYTE COMP_0068 1 100 0 255 ECU_ADDRESS 0xFFFF3522 READ_WRITE /end MEASUREMENT
/begin MEASUREMENT vCANDAT111 "RAM value vCANDAT111" UBYTE COMP_0068 1 100 0 255 ECU_ADDRESS 0xFFFF3523 READ_WRITE /end MEASUREMENT
/begin MEASUREMENT vCANDAT112 "RAM value vCANDAT112" UBYTE COMP_0068 1 100 0 255 ECU_ADDRESS 0xFFFF3524 READ_WRITE /end MEASUREMENT
/begin MEASUREMENT vCANDAT113 "RAM value vCANDAT113" UBYTE COMP_0068 1 100 0 255 ECU_ADDRESS 0xFFFF3525 READ_WRITE /end MEASUREMENT
/begin MEASUREMENT vCANDAT114 "RAM value vCANDAT114" UBYTE COMP_0068 1 100 0 255 ECU_ADDRESS 0xFFFF3526 READ_WRITE /end MEASUREMENT
/begin MEASUREMENT vCANDAT115 "RAM value vCANDAT115" UBYTE COMP_0068 1 100 0 255 ECU_ADDRESS 0xFFFF3527 READ_WRITE /end MEASUREMENT
/begin MEASUREMENT vCANDAT116 "RAM value vCANDAT116" UBYTE COMP_0068 1 100 0 255 ECU_ADDRESS 0xFFFF3528 READ_WRITE /end MEASUREMENT
/begin MEASUREMENT vCANDAT117 "RAM value vCANDAT117" UBYTE COMP_0068 1 100 0 255 ECU_ADDRESS 0xFFFF3529 READ_WRITE /end MEASUREMENT
/begin MEASUREMENT vCANDAT118 "RAM value vCANDAT118" UBYTE COMP_0068 1 100 0 255 ECU_ADDRESS 0xFFFF352A READ_WRITE /end MEASUREMENT
/begin MEASUREMENT vCANDAT119 "RAM value vCANDAT119" UBYTE COMP_0068 1 100 0 255 ECU_ADDRESS 0xFFFF352B READ_WRITE /end MEASUREMENT
/begin MEASUREMENT vCANDAT120 "RAM value vCANDAT120" UBYTE COMP_0068 1 100 0 255 ECU_ADDRESS 0xFFFF352C READ_WRITE /end MEASUREMENT
/begin MEASUREMENT vCANDAT121 "RAM value vCANDAT121" UBYTE COMP_0068 1 100 0 255 ECU_ADDRESS 0xFFFF352D READ_WRITE /end MEASUREMENT
/begin MEASUREMENT vCANDAT122 "RAM value vCANDAT122" UBYTE COMP_0068 1 100 0 255 ECU_ADDRESS 0xFFFF352E READ_WRITE /end MEASUREMENT
/begin MEASUREMENT vCANDAT123 "RAM value vCANDAT123" UBYTE COMP_0068 1 100 0 255 ECU_ADDRESS 0xFFFF352F READ_WRITE /end MEASUREMENT
/begin MEASUREMENT vCANDAT124 "RAM value vCANDAT124" UBYTE COMP_0068 1 100 0 255 ECU_ADDRESS 0xFFFF3530 READ_WRITE /end MEASUREMENT
/begin MEASUREMENT vCANDAT125 "RAM value vCANDAT125" UBYTE COMP_0068 1 100 0 255 ECU_ADDRESS 0xFFFF3531 READ_WRITE /end MEASUREMENT
/begin MEASUREMENT vCANDAT126 "RAM value vCANDAT126" UBYTE COMP_0068 1 100 0 255 ECU_ADDRESS 0xFFFF3532 READ_WRITE /end MEASUREMENT
/begin MEASUREMENT vCANDAT127 "RAM value vCANDAT127" UBYTE COMP_0068 1 100 0 255 ECU_ADDRESS 0xFFFF3533 READ_WRITE /end MEASUREMENT
/begin MEASUREMENT vCANDAT128 "RAM value vCANDAT128" UBYTE COMP_0068 1 100 0 255 ECU_ADDRESS 0xFFFF3534 READ_WRITE /end MEASUREMENT
/begin MEASUREMENT vCANDAT129 "RAM value vCANDAT129" UBYTE COMP_0068 1 100 0 255 ECU_ADDRESS 0xFFFF3535 READ_WRITE /end MEASUREMENT
/begin MEASUREMENT vCANDAT130 "RAM value vCANDAT130" UBYTE COMP_0068 1 100 0 255 ECU_ADDRESS 0xFFFF3536 READ_WRITE /end MEASUREMENT
/begin MEASUREMENT vCANDAT131 "RAM value vCANDAT131" UBYTE COMP_0068 1 100 0 255 ECU_ADDRESS 0xFFFF3537 READ_WRITE /end MEASUREMENT
/begin MEASUREMENT vCANDAT132 "RAM value vCANDAT132" UBYTE COMP_0068 1 100 0 255 ECU_ADDRESS 0xFFFF3538 READ_WRITE /end MEASUREMENT
/begin MEASUREMENT vCANDAT133 "RAM value vCANDAT133" UBYTE COMP_0068 1 100 0 255 ECU_ADDRESS 0xFFFF3539 READ_WRITE /end MEASUREMENT
/begin MEASUREMENT vCANDAT134 "RAM value vCANDAT134" UBYTE COMP_0068 1 100 0 255 ECU_ADDRESS 0xFFFF353A READ_WRITE /end MEASUREMENT
/begin MEASUREMENT vCANDAT135 "RAM value vCANDAT135" UBYTE COMP_0068 1 100 0 255 ECU_ADDRESS 0xFFFF353B READ_WRITE /end MEASUREMENT
/begin MEASUREMENT vCANDAT136 "RAM value vCANDAT136" UBYTE COMP_0068 1 100 0 255 ECU_ADDRESS 0xFFFF353C READ_WRITE /end MEASUREMENT
/begin MEASUREMENT vCANDAT137 "RAM value vCANDAT137" UBYTE COMP_0068 1 100 0 255 ECU_ADDRESS 0xFFFF353D READ_WRITE /end MEASUREMENT
/begin MEASUREMENT vCANDAT138 "RAM value vCANDAT138" UBYTE COMP_0068 1 100 0 255 ECU_ADDRESS 0xFFFF353E READ_WRITE /end MEASUREMENT
/begin MEASUREMENT vCANDAT139 "RAM value vCANDAT139" UBYTE COMP_0068 1 100 0 255 ECU_ADDRESS 0xFFFF353F READ_WRITE /end MEASUREMENT
/begin MEASUREMENT vCANDAT140 "RAM value vCANDAT140" UBYTE COMP_0068 1 100 0 255 ECU_ADDRESS 0xFFFF3540 READ_WRITE /end MEASUREMENT
/begin MEASUREMENT vCANDAT141 "RAM value vCANDAT141" UBYTE COMP_0068 1 100 0 255 ECU_ADDRESS 0xFFFF3541 READ_WRITE /end MEASUREMENT
/begin MEASUREMENT vCANDAT142 "RAM value vCANDAT142" UBYTE COMP_0068 1 100 0 255 ECU_ADDRESS 0xFFFF3542 READ_WRITE /end MEASUREMENT
/begin MEASUREMENT vCANDAT143 "RAM value vCANDAT143" UBYTE COMP_0068 1 100 0 255 ECU_ADDRESS 0xFFFF3543 READ_WRITE /end MEASUREMENT
/begin MEASUREMENT vCANDAT144 "RAM value vCANDAT144" UBYTE COMP_0068 1 100 0 255 ECU_ADDRESS 0xFFFF3544 READ_WRITE /end MEASUREMENT
/begin MEASUREMENT vCANDAT145 "RAM value vCANDAT145" UBYTE COMP_0068 1 100 0 255 ECU_ADDRESS 0xFFFF3545 READ_WRITE /end MEASUREMENT
/begin MEASUREMENT vCANDAT146 "RAM value vCANDAT146" UBYTE COMP_0068 1 100 0 255 ECU_ADDRESS 0xFFFF3546 READ_WRITE /end MEASUREMENT
/begin MEASUREMENT vCANDAT147 "RAM value vCANDAT147" UBYTE COMP_0068 1 100 0 255 ECU_ADDRESS 0xFFFF3547 READ_WRITE /end MEASUREMENT
/begin MEASUREMENT vCANDAT148 "RAM value vCANDAT148" UBYTE COMP_0068 1 100 0 255 ECU_ADDRESS 0xFFFF3548 READ_WRITE /end MEASUREMENT
/begin MEASUREMENT vCANDAT149 "RAM value vCANDAT149" UBYTE COMP_0068 1 100 0 255 ECU_ADDRESS 0xFFFF3549 READ_WRITE /end MEASUREMENT
/begin MEASUREMENT vCANDAT150 "RAM value vCANDAT150" UBYTE COMP_0068 1 100 0 255 ECU_ADDRESS 0xFFFF354A READ_WRITE /end MEASUREMENT
/begin MEASUREMENT vCANDAT151 "RAM value vCANDAT151" UBYTE COMP_0068 1 100 0 255 ECU_ADDRESS 0xFFFF354B READ_WRITE /end MEASUREMENT
/begin MEASUREMENT vCANDAT152 "RAM value vCANDAT152" UBYTE COMP_0068 1 100 0 255 ECU_ADDRESS 0xFFFF354C READ_WRITE /end MEASUREMENT
/begin MEASUREMENT vCANDAT153 "RAM value vCANDAT153" UBYTE COMP_0068 1 100 0 255 ECU_ADDRESS 0xFFFF354D READ_WRITE /end MEASUREMENT
/begin MEASUREMENT vCANDAT154 "RAM value vCANDAT154" UBYTE COMP_0068 1 100 0 255 ECU_ADDRESS 0xFFFF354E READ_WRITE /end MEASUREMENT
/begin MEASUREMENT vCANDAT155 "RAM value vCANDAT155" UBYTE COMP_0068 1 100 0 255 ECU_ADDRESS 0xFFFF354F READ_WRITE /end MEASUREMENT
/begin MEASUREMENT vCANDAT156 "RAM value vCANDAT156" UBYTE COMP_0068 1 100 0 255 ECU_ADDRESS 0xFFFF3550 READ_WRITE /end MEASUREMENT
/begin MEASUREMENT vCANDAT157 "RAM value vCANDAT157" UBYTE COMP_0068 1 100 0 255 ECU_ADDRESS 0xFFFF3551 READ_WRITE /end MEASUREMENT
/begin MEASUREMENT vCANDAT158 "RAM value vCANDAT158" UBYTE COMP_0068 1 100 0 255 ECU_ADDRESS 0xFFFF3552 READ_WRITE /end MEASUREMENT
/begin MEASUREMENT vCANDAT159 "RAM value vCANDAT159" UBYTE COMP_0068 1 100 0 255 ECU_ADDRESS 0xFFFF3553 READ_WRITE /end MEASUREMENT
/begin MEASUREMENT vCANDAT160 "RAM value vCANDAT160" UBYTE COMP_0068 1 100 0 255 ECU_ADDRESS 0xFFFF3554 READ_WRITE /end MEASUREMENT
/begin MEASUREMENT vCANDAT161 "RAM value vCANDAT161" UBYTE COMP_0068 1 100 0 255 ECU_ADDRESS 0xFFFF3555 READ_WRITE /end MEASUREMENT
/begin MEASUREMENT vCANDAT162 "RAM value vCANDAT162" UBYTE COMP_0068 1 100 0 255 ECU_ADDRESS 0xFFFF3556 READ_WRITE /end MEASUREMENT
/begin MEASUREMENT vCANDAT163 "RAM value vCANDAT163" UBYTE COMP_0068 1 100 0 255 ECU_ADDRESS 0xFFFF3557 READ_WRITE /end MEASUREMENT
/begin MEASUREMENT vCANDAT164 "RAM value vCANDAT164" UBYTE COMP_0068 1 100 0 255 ECU_ADDRESS 0xFFFF3558 READ_WRITE /end MEASUREMENT
/begin MEASUREMENT vCANDAT165 "RAM value vCANDAT165" UBYTE COMP_0068 1 100 0 255 ECU_ADDRESS 0xFFFF3559 READ_WRITE /end MEASUREMENT
/begin MEASUREMENT vCANDAT166 "RAM value vCANDAT166" UBYTE COMP_0068 1 100 0 255 ECU_ADDRESS 0xFFFF355A READ_WRITE /end MEASUREMENT
/begin MEASUREMENT vCANDAT167 "RAM value vCANDAT167" UBYTE COMP_0068 1 100 0 255 ECU_ADDRESS 0xFFFF355B READ_WRITE /end MEASUREMENT
/begin MEASUREMENT vCANDAT168 "RAM value vCANDAT168" UBYTE COMP_0068 1 100 0 255 ECU_ADDRESS 0xFFFF355C READ_WRITE /end MEASUREMENT
/begin MEASUREMENT vCANDAT169 "RAM value vCANDAT169" UBYTE COMP_0068 1 100 0 255 ECU_ADDRESS 0xFFFF355D READ_WRITE /end MEASUREMENT
/begin MEASUREMENT vCANDAT170 "RAM value vCANDAT170" UBYTE COMP_0068 1 100 0 255 ECU_ADDRESS 0xFFFF355E READ_WRITE /end MEASUREMENT
/begin MEASUREMENT vCANDAT171 "RAM value vCANDAT171" UBYTE COMP_0068 1 100 0 255 ECU_ADDRESS 0xFFFF355F READ_WRITE /end MEASUREMENT
/begin MEASUREMENT vCANDAT172 "RAM value vCANDAT172" UBYTE COMP_0068 1 100 0 255 ECU_ADDRESS 0xFFFF3560 READ_WRITE /end MEASUREMENT
/begin MEASUREMENT vCANDAT173 "RAM value vCANDAT173" UBYTE COMP_0068 1 100 0 255 ECU_ADDRESS 0xFFFF3561 READ_WRITE /end MEASUREMENT
/begin MEASUREMENT vCANDAT174 "RAM value vCANDAT174" UBYTE COMP_0068 1 100 0 255 ECU_ADDRESS 0xFFFF3562 READ_WRITE /end MEASUREMENT
/begin MEASUREMENT vCANDAT175 "RAM value vCANDAT175" UBYTE COMP_0068 1 100 0 255 ECU_ADDRESS 0xFFFF3563 READ_WRITE /end MEASUREMENT
/begin MEASUREMENT vCANDAT176 "RAM value vCANDAT176" UBYTE COMP_0068 1 100 0 255 ECU_ADDRESS 0xFFFF3564 READ_WRITE /end MEASUREMENT
/begin MEASUREMENT vCANDAT177 "RAM value vCANDAT177" UBYTE COMP_0068 1 100 0 255 ECU_ADDRESS 0xFFFF3565 READ_WRITE /end MEASUREMENT
/begin MEASUREMENT vCANDAT178 "RAM value vCANDAT178" UBYTE COMP_0068 1 100 0 255 ECU_ADDRESS 0xFFFF3566 READ_WRITE /end MEASUREMENT
/begin MEASUREMENT vCANDAT179 "RAM value vCANDAT179" UBYTE COMP_0068 1 100 0 255 ECU_ADDRESS 0xFFFF3567 READ_WRITE /end MEASUREMENT
/begin MEASUREMENT vCANDAT180 "RAM value vCANDAT180" UBYTE COMP_0068 1 100 0 255 ECU_ADDRESS 0xFFFF3568 READ_WRITE /end MEASUREMENT
/begin MEASUREMENT vCANDAT181 "RAM value vCANDAT181" UBYTE COMP_0068 1 100 0 255 ECU_ADDRESS 0xFFFF3569 READ_WRITE /end MEASUREMENT
/begin MEASUREMENT vCANDAT182 "RAM value vCANDAT182" UBYTE COMP_0068 1 100 0 255 ECU_ADDRESS 0xFFFF356A READ_WRITE /end MEASUREMENT
/begin MEASUREMENT vCANDAT183 "RAM value vCANDAT183" UBYTE COMP_0068 1 100 0 255 ECU_ADDRESS 0xFFFF356B READ_WRITE /end MEASUREMENT
/begin MEASUREMENT vCANDAT184 "RAM value vCANDAT184" UBYTE COMP_0068 1 100 0 255 ECU_ADDRESS 0xFFFF356C READ_WRITE /end MEASUREMENT
/begin MEASUREMENT vCANDAT185 "RAM value vCANDAT185" UBYTE COMP_0068 1 100 0 255 ECU_ADDRESS 0xFFFF356D READ_WRITE /end MEASUREMENT
/begin MEASUREMENT vCANDAT186 "RAM value vCANDAT186" UBYTE COMP_0068 1 100 0 255 ECU_ADDRESS 0xFFFF356E READ_WRITE /end MEASUREMENT
/begin MEASUREMENT vCANDAT187 "RAM value vCANDAT187" UBYTE COMP_0068 1 100 0 255 ECU_ADDRESS 0xFFFF356F READ_WRITE /end MEASUREMENT
/begin MEASUREMENT vCANDAT188 "RAM value vCANDAT188" UBYTE COMP_0068 1 100 0 255 ECU_ADDRESS 0xFFFF3570 READ_WRITE /end MEASUREMENT
/begin MEASUREMENT vCANDAT189 "RAM value vCANDAT189" UBYTE COMP_0068 1 100 0 255 ECU_ADDRESS 0xFFFF3571 READ_WRITE /end MEASUREMENT
/begin MEASUREMENT vCANDAT190 "RAM value vCANDAT190" UBYTE COMP_0068 1 100 0 255 ECU_ADDRESS 0xFFFF3572 READ_WRITE /end MEASUREMENT
/begin MEASUREMENT vCANDAT191 "RAM value vCANDAT191" UBYTE COMP_0068 1 100 0 255 ECU_ADDRESS 0xFFFF3573 READ_WRITE /end MEASUREMENT
/begin MEASUREMENT vCANDAT192 "RAM value vCANDAT192" UBYTE COMP_0068 1 100 0 255 ECU_ADDRESS 0xFFFF3574 READ_WRITE /end MEASUREMENT
/begin MEASUREMENT vCANDAT193 "RAM value vCANDAT193" UBYTE COMP_0068 1 100 0 255 ECU_ADDRESS 0xFFFF3575 READ_WRITE /end MEASUREMENT
/begin MEASUREMENT vCANDAT194 "RAM value vCANDAT194" UBYTE COMP_0068 1 100 0 255 ECU_ADDRESS 0xFFFF3576 READ_WRITE /end MEASUREMENT
/begin MEASUREMENT vCANDAT195 "RAM value vCANDAT195" UBYTE COMP_0068 1 100 0 255 ECU_ADDRESS 0xFFFF3577 READ_WRITE /end MEASUREMENT
/begin MEASUREMENT vCANDAT196 "RAM value vCANDAT196" UBYTE COMP_0068 1 100 0 255 ECU_ADDRESS 0xFFFF3578 READ_WRITE /end MEASUREMENT
/begin MEASUREMENT vCANDAT197 "RAM value vCANDAT197" UBYTE COMP_0068 1 100 0 255 ECU_ADDRESS 0xFFFF3579 READ_WRITE /end MEASUREMENT
/begin MEASUREMENT vCANDAT198 "RAM value vCANDAT198" UBYTE COMP_0068 1 100 0 255 ECU_ADDRESS 0xFFFF357A READ_WRITE /end MEASUREMENT
/begin MEASUREMENT vCANDAT199 "RAM value vCANDAT199" UBYTE COMP_0068 1 100 0 255 ECU_ADDRESS 0xFFFF357B READ_WRITE /end MEASUREMENT
/begin MEASUREMENT vCANDAT1A0 "RAM value vCANDAT1A0" UBYTE COMP_0068 1 100 0 255 ECU_ADDRESS 0xFFFF357C READ_WRITE /end MEASUREMENT
/begin MEASUREMENT vCANDAT1A1 "RAM value vCANDAT1A1" UBYTE COMP_0068 1 100 0 255 ECU_ADDRESS 0xFFFF357D READ_WRITE /end MEASUREMENT
/begin MEASUREMENT vCANDAT1A2 "RAM value vCANDAT1A2" UBYTE COMP_0068 1 100 0 255 ECU_ADDRESS 0xFFFF357E READ_WRITE /end MEASUREMENT
/begin MEASUREMENT vCANDAT1A3 "RAM value vCANDAT1A3" UBYTE COMP_0068 1 100 0 255 ECU_ADDRESS 0xFFFF357F READ_WRITE /end MEASUREMENT
/begin MEASUREMENT vCANDAT1A4 "RAM value vCANDAT1A4" UBYTE COMP_0068 1 100 0 255 ECU_ADDRESS 0xFFFF3580 READ_WRITE /end MEASUREMENT
/begin MEASUREMENT vCANDAT1A5 "RAM value vCANDAT1A5" UBYTE COMP_0068 1 100 0 255 ECU_ADDRESS 0xFFFF3581 READ_WRITE /end MEASUREMENT
/begin MEASUREMENT vCANDAT1A6 "RAM value vCANDAT1A6" UBYTE COMP_0068 1 100 0 255 ECU_ADDRESS 0xFFFF3582 READ_WRITE /end MEASUREMENT
/begin MEASUREMENT vCANDAT1A7 "RAM value vCANDAT1A7" UBYTE COMP_0068 1 100 0 255 ECU_ADDRESS 0xFFFF3583 READ_WRITE /end MEASUREMENT
/begin MEASUREMENT vCANDAT1A8 "RAM value vCANDAT1A8" UBYTE COMP_0068 1 100 0 255 ECU_ADDRESS 0xFFFF3584 READ_WRITE /end MEASUREMENT
/begin MEASUREMENT vCANDAT1A9 "RAM value vCANDAT1A9" UBYTE COMP_0068 1 100 0 255 ECU_ADDRESS 0xFFFF3585 READ_WRITE /end MEASUREMENT
/begin MEASUREMENT vCANDAT1B0 "RAM value vCANDAT1B0" UBYTE COMP_0068 1 100 0 255 ECU_ADDRESS 0xFFFF3586 READ_WRITE /end MEASUREMENT
/begin MEASUREMENT vCANDAT1B1 "RAM value vCANDAT1B1" UBYTE COMP_0068 1 100 0 255 ECU_ADDRESS 0xFFFF3587 READ_WRITE /end MEASUREMENT
/begin MEASUREMENT vCANDAT1B2 "RAM value vCANDAT1B2" UBYTE COMP_0068 1 100 0 255 ECU_ADDRESS 0xFFFF3588 READ_WRITE /end MEASUREMENT
/begin MEASUREMENT vCANDAT1B3 "RAM value vCANDAT1B3" UBYTE COMP_0068 1 100 0 255 ECU_ADDRESS 0xFFFF3589 READ_WRITE /end MEASUREMENT
/begin MEASUREMENT vCANDAT1B4 "RAM value vCANDAT1B4" UBYTE COMP_0068 1 100 0 255 ECU_ADDRESS 0xFFFF358A READ_WRITE /end MEASUREMENT
/begin MEASUREMENT vCANDAT1B5 "RAM value vCANDAT1B5" UBYTE COMP_0068 1 100 0 255 ECU_ADDRESS 0xFFFF358B READ_WRITE /end MEASUREMENT
/begin MEASUREMENT vCANDAT1B6 "RAM value vCANDAT1B6" UBYTE COMP_0068 1 100 0 255 ECU_ADDRESS 0xFFFF358C READ_WRITE /end MEASUREMENT
/begin MEASUREMENT vCANDAT1B7 "RAM value vCANDAT1B7" UBYTE COMP_0068 1 100 0 255 ECU_ADDRESS 0xFFFF358D READ_WRITE /end MEASUREMENT
/begin MEASUREMENT vCANDAT1B8 "RAM value vCANDAT1B8" UBYTE COMP_0068 1 100 0 255 ECU_ADDRESS 0xFFFF358E READ_WRITE /end MEASUREMENT
/begin MEASUREMENT vCANDAT1B9 "RAM value vCANDAT1B9" UBYTE COMP_0068 1 100 0 255 ECU_ADDRESS 0xFFFF358F READ_WRITE /end MEASUREMENT
/begin MEASUREMENT vCANDAT1C0 "RAM value vCANDAT1C0" UBYTE COMP_0068 1 100 0 255 ECU_ADDRESS 0xFFFF3590 READ_WRITE /end MEASUREMENT
/begin MEASUREMENT vCANDAT1C1 "RAM value vCANDAT1C1" UBYTE COMP_0068 1 100 0 255 ECU_ADDRESS 0xFFFF3591 READ_WRITE /end MEASUREMENT
/begin MEASUREMENT vCANDAT1C2 "RAM value vCANDAT1C2" UBYTE COMP_0068 1 100 0 255 ECU_ADDRESS 0xFFFF3592 READ_WRITE /end MEASUREMENT
/begin MEASUREMENT vCANDAT1C3 "RAM value vCANDAT1C3" UBYTE COMP_0068 1 100 0 255 ECU_ADDRESS 0xFFFF3593 READ_WRITE /end MEASUREMENT
/begin MEASUREMENT vCANDAT1C4 "RAM value vCANDAT1C4" UBYTE COMP_0068 1 100 0 255 ECU_ADDRESS 0xFFFF3594 READ_WRITE /end MEASUREMENT
/begin MEASUREMENT vCANDAT1C5 "RAM value vCANDAT1C5" UBYTE COMP_0068 1 100 0 255 ECU_ADDRESS 0xFFFF3595 READ_WRITE /end MEASUREMENT
/begin MEASUREMENT vCANDAT1C6 "RAM value vCANDAT1C6" UBYTE COMP_0068 1 100 0 255 ECU_ADDRESS 0xFFFF3596 READ_WRITE /end MEASUREMENT
/begin MEASUREMENT vCANDAT1C7 "RAM value vCANDAT1C7" UBYTE COMP_0068 1 100 0 255 ECU_ADDRESS 0xFFFF3597 READ_WRITE /end MEASUREMENT
/begin MEASUREMENT vCANDAT1C8 "RAM value vCANDAT1C8" UBYTE COMP_0068 1 100 0 255 ECU_ADDRESS 0xFFFF3598 READ_WRITE /end MEASUREMENT
/begin MEASUREMENT vCANDAT1C9 "RAM value vCANDAT1C9" UBYTE COMP_0068 1 100 0 255 ECU_ADDRESS 0xFFFF3599 READ_WRITE /end MEASUREMENT
/begin MEASUREMENT vCANDAT1D0 "RAM value vCANDAT1D0" UBYTE COMP_0068 1 100 0 255 ECU_ADDRESS 0xFFFF359A READ_WRITE /end MEASUREMENT
/begin MEASUREMENT vCANDAT1D1 "RAM value vCANDAT1D1" UBYTE COMP_0068 1 100 0 255 ECU_ADDRESS 0xFFFF359B READ_WRITE /end MEASUREMENT
/begin MEASUREMENT vCANDAT1D2 "RAM value vCANDAT1D2" UBYTE COMP_0068 1 100 0 255 ECU_ADDRESS 0xFFFF359C READ_WRITE /end MEASUREMENT
/begin MEASUREMENT vCANDAT1D3 "RAM value vCANDAT1D3" UBYTE COMP_0068 1 100 0 255 ECU_ADDRESS 0xFFFF359D READ_WRITE /end MEASUREMENT
/begin MEASUREMENT vCANDAT1D4 "RAM value vCANDAT1D4" UBYTE COMP_0068 1 100 0 255 ECU_ADDRESS 0xFFFF359E READ_WRITE /end MEASUREMENT
/begin MEASUREMENT vCANDAT1D5 "RAM value vCANDAT1D5" UBYTE COMP_0068 1 100 0 255 ECU_ADDRESS 0xFFFF359F READ_WRITE /end MEASUREMENT
/begin MEASUREMENT vCANDAT1D6 "RAM value vCANDAT1D6" UBYTE COMP_0068 1 100 0 255 ECU_ADDRESS 0xFFFF35A0 READ_WRITE /end MEASUREMENT
/begin MEASUREMENT vCANDAT1D7 "RAM value vCANDAT1D7" UBYTE COMP_0068 1 100 0 255 ECU_ADDRESS 0xFFFF35A1 READ_WRITE /end MEASUREMENT
/begin MEASUREMENT vCANDAT1D8 "RAM value vCANDAT1D8" UBYTE COMP_0068 1 100 0 255 ECU_ADDRESS 0xFFFF35A2 READ_WRITE /end MEASUREMENT
/begin MEASUREMENT vCANDAT1D9 "RAM value vCANDAT1D9" UBYTE COMP_0068 1 100 0 255 ECU_ADDRESS 0xFFFF35A3 READ_WRITE /end MEASUREMENT
/begin MEASUREMENT vCANDAT1E0 "RAM value vCANDAT1E0" UBYTE COMP_0068 1 100 0 255 ECU_ADDRESS 0xFFFF35A4 READ_WRITE /end MEASUREMENT
/begin MEASUREMENT vCANDAT1E1 "RAM value vCANDAT1E1" UBYTE COMP_0068 1 100 0 255 ECU_ADDRESS 0xFFFF35A5 READ_WRITE /end MEASUREMENT
/begin MEASUREMENT vCANDAT1E2 "RAM value vCANDAT1E2" UBYTE COMP_0068 1 100 0 255 ECU_ADDRESS 0xFFFF35A6 READ_WRITE /end MEASUREMENT
/begin MEASUREMENT vCANDAT1E3 "RAM value vCANDAT1E3" UBYTE COMP_0068 1 100 0 255 ECU_ADDRESS 0xFFFF35A7 READ_WRITE /end MEASUREMENT
/begin MEASUREMENT vCANDAT1E4 "RAM value vCANDAT1E4" UBYTE COMP_0068 1 100 0 255 ECU_ADDRESS 0xFFFF35A8 READ_WRITE /end MEASUREMENT
/begin MEASUREMENT vCANDAT1E5 "RAM value vCANDAT1E5" UBYTE COMP_0068 1 100 0 255 ECU_ADDRESS 0xFFFF35A9 READ_WRITE /end MEASUREMENT
/begin MEASUREMENT vCANDAT1E6 "RAM value vCANDAT1E6" UBYTE COMP_0068 1 100 0 255 ECU_ADDRESS 0xFFFF35AA READ_WRITE /end MEASUREMENT
/begin MEASUREMENT vCANDAT1E7 "RAM value vCANDAT1E7" UBYTE COMP_0068 1 100 0 255 ECU_ADDRESS 0xFFFF35AB READ_WRITE /end MEASUREMENT
/begin MEASUREMENT vCANDAT1E8 "RAM value vCANDAT1E8" UBYTE COMP_0068 1 100 0 255 ECU_ADDRESS 0xFFFF35AC READ_WRITE /end MEASUREMENT
/begin MEASUREMENT vCANDAT1E9 "RAM value vCANDAT1E9" UBYTE COMP_0068 1 100 0 255 ECU_ADDRESS 0xFFFF35AD READ_WRITE /end MEASUREMENT
/begin MEASUREMENT vCANDAT1F0 "RAM value vCANDAT1F0" UBYTE COMP_0068 1 100 0 255 ECU_ADDRESS 0xFFFF35AE READ_WRITE /end MEASUREMENT
/begin MEASUREMENT vCANDAT1F1 "RAM value vCANDAT1F1" UBYTE COMP_0068 1 100 0 255 ECU_ADDRESS 0xFFFF35AF READ_WRITE /end MEASUREMENT
/begin MEASUREMENT vCANDAT1F2 "RAM value vCANDAT1F2" UBYTE COMP_0068 1 100 0 255 ECU_ADDRESS 0xFFFF35B0 READ_WRITE /end MEASUREMENT
/begin MEASUREMENT vCANDAT1F3 "RAM value vCANDAT1F3" UBYTE COMP_0068 1 100 0 255 ECU_ADDRESS 0xFFFF35B1 READ_WRITE /end MEASUREMENT
/begin MEASUREMENT vCANDAT1F4 "RAM value vCANDAT1F4" UBYTE COMP_0068 1 100 0 255 ECU_ADDRESS 0xFFFF35B2 READ_WRITE /end MEASUREMENT
/begin MEASUREMENT vCANDAT1F5 "RAM value vCANDAT1F5" UBYTE COMP_0068 1 100 0 255 ECU_ADDRESS 0xFFFF35B3 READ_WRITE /end MEASUREMENT
/begin MEASUREMENT vCANDAT1F6 "RAM value vCANDAT1F6" UBYTE COMP_0068 1 100 0 255 ECU_ADDRESS 0xFFFF35B4 READ_WRITE /end MEASUREMENT
/begin MEASUREMENT vCANDAT1F7 "RAM value vCANDAT1F7" UBYTE COMP_0068 1 100 0 255 ECU_ADDRESS 0xFFFF35B5 READ_WRITE /end MEASUREMENT
/begin MEASUREMENT vCANDAT1F8 "RAM value vCANDAT1F8" UBYTE COMP_0068 1 100 0 255 ECU_ADDRESS 0xFFFF35B6 READ_WRITE /end MEASUREMENT
/begin MEASUREMENT vCANDAT1F9 "RAM value vCANDAT1F9" UBYTE COMP_0068 1 100 0 255 ECU_ADDRESS 0xFFFF35B7 READ_WRITE /end MEASUREMENT
/begin MEASUREMENT vCANDAT200 "RAM value vCANDAT200" UBYTE COMP_0068 1 100 0 255 ECU_ADDRESS 0xFFFF35B8 READ_WRITE /end MEASUREMENT
/begin MEASUREMENT vCANDAT201 "RAM value vCANDAT201" UBYTE COMP_0068 1 100 0 255 ECU_ADDRESS 0xFFFF35B9 READ_WRITE /end MEASUREMENT
/begin MEASUREMENT vCANDAT202 "RAM value vCANDAT202" UBYTE COMP_0068 1 100 0 255 ECU_ADDRESS 0xFFFF35BA READ_WRITE /end MEASUREMENT
/begin MEASUREMENT vCANDAT203 "RAM value vCANDAT203" UBYTE COMP_0068 1 100 0 255 ECU_ADDRESS 0xFFFF35BB READ_WRITE /end MEASUREMENT
/begin MEASUREMENT vCANDAT204 "RAM value vCANDAT204" UBYTE COMP_0068 1 100 0 255 ECU_ADDRESS 0xFFFF35BC READ_WRITE /end MEASUREMENT
/begin MEASUREMENT vCANDAT205 "RAM value vCANDAT205" UBYTE COMP_0068 1 100 0 255 ECU_ADDRESS 0xFFFF35BD READ_WRITE /end MEASUREMENT
/begin MEASUREMENT vCANDAT206 "RAM value vCANDAT206" UBYTE COMP_0068 1 100 0 255 ECU_ADDRESS 0xFFFF35BE READ_WRITE /end MEASUREMENT
/begin MEASUREMENT vCANDAT207 "RAM value vCANDAT207" UBYTE COMP_0068 1 100 0 255 ECU_ADDRESS 0xFFFF35BF READ_WRITE /end MEASUREMENT
/begin MEASUREMENT vCANDAT208 "RAM value vCANDAT208" UBYTE COMP_0068 1 100 0 255 ECU_ADDRESS 0xFFFF35C0 READ_WRITE /end MEASUREMENT
/begin MEASUREMENT vCANDAT209 "RAM value vCANDAT209" UBYTE COMP_0068 1 100 0 255 ECU_ADDRESS 0xFFFF35C1 READ_WRITE /end MEASUREMENT
/begin MEASUREMENT vCANDAT210 "RAM value vCANDAT210" UBYTE COMP_0068 1 100 0 255 ECU_ADDRESS 0xFFFF35C2 READ_WRITE /end MEASUREMENT
/begin MEASUREMENT vCANDAT211 "RAM value vCANDAT211" UBYTE COMP_0068 1 100 0 255 ECU_ADDRESS 0xFFFF35C3 READ_WRITE /end MEASUREMENT
/begin MEASUREMENT vCANDAT212 "RAM value vCANDAT212" UBYTE COMP_0068 1 100 0 255 ECU_ADDRESS 0xFFFF35C4 READ_WRITE /end MEASUREMENT
/begin MEASUREMENT vCANDAT213 "RAM value vCANDAT213" UBYTE COMP_0068 1 100 0 255 ECU_ADDRESS 0xFFFF35C5 READ_WRITE /end MEASUREMENT
/begin MEASUREMENT vCANDAT214 "RAM value vCANDAT214" UBYTE COMP_0068 1 100 0 255 ECU_ADDRESS 0xFFFF35C6 READ_WRITE /end MEASUREMENT
/begin MEASUREMENT vCANDAT215 "RAM value vCANDAT215" UBYTE COMP_0068 1 100 0 255 ECU_ADDRESS 0xFFFF35C7 READ_WRITE /end MEASUREMENT
/begin MEASUREMENT vCANDAT216 "RAM value vCANDAT216" UBYTE COMP_0068 1 100 0 255 ECU_ADDRESS 0xFFFF35C8 READ_WRITE /end MEASUREMENT
/begin MEASUREMENT vCANDAT217 "RAM value vCANDAT217" UBYTE COMP_0068 1 100 0 255 ECU_ADDRESS 0xFFFF35C9 READ_WRITE /end MEASUREMENT
/begin MEASUREMENT vCANDAT218 "RAM value vCANDAT218" UBYTE COMP_0068 1 100 0 255 ECU_ADDRESS 0xFFFF35CA READ_WRITE /end MEASUREMENT
/begin MEASUREMENT vCANDAT219 "RAM value vCANDAT219" UBYTE COMP_0068 1 100 0 255 ECU_ADDRESS 0xFFFF35CB READ_WRITE /end MEASUREMENT
/begin MEASUREMENT vCANDAT220 "RAM value vCANDAT220" UBYTE COMP_0068 1 100 0 255 ECU_ADDRESS 0xFFFF35CC READ_WRITE /end MEASUREMENT
/begin MEASUREMENT vCANDAT221 "RAM value vCANDAT221" UBYTE COMP_0068 1 100 0 255 ECU_ADDRESS 0xFFFF35CD READ_WRITE /end MEASUREMENT
/begin MEASUREMENT vCANDAT222 "RAM value vCANDAT222" UBYTE COMP_0068 1 100 0 255 ECU_ADDRESS 0xFFFF35CE READ_WRITE /end MEASUREMENT
/begin MEASUREMENT vCANDAT223 "RAM value vCANDAT223" UBYTE COMP_0068 1 100 0 255 ECU_ADDRESS 0xFFFF35CF READ_WRITE /end MEASUREMENT
/begin MEASUREMENT vCANDAT224 "RAM value vCANDAT224" UBYTE COMP_0068 1 100 0 255 ECU_ADDRESS 0xFFFF35D0 READ_WRITE /end MEASUREMENT
/begin MEASUREMENT vCANDAT225 "RAM value vCANDAT225" UBYTE COMP_0068 1 100 0 255 ECU_ADDRESS 0xFFFF35D1 READ_WRITE /end MEASUREMENT
/begin MEASUREMENT vCANDAT226 "RAM value vCANDAT226" UBYTE COMP_0068 1 100 0 255 ECU_ADDRESS 0xFFFF35D2 READ_WRITE /end MEASUREMENT
/begin MEASUREMENT vCANDAT227 "RAM value vCANDAT227" UBYTE COMP_0068 1 100 0 255 ECU_ADDRESS 0xFFFF35D3 READ_WRITE /end MEASUREMENT
/begin MEASUREMENT vCANDAT228 "RAM value vCANDAT228" UBYTE COMP_0068 1 100 0 255 ECU_ADDRESS 0xFFFF35D4 READ_WRITE /end MEASUREMENT
/begin MEASUREMENT vCANDAT229 "RAM value vCANDAT229" UBYTE COMP_0068 1 100 0 255 ECU_ADDRESS 0xFFFF35D5 READ_WRITE /end MEASUREMENT
/begin MEASUREMENT vCANDAT230 "RAM value vCANDAT230" UBYTE COMP_0068 1 100 0 255 ECU_ADDRESS 0xFFFF35D6 READ_WRITE /end MEASUREMENT
/begin MEASUREMENT vCANDAT231 "RAM value vCANDAT231" UBYTE COMP_0068 1 100 0 255 ECU_ADDRESS 0xFFFF35D7 READ_WRITE /end MEASUREMENT
/begin MEASUREMENT vCANDAT232 "RAM value vCANDAT232" UBYTE COMP_0068 1 100 0 255 ECU_ADDRESS 0xFFFF35D8 READ_WRITE /end MEASUREMENT
/begin MEASUREMENT vCANDAT233 "RAM value vCANDAT233" UBYTE COMP_0068 1 100 0 255 ECU_ADDRESS 0xFFFF35D9 READ_WRITE /end MEASUREMENT
/begin MEASUREMENT vCANDAT234 "RAM value vCANDAT234" UBYTE COMP_0068 1 100 0 255 ECU_ADDRESS 0xFFFF35DA READ_WRITE /end MEASUREMENT
/begin MEASUREMENT vCANDAT235 "RAM value vCANDAT235" UBYTE COMP_0068 1 100 0 255 ECU_ADDRESS 0xFFFF35DB READ_WRITE /end MEASUREMENT
/begin MEASUREMENT vCANDAT236 "RAM value vCANDAT236" UBYTE COMP_0068 1 100 0 255 ECU_ADDRESS 0xFFFF35DC READ_WRITE /end MEASUREMENT
/begin MEASUREMENT vCANDAT237 "RAM value vCANDAT237" UBYTE COMP_0068 1 100 0 255 ECU_ADDRESS 0xFFFF35DD READ_WRITE /end MEASUREMENT
/begin MEASUREMENT vCANDAT238 "RAM value vCANDAT238" UBYTE COMP_0068 1 100 0 255 ECU_ADDRESS 0xFFFF35DE READ_WRITE /end MEASUREMENT
/begin MEASUREMENT vCANDAT239 "RAM value vCANDAT239" UBYTE COMP_0068 1 100 0 255 ECU_ADDRESS 0xFFFF35DF READ_WRITE /end MEASUREMENT
/begin MEASUREMENT vM1MIN1 "RAM value vM1MIN1" ULONG COMP_0068 1 100 0 4294967295 ECU_ADDRESS 0xFFFF4B94 READ_WRITE /end MEASUREMENT
/begin MEASUREMENT vM1MIN2 "RAM value vM1MIN2" ULONG COMP_0068 1 100 0 4294967295 ECU_ADDRESS 0xFFFF4B98 READ_WRITE /end MEASUREMENT
/begin MEASUREMENT vM1MIN3 "RAM value vM1MIN3" ULONG COMP_0068 1 100 0 4294967295 ECU_ADDRESS 0xFFFF4B9C READ_WRITE /end MEASUREMENT
/begin MEASUREMENT vM1MIN4 "RAM value vM1MIN4" ULONG COMP_0068 1 100 0 4294967295 ECU_ADDRESS 0xFFFF4BA0 READ_WRITE /end MEASUREMENT
/begin MEASUREMENT vM1MAX1 "RAM value vM1MAX1" ULONG COMP_0068 1 100 0 4294967295 ECU_ADDRESS 0xFFFF4BA4 READ_WRITE /end MEASUREMENT
/begin MEASUREMENT vM1MAX2 "RAM value vM1MAX2" ULONG COMP_0068 1 100 0 4294967295 ECU_ADDRESS 0xFFFF4BA8 READ_WRITE /end MEASUREMENT
/begin MEASUREMENT vM1MAX3 "RAM value vM1MAX3" ULONG COMP_0068 1 100 0 4294967295 ECU_ADDRESS 0xFFFF4BAC READ_WRITE /end MEASUREMENT
/begin MEASUREMENT vM1MAX4 "RAM value vM1MAX4" ULONG COMP_0068 1 100 0 4294967295 ECU_ADDRESS 0xFFFF4BB0 READ_WRITE /end MEASUREMENT
/begin MEASUREMENT vM2MIN1 "RAM value vM2MIN1" ULONG COMP_0068 1 100 0 4294967295 ECU_ADDRESS 0xFFFF4BB4 READ_WRITE /end MEASUREMENT
/begin MEASUREMENT vM2MIN2 "RAM value vM2MIN2" ULONG COMP_0068 1 100 0 4294967295 ECU_ADDRESS 0xFFFF4BB8 READ_WRITE /end MEASUREMENT
/begin MEASUREMENT vM2MIN3 "RAM value vM2MIN3" ULONG COMP_0068 1 100 0 4294967295 ECU_ADDRESS 0xFFFF4BBC READ_WRITE /end MEASUREMENT
/begin MEASUREMENT vM2MIN4 "RAM value vM2MIN4" ULONG COMP_0068 1 100 0 4294967295 ECU_ADDRESS 0xFFFF4BC0 READ_WRITE /end MEASUREMENT
/begin MEASUREMENT vM2MIN5 "RAM value vM2MIN5" ULONG COMP_0068 1 100 0 4294967295 ECU_ADDRESS 0xFFFF4BC4 READ_WRITE /end MEASUREMENT
/begin MEASUREMENT vM2MIN6 "RAM value vM2MIN6" ULONG COMP_0068 1 100 0 4294967295 ECU_ADDRESS 0xFFFF4BC8 READ_WRITE /end MEASUREMENT
/begin MEASUREMENT vM2MIN7 "RAM value vM2MIN7" ULONG COMP_0068 1 100 0 4294967295 ECU_ADDRESS 0xFFFF4BCC READ_WRITE /end MEASUREMENT
/begin MEASUREMENT vM2MIN8 "RAM value vM2MIN8" ULONG COMP_0068 1 100 0 4294967295 ECU_ADDRESS 0xFFFF4BD0 READ_WRITE /end MEASUREMENT
/begin MEASUREMENT vM2MAX1 "RAM value vM2MAX1" ULONG COMP_0068 1 100 0 4294967295 ECU_ADDRESS 0xFFFF4BD4 READ_WRITE /end MEASUREMENT
/begin MEASUREMENT vM2MAX2 "RAM value vM2MAX2" ULONG COMP_0068 1 100 0 4294967295 ECU_ADDRESS 0xFFFF4BD8 READ_WRITE /end MEASUREMENT
/begin MEASUREMENT vM2MAX3 "RAM value vM2MAX3" ULONG COMP_0068 1 100 0 4294967295 ECU_ADDRESS 0xFFFF4BDC READ_WRITE /end MEASUREMENT
/begin MEASUREMENT vM2MAX4 "RAM value vM2MAX4" ULONG COMP_0068 1 100 0 4294967295 ECU_ADDRESS 0xFFFF4BE0 READ_WRITE /end MEASUREMENT
/begin MEASUREMENT vM2MAX5 "RAM value vM2MAX5" ULONG COMP_0068 1 100 0 4294967295 ECU_ADDRESS 0xFFFF4BE4 READ_WRITE /end MEASUREMENT
/begin MEASUREMENT vM2MAX6 "RAM value vM2MAX6" ULONG COMP_0068 1 100 0 4294967295 ECU_ADDRESS 0xFFFF4BE8 READ_WRITE /end MEASUREMENT
/begin MEASUREMENT vM2MAX7 "RAM value vM2MAX7" ULONG COMP_0068 1 100 0 4294967295 ECU_ADDRESS 0xFFFF4BEC READ_WRITE /end MEASUREMENT
/begin MEASUREMENT vM2MAX8 "RAM value vM2MAX8" ULONG COMP_0068 1 100 0 4294967295 ECU_ADDRESS 0xFFFF4BF0 READ_WRITE /end MEASUREMENT
/begin MEASUREMENT VSPNG "RAM value VSPNG" UBYTE COMP_0068 1 100 0 255 ECU_ADDRESS 0xFFFF528C READ_WRITE /end MEASUREMENT
/begin MEASUREMENT OVHEAT "RAM value OVHEAT" UBYTE COMP_0068 1 100 0 255 ECU_ADDRESS 0xFFFF528F READ_WRITE /end MEASUREMENT
/begin MEASUREMENT O2CLB1 "RAM value O2CLB1" UBYTE COMP_0068 1 100 0 255 ECU_ADDRESS 0xFFFF5292 READ_WRITE /end MEASUREMENT
/begin MEASUREMENT TXLNNG "RAM value TXLNNG" UBYTE COMP_0068 1 100 0 255 ECU_ADDRESS 0xFFFF5295 READ_WRITE /end MEASUREMENT
/begin MEASUREMENT MF4NG "RAM value MF4NG" UBYTE COMP_0068 1 100 0 255 ECU_ADDRESS 0xFFFF5298 READ_WRITE /end MEASUREMENT
/begin MEASUREMENT MF3NG "RAM value MF3NG" UBYTE COMP_0068 1 100 0 255 ECU_ADDRESS 0xFFFF529B READ_WRITE /end MEASUREMENT
/begin MEASUREMENT MF2NG "RAM value MF2NG" UBYTE COMP_0068 1 100 0 255 ECU_ADDRESS 0xFFFF529E READ_WRITE /end MEASUREMENT
/begin MEASUREMENT MF1NG "RAM value MF1NG" UBYTE COMP_0068 1 100 0 255 ECU_ADDRESS 0xFFFF52A1 READ_WRITE /end MEASUREMENT
/begin MEASUREMENT MFMCNG "RAM value MFMCNG" UBYTE COMP_0068 1 100 0 255 ECU_ADDRESS 0xFFFF52A4 READ_WRITE /end MEASUREMENT
/begin MEASUREMENT CAT1NG "RAM value CAT1NG" UBYTE COMP_0068 1 100 0 255 ECU_ADDRESS 0xFFFF52A7 READ_WRITE /end MEASUREMENT
/begin MEASUREMENT MRNG "RAM value MRNG" UBYTE COMP_0068 1 100 0 255 ECU_ADDRESS 0xFFFF52AA READ_WRITE /end MEASUREMENT
/begin MEASUREMENT TWCLNG "RAM value TWCLNG" UBYTE COMP_0068 1 100 0 255 ECU_ADDRESS 0xFFFF52AD READ_WRITE /end MEASUREMENT
/begin MEASUREMENT NSNG "RAM value NSNG" UBYTE COMP_0068 1 100 0 255 ECU_ADDRESS 0xFFFF52B0 READ_WRITE /end MEASUREMENT
/begin MEASUREMENT EVCN3 "RAM value EVCN3" UBYTE COMP_0068 1 100 0 255 ECU_ADDRESS 0xFFFF52B3 READ_WRITE /end MEASUREMENT
/begin MEASUREMENT INHSW "RAM value INHSW" UBYTE COMP_0068 1 100 0 255 ECU_ADDRESS 0xFFFF52B6 READ_WRITE /end MEASUREMENT
/begin MEASUREMENT OUTSNG "RAM value OUTSNG" UBYTE COMP_0068 1 100 0 255 ECU_ADDRESS 0xFFFF52B9 READ_WRITE /end MEASUREMENT
/begin MEASUREMENT SP1NG "RAM value SP1NG" UBYTE COMP_0068 1 100 0 255 ECU_ADDRESS 0xFFFF52BC READ_WRITE /end MEASUREMENT
/begin MEASUREMENT SP2NG "RAM value SP2NG" UBYTE COMP_0068 1 100 0 255 ECU_ADDRESS 0xFFFF52BF READ_WRITE /end MEASUREMENT
/begin MEASUREMENT SP3NG "RAM value SP3NG" UBYTE COMP_0068 1 100 0 255 ECU_ADDRESS 0xFFFF52C2 READ_WRITE /end MEASUREMENT
/begin MEASUREMENT SP4NG "RAM value SP4NG" UBYTE COMP_0068 1 100 0 255 ECU_ADDRESS 0xFFFF52C5 READ_WRITE /end MEASUREMENT
/begin MEASUREMENT LUFNG "RAM value LUFNG" UBYTE COMP_0068 1 100 0 255 ECU_ADDRESS 0xFFFF52C8 READ_WRITE /end MEASUREMENT
/begin MEASUREMENT SHANG "RAM value SHANG" UBYTE COMP_0068 1 100 0 255 ECU_ADDRESS 0xFFFF52CB READ_WRITE /end MEASUREMENT
/begin MEASUREMENT SHBNG "RAM value SHBNG" UBYTE COMP_0068 1 100 0 255 ECU_ADDRESS 0xFFFF52CE READ_WRITE /end MEASUREMENT
/begin MEASUREMENT OVRSNG "RAM value OVRSNG" UBYTE COMP_0068 1 100 0 255 ECU_ADDRESS 0xFFFF52D1 READ_WRITE /end MEASUREMENT
/begin MEASUREMENT LUSNG "RAM value LUSNG" UBYTE COMP_0068 1 100 0 255 ECU_ADDRESS 0xFFFF52D4 READ_WRITE /end MEASUREMENT
/begin MEASUREMENT PLSNG "RAM value PLSNG" UBYTE COMP_0068 1 100 0 255 ECU_ADDRESS 0xFFFF52D7 READ_WRITE /end MEASUREMENT
/begin MEASUREMENT ATTHNG "RAM value ATTHNG" UBYTE COMP_0068 1 100 0 255 ECU_ADDRESS 0xFFFF52DA READ_WRITE /end MEASUREMENT
/begin MEASUREMENT ENINNG "RAM value ENINNG" UBYTE COMP_0068 1 100 0 255 ECU_ADDRESS 0xFFFF52DD READ_WRITE /end MEASUREMENT
/begin MEASUREMENT SOTMP "RAM value SOTMP" UBYTE COMP_0068 1 100 0 255 ECU_ADDRESS 0xFFFF52E0 READ_WRITE /end MEASUREMENT
/begin MEASUREMENT FPCMNG "RAM value FPCMNG" UBYTE COMP_0068 1 100 0 255 ECU_ADDRESS 0xFFFF52E3 READ_WRITE /end MEASUREMENT
/begin MEASUREMENT LCMNG "RAM value LCMNG" UBYTE COMP_0068 1 100 0 255 ECU_ADDRESS 0xFFFF52E6 READ_WRITE /end MEASUREMENT
/begin MEASUREMENT VIDNG "RAM value VIDNG" UBYTE COMP_0068 1 100 0 255 ECU_ADDRESS 0xFFFF52E9 READ_WRITE /end MEASUREMENT
/begin MEASUREMENT COMNG "RAM value COMNG" UBYTE COMP_0068 1 100 0 255 ECU_ADDRESS 0xFFFF52EC READ_WRITE /end MEASUREMENT
/begin MEASUREMENT IMLCK "RAM value IMLCK" UBYTE COMP_0068 1 100 0 255 ECU_ADDRESS 0xFFFF52EF READ_WRITE /end MEASUREMENT
/begin MEASUREMENT KEYNG "RAM value KEYNG" UBYTE COMP_0068 1 100 0 255 ECU_ADDRESS 0xFFFF52F2 READ_WRITE /end MEASUREMENT
/begin MEASUREMENT KEYER "RAM value KEYER" UBYTE COMP_0068 1 100 0 255 ECU_ADDRESS 0xFFFF52F5 READ_WRITE /end MEASUREMENT
/begin MEASUREMENT KHTDGN "RAM value KHTDGN" UBYTE COMP_0068 1 100 0 255 ECU_ADDRESS 0xFFFF52F8 READ_WRITE /end MEASUREMENT
/begin MEASUREMENT EVCN2 "RAM value EVCN2" UBYTE COMP_0068 1 100 0 255 ECU_ADDRESS 0xFFFF52FB READ_WRITE /end MEASUREMENT
/begin MEASUREMENT CDCNG2 "RAM value CDCNG2" UBYTE COMP_0068 1 100 0 255 ECU_ADDRESS 0xFFFF52FE READ_WRITE /end MEASUREMENT
/begin MEASUREMENT FLRNG "RAM value FLRNG" UBYTE COMP_0068 1 100 0 255 ECU_ADDRESS 0xFFFF5301 READ_WRITE /end MEASUREMENT
/begin MEASUREMENT CDCNG3 "RAM value CDCNG3" UBYTE COMP_0068 1 100 0 255 ECU_ADDRESS 0xFFFF5304 READ_WRITE /end MEASUREMENT
/begin MEASUREMENT VTCSV1 "RAM value VTCSV1" UBYTE COMP_0068 1 100 0 255 ECU_ADDRESS 0xFFFF5307 READ_WRITE /end MEASUREMENT
/begin MEASUREMENT STMFNG "RAM value STMFNG" UBYTE COMP_0068 1 100 0 255 ECU_ADDRESS 0xFFFF530A READ_WRITE /end MEASUREMENT
/begin MEASUREMENT PRINNG "RAM value PRINNG" UBYTE COMP_0068 1 100 0 255 ECU_ADDRESS 0xFFFF530D READ_WRITE /end MEASUREMENT
/begin MEASUREMENT STMDNG "RAM value STMDNG" UBYTE COMP_0068 1 100 0 255 ECU_ADDRESS 0xFFFF5310 READ_WRITE /end MEASUREMENT
/begin MEASUREMENT OPSNG "RAM value OPSNG" UBYTE COMP_0068 1 100 0 255 ECU_ADDRESS 0xFFFF5313 READ_WRITE /end MEASUREMENT
/begin MEASUREMENT CLUDNG "RAM value CLUDNG" UBYTE COMP_0068 1 100 0 255 ECU_ADDRESS 0xFFFF5316 READ_WRITE /end MEASUREMENT
/begin MEASUREMENT CPLDNG "RAM value CPLDNG" UBYTE COMP_0068 1 100 0 255 ECU_ADDRESS 0xFFFF5319 READ_WRITE /end MEASUREMENT
/begin MEASUREMENT FPSNG "RAM value FPSNG" UBYTE COMP_0068 1 100 0 255 ECU_ADDRESS 0xFFFF531C READ_WRITE /end MEASUREMENT
/begin MEASUREMENT PREGNG "RAM value PREGNG" UBYTE COMP_0068 1 100 0 255 ECU_ADDRESS 0xFFFF531F READ_WRITE /end MEASUREMENT
/begin MEASUREMENT CLUFNG "RAM value CLUFNG" UBYTE COMP_0068 1 100 0 255 ECU_ADDRESS 0xFFFF5322 READ_WRITE /end MEASUREMENT
/begin MEASUREMENT CPLFNG "RAM value CPLFNG" UBYTE COMP_0068 1 100 0 255 ECU_ADDRESS 0xFFFF5325 READ_WRITE /end MEASUREMENT
/begin MEASUREMENT SSFNG "RAM value SSFNG" UBYTE COMP_0068 1 100 0 255 ECU_ADDRESS 0xFFFF5328 READ_WRITE /end MEASUREMENT
/begin MEASUREMENT SSDNG "RAM value SSDNG" UBYTE COMP_0068 1 100 0 255 ECU_ADDRESS 0xFFFF532B READ_WRITE /end MEASUREMENT
/begin MEASUREMENT LSSDNG "RAM value LSSDNG" UBYTE COMP_0068 1 100 0 255 ECU_ADDRESS 0xFFFF532E READ_WRITE /end MEASUREMENT
/begin MEASUREMENT VTSVE1 "RAM value VTSVE1" UBYTE COMP_0068 1 100 0 255 ECU_ADDRESS 0xFFFF5331 READ_WRITE /end MEASUREMENT
/begin MEASUREMENT FGPNG2 "RAM value FGPNG2" UBYTE COMP_0068 1 100 0 255 ECU_ADDRESS 0xFFFF5334 READ_WRITE /end MEASUREMENT
/begin MEASUREMENT FGPNG3 "RAM value FGPNG3" UBYTE COMP_0068 1 100 0 255 ECU_ADDRESS 0xFFFF5337 READ_WRITE /end MEASUREMENT
/begin MEASUREMENT DCS1NG "RAM value DCS1NG" UBYTE COMP_0068 1 100 0 255 ECU_ADDRESS 0xFFFF533A READ_WRITE /end MEASUREMENT
/begin MEASUREMENT DCS2NG "RAM value DCS2NG" UBYTE COMP_0068 1 100 0 255 ECU_ADDRESS 0xFFFF533D READ_WRITE /end MEASUREMENT
/begin MEASUREMENT DCS3NG "RAM value DCS3NG" UBYTE COMP_0068 1 100 0 255 ECU_ADDRESS 0xFFFF5340 READ_WRITE /end MEASUREMENT
/begin MEASUREMENT DPS1NG "RAM value DPS1NG" UBYTE COMP_0068 1 100 0 255 ECU_ADDRESS 0xFFFF5343 READ_WRITE /end MEASUREMENT
/begin MEASUREMENT DPS2NG "RAM value DPS2NG" UBYTE COMP_0068 1 100 0 255 ECU_ADDRESS 0xFFFF5346 READ_WRITE /end MEASUREMENT
/begin MEASUREMENT DPS3NG "RAM value DPS3NG" UBYTE COMP_0068 1 100 0 255 ECU_ADDRESS 0xFFFF5349 READ_WRITE /end MEASUREMENT
/begin MEASUREMENT VBONG1 "RAM value VBONG1" UBYTE COMP_0068 1 100 0 255 ECU_ADDRESS 0xFFFF534C READ_WRITE /end MEASUREMENT
/begin MEASUREMENT DUCMB "RAM value DUCMB" UBYTE COMP_0068 1 100 0 255 ECU_ADDRESS 0xFFFF534F READ_WRITE /end MEASUREMENT
/begin MEASUREMENT DUFLB "RAM value DUFLB" UBYTE COMP_0068 1 100 0 255 ECU_ADDRESS 0xFFFF5352 READ_WRITE /end MEASUREMENT
/begin MEASUREMENT SYNCNG "RAM value SYNCNG" UBYTE COMP_0068 1 100 0 255 ECU_ADDRESS 0xFFFF5355 READ_WRITE /end MEASUREMENT
/begin MEASUREMENT ALUNG "RAM value ALUNG" UBYTE COMP_0068 1 100 0 255 ECU_ADDRESS 0xFFFF5358 READ_WRITE /end MEASUREMENT
/begin MEASUREMENT QCKNG "RAM value QCKNG" UBYTE COMP_0068 1 100 0 255 ECU_ADDRESS 0xFFFF535B READ_WRITE /end MEASUREMENT
/begin MEASUREMENT CALCNG "RAM value CALCNG" UBYTE COMP_0068 1 100 0 255 ECU_ADDRESS 0xFFFF535E READ_WRITE /end MEASUREMENT
/begin MEASUREMENT CANGNE "RAM value CANGNE" UBYTE COMP_0068 1 100 0 255 ECU_ADDRESS 0xFFFF5361 READ_WRITE /end MEASUREMENT
/begin MEASUREMENT ADNG "RAM value ADNG" UBYTE COMP_0068 1 100 0 255 ECU_ADDRESS 0xFFFF5364 READ_WRITE /end MEASUREMENT
/begin MEASUREMENT IC3NG "RAM value IC3NG" UBYTE COMP_0068 1 100 0 255 ECU_ADDRESS 0xFFFF5367 READ_WRITE /end MEASUREMENT
/begin MEASUREMENT CANNG "RAM value CANNG" UBYTE COMP_0068 1 100 0 255 ECU_ADDRESS 0xFFFF536A READ_WRITE /end MEASUREMENT
/begin MEASUREMENT INONG4 "RAM value INONG4" UBYTE COMP_0068 1 100 0 255 ECU_ADDRESS 0xFFFF536D READ_WRITE /end MEASUREMENT
/begin MEASUREMENT INONG3 "RAM value INONG3" UBYTE COMP_0068 1 100 0 255 ECU_ADDRESS 0xFFFF5370 READ_WRITE /end MEASUREMENT
/begin MEASUREMENT INONG2 "RAM value INONG2" UBYTE COMP_0068 1 100 0 255 ECU_ADDRESS 0xFFFF5373 READ_WRITE /end MEASUREMENT
/begin MEASUREMENT INONG1 "RAM value INONG1" UBYTE COMP_0068 1 100 0 255 ECU_ADDRESS 0xFFFF5376 READ_WRITE /end MEASUREMENT
/begin MEASUREMENT AVCCNG "RAM value AVCCNG" UBYTE COMP_0068 1 100 0 255 ECU_ADDRESS 0xFFFF5379 READ_WRITE /end MEASUREMENT
/begin MEASUREMENT TPS4NG "RAM value TPS4NG" UBYTE COMP_0068 1 100 0 255 ECU_ADDRESS 0xFFFF537C READ_WRITE /end MEASUREMENT
/begin MEASUREMENT TPCLNG "RAM value TPCLNG" UBYTE COMP_0068 1 100 0 255 ECU_ADDRESS 0xFFFF537F READ_WRITE /end MEASUREMENT
/begin MEASUREMENT TPLRNG "RAM value TPLRNG" UBYTE COMP_0068 1 100 0 255 ECU_ADDRESS 0xFFFF5382 READ_WRITE /end MEASUREMENT
/begin MEASUREMENT THFBNG "RAM value THFBNG" UBYTE COMP_0068 1 100 0 255 ECU_ADDRESS 0xFFFF5385 READ_WRITE /end MEASUREMENT
/begin MEASUREMENT VAPXNG "RAM value VAPXNG" UBYTE COMP_0068 1 100 0 255 ECU_ADDRESS 0xFFFF5388 READ_WRITE /end MEASUREMENT
/begin MEASUREMENT APOXNG "RAM value APOXNG" UBYTE COMP_0068 1 100 0 255 ECU_ADDRESS 0xFFFF538B READ_WRITE /end MEASUREMENT
/begin MEASUREMENT TGTXNG "RAM value TGTXNG" UBYTE COMP_0068 1 100 0 255 ECU_ADDRESS 0xFFFF538E READ_WRITE /end MEASUREMENT
/begin MEASUREMENT SERVNG "RAM value SERVNG" UBYTE COMP_0068 1 100 0 255 ECU_ADDRESS 0xFFFF5391 READ_WRITE /end MEASUREMENT
/begin MEASUREMENT ASTRNG "RAM value ASTRNG" UBYTE COMP_0068 1 100 0 255 ECU_ADDRESS 0xFFFF5394 READ_WRITE /end MEASUREMENT
/begin MEASUREMENT CVCUNG "RAM value CVCUNG" UBYTE COMP_0068 1 100 0 255 ECU_ADDRESS 0xFFFF5397 READ_WRITE /end MEASUREMENT
/begin MEASUREMENT QHAPNG "RAM value QHAPNG" UBYTE COMP_0068 1 100 0 255 ECU_ADDRESS 0xFFFF539A READ_WRITE /end MEASUREMENT
/begin MEASUREMENT TEPDNG "RAM value TEPDNG" UBYTE COMP_0068 1 100 0 255 ECU_ADDRESS 0xFFFF539D READ_WRITE /end MEASUREMENT
/begin MEASUREMENT TATENG "RAM value TATENG" UBYTE COMP_0068 1 100 0 255 ECU_ADDRESS 0xFFFF53A0 READ_WRITE /end MEASUREMENT
/begin MEASUREMENT TTEPNG "RAM value TTEPNG" UBYTE COMP_0068 1 100 0 255 ECU_ADDRESS 0xFFFF53A3 READ_WRITE /end MEASUREMENT
/begin MEASUREMENT RLONNG "RAM value RLONNG" UBYTE COMP_0068 1 100 0 255 ECU_ADDRESS 0xFFFF53A6 READ_WRITE /end MEASUREMENT
/begin MEASUREMENT RLOFNG "RAM value RLOFNG" UBYTE COMP_0068 1 100 0 255 ECU_ADDRESS 0xFFFF53A9 READ_WRITE /end MEASUREMENT
/begin MEASUREMENT DTSPNG "RAM value DTSPNG" UBYTE COMP_0068 1 100 0 255 ECU_ADDRESS 0xFFFF53AC READ_WRITE /end MEASUREMENT
/begin MEASUREMENT VSPRNG "RAM value VSPRNG" UBYTE COMP_0068 1 100 0 255 ECU_ADDRESS 0xFFFF53AF READ_WRITE /end MEASUREMENT
/begin MEASUREMENT IREVNG "RAM value IREVNG" UBYTE COMP_0068 1 100 0 255 ECU_ADDRESS 0xFFFF53B2 READ_WRITE /end MEASUREMENT
/begin MEASUREMENT BSOFNG "RAM value BSOFNG" UBYTE COMP_0068 1 100 0 255 ECU_ADDRESS 0xFFFF53B5 READ_WRITE /end MEASUREMENT
/begin MEASUREMENT RTSPNG "RAM value RTSPNG" UBYTE COMP_0068 1 100 0 255 ECU_ADDRESS 0xFFFF53B8 READ_WRITE /end MEASUREMENT
/begin MEASUREMENT DFLTNG "RAM value DFLTNG" UBYTE COMP_0068 1 100 0 255 ECU_ADDRESS 0xFFFF53BB READ_WRITE /end MEASUREMENT
/begin MEASUREMENT THOPNG "RAM value THOPNG" UBYTE COMP_0068 1 100 0 255 ECU_ADDRESS 0xFFFF53BE READ_WRITE /end MEASUREMENT
/begin MEASUREMENT BURNG "RAM value BURNG" UBYTE COMP_0068 1 100 0 255 ECU_ADDRESS 0xFFFF53C1 READ_WRITE /end MEASUREMENT
/begin MEASUREMENT SSOFNG "RAM value SSOFNG" UBYTE COMP_0068 1 100 0 255 ECU_ADDRESS 0xFFFF53C4 READ_WRITE /end MEASUREMENT
/begin MEASUREMENT TSKNGM "RAM value TSKNGM" UBYTE COMP_0068 1 100 0 255 ECU_ADDRESS 0xFFFF53C7 READ_WRITE /end MEASUREMENT
/begin MEASUREMENT ROMNGM "RAM value ROMNGM" UBYTE COMP_0068 1 100 0 255 ECU_ADDRESS 0xFFFF53CA READ_WRITE /end MEASUREMENT
/begin MEASUREMENT RAMNGM "RAM value RAMNGM" UBYTE COMP_0068 1 100 0 255 ECU_ADDRESS 0xFFFF53CD READ_WRITE /end MEASUREMENT
/begin MEASUREMENT WDTNGM "RAM value WDTNGM" UBYTE COMP_0068 1 100 0 255 ECU_ADDRESS 0xFFFF53D0 READ_WRITE /end MEASUREMENT
/begin MEASUREMENT TIMNGM "RAM value TIMNGM" UBYTE COMP_0068 1 100 0 255 ECU_ADDRESS 0xFFFF53D3 READ_WRITE /end MEASUREMENT
/begin MEASUREMENT EPWNGM "RAM value EPWNGM" UBYTE COMP_0068 1 100 0 255 ECU_ADDRESS 0xFFFF53D6 READ_WRITE /end MEASUREMENT
/begin MEASUREMENT EPRNGM "RAM value EPRNGM" UBYTE COMP_0068 1 100 0 255 ECU_ADDRESS 0xFFFF53D9 READ_WRITE /end MEASUREMENT
/begin MEASUREMENT RANGM2 "RAM value RANGM2" UBYTE COMP_0068 1 100 0 255 ECU_ADDRESS 0xFFFF53DC READ_WRITE /end MEASUREMENT
/begin MEASUREMENT ASJBNG "RAM value ASJBNG" UBYTE COMP_0068 1 100 0 255 ECU_ADDRESS 0xFFFF53DF READ_WRITE /end MEASUREMENT
/begin MEASUREMENT ASFXNG "RAM value ASFXNG" UBYTE COMP_0068 1 100 0 255 ECU_ADDRESS 0xFFFF53E2 READ_WRITE /end MEASUREMENT
/begin MEASUREMENT ASSWNG "RAM value ASSWNG" UBYTE COMP_0068 1 100 0 255 ECU_ADDRESS 0xFFFF53E5 READ_WRITE /end MEASUREMENT
/begin MEASUREMENT ASBSNG "RAM value ASBSNG" UBYTE COMP_0068 1 100 0 255 ECU_ADDRESS 0xFFFF53E8 READ_WRITE /end MEASUREMENT
/begin MEASUREMENT ASVSNG "RAM value ASVSNG" UBYTE COMP_0068 1 100 0 255 ECU_ADDRESS 0xFFFF53EB READ_WRITE /end MEASUREMENT
/begin MEASUREMENT BNCPNG "RAM value BNCPNG" UBYTE COMP_0068 1 100 0 255 ECU_ADDRESS 0xFFFF53EE READ_WRITE /end MEASUREMENT
/begin MEASUREMENT VTSBE1 "RAM value VTSBE1" UBYTE COMP_0068 1 100 0 255 ECU_ADDRESS 0xFFFF53F1 READ_WRITE /end MEASUREMENT
/begin MEASUREMENT VTSNE1 "RAM value VTSNE1" UBYTE COMP_0068 1 100 0 255 ECU_ADDRESS 0xFFFF53F4 READ_WRITE /end MEASUREMENT
/begin MEASUREMENT AFLNG1 "RAM value AFLNG1" UBYTE COMP_0068 1 100 0 255 ECU_ADDRESS 0xFFFF53F7 READ_WRITE /end MEASUREMENT
/begin MEASUREMENT AFLNG2 "RAM value AFLNG2" UBYTE COMP_0068 1 100 0 255 ECU_ADDRESS 0xFFFF53FA READ_WRITE /end MEASUREMENT
/begin MEASUREMENT AFLLS "RAM value AFLLS" UBYTE COMP_0068 1 100 0 255 ECU_ADDRESS 0xFFFF53FD READ_WRITE /end MEASUREMENT
/begin MEASUREMENT AFLRS "RAM value AFLRS" UBYTE COMP_0068 1 100 0 255 ECU_ADDRESS 0xFFFF5400 READ_WRITE /end MEASUREMENT
/begin MEASUREMENT AFLAV "RAM value AFLAV" UBYTE COMP_0068 1 100 0 255 ECU_ADDRESS 0xFFFF5403 READ_WRITE /end MEASUREMENT
/begin MEASUREMENT TCNTNG "RAM value TCNTNG" UBYTE COMP_0068 1 100 0 255 ECU_ADDRESS 0xFFFF5406 READ_WRITE /end MEASUREMENT
/begin MEASUREMENT ISCNGL "RAM value ISCNGL" UBYTE COMP_0068 1 100 0 255 ECU_ADDRESS 0xFFFF5409 READ_WRITE /end MEASUREMENT
/begin MEASUREMENT ISCNGH "RAM value ISCNGH" UBYTE COMP_0068 1 100 0 255 ECU_ADDRESS 0xFFFF540C READ_WRITE /end MEASUREMENT
/begin MEASUREMENT O2R1O "RAM value O2R1O" UBYTE COMP_0068 1 100 0 255 ECU_ADDRESS 0xFFFF540F READ_WRITE /end MEASUREMENT
/begin MEASUREMENT O2R1L "RAM value O2R1L" UBYTE COMP_0068 1 100 0 255 ECU_ADDRESS 0xFFFF5412 READ_WRITE /end MEASUREMENT
/begin MEASUREMENT O2R1R "RAM value O2R1R" UBYTE COMP_0068 1 100 0 255 ECU_ADDRESS 0xFFFF5415 READ_WRITE /end MEASUREMENT
/begin MEASUREMENT O2R1H "RAM value O2R1H" UBYTE COMP_0068 1 100 0 255 ECU_ADDRESS 0xFFFF5418 READ_WRITE /end MEASUREMENT
/begin MEASUREMENT RO2HH1 "RAM value RO2HH1" UBYTE COMP_0068 1 100 0 255 ECU_ADDRESS 0xFFFF541B READ_WRITE /end MEASUREMENT
/begin MEASUREMENT RO2HL1 "RAM value RO2HL1" UBYTE COMP_0068 1 100 0 255 ECU_ADDRESS 0xFFFF541E READ_WRITE /end MEASUREMENT
/begin MEASUREMENT KN1NGL "RAM value KN1NGL" UBYTE COMP_0068 1 100 0 255 ECU_ADDRESS 0xFFFF5421 READ_WRITE /end MEASUREMENT
/begin MEASUREMENT KN1NGH "RAM value KN1NGH" UBYTE COMP_0068 1 100 0 255 ECU_ADDRESS 0xFFFF5424 READ_WRITE /end MEASUREMENT
/begin MEASUREMENT AFMNGL "RAM value AFMNGL" UBYTE COMP_0068 1 100 0 255 ECU_ADDRESS 0xFFFF5427 READ_WRITE /end MEASUREMENT
/begin MEASUREMENT AFMNGH "RAM value AFMNGH" UBYTE COMP_0068 1 100 0 255 ECU_ADDRESS 0xFFFF542A READ_WRITE /end MEASUREMENT
/begin MEASUREMENT TWNGL "RAM value TWNGL" UBYTE COMP_0068 1 100 0 255 ECU_ADDRESS 0xFFFF542D READ_WRITE /end MEASUREMENT
/begin MEASUREMENT TWNGH "RAM value TWNGH" UBYTE COMP_0068 1 100 0 255 ECU_ADDRESS 0xFFFF5430 READ_WRITE /end MEASUREMENT
/begin MEASUREMENT TANGL "RAM value TANGL" UBYTE COMP_0068 1 100 0 255 ECU_ADDRESS 0xFFFF5433 READ_WRITE /end MEASUREMENT
/begin MEASUREMENT TANGH "RAM value TANGH" UBYTE COMP_0068 1 100 0 255 ECU_ADDRESS 0xFFFF5436 READ_WRITE /end MEASUREMENT
/begin MEASUREMENT TANGR "RAM value TANGR" UBYTE COMP_0068 1 100 0 255 ECU_ADDRESS 0xFFFF5439 READ_WRITE /end MEASUREMENT
/begin MEASUREMENT EVSNGR "RAM value EVSNGR" UBYTE COMP_0068 1 100 0 255 ECU_ADDRESS 0xFFFF543C READ_WRITE /end MEASUREMENT
/begin MEASUREMENT TFNGR "RAM value TFNGR" UBYTE COMP_0068 1 100 0 255 ECU_ADDRESS 0xFFFF543F READ_WRITE /end MEASUREMENT
/begin MEASUREMENT TFNGL "RAM value TFNGL" UBYTE COMP_0068 1 100 0 255 ECU_ADDRESS 0xFFFF5442 READ_WRITE /end MEASUREMENT
/begin MEASUREMENT TFNGH "RAM value TFNGH" UBYTE COMP_0068 1 100 0 255 ECU_ADDRESS 0xFFFF5445 READ_WRITE /end MEASUREMENT
/begin MEASUREMENT FGPNGL "RAM value FGPNGL" UBYTE COMP_0068 1 100 0 255 ECU_ADDRESS 0xFFFF5448 READ_WRITE /end MEASUREMENT
/begin MEASUREMENT FGPNGH "RAM value FGPNGH" UBYTE COMP_0068 1 100 0 255 ECU_ADDRESS 0xFFFF544B READ_WRITE /end MEASUREMENT
/begin MEASUREMENT EVCNGO "RAM value EVCNGO" UBYTE COMP_0068 1 100 0 255 ECU_ADDRESS 0xFFFF544E READ_WRITE /end MEASUREMENT
/begin MEASUREMENT EVCNGS "RAM value EVCNGS" UBYTE COMP_0068 1 100 0 255 ECU_ADDRESS 0xFFFF5451 READ_WRITE /end MEASUREMENT
/begin MEASUREMENT MRNR "RAM value MRNR" UBYTE COMP_0068 1 100 0 255 ECU_ADDRESS 0xFFFF5454 READ_WRITE /end MEASUREMENT
/begin MEASUREMENT MRNL "RAM value MRNL" UBYTE COMP_0068 1 100 0 255 ECU_ADDRESS 0xFFFF5457 READ_WRITE /end MEASUREMENT
/begin MEASUREMENT VTCI1R "RAM value VTCI1R" UBYTE COMP_0068 1 100 0 255 ECU_ADDRESS 0xFFFF545A READ_WRITE /end MEASUREMENT
/begin MEASUREMENT VTCE1R "RAM value VTCE1R" UBYTE COMP_0068 1 100 0 255 ECU_ADDRESS 0xFFFF545D READ_WRITE /end MEASUREMENT
/begin MEASUREMENT PRSNGR "RAM value PRSNGR" UBYTE COMP_0068 1 100 0 255 ECU_ADDRESS 0xFFFF5460 READ_WRITE /end MEASUREMENT
/begin MEASUREMENT PRSNGL "RAM value PRSNGL" UBYTE COMP_0068 1 100 0 255 ECU_ADDRESS 0xFFFF5463 READ_WRITE /end MEASUREMENT
/begin MEASUREMENT PRSNGH "RAM value PRSNGH" UBYTE COMP_0068 1 100 0 255 ECU_ADDRESS 0xFFFF5466 READ_WRITE /end MEASUREMENT
/begin MEASUREMENT EPSNGL "RAM value EPSNGL" UBYTE COMP_0068 1 100 0 255 ECU_ADDRESS 0xFFFF5469 READ_WRITE /end MEASUREMENT
/begin MEASUREMENT EPSNGH "RAM value EPSNGH" UBYTE COMP_0068 1 100 0 255 ECU_ADDRESS 0xFFFF546C READ_WRITE /end MEASUREMENT
/begin MEASUREMENT EVPFLW "RAM value EVPFLW" UBYTE COMP_0068 1 100 0 255 ECU_ADDRESS 0xFFFF546F READ_WRITE /end MEASUREMENT
/begin MEASUREMENT CDCNGC "RAM value CDCNGC" UBYTE COMP_0068 1 100 0 255 ECU_ADDRESS 0xFFFF5472 READ_WRITE /end MEASUREMENT
/begin MEASUREMENT EVPVSL "RAM value EVPVSL" UBYTE COMP_0068 1 100 0 255 ECU_ADDRESS 0xFFFF5475 READ_WRITE /end MEASUREMENT
/begin MEASUREMENT EVVSLP "RAM value EVVSLP" UBYTE COMP_0068 1 100 0 255 ECU_ADDRESS 0xFFFF5478 READ_WRITE /end MEASUREMENT
/begin MEASUREMENT EVPSL "RAM value EVPSL" UBYTE COMP_0068 1 100 0 255 ECU_ADDRESS 0xFFFF547B READ_WRITE /end MEASUREMENT
/begin MEASUREMENT EVPSLP "RAM value EVPSLP" UBYTE COMP_0068 1 100 0 255 ECU_ADDRESS 0xFFFF547E READ_WRITE /end MEASUREMENT
/begin MEASUREMENT TONGL "RAM value TONGL" UBYTE COMP_0068 1 100 0 255 ECU_ADDRESS 0xFFFF5481 READ_WRITE /end MEASUREMENT
/begin MEASUREMENT TONGH "RAM value TONGH" UBYTE COMP_0068 1 100 0 255 ECU_ADDRESS 0xFFFF5484 READ_WRITE /end MEASUREMENT
/begin MEASUREMENT AP1NGH "RAM value AP1NGH" UBYTE COMP_0068 1 100 0 255 ECU_ADDRESS 0xFFFF5487 READ_WRITE /end MEASUREMENT
/begin MEASUREMENT AP1NGL "RAM value AP1NGL" UBYTE COMP_0068 1 100 0 255 ECU_ADDRESS 0xFFFF548A READ_WRITE /end MEASUREMENT
/begin MEASUREMENT AP2NGH "RAM value AP2NGH" UBYTE COMP_0068 1 100 0 255 ECU_ADDRESS 0xFFFF548D READ_WRITE /end MEASUREMENT
/begin MEASUREMENT AP2NGL "RAM value AP2NGL" UBYTE COMP_0068 1 100 0 255 ECU_ADDRESS 0xFFFF5490 READ_WRITE /end MEASUREMENT
/begin MEASUREMENT AP12NG "RAM value AP12NG" UBYTE COMP_0068 1 100 0 255 ECU_ADDRESS 0xFFFF5493 READ_WRITE /end MEASUREMENT
/begin MEASUREMENT TORPNG "RAM value TORPNG" UBYTE COMP_0068 1 100 0 255 ECU_ADDRESS 0xFFFF5496 READ_WRITE /end MEASUREMENT
/begin MEASUREMENT EONVNG "RAM value EONVNG" UBYTE COMP_0068 1 100 0 255 ECU_ADDRESS 0xFFFF5499 READ_WRITE /end MEASUREMENT
/begin MEASUREMENT AVCCSH "RAM value AVCCSH" UBYTE COMP_0068 1 100 0 255 ECU_ADDRESS 0xFFFF549C READ_WRITE /end MEASUREMENT
/begin MEASUREMENT TP1NGH "RAM value TP1NGH" UBYTE COMP_0068 1 100 0 255 ECU_ADDRESS 0xFFFF549F READ_WRITE /end MEASUREMENT
/begin MEASUREMENT TP1NGL "RAM value TP1NGL" UBYTE COMP_0068 1 100 0 255 ECU_ADDRESS 0xFFFF54A2 READ_WRITE /end MEASUREMENT
/begin MEASUREMENT TP2NGH "RAM value TP2NGH" UBYTE COMP_0068 1 100 0 255 ECU_ADDRESS 0xFFFF54A5 READ_WRITE /end MEASUREMENT
/begin MEASUREMENT TP2NGL "RAM value TP2NGL" UBYTE COMP_0068 1 100 0 255 ECU_ADDRESS 0xFFFF54A8 READ_WRITE /end MEASUREMENT
/begin MEASUREMENT TP12NG "RAM value TP12NG" UBYTE COMP_0068 1 100 0 255 ECU_ADDRESS 0xFFFF54AB READ_WRITE /end MEASUREMENT
/begin MEASUREMENT TPLRLO "RAM value TPLRLO" UBYTE COMP_0068 1 100 0 255 ECU_ADDRESS 0xFFFF54AE READ_WRITE /end MEASUREMENT
/begin MEASUREMENT TPLRNO "RAM value TPLRNO" UBYTE COMP_0068 1 100 0 255 ECU_ADDRESS 0xFFFF54B1 READ_WRITE /end MEASUREMENT
/begin MEASUREMENT VMOOPN "RAM value VMOOPN" UBYTE COMP_0068 1 100 0 255 ECU_ADDRESS 0xFFFF54B4 READ_WRITE /end MEASUREMENT
/begin MEASUREMENT VMOSHT "RAM value VMOSHT" UBYTE COMP_0068 1 100 0 255 ECU_ADDRESS 0xFFFF54B7 READ_WRITE /end MEASUREMENT
/begin MEASUREMENT MOTOPN "RAM value MOTOPN" UBYTE COMP_0068 1 100 0 255 ECU_ADDRESS 0xFFFF54BA READ_WRITE /end MEASUREMENT
/begin MEASUREMENT MOTSHT "RAM value MOTSHT" UBYTE COMP_0068 1 100 0 255 ECU_ADDRESS 0xFFFF54BD READ_WRITE /end MEASUREMENT
/begin MEASUREMENT GMOOPN "RAM value GMOOPN" UBYTE COMP_0068 1 100 0 255 ECU_ADDRESS 0xFFFF54C0 READ_WRITE /end MEASUREMENT
/begin MEASUREMENT AFLHZR "RAM value AFLHZR" UBYTE COMP_0068 1 100 0 255 ECU_ADDRESS 0xFFFF54C3 READ_WRITE /end MEASUREMENT
/begin MEASUREMENT AFLHZL "RAM value AFLHZL" UBYTE COMP_0068 1 100 0 255 ECU_ADDRESS 0xFFFF54C6 READ_WRITE /end MEASUREMENT
/begin MEASUREMENT AFHF1L "RAM value AFHF1L" UBYTE COMP_0068 1 100 0 255 ECU_ADDRESS 0xFFFF54C9 READ_WRITE /end MEASUREMENT
/begin MEASUREMENT AFHF1H "RAM value AFHF1H" UBYTE COMP_0068 1 100 0 255 ECU_ADDRESS 0xFFFF54CC READ_WRITE /end MEASUREMENT
/begin MEASUREMENT AFRLD1 "RAM value AFRLD1" UBYTE COMP_0068 1 100 0 255 ECU_ADDRESS 0xFFFF54CF READ_WRITE /end MEASUREMENT
/begin MEASUREMENT AFLRD1 "RAM value AFLRD1" UBYTE COMP_0068 1 100 0 255 ECU_ADDRESS 0xFFFF54D2 READ_WRITE /end MEASUREMENT
/begin MEASUREMENT SECPNG "RAM value SECPNG" UBYTE COMP_0068 1 100 0 255 ECU_ADDRESS 0xFFFF54D5 READ_WRITE /end MEASUREMENT
/begin MEASUREMENT PRIPNG "RAM value PRIPNG" UBYTE COMP_0068 1 100 0 255 ECU_ADDRESS 0xFFFF54D8 READ_WRITE /end MEASUREMENT
/begin MEASUREMENT PSRANG "RAM value PSRANG" UBYTE COMP_0068 1 100 0 255 ECU_ADDRESS 0xFFFF54DB READ_WRITE /end MEASUREMENT
/begin MEASUREMENT BTSNGH "RAM value BTSNGH" UBYTE COMP_0068 1 100 0 255 ECU_ADDRESS 0xFFFF54DE READ_WRITE /end MEASUREMENT
/begin MEASUREMENT BTSNGL "RAM value BTSNGL" UBYTE COMP_0068 1 100 0 255 ECU_ADDRESS 0xFFFF54E1 READ_WRITE /end MEASUREMENT
/begin MEASUREMENT BCSNG2 "RAM value BCSNG2" UBYTE COMP_0068 1 100 0 255 ECU_ADDRESS 0xFFFF54E4 READ_WRITE /end MEASUREMENT
/begin MEASUREMENT BCSNG1 "RAM value BCSNG1" UBYTE COMP_0068 1 100 0 255 ECU_ADDRESS 0xFFFF54E7 READ_WRITE /end MEASUREMENT
/begin MEASUREMENT BCSNGH "RAM value BCSNGH" UBYTE COMP_0068 1 100 0 255 ECU_ADDRESS 0xFFFF54EA READ_WRITE /end MEASUREMENT
/begin MEASUREMENT BCSNGL "RAM value BCSNGL" UBYTE COMP_0068 1 100 0 255 ECU_ADDRESS 0xFFFF54ED READ_WRITE /end MEASUREMENT
/begin MEASUREMENT BCSNGC "RAM value BCSNGC" UBYTE COMP_0068 1 100 0 255 ECU_ADDRESS 0xFFFF54F0 READ_WRITE /end MEASUREMENT
/begin MEASUREMENT EVSNGE "RAM value EVSNGE" UBYTE COMP_0068 1 100 0 255 ECU_ADDRESS 0xFFFF54F3 READ_WRITE /end MEASUREMENT
/begin MEASUREMENT CANFNG "RAM value CANFNG" UBYTE COMP_0068 1 100 0 255 ECU_ADDRESS 0xFFFF54F6 READ_WRITE /end MEASUREMENT
/begin MEASUREMENT AFSNG1 "RAM value AFSNG1" UBYTE COMP_0068 1 100 0 255 ECU_ADDRESS 0xFFFF54F9 READ_WRITE /end MEASUREMENT
/begin MEASUREMENT STSYS "RAM value STSYS" UBYTE COMP_0068 1 100 0 255 ECU_ADDRESS 0xFFFF54FC READ_WRITE /end MEASUREMENT
/begin MEASUREMENT CUTLN "RAM value CUTLN" UBYTE COMP_0068 1 100 0 255 ECU_ADDRESS 0xFFFF54FF READ_WRITE /end MEASUREMENT
/begin MEASUREMENT STRLON "RAM value STRLON" UBYTE COMP_0068 1 100 0 255 ECU_ADDRESS 0xFFFF5502 READ_WRITE /end MEASUREMENT
/begin MEASUREMENT STRLOF "RAM value STRLOF" UBYTE COMP_0068 1 100 0 255 ECU_ADDRESS 0xFFFF5505 READ_WRITE /end MEASUREMENT
/begin MEASUREMENT INHBON "RAM value INHBON" UBYTE COMP_0068 1 100 0 255 ECU_ADDRESS 0xFFFF5508 READ_WRITE /end MEASUREMENT
/begin MEASUREMENT STROPN "RAM value STROPN" UBYTE COMP_0068 1 100 0 255 ECU_ADDRESS 0xFFFF550B READ_WRITE /end MEASUREMENT
/begin MEASUREMENT VPBNGL "RAM value VPBNGL" UBYTE COMP_0068 1 100 0 255 ECU_ADDRESS 0xFFFF550E READ_WRITE /end MEASUREMENT
/begin MEASUREMENT VPBNGH "RAM value VPBNGH" UBYTE COMP_0068 1 100 0 255 ECU_ADDRESS 0xFFFF5511 READ_WRITE /end MEASUREMENT
/begin MEASUREMENT OVBST1 "RAM value OVBST1" UBYTE COMP_0068 1 100 0 255 ECU_ADDRESS 0xFFFF5514 READ_WRITE /end MEASUREMENT
/begin MEASUREMENT TUBNG "RAM value TUBNG" UBYTE COMP_0068 1 100 0 255 ECU_ADDRESS 0xFFFF5517 READ_WRITE /end MEASUREMENT
/begin MEASUREMENT BCONG1 "RAM value BCONG1" UBYTE COMP_0068 1 100 0 255 ECU_ADDRESS 0xFFFF551A READ_WRITE /end MEASUREMENT
/begin MEASUREMENT BCGNG1 "RAM value BCGNG1" UBYTE COMP_0068 1 100 0 255 ECU_ADDRESS 0xFFFF551D READ_WRITE /end MEASUREMENT
/begin MEASUREMENT TBSNG1 "RAM value TBSNG1" UBYTE COMP_0068 1 100 0 255 ECU_ADDRESS 0xFFFF5520 READ_WRITE /end MEASUREMENT
/begin MEASUREMENT TATHL "RAM value TATHL" UBYTE COMP_0068 1 100 0 255 ECU_ADDRESS 0xFFFF5523 READ_WRITE /end MEASUREMENT
/begin MEASUREMENT TATHH "RAM value TATHH" UBYTE COMP_0068 1 100 0 255 ECU_ADDRESS 0xFFFF5526 READ_WRITE /end MEASUREMENT
/begin MEASUREMENT TWSTNG "RAM value TWSTNG" UBYTE COMP_0068 1 100 0 255 ECU_ADDRESS 0xFFFF5529 READ_WRITE /end MEASUREMENT
/begin MEASUREMENT ACRING "RAM value ACRING" UBYTE COMP_0068 1 100 0 255 ECU_ADDRESS 0xFFFF552C READ_WRITE /end MEASUREMENT
/begin MEASUREMENT BCRING "RAM value BCRING" UBYTE COMP_0068 1 100 0 255 ECU_ADDRESS 0xFFFF552F READ_WRITE /end MEASUREMENT
/begin MEASUREMENT ATRING "RAM value ATRING" UBYTE COMP_0068 1 100 0 255 ECU_ADDRESS 0xFFFF5532 READ_WRITE /end MEASUREMENT
/begin MEASUREMENT RODRD1 "RAM value RODRD1" UBYTE COMP_0068 1 100 0 255 ECU_ADDRESS 0xFFFF5535 READ_WRITE /end MEASUREMENT
/begin MEASUREMENT FPHNG "RAM value FPHNG" UBYTE COMP_0068 1 100 0 255 ECU_ADDRESS 0xFFFF5538 READ_WRITE /end MEASUREMENT
/begin MEASUREMENT FPLNG "RAM value FPLNG" UBYTE COMP_0068 1 100 0 255 ECU_ADDRESS 0xFFFF553B READ_WRITE /end MEASUREMENT
/begin MEASUREMENT PSHNG "RAM value PSHNG" UBYTE COMP_0068 1 100 0 255 ECU_ADDRESS 0xFFFF553E READ_WRITE /end MEASUREMENT
/begin MEASUREMENT PSLNG "RAM value PSLNG" UBYTE COMP_0068 1 100 0 255 ECU_ADDRESS 0xFFFF5541 READ_WRITE /end MEASUREMENT
/begin MEASUREMENT PSFNG "RAM value PSFNG" UBYTE COMP_0068 1 100 0 255 ECU_ADDRESS 0xFFFF5544 READ_WRITE /end MEASUREMENT
/begin MEASUREMENT OPSNNG "RAM value OPSNNG" UBYTE COMP_0068 1 100 0 255 ECU_ADDRESS 0xFFFF5547 READ_WRITE /end MEASUREMENT
/begin MEASUREMENT FABRS "RAM value FABRS" UBYTE COMP_0068 1 100 0 255 ECU_ADDRESS 0xFFFF554A READ_WRITE /end MEASUREMENT
/begin MEASUREMENT CSSADV "RAM value CSSADV" UBYTE COMP_0068 1 100 0 255 ECU_ADDRESS 0xFFFF554D READ_WRITE /end MEASUREMENT
/begin MEASUREMENT CSSRPM "RAM value CSSRPM" UBYTE COMP_0068 1 100 0 255 ECU_ADDRESS 0xFFFF5550 READ_WRITE /end MEASUREMENT
/begin MEASUREMENT CSSTNG "RAM value CSSTNG" UBYTE COMP_0068 1 100 0 255 ECU_ADDRESS 0xFFFF5553 READ_WRITE /end MEASUREMENT
/begin MEASUREMENT TANTRH "RAM value TANTRH" UBYTE COMP_0068 1 100 0 255 ECU_ADDRESS 0xFFFF5556 READ_WRITE /end MEASUREMENT
/begin MEASUREMENT TANTRL "RAM value TANTRL" UBYTE COMP_0068 1 100 0 255 ECU_ADDRESS 0xFFFF5559 READ_WRITE /end MEASUREMENT
/begin MEASUREMENT PSTNG3 "RAM value PSTNG3" UBYTE COMP_0068 1 100 0 255 ECU_ADDRESS 0xFFFF555C READ_WRITE /end MEASUREMENT
/begin MEASUREMENT PSTNG2 "RAM value PSTNG2" UBYTE COMP_0068 1 100 0 255 ECU_ADDRESS 0xFFFF555F READ_WRITE /end MEASUREMENT
/begin MEASUREMENT PSTNG1 "RAM value PSTNG1" UBYTE COMP_0068 1 100 0 255 ECU_ADDRESS 0xFFFF5562 READ_WRITE /end MEASUREMENT
/begin MEASUREMENT CSSIT "RAM value CSSIT" UBYTE COMP_0068 1 100 0 255 ECU_ADDRESS 0xFFFF5565 READ_WRITE /end MEASUREMENT
/begin MEASUREMENT CSSKRT "RAM value CSSKRT" UBYTE COMP_0068 1 100 0 255 ECU_ADDRESS 0xFFFF5568 READ_WRITE /end MEASUREMENT
/begin MEASUREMENT CSSDIG "RAM value CSSDIG" UBYTE COMP_0068 1 100 0 255 ECU_ADDRESS 0xFFFF556B READ_WRITE /end MEASUREMENT
/begin MEASUREMENT THCLNG "RAM value THCLNG" UBYTE COMP_0068 1 100 0 255 ECU_ADDRESS 0xFFFF556E READ_WRITE /end MEASUREMENT
/begin MEASUREMENT THNGH "RAM value THNGH" UBYTE COMP_0068 1 100 0 255 ECU_ADDRESS 0xFFFF5571 READ_WRITE /end MEASUREMENT
/begin MEASUREMENT THNGL "RAM value THNGL" UBYTE COMP_0068 1 100 0 255 ECU_ADDRESS 0xFFFF5574 READ_WRITE /end MEASUREMENT
/begin MEASUREMENT ECMTMH "RAM value ECMTMH" UBYTE COMP_0068 1 100 0 255 ECU_ADDRESS 0xFFFF5577 READ_WRITE /end MEASUREMENT
/begin MEASUREMENT AFMRM1 "RAM value AFMRM1" UBYTE COMP_0068 1 100 0 255 ECU_ADDRESS 0xFFFF557A READ_WRITE /end MEASUREMENT
/begin MEASUREMENT AFMFS1 "RAM value AFMFS1" UBYTE COMP_0068 1 100 0 255 ECU_ADDRESS 0xFFFF557D READ_WRITE /end MEASUREMENT
/begin MEASUREMENT PLGSNG "RAM value PLGSNG" UBYTE COMP_0068 1 100 0 255 ECU_ADDRESS 0xFFFF5580 READ_WRITE /end MEASUREMENT
/begin MEASUREMENT PRGSNG "RAM value PRGSNG" UBYTE COMP_0068 1 100 0 255 ECU_ADDRESS 0xFFFF5583 READ_WRITE /end MEASUREMENT
/begin MEASUREMENT MCTHNG "RAM value MCTHNG" UBYTE COMP_0068 1 100 0 255 ECU_ADDRESS 0xFFFF5586 READ_WRITE /end MEASUREMENT
/begin MEASUREMENT DCMTDG "RAM value DCMTDG" UBYTE COMP_0068 1 100 0 255 ECU_ADDRESS 0xFFFF5589 READ_WRITE /end MEASUREMENT
/begin MEASUREMENT MCTONG "RAM value MCTONG" UBYTE COMP_0068 1 100 0 255 ECU_ADDRESS 0xFFFF558C READ_WRITE /end MEASUREMENT
/begin MEASUREMENT MCTFNG "RAM value MCTFNG" UBYTE COMP_0068 1 100 0 255 ECU_ADDRESS 0xFFFF558F READ_WRITE /end MEASUREMENT
/begin MEASUREMENT MCTANG "RAM value MCTANG" UBYTE COMP_0068 1 100 0 255 ECU_ADDRESS 0xFFFF5592 READ_WRITE /end MEASUREMENT
/begin MEASUREMENT MCTWNG "RAM value MCTWNG" UBYTE COMP_0068 1 100 0 255 ECU_ADDRESS 0xFFFF5595 READ_WRITE /end MEASUREMENT
/begin MEASUREMENT VDRING "RAM value VDRING" UBYTE COMP_0068 1 100 0 255 ECU_ADDRESS 0xFFFF5598 READ_WRITE /end MEASUREMENT
/begin MEASUREMENT VSPLRA "RAM value VSPLRA" UBYTE COMP_0068 1 100 0 255 ECU_ADDRESS 0xFFFF559B READ_WRITE /end MEASUREMENT
/begin MEASUREMENT VSPLDR "RAM value VSPLDR" UBYTE COMP_0068 1 100 0 255 ECU_ADDRESS 0xFFFF559E READ_WRITE /end MEASUREMENT
/begin MEASUREMENT VSPLDL "RAM value VSPLDL" UBYTE COMP_0068 1 100 0 255 ECU_ADDRESS 0xFFFF55A1 READ_WRITE /end MEASUREMENT
/begin MEASUREMENT GCALNG "RAM value GCALNG" UBYTE COMP_0068 1 100 0 255 ECU_ADDRESS 0xFFFF55A4 READ_WRITE /end MEASUREMENT
/begin MEASUREMENT GRVRAT "RAM value GRVRAT" UBYTE COMP_0068 1 100 0 255 ECU_ADDRESS 0xFFFF55A7 READ_WRITE /end MEASUREMENT
/begin MEASUREMENT GRVOOR "RAM value GRVOOR" UBYTE COMP_0068 1 100 0 255 ECU_ADDRESS 0xFFFF55AA READ_WRITE /end MEASUREMENT
/begin MEASUREMENT EPBPCR "RAM value EPBPCR" UBYTE COMP_0068 1 100 0 255 ECU_ADDRESS 0xFFFF55AD READ_WRITE /end MEASUREMENT
/begin MEASUREMENT GRVNGL "RAM value GRVNGL" UBYTE COMP_0068 1 100 0 255 ECU_ADDRESS 0xFFFF55B0 READ_WRITE /end MEASUREMENT
/begin MEASUREMENT GRVNGH "RAM value GRVNGH" UBYTE COMP_0068 1 100 0 255 ECU_ADDRESS 0xFFFF55B3 READ_WRITE /end MEASUREMENT
/begin MEASUREMENT vVSPNG1 "RAM value vVSPNG1" UBYTE COMP_0068 1 100 0 255 ECU_ADDRESS 0xFFFF528D READ_WRITE /end MEASUREMENT
/begin MEASUREMENT vVSPNG2 "RAM value vVSPNG2" UBYTE COMP_0068 1 100 0 255 ECU_ADDRESS 0xFFFF528E READ_WRITE /end MEASUREMENT
/begin MEASUREMENT vOVHEAT "RAM value vOVHEAT" UWORD COMP_0068 1 100 0 65535 ECU_ADDRESS 0xFFFF5290 READ_WRITE /end MEASUREMENT
/begin MEASUREMENT vO2CLB11 "RAM value vO2CLB11" UBYTE COMP_0068 1 100 0 255 ECU_ADDRESS 0xFFFF5293 READ_WRITE /end MEASUREMENT
/begin MEASUREMENT vO2CLB12 "RAM value vO2CLB12" UBYTE COMP_0068 1 100 0 255 ECU_ADDRESS 0xFFFF5294 READ_WRITE /end MEASUREMENT
/begin MEASUREMENT vTXLNNG "RAM value vTXLNNG" UWORD COMP_0068 1 100 0 65535 ECU_ADDRESS 0xFFFF5296 READ_WRITE /end MEASUREMENT
/begin MEASUREMENT vMF4NG1 "RAM value vMF4NG1" UBYTE COMP_0068 1 100 0 255 ECU_ADDRESS 0xFFFF5299 READ_WRITE /end MEASUREMENT
/begin MEASUREMENT vMF4NG2 "RAM value vMF4NG2" UBYTE COMP_0068 1 100 0 255 ECU_ADDRESS 0xFFFF529A READ_WRITE /end MEASUREMENT
/begin MEASUREMENT vMF3NG "RAM value vMF3NG" UWORD COMP_0068 1 100 0 65535 ECU_ADDRESS 0xFFFF529C READ_WRITE /end MEASUREMENT
/begin MEASUREMENT vMF2NG1 "RAM value vMF2NG1" UBYTE COMP_0068 1 100 0 255 ECU_ADDRESS 0xFFFF529F READ_WRITE /end MEASUREMENT
/begin MEASUREMENT vMF2NG2 "RAM value vMF2NG2" UBYTE COMP_0068 1 100 0 255 ECU_ADDRESS 0xFFFF52A0 READ_WRITE /end MEASUREMENT
/begin MEASUREMENT vMF1NG "RAM value vMF1NG" UWORD COMP_0068 1 100 0 65535 ECU_ADDRESS 0xFFFF52A2 READ_WRITE /end MEASUREMENT
/begin MEASUREMENT vMFMCNG1 "RAM value vMFMCNG1" UBYTE COMP_0068 1 100 0 255 ECU_ADDRESS 0xFFFF52A5 READ_WRITE /end MEASUREMENT
/begin MEASUREMENT vMFMCNG2 "RAM value vMFMCNG2" UBYTE COMP_0068 1 100 0 255 ECU_ADDRESS 0xFFFF52A6 READ_WRITE /end MEASUREMENT
/begin MEASUREMENT vCAT1NG "RAM value vCAT1NG" UWORD COMP_0068 1 100 0 65535 ECU_ADDRESS 0xFFFF52A8 READ_WRITE /end MEASUREMENT
/begin MEASUREMENT vMRNG1 "RAM value vMRNG1" UBYTE COMP_0068 1 100 0 255 ECU_ADDRESS 0xFFFF52AB READ_WRITE /end MEASUREMENT
/begin MEASUREMENT vMRNG2 "RAM value vMRNG2" UBYTE COMP_0068 1 100 0 255 ECU_ADDRESS 0xFFFF52AC READ_WRITE /end MEASUREMENT
/begin MEASUREMENT vTWCLNG "RAM value vTWCLNG" UWORD COMP_0068 1 100 0 65535 ECU_ADDRESS 0xFFFF52AE READ_WRITE /end MEASUREMENT
/begin MEASUREMENT vNSNG1 "RAM value vNSNG1" UBYTE COMP_0068 1 100 0 255 ECU_ADDRESS 0xFFFF52B1 READ_WRITE /end MEASUREMENT
/begin MEASUREMENT vNSNG2 "RAM value vNSNG2" UBYTE COMP_0068 1 100 0 255 ECU_ADDRESS 0xFFFF52B2 READ_WRITE /end MEASUREMENT
/begin MEASUREMENT vEVCN3 "RAM value vEVCN3" UWORD COMP_0068 1 100 0 65535 ECU_ADDRESS 0xFFFF52B4 READ_WRITE /end MEASUREMENT
/begin MEASUREMENT vINHSW1 "RAM value vINHSW1" UBYTE COMP_0068 1 100 0 255 ECU_ADDRESS 0xFFFF52B7 READ_WRITE /end MEASUREMENT
/begin MEASUREMENT vINHSW2 "RAM value vINHSW2" UBYTE COMP_0068 1 100 0 255 ECU_ADDRESS 0xFFFF52B8 READ_WRITE /end MEASUREMENT
/begin MEASUREMENT vOUTSNG "RAM value vOUTSNG" UWORD COMP_0068 1 100 0 65535 ECU_ADDRESS 0xFFFF52BA READ_WRITE /end MEASUREMENT
/begin MEASUREMENT vSP1NG1 "RAM value vSP1NG1" UBYTE COMP_0068 1 100 0 255 ECU_ADDRESS 0xFFFF52BD READ_WRITE /end MEASUREMENT
/begin MEASUREMENT vSP1NG2 "RAM value vSP1NG2" UBYTE COMP_0068 1 100 0 255 ECU_ADDRESS 0xFFFF52BE READ_WRITE /end MEASUREMENT
/begin MEASUREMENT vSP2NG "RAM value vSP2NG" UWORD COMP_0068 1 100 0 65535 ECU_ADDRESS 0xFFFF52C0 READ_WRITE /end MEASUREMENT
/begin MEASUREMENT vSP3NG1 "RAM value vSP3NG1" UBYTE COMP_0068 1 100 0 255 ECU_ADDRESS 0xFFFF52C3 READ_WRITE /end MEASUREMENT
/begin MEASUREMENT vSP3NG2 "RAM value vSP3NG2" UBYTE COMP_0068 1 100 0 255 ECU_ADDRESS 0xFFFF52C4 READ_WRITE /end MEASUREMENT
/begin MEASUREMENT vSP4NG "RAM value vSP4NG" UWORD COMP_0068 1 100 0 65535 ECU_ADDRESS 0xFFFF52C6 READ_WRITE /end MEASUREMENT
/begin MEASUREMENT vLUFNG1 "RAM value vLUFNG1" UBYTE COMP_0068 1 100 0 255 ECU_ADDRESS 0xFFFF52C9 READ_WRITE /end MEASUREMENT
/begin MEASUREMENT vLUFNG2 "RAM value vLUFNG2" UBYTE COMP_0068 1 100 0 255 ECU_ADDRESS 0xFFFF52CA READ_WRITE /end MEASUREMENT
/begin MEASUREMENT vSHANG "RAM value vSHANG" UWORD COMP_0068 1 100 0 65535 ECU_ADDRESS 0xFFFF52CC READ_WRITE /end MEASUREMENT
/begin MEASUREMENT vSHBNG1 "RAM value vSHBNG1" UBYTE COMP_0068 1 100 0 255 ECU_ADDRESS 0xFFFF52CF READ_WRITE /end MEASUREMENT
/begin MEASUREMENT vSHBNG2 "RAM value vSHBNG2" UBYTE COMP_0068 1 100 0 255 ECU_ADDRESS 0xFFFF52D0 READ_WRITE /end MEASUREMENT
/begin MEASUREMENT vOVRSNG "RAM value vOVRSNG" UWORD COMP_0068 1 100 0 65535 ECU_ADDRESS 0xFFFF52D2 READ_WRITE /end MEASUREMENT
/begin MEASUREMENT vLUSNG1 "RAM value vLUSNG1" UBYTE COMP_0068 1 100 0 255 ECU_ADDRESS 0xFFFF52D5 READ_WRITE /end MEASUREMENT
/begin MEASUREMENT vLUSNG2 "RAM value vLUSNG2" UBYTE COMP_0068 1 100 0 255 ECU_ADDRESS 0xFFFF52D6 READ_WRITE /end MEASUREMENT
/begin MEASUREMENT vPLSNG "RAM value vPLSNG" UWORD COMP_0068 1 100 0 65535 ECU_ADDRESS 0xFFFF52D8 READ_WRITE /end MEASUREMENT
/begin MEASUREMENT vATTHNG1 "RAM value vATTHNG1" UBYTE COMP_0068 1 100 0 255 ECU_ADDRESS 0xFFFF52DB READ_WRITE /end MEASUREMENT
/begin MEASUREMENT vATTHNG2 "RAM value vATTHNG2" UBYTE COMP_0068 1 100 0 255 ECU_ADDRESS 0xFFFF52DC READ_WRITE /end MEASUREMENT
/begin MEASUREMENT vENINNG "RAM value vENINNG" UWORD COMP_0068 1 100 0 65535 ECU_ADDRESS 0xFFFF52DE READ_WRITE /end MEASUREMENT
/begin MEASUREMENT vSOTMP1 "RAM value vSOTMP1" UBYTE COMP_0068 1 100 0 255 ECU_ADDRESS 0xFFFF52E1 READ_WRITE /end MEASUREMENT
/begin MEASUREMENT vSOTMP2 "RAM value vSOTMP2" UBYTE COMP_0068 1 100 0 255 ECU_ADDRESS 0xFFFF52E2 READ_WRITE /end MEASUREMENT
/begin MEASUREMENT vFPCMNG "RAM value vFPCMNG" UWORD COMP_0068 1 100 0 65535 ECU_ADDRESS 0xFFFF52E4 READ_WRITE /end MEASUREMENT
/begin MEASUREMENT vLCMNG1 "RAM value vLCMNG1" UBYTE COMP_0068 1 100 0 255 ECU_ADDRESS 0xFFFF52E7 READ_WRITE /end MEASUREMENT
/begin MEASUREMENT vLCMNG2 "RAM value vLCMNG2" UBYTE COMP_0068 1 100 0 255 ECU_ADDRESS 0xFFFF52E8 READ_WRITE /end MEASUREMENT
/begin MEASUREMENT vVIDNG "RAM value vVIDNG" UWORD COMP_0068 1 100 0 65535 ECU_ADDRESS 0xFFFF52EA READ_WRITE /end MEASUREMENT
/begin MEASUREMENT vCOMNG1 "RAM value vCOMNG1" UBYTE COMP_0068 1 100 0 255 ECU_ADDRESS 0xFFFF52ED READ_WRITE /end MEASUREMENT
/begin MEASUREMENT vCOMNG2 "RAM value vCOMNG2" UBYTE COMP_0068 1 100 0 255 ECU_ADDRESS 0xFFFF52EE READ_WRITE /end MEASUREMENT
/begin MEASUREMENT vIMLCK "RAM value vIMLCK" UWORD COMP_0068 1 100 0 65535 ECU_ADDRESS 0xFFFF52F0 READ_WRITE /end MEASUREMENT
/begin MEASUREMENT vKEYNG1 "RAM value vKEYNG1" UBYTE COMP_0068 1 100 0 255 ECU_ADDRESS 0xFFFF52F3 READ_WRITE /end MEASUREMENT
/begin MEASUREMENT vKEYNG2 "RAM value vKEYNG2" UBYTE COMP_0068 1 100 0 255 ECU_ADDRESS 0xFFFF52F4 READ_WRITE /end MEASUREMENT
/begin MEASUREMENT vKEYER "RAM value vKEYER" UWORD COMP_0068 1 100 0 65535 ECU_ADDRESS 0xFFFF52F6 READ_WRITE /end MEASUREMENT
/begin MEASUREMENT vKHTDGN1 "RAM value vKHTDGN1" UBYTE COMP_0068 1 100 0 255 ECU_ADDRESS 0xFFFF52F9 READ_WRITE /end MEASUREMENT
/begin MEASUREMENT vKHTDGN2 "RAM value vKHTDGN2" UBYTE COMP_0068 1 100 0 255 ECU_ADDRESS 0xFFFF52FA READ_WRITE /end MEASUREMENT
/begin MEASUREMENT vEVCN2 "RAM value vEVCN2" UWORD COMP_0068 1 100 0 65535 ECU_ADDRESS 0xFFFF52FC READ_WRITE /end MEASUREMENT
/begin MEASUREMENT vCDCNG21 "RAM value vCDCNG21" UBYTE COMP_0068 1 100 0 255 ECU_ADDRESS 0xFFFF52FF READ_WRITE /end MEASUREMENT
/begin MEASUREMENT vCDCNG22 "RAM value vCDCNG22" UBYTE COMP_0068 1 100 0 255 ECU_ADDRESS 0xFFFF5300 READ_WRITE /end MEASUREMENT
/begin MEASUREMENT vFLRNG "RAM value vFLRNG" UWORD COMP_0068 1 100 0 65535 ECU_ADDRESS 0xFFFF5302 READ_WRITE /end MEASUREMENT
/begin MEASUREMENT vCDCNG31 "RAM value vCDCNG31" UBYTE COMP_0068 1 100 0 255 ECU_ADDRESS 0xFFFF5305 READ_WRITE /end MEASUREMENT
/begin MEASUREMENT vCDCNG32 "RAM value vCDCNG32" UBYTE COMP_0068 1 100 0 255 ECU_ADDRESS 0xFFFF5306 READ_WRITE /end MEASUREMENT
/begin MEASUREMENT vVTCSV1 "RAM value vVTCSV1" UWORD COMP_0068 1 100 0 65535 ECU_ADDRESS 0xFFFF5308 READ_WRITE /end MEASUREMENT
/begin MEASUREMENT vSTMFNG1 "RAM value vSTMFNG1" UBYTE COMP_0068 1 100 0 255 ECU_ADDRESS 0xFFFF530B READ_WRITE /end MEASUREMENT
/begin MEASUREMENT vSTMFNG2 "RAM value vSTMFNG2" UBYTE COMP_0068 1 100 0 255 ECU_ADDRESS 0xFFFF530C READ_WRITE /end MEASUREMENT
/begin MEASUREMENT vPRINNG "RAM value vPRINNG" UWORD COMP_0068 1 100 0 65535 ECU_ADDRESS 0xFFFF530E READ_WRITE /end MEASUREMENT
/begin MEASUREMENT vSTMDNG1 "RAM value vSTMDNG1" UBYTE COMP_0068 1 100 0 255 ECU_ADDRESS 0xFFFF5311 READ_WRITE /end MEASUREMENT
/begin MEASUREMENT vSTMDNG2 "RAM value vSTMDNG2" UBYTE COMP_0068 1 100 0 255 ECU_ADDRESS 0xFFFF5312 READ_WRITE /end MEASUREMENT
/begin MEASUREMENT vOPSNG "RAM value vOPSNG" UWORD COMP_0068 1 100 0 65535 ECU_ADDRESS 0xFFFF5314 READ_WRITE /end MEASUREMENT
/begin MEASUREMENT vCLUDNG1 "RAM value vCLUDNG1" UBYTE COMP_0068 1 100 0 255 ECU_ADDRESS 0xFFFF5317 READ_WRITE /end MEASUREMENT
/begin MEASUREMENT vCLUDNG2 "RAM value vCLUDNG2" UBYTE COMP_0068 1 100 0 255 ECU_ADDRESS 0xFFFF5318 READ_WRITE /end MEASUREMENT
/begin MEASUREMENT vCPLDNG "RAM value vCPLDNG" UWORD COMP_0068 1 100 0 65535 ECU_ADDRESS 0xFFFF531A READ_WRITE /end MEASUREMENT
/begin MEASUREMENT vFPSNG1 "RAM value vFPSNG1" UBYTE COMP_0068 1 100 0 255 ECU_ADDRESS 0xFFFF531D READ_WRITE /end MEASUREMENT
/begin MEASUREMENT vFPSNG2 "RAM value vFPSNG2" UBYTE COMP_0068 1 100 0 255 ECU_ADDRESS 0xFFFF531E READ_WRITE /end MEASUREMENT
/begin MEASUREMENT vPREGNG "RAM value vPREGNG" UWORD COMP_0068 1 100 0 65535 ECU_ADDRESS 0xFFFF5320 READ_WRITE /end MEASUREMENT
/begin MEASUREMENT vCLUFNG1 "RAM value vCLUFNG1" UBYTE COMP_0068 1 100 0 255 ECU_ADDRESS 0xFFFF5323 READ_WRITE /end MEASUREMENT
/begin MEASUREMENT vCLUFNG2 "RAM value vCLUFNG2" UBYTE COMP_0068 1 100 0 255 ECU_ADDRESS 0xFFFF5324 READ_WRITE /end MEASUREMENT
/begin MEASUREMENT vCPLFNG "RAM value vCPLFNG" UWORD COMP_0068 1 100 0 65535 ECU_ADDRESS 0xFFFF5326 READ_WRITE /end MEASUREMENT
/begin MEASUREMENT vSSFNG1 "RAM value vSSFNG1" UBYTE COMP_0068 1 100 0 255 ECU_ADDRESS 0xFFFF5329 READ_WRITE /end MEASUREMENT
/begin MEASUREMENT vSSFNG2 "RAM value vSSFNG2" UBYTE COMP_0068 1 100 0 255 ECU_ADDRESS 0xFFFF532A READ_WRITE /end MEASUREMENT
/begin MEASUREMENT vSSDNG "RAM value vSSDNG" UWORD COMP_0068 1 100 0 65535 ECU_ADDRESS 0xFFFF532C READ_WRITE /end MEASUREMENT
/begin MEASUREMENT vLSSDNG1 "RAM value vLSSDNG1" UBYTE COMP_0068 1 100 0 255 ECU_ADDRESS 0xFFFF532F READ_WRITE /end MEASUREMENT
/begin MEASUREMENT vLSSDNG2 "RAM value vLSSDNG2" UBYTE COMP_0068 1 100 0 255 ECU_ADDRESS 0xFFFF5330 READ_WRITE /end MEASUREMENT
/begin MEASUREMENT vVTSVE1 "RAM value vVTSVE1" UWORD COMP_0068 1 100 0 65535 ECU_ADDRESS 0xFFFF5332 READ_WRITE /end MEASUREMENT
/begin MEASUREMENT vFGPNG21 "RAM value vFGPNG21" UBYTE COMP_0068 1 100 0 255 ECU_ADDRESS 0xFFFF5335 READ_WRITE /end MEASUREMENT
/begin MEASUREMENT vFGPNG22 "RAM value vFGPNG22" UBYTE COMP_0068 1 100 0 255 ECU_ADDRESS 0xFFFF5336 READ_WRITE /end MEASUREMENT
/begin MEASUREMENT vFGPNG3 "RAM value vFGPNG3" UWORD COMP_0068 1 100 0 65535 ECU_ADDRESS 0xFFFF5338 READ_WRITE /end MEASUREMENT
/begin MEASUREMENT vDCS1NG1 "RAM value vDCS1NG1" UBYTE COMP_0068 1 100 0 255 ECU_ADDRESS 0xFFFF533B READ_WRITE /end MEASUREMENT
/begin MEASUREMENT vDCS1NG2 "RAM value vDCS1NG2" UBYTE COMP_0068 1 100 0 255 ECU_ADDRESS 0xFFFF533C READ_WRITE /end MEASUREMENT
/begin MEASUREMENT vDCS2NG "RAM value vDCS2NG" UWORD COMP_0068 1 100 0 65535 ECU_ADDRESS 0xFFFF533E READ_WRITE /end MEASUREMENT
/begin MEASUREMENT vDCS3NG1 "RAM value vDCS3NG1" UBYTE COMP_0068 1 100 0 255 ECU_ADDRESS 0xFFFF5341 READ_WRITE /end MEASUREMENT
/begin MEASUREMENT vDCS3NG2 "RAM value vDCS3NG2" UBYTE COMP_0068 1 100 0 255 ECU_ADDRESS 0xFFFF5342 READ_WRITE /end MEASUREMENT
/begin MEASUREMENT vDPS1NG "RAM value vDPS1NG" UWORD COMP_0068 1 100 0 65535 ECU_ADDRESS 0xFFFF5344 READ_WRITE /end MEASUREMENT
/begin MEASUREMENT vDPS2NG1 "RAM value vDPS2NG1" UBYTE COMP_0068 1 100 0 255 ECU_ADDRESS 0xFFFF5347 READ_WRITE /end MEASUREMENT
/begin MEASUREMENT vDPS2NG2 "RAM value vDPS2NG2" UBYTE COMP_0068 1 100 0 255 ECU_ADDRESS 0xFFFF5348 READ_WRITE /end MEASUREMENT
/begin MEASUREMENT vDPS3NG "RAM value vDPS3NG" UWORD COMP_0068 1 100 0 65535 ECU_ADDRESS 0xFFFF534A READ_WRITE /end MEASUREMENT
/begin MEASUREMENT vVBONG11 "RAM value vVBONG11" UBYTE COMP_0068 1 100 0 255 ECU_ADDRESS 0xFFFF534D READ_WRITE /end MEASUREMENT
/begin MEASUREMENT vVBONG12 "RAM value vVBONG12" UBYTE COMP_0068 1 100 0 255 ECU_ADDRESS 0xFFFF534E READ_WRITE /end MEASUREMENT
/begin MEASUREMENT vDUCMB "RAM value vDUCMB" UWORD COMP_0068 1 100 0 65535 ECU_ADDRESS 0xFFFF5350 READ_WRITE /end MEASUREMENT
/begin MEASUREMENT vDUFLB1 "RAM value vDUFLB1" UBYTE COMP_0068 1 100 0 255 ECU_ADDRESS 0xFFFF5353 READ_WRITE /end MEASUREMENT
/begin MEASUREMENT vDUFLB2 "RAM value vDUFLB2" UBYTE COMP_0068 1 100 0 255 ECU_ADDRESS 0xFFFF5354 READ_WRITE /end MEASUREMENT
/begin MEASUREMENT vSYNCNG "RAM value vSYNCNG" UWORD COMP_0068 1 100 0 65535 ECU_ADDRESS 0xFFFF5356 READ_WRITE /end MEASUREMENT
/begin MEASUREMENT vALUNG1 "RAM value vALUNG1" UBYTE COMP_0068 1 100 0 255 ECU_ADDRESS 0xFFFF5359 READ_WRITE /end MEASUREMENT
/begin MEASUREMENT vALUNG2 "RAM value vALUNG2" UBYTE COMP_0068 1 100 0 255 ECU_ADDRESS 0xFFFF535A READ_WRITE /end MEASUREMENT
/begin MEASUREMENT vQCKNG "RAM value vQCKNG" UWORD COMP_0068 1 100 0 65535 ECU_ADDRESS 0xFFFF535C READ_WRITE /end MEASUREMENT
/begin MEASUREMENT vCALCNG1 "RAM value vCALCNG1" UBYTE COMP_0068 1 100 0 255 ECU_ADDRESS 0xFFFF535F READ_WRITE /end MEASUREMENT
/begin MEASUREMENT vCALCNG2 "RAM value vCALCNG2" UBYTE COMP_0068 1 100 0 255 ECU_ADDRESS 0xFFFF5360 READ_WRITE /end MEASUREMENT
/begin MEASUREMENT vCANGNE "RAM value vCANGNE" UWORD COMP_0068 1 100 0 65535 ECU_ADDRESS 0xFFFF5362 READ_WRITE /end MEASUREMENT
/begin MEASUREMENT vADNG1 "RAM value vADNG1" UBYTE COMP_0068 1 100 0 255 ECU_ADDRESS 0xFFFF5365 READ_WRITE /end MEASUREMENT
/begin MEASUREMENT vADNG2 "RAM value vADNG2" UBYTE COMP_0068 1 100 0 255 ECU_ADDRESS 0xFFFF5366 READ_WRITE /end MEASUREMENT
/begin MEASUREMENT vIC3NG "RAM value vIC3NG" UWORD COMP_0068 1 100 0 65535 ECU_ADDRESS 0xFFFF5368 READ_WRITE /end MEASUREMENT
/begin MEASUREMENT vCANNG1 "RAM value vCANNG1" UBYTE COMP_0068 1 100 0 255 ECU_ADDRESS 0xFFFF536B READ_WRITE /end MEASUREMENT
/begin MEASUREMENT vCANNG2 "RAM value vCANNG2" UBYTE COMP_0068 1 100 0 255 ECU_ADDRESS 0xFFFF536C READ_WRITE /end MEASUREMENT
/begin MEASUREMENT vINONG4 "RAM value vINONG4" UWORD COMP_0068 1 100 0 65535 ECU_ADDRESS 0xFFFF536E READ_WRITE /end MEASUREMENT
/begin MEASUREMENT vINONG31 "RAM value vINONG31" UBYTE COMP_0068 1 100 0 255 ECU_ADDRESS 0xFFFF5371 READ_WRITE /end MEASUREMENT
/begin MEASUREMENT vINONG32 "RAM value vINONG32" UBYTE COMP_0068 1 100 0 255 ECU_ADDRESS 0xFFFF5372 READ_WRITE /end MEASUREMENT
/begin MEASUREMENT vINONG2 "RAM value vINONG2" UWORD COMP_0068 1 100 0 65535 ECU_ADDRESS 0xFFFF5374 READ_WRITE /end MEASUREMENT
/begin MEASUREMENT vINONG11 "RAM value vINONG11" UBYTE COMP_0068 1 100 0 255 ECU_ADDRESS 0xFFFF5377 READ_WRITE /end MEASUREMENT
/begin MEASUREMENT vINONG12 "RAM value vINONG12" UBYTE COMP_0068 1 100 0 255 ECU_ADDRESS 0xFFFF5378 READ_WRITE /end MEASUREMENT
/begin MEASUREMENT vAVCCNG "RAM value vAVCCNG" UWORD COMP_0068 1 100 0 65535 ECU_ADDRESS 0xFFFF537A READ_WRITE /end MEASUREMENT
/begin MEASUREMENT vTPS4NG1 "RAM value vTPS4NG1" UBYTE COMP_0068 1 100 0 255 ECU_ADDRESS 0xFFFF537D READ_WRITE /end MEASUREMENT
/begin MEASUREMENT vTPS4NG2 "RAM value vTPS4NG2" UBYTE COMP_0068 1 100 0 255 ECU_ADDRESS 0xFFFF537E READ_WRITE /end MEASUREMENT
/begin MEASUREMENT vTPCLNG "RAM value vTPCLNG" UWORD COMP_0068 1 100 0 65535 ECU_ADDRESS 0xFFFF5380 READ_WRITE /end MEASUREMENT
/begin MEASUREMENT vTPLRNG1 "RAM value vTPLRNG1" UBYTE COMP_0068 1 100 0 255 ECU_ADDRESS 0xFFFF5383 READ_WRITE /end MEASUREMENT
/begin MEASUREMENT vTPLRNG2 "RAM value vTPLRNG2" UBYTE COMP_0068 1 100 0 255 ECU_ADDRESS 0xFFFF5384 READ_WRITE /end MEASUREMENT
/begin MEASUREMENT vTHFBNG "RAM value vTHFBNG" UWORD COMP_0068 1 100 0 65535 ECU_ADDRESS 0xFFFF5386 READ_WRITE /end MEASUREMENT
/begin MEASUREMENT vVAPXNG1 "RAM value vVAPXNG1" UBYTE COMP_0068 1 100 0 255 ECU_ADDRESS 0xFFFF5389 READ_WRITE /end MEASUREMENT
/begin MEASUREMENT vVAPXNG2 "RAM value vVAPXNG2" UBYTE COMP_0068 1 100 0 255 ECU_ADDRESS 0xFFFF538A READ_WRITE /end MEASUREMENT
/begin MEASUREMENT vAPOXNG "RAM value vAPOXNG" UWORD COMP_0068 1 100 0 65535 ECU_ADDRESS 0xFFFF538C READ_WRITE /end MEASUREMENT
/begin MEASUREMENT vTGTXNG1 "RAM value vTGTXNG1" UBYTE COMP_0068 1 100 0 255 ECU_ADDRESS 0xFFFF538F READ_WRITE /end MEASUREMENT
/begin MEASUREMENT vTGTXNG2 "RAM value vTGTXNG2" UBYTE COMP_0068 1 100 0 255 ECU_ADDRESS 0xFFFF5390 READ_WRITE /end MEASUREMENT
/begin MEASUREMENT vSERVNG "RAM value vSERVNG" UWORD COMP_0068 1 100 0 65535 ECU_ADDRESS 0xFFFF5392 READ_WRITE /end MEASUREMENT
/begin MEASUREMENT vASTRNG1 "RAM value vASTRNG1" UBYTE COMP_0068 1 100 0 255 ECU_ADDRESS 0xFFFF5395 READ_WRITE /end MEASUREMENT
/begin MEASUREMENT vASTRNG2 "RAM value vASTRNG2" UBYTE COMP_0068 1 100 0 255 ECU_ADDRESS 0xFFFF5396 READ_WRITE /end MEASUREMENT
/begin MEASUREMENT vCVCUNG "RAM value vCVCUNG" UWORD COMP_0068 1 100 0 65535 ECU_ADDRESS 0xFFFF5398 READ_WRITE /end MEASUREMENT
/begin MEASUREMENT vQHAPNG1 "RAM value vQHAPNG1" UBYTE COMP_0068 1 100 0 255 ECU_ADDRESS 0xFFFF539B READ_WRITE /end MEASUREMENT
/begin MEASUREMENT vQHAPNG2 "RAM value vQHAPNG2" UBYTE COMP_0068 1 100 0 255 ECU_ADDRESS 0xFFFF539C READ_WRITE /end MEASUREMENT
/begin MEASUREMENT vTEPDNG "RAM value vTEPDNG" UWORD COMP_0068 1 100 0 65535 ECU_ADDRESS 0xFFFF539E READ_WRITE /end MEASUREMENT
/begin MEASUREMENT vTATENG1 "RAM value vTATENG1" UBYTE COMP_0068 1 100 0 255 ECU_ADDRESS 0xFFFF53A1 READ_WRITE /end MEASUREMENT
/begin MEASUREMENT vTATENG2 "RAM value vTATENG2" UBYTE COMP_0068 1 100 0 255 ECU_ADDRESS 0xFFFF53A2 READ_WRITE /end MEASUREMENT
/begin MEASUREMENT vTTEPNG "RAM value vTTEPNG" UWORD COMP_0068 1 100 0 65535 ECU_ADDRESS 0xFFFF53A4 READ_WRITE /end MEASUREMENT
/begin MEASUREMENT vRLONNG1 "RAM value vRLONNG1" UBYTE COMP_0068 1 100 0 255 ECU_ADDRESS 0xFFFF53A7 READ_WRITE /end MEASUREMENT
/begin MEASUREMENT vRLONNG2 "RAM value vRLONNG2" UBYTE COMP_0068 1 100 0 255 ECU_ADDRESS 0xFFFF53A8 READ_WRITE /end MEASUREMENT
/begin MEASUREMENT vRLOFNG "RAM value vRLOFNG" UWORD COMP_0068 1 100 0 65535 ECU_ADDRESS 0xFFFF53AA READ_WRITE /end MEASUREMENT
/begin MEASUREMENT vDTSPNG1 "RAM value vDTSPNG1" UBYTE COMP_0068 1 100 0 255 ECU_ADDRESS 0xFFFF53AD READ_WRITE /end MEASUREMENT
/begin MEASUREMENT vDTSPNG2 "RAM value vDTSPNG2" UBYTE COMP_0068 1 100 0 255 ECU_ADDRESS 0xFFFF53AE READ_WRITE /end MEASUREMENT
/begin MEASUREMENT vVSPRNG "RAM value vVSPRNG" UWORD COMP_0068 1 100 0 65535 ECU_ADDRESS 0xFFFF53B0 READ_WRITE /end MEASUREMENT
/begin MEASUREMENT vIREVNG1 "RAM value vIREVNG1" UBYTE COMP_0068 1 100 0 255 ECU_ADDRESS 0xFFFF53B3 READ_WRITE /end MEASUREMENT
/begin MEASUREMENT vIREVNG2 "RAM value vIREVNG2" UBYTE COMP_0068 1 100 0 255 ECU_ADDRESS 0xFFFF53B4 READ_WRITE /end MEASUREMENT
/begin MEASUREMENT vBSOFNG "RAM value vBSOFNG" UWORD COMP_0068 1 100 0 65535 ECU_ADDRESS 0xFFFF53B6 READ_WRITE /end MEASUREMENT
/begin MEASUREMENT vRTSPNG1 "RAM value vRTSPNG1" UBYTE COMP_0068 1 100 0 255 ECU_ADDRESS 0xFFFF53B9 READ_WRITE /end MEASUREMENT
/begin MEASUREMENT vRTSPNG2 "RAM value vRTSPNG2" UBYTE COMP_0068 1 100 0 255 ECU_ADDRESS 0xFFFF53BA READ_WRITE /end MEASUREMENT
/begin MEASUREMENT vDFLTNG "RAM value vDFLTNG" UWORD COMP_0068 1 100 0 65535 ECU_ADDRESS 0xFFFF53BC READ_WRITE /end MEASUREMENT
/begin MEASUREMENT vTHOPNG1 "RAM value vTHOPNG1" UBYTE COMP_0068 1 100 0 255 ECU_ADDRESS 0xFFFF53BF READ_WRITE /end MEASUREMENT
/begin MEASUREMENT vTHOPNG2 "RAM value vTHOPNG2" UBYTE COMP_0068 1 100 0 255 ECU_ADDRESS 0xFFFF53C0 READ_WRITE /end MEASUREMENT
/begin MEASUREMENT vBURNG "RAM value vBURNG" UWORD COMP_0068 1 100 0 65535 ECU_ADDRESS 0xFFFF53C2 READ_WRITE /end MEASUREMENT
/begin MEASUREMENT vSSOFNG1 "RAM value vSSOFNG1" UBYTE COMP_0068 1 100 0 255 ECU_ADDRESS 0xFFFF53C5 READ_WRITE /end MEASUREMENT
/begin MEASUREMENT vSSOFNG2 "RAM value vSSOFNG2" UBYTE COMP_0068 1 100 0 255 ECU_ADDRESS 0xFFFF53C6 READ_WRITE /end MEASUREMENT
/begin MEASUREMENT vTSKNGM "RAM value vTSKNGM" UWORD COMP_0068 1 100 0 65535 ECU_ADDRESS 0xFFFF53C8 READ_WRITE /end MEASUREMENT
/begin MEASUREMENT vROMNGM1 "RAM value vROMNGM1" UBYTE COMP_0068 1 100 0 255 ECU_ADDRESS 0xFFFF53CB READ_WRITE /end MEASUREMENT
/begin MEASUREMENT vROMNGM2 "RAM value vROMNGM2" UBYTE COMP_0068 1 100 0 255 ECU_ADDRESS 0xFFFF53CC READ_WRITE /end MEASUREMENT
/begin MEASUREMENT vRAMNGM "RAM value vRAMNGM" UWORD COMP_0068 1 100 0 65535 ECU_ADDRESS 0xFFFF53CE READ_WRITE /end MEASUREMENT
/begin MEASUREMENT vWDTNGM1 "RAM value vWDTNGM1" UBYTE COMP_0068 1 100 0 255 ECU_ADDRESS 0xFFFF53D1 READ_WRITE /end MEASUREMENT
/begin MEASUREMENT vWDTNGM2 "RAM value vWDTNGM2" UBYTE COMP_0068 1 100 0 255 ECU_ADDRESS 0xFFFF53D2 READ_WRITE /end MEASUREMENT
/begin MEASUREMENT vTIMNGM "RAM value vTIMNGM" UWORD COMP_0068 1 100 0 65535 ECU_ADDRESS 0xFFFF53D4 READ_WRITE /end MEASUREMENT
/begin MEASUREMENT vEPWNGM1 "RAM value vEPWNGM1" UBYTE COMP_0068 1 100 0 255 ECU_ADDRESS 0xFFFF53D7 READ_WRITE /end MEASUREMENT
/begin MEASUREMENT vEPWNGM2 "RAM value vEPWNGM2" UBYTE COMP_0068 1 100 0 255 ECU_ADDRESS 0xFFFF53D8 READ_WRITE /end MEASUREMENT
/begin MEASUREMENT vEPRNGM "RAM value vEPRNGM" UWORD COMP_0068 1 100 0 65535 ECU_ADDRESS 0xFFFF53DA READ_WRITE /end MEASUREMENT
/begin MEASUREMENT vRANGM21 "RAM value vRANGM21" UBYTE COMP_0068 1 100 0 255 ECU_ADDRESS 0xFFFF53DD READ_WRITE /end MEASUREMENT
/begin MEASUREMENT vRANGM22 "RAM value vRANGM22" UBYTE COMP_0068 1 100 0 255 ECU_ADDRESS 0xFFFF53DE READ_WRITE /end MEASUREMENT
/begin MEASUREMENT vASJBNG "RAM value vASJBNG" UWORD COMP_0068 1 100 0 65535 ECU_ADDRESS 0xFFFF53E0 READ_WRITE /end MEASUREMENT
/begin MEASUREMENT vASFXNG1 "RAM value vASFXNG1" UBYTE COMP_0068 1 100 0 255 ECU_ADDRESS 0xFFFF53E3 READ_WRITE /end MEASUREMENT
/begin MEASUREMENT vASFXNG2 "RAM value vASFXNG2" UBYTE COMP_0068 1 100 0 255 ECU_ADDRESS 0xFFFF53E4 READ_WRITE /end MEASUREMENT
/begin MEASUREMENT vASSWNG "RAM value vASSWNG" UWORD COMP_0068 1 100 0 65535 ECU_ADDRESS 0xFFFF53E6 READ_WRITE /end MEASUREMENT
/begin MEASUREMENT vASBSNG1 "RAM value vASBSNG1" UBYTE COMP_0068 1 100 0 255 ECU_ADDRESS 0xFFFF53E9 READ_WRITE /end MEASUREMENT
/begin MEASUREMENT vASBSNG2 "RAM value vASBSNG2" UBYTE COMP_0068 1 100 0 255 ECU_ADDRESS 0xFFFF53EA READ_WRITE /end MEASUREMENT
/begin MEASUREMENT vASVSNG "RAM value vASVSNG" UWORD COMP_0068 1 100 0 65535 ECU_ADDRESS 0xFFFF53EC READ_WRITE /end MEASUREMENT
/begin MEASUREMENT vBNCPNG1 "RAM value vBNCPNG1" UBYTE COMP_0068 1 100 0 255 ECU_ADDRESS 0xFFFF53EF READ_WRITE /end MEASUREMENT
/begin MEASUREMENT vBNCPNG2 "RAM value vBNCPNG2" UBYTE COMP_0068 1 100 0 255 ECU_ADDRESS 0xFFFF53F0 READ_WRITE /end MEASUREMENT
/begin MEASUREMENT vVTSBE1 "RAM value vVTSBE1" UWORD COMP_0068 1 100 0 65535 ECU_ADDRESS 0xFFFF53F2 READ_WRITE /end MEASUREMENT
/begin MEASUREMENT vVTSNE11 "RAM value vVTSNE11" UBYTE COMP_0068 1 100 0 255 ECU_ADDRESS 0xFFFF53F5 READ_WRITE /end MEASUREMENT
/begin MEASUREMENT vVTSNE12 "RAM value vVTSNE12" UBYTE COMP_0068 1 100 0 255 ECU_ADDRESS 0xFFFF53F6 READ_WRITE /end MEASUREMENT
/begin MEASUREMENT vAFLNG1 "RAM value vAFLNG1" UWORD COMP_0068 1 100 0 65535 ECU_ADDRESS 0xFFFF53F8 READ_WRITE /end MEASUREMENT
/begin MEASUREMENT vAFLNG21 "RAM value vAFLNG21" UBYTE COMP_0068 1 100 0 255 ECU_ADDRESS 0xFFFF53FB READ_WRITE /end MEASUREMENT
/begin MEASUREMENT vAFLNG22 "RAM value vAFLNG22" UBYTE COMP_0068 1 100 0 255 ECU_ADDRESS 0xFFFF53FC READ_WRITE /end MEASUREMENT
/begin MEASUREMENT vAFLLS "RAM value vAFLLS" UWORD COMP_0068 1 100 0 65535 ECU_ADDRESS 0xFFFF53FE READ_WRITE /end MEASUREMENT
/begin MEASUREMENT vAFLRS1 "RAM value vAFLRS1" UBYTE COMP_0068 1 100 0 255 ECU_ADDRESS 0xFFFF5401 READ_WRITE /end MEASUREMENT
/begin MEASUREMENT vAFLRS2 "RAM value vAFLRS2" UBYTE COMP_0068 1 100 0 255 ECU_ADDRESS 0xFFFF5402 READ_WRITE /end MEASUREMENT
/begin MEASUREMENT vAFLAV "RAM value vAFLAV" UWORD COMP_0068 1 100 0 65535 ECU_ADDRESS 0xFFFF5404 READ_WRITE /end MEASUREMENT
/begin MEASUREMENT vTCNTNG1 "RAM value vTCNTNG1" UBYTE COMP_0068 1 100 0 255 ECU_ADDRESS 0xFFFF5407 READ_WRITE /end MEASUREMENT
/begin MEASUREMENT vTCNTNG2 "RAM value vTCNTNG2" UBYTE COMP_0068 1 100 0 255 ECU_ADDRESS 0xFFFF5408 READ_WRITE /end MEASUREMENT
/begin MEASUREMENT vISCNGL "RAM value vISCNGL" UWORD COMP_0068 1 100 0 65535 ECU_ADDRESS 0xFFFF540A READ_WRITE /end MEASUREMENT
/begin MEASUREMENT vISCNGH1 "RAM value vISCNGH1" UBYTE COMP_0068 1 100 0 255 ECU_ADDRESS 0xFFFF540D READ_WRITE /end MEASUREMENT
/begin MEASUREMENT vISCNGH2 "RAM value vISCNGH2" UBYTE COMP_0068 1 100 0 255 ECU_ADDRESS 0xFFFF540E READ_WRITE /end MEASUREMENT
/begin MEASUREMENT vO2R1O "RAM value vO2R1O" UWORD COMP_0068 1 100 0 65535 ECU_ADDRESS 0xFFFF5410 READ_WRITE /end MEASUREMENT
/begin MEASUREMENT vO2R1L1 "RAM value vO2R1L1" UBYTE COMP_0068 1 100 0 255 ECU_ADDRESS 0xFFFF5413 READ_WRITE /end MEASUREMENT
/begin MEASUREMENT vO2R1L2 "RAM value vO2R1L2" UBYTE COMP_0068 1 100 0 255 ECU_ADDRESS 0xFFFF5414 READ_WRITE /end MEASUREMENT
/begin MEASUREMENT vO2R1R "RAM value vO2R1R" UWORD COMP_0068 1 100 0 65535 ECU_ADDRESS 0xFFFF5416 READ_WRITE /end MEASUREMENT
/begin MEASUREMENT vO2R1H1 "RAM value vO2R1H1" UBYTE COMP_0068 1 100 0 255 ECU_ADDRESS 0xFFFF5419 READ_WRITE /end MEASUREMENT
/begin MEASUREMENT vO2R1H2 "RAM value vO2R1H2" UBYTE COMP_0068 1 100 0 255 ECU_ADDRESS 0xFFFF541A READ_WRITE /end MEASUREMENT
/begin MEASUREMENT vRO2HH1 "RAM value vRO2HH1" UWORD COMP_0068 1 100 0 65535 ECU_ADDRESS 0xFFFF541C READ_WRITE /end MEASUREMENT
/begin MEASUREMENT vRO2HL11 "RAM value vRO2HL11" UBYTE COMP_0068 1 100 0 255 ECU_ADDRESS 0xFFFF541F READ_WRITE /end MEASUREMENT
/begin MEASUREMENT vRO2HL12 "RAM value vRO2HL12" UBYTE COMP_0068 1 100 0 255 ECU_ADDRESS 0xFFFF5420 READ_WRITE /end MEASUREMENT
/begin MEASUREMENT vKN1NGL "RAM value vKN1NGL" UWORD COMP_0068 1 100 0 65535 ECU_ADDRESS 0xFFFF5422 READ_WRITE /end MEASUREMENT
/begin MEASUREMENT vKN1NGH1 "RAM value vKN1NGH1" UBYTE COMP_0068 1 100 0 255 ECU_ADDRESS 0xFFFF5425 READ_WRITE /end MEASUREMENT
/begin MEASUREMENT vKN1NGH2 "RAM value vKN1NGH2" UBYTE COMP_0068 1 100 0 255 ECU_ADDRESS 0xFFFF5426 READ_WRITE /end MEASUREMENT
/begin MEASUREMENT vAFMNGL "RAM value vAFMNGL" UWORD COMP_0068 1 100 0 65535 ECU_ADDRESS 0xFFFF5428 READ_WRITE /end MEASUREMENT
/begin MEASUREMENT vAFMNGH1 "RAM value vAFMNGH1" UBYTE COMP_0068 1 100 0 255 ECU_ADDRESS 0xFFFF542B READ_WRITE /end MEASUREMENT
/begin MEASUREMENT vAFMNGH2 "RAM value vAFMNGH2" UBYTE COMP_0068 1 100 0 255 ECU_ADDRESS 0xFFFF542C READ_WRITE /end MEASUREMENT
/begin MEASUREMENT vTWNGL "RAM value vTWNGL" UWORD COMP_0068 1 100 0 65535 ECU_ADDRESS 0xFFFF542E READ_WRITE /end MEASUREMENT
/begin MEASUREMENT vTWNGH1 "RAM value vTWNGH1" UBYTE COMP_0068 1 100 0 255 ECU_ADDRESS 0xFFFF5431 READ_WRITE /end MEASUREMENT
/begin MEASUREMENT vTWNGH2 "RAM value vTWNGH2" UBYTE COMP_0068 1 100 0 255 ECU_ADDRESS 0xFFFF5432 READ_WRITE /end MEASUREMENT
/begin MEASUREMENT vTANGL "RAM value vTANGL" UWORD COMP_0068 1 100 0 65535 ECU_ADDRESS 0xFFFF5434 READ_WRITE /end MEASUREMENT
/begin MEASUREMENT vTANGH1 "RAM value vTANGH1" UBYTE COMP_0068 1 100 0 255 ECU_ADDRESS 0xFFFF5437 READ_WRITE /end MEASUREMENT
/begin MEASUREMENT vTANGH2 "RAM value vTANGH2" UBYTE COMP_0068 1 100 0 255 ECU_ADDRESS 0xFFFF5438 READ_WRITE /end MEASUREMENT
/begin MEASUREMENT vTANGR "RAM value vTANGR" UWORD COMP_0068 1 100 0 65535 ECU_ADDRESS 0xFFFF543A READ_WRITE /end MEASUREMENT
/begin MEASUREMENT vEVSNGR1 "RAM value vEVSNGR1" UBYTE COMP_0068 1 100 0 255 ECU_ADDRESS 0xFFFF543D READ_WRITE /end MEASUREMENT
/begin MEASUREMENT vEVSNGR2 "RAM value vEVSNGR2" UBYTE COMP_0068 1 100 0 255 ECU_ADDRESS 0xFFFF543E READ_WRITE /end MEASUREMENT
/begin MEASUREMENT vTFNGR "RAM value vTFNGR" UWORD COMP_0068 1 100 0 65535 ECU_ADDRESS 0xFFFF5440 READ_WRITE /end MEASUREMENT
/begin MEASUREMENT vTFNGL1 "RAM value vTFNGL1" UBYTE COMP_0068 1 100 0 255 ECU_ADDRESS 0xFFFF5443 READ_WRITE /end MEASUREMENT
/begin MEASUREMENT vTFNGL2 "RAM value vTFNGL2" UBYTE COMP_0068 1 100 0 255 ECU_ADDRESS 0xFFFF5444 READ_WRITE /end MEASUREMENT
/begin MEASUREMENT vTFNGH "RAM value vTFNGH" UWORD COMP_0068 1 100 0 65535 ECU_ADDRESS 0xFFFF5446 READ_WRITE /end MEASUREMENT
/begin MEASUREMENT vFGPNGL1 "RAM value vFGPNGL1" UBYTE COMP_0068 1 100 0 255 ECU_ADDRESS 0xFFFF5449 READ_WRITE /end MEASUREMENT
/begin MEASUREMENT vFGPNGL2 "RAM value vFGPNGL2" UBYTE COMP_0068 1 100 0 255 ECU_ADDRESS 0xFFFF544A READ_WRITE /end MEASUREMENT
/begin MEASUREMENT vFGPNGH "RAM value vFGPNGH" UWORD COMP_0068 1 100 0 65535 ECU_ADDRESS 0xFFFF544C READ_WRITE /end MEASUREMENT
/begin MEASUREMENT vEVCNGO1 "RAM value vEVCNGO1" UBYTE COMP_0068 1 100 0 255 ECU_ADDRESS 0xFFFF544F READ_WRITE /end MEASUREMENT
/begin MEASUREMENT vEVCNGO2 "RAM value vEVCNGO2" UBYTE COMP_0068 1 100 0 255 ECU_ADDRESS 0xFFFF5450 READ_WRITE /end MEASUREMENT
/begin MEASUREMENT vEVCNGS "RAM value vEVCNGS" UWORD COMP_0068 1 100 0 65535 ECU_ADDRESS 0xFFFF5452 READ_WRITE /end MEASUREMENT
/begin MEASUREMENT vMRNR1 "RAM value vMRNR1" UBYTE COMP_0068 1 100 0 255 ECU_ADDRESS 0xFFFF5455 READ_WRITE /end MEASUREMENT
/begin MEASUREMENT vMRNR2 "RAM value vMRNR2" UBYTE COMP_0068 1 100 0 255 ECU_ADDRESS 0xFFFF5456 READ_WRITE /end MEASUREMENT
/begin MEASUREMENT vMRNL "RAM value vMRNL" UWORD COMP_0068 1 100 0 65535 ECU_ADDRESS 0xFFFF5458 READ_WRITE /end MEASUREMENT
/begin MEASUREMENT vVTCI1R1 "RAM value vVTCI1R1" UBYTE COMP_0068 1 100 0 255 ECU_ADDRESS 0xFFFF545B READ_WRITE /end MEASUREMENT
/begin MEASUREMENT vVTCI1R2 "RAM value vVTCI1R2" UBYTE COMP_0068 1 100 0 255 ECU_ADDRESS 0xFFFF545C READ_WRITE /end MEASUREMENT
/begin MEASUREMENT vVTCE1R "RAM value vVTCE1R" UWORD COMP_0068 1 100 0 65535 ECU_ADDRESS 0xFFFF545E READ_WRITE /end MEASUREMENT
/begin MEASUREMENT vPRSNGR1 "RAM value vPRSNGR1" UBYTE COMP_0068 1 100 0 255 ECU_ADDRESS 0xFFFF5461 READ_WRITE /end MEASUREMENT
/begin MEASUREMENT vPRSNGR2 "RAM value vPRSNGR2" UBYTE COMP_0068 1 100 0 255 ECU_ADDRESS 0xFFFF5462 READ_WRITE /end MEASUREMENT
/begin MEASUREMENT vPRSNGL "RAM value vPRSNGL" UWORD COMP_0068 1 100 0 65535 ECU_ADDRESS 0xFFFF5464 READ_WRITE /end MEASUREMENT
/begin MEASUREMENT vPRSNGH1 "RAM value vPRSNGH1" UBYTE COMP_0068 1 100 0 255 ECU_ADDRESS 0xFFFF5467 READ_WRITE /end MEASUREMENT
/begin MEASUREMENT vPRSNGH2 "RAM value vPRSNGH2" UBYTE COMP_0068 1 100 0 255 ECU_ADDRESS 0xFFFF5468 READ_WRITE /end MEASUREMENT
/begin MEASUREMENT vEPSNGL "RAM value vEPSNGL" UWORD COMP_0068 1 100 0 65535 ECU_ADDRESS 0xFFFF546A READ_WRITE /end MEASUREMENT
/begin MEASUREMENT vEPSNGH1 "RAM value vEPSNGH1" UBYTE COMP_0068 1 100 0 255 ECU_ADDRESS 0xFFFF546D READ_WRITE /end MEASUREMENT
/begin MEASUREMENT vEPSNGH2 "RAM value vEPSNGH2" UBYTE COMP_0068 1 100 0 255 ECU_ADDRESS 0xFFFF546E READ_WRITE /end MEASUREMENT
/begin MEASUREMENT vEVPFLW "RAM value vEVPFLW" UWORD COMP_0068 1 100 0 65535 ECU_ADDRESS 0xFFFF5470 READ_WRITE /end MEASUREMENT
/begin MEASUREMENT vCDCNGC1 "RAM value vCDCNGC1" UBYTE COMP_0068 1 100 0 255 ECU_ADDRESS 0xFFFF5473 READ_WRITE /end MEASUREMENT
/begin MEASUREMENT vCDCNGC2 "RAM value vCDCNGC2" UBYTE COMP_0068 1 100 0 255 ECU_ADDRESS 0xFFFF5474 READ_WRITE /end MEASUREMENT
/begin MEASUREMENT vEVPVSL "RAM value vEVPVSL" UWORD COMP_0068 1 100 0 65535 ECU_ADDRESS 0xFFFF5476 READ_WRITE /end MEASUREMENT
/begin MEASUREMENT vEVVSLP1 "RAM value vEVVSLP1" UBYTE COMP_0068 1 100 0 255 ECU_ADDRESS 0xFFFF5479 READ_WRITE /end MEASUREMENT
/begin MEASUREMENT vEVVSLP2 "RAM value vEVVSLP2" UBYTE COMP_0068 1 100 0 255 ECU_ADDRESS 0xFFFF547A READ_WRITE /end MEASUREMENT
/begin MEASUREMENT vEVPSL "RAM value vEVPSL" UWORD COMP_0068 1 100 0 65535 ECU_ADDRESS 0xFFFF547C READ_WRITE /end MEASUREMENT
/begin MEASUREMENT vEVPSLP1 "RAM value vEVPSLP1" UBYTE COMP_0068 1 100 0 255 ECU_ADDRESS 0xFFFF547F READ_WRITE /end MEASUREMENT
/begin MEASUREMENT vEVPSLP2 "RAM value vEVPSLP2" UBYTE COMP_0068 1 100 0 255 ECU_ADDRESS 0xFFFF5480 READ_WRITE /end MEASUREMENT
/begin MEASUREMENT vTONGL "RAM value vTONGL" UWORD COMP_0068 1 100 0 65535 ECU_ADDRESS 0xFFFF5482 READ_WRITE /end MEASUREMENT
/begin MEASUREMENT vTONGH1 "RAM value vTONGH1" UBYTE COMP_0068 1 100 0 255 ECU_ADDRESS 0xFFFF5485 READ_WRITE /end MEASUREMENT
/begin MEASUREMENT vTONGH2 "RAM value vTONGH2" UBYTE COMP_0068 1 100 0 255 ECU_ADDRESS 0xFFFF5486 READ_WRITE /end MEASUREMENT
/begin MEASUREMENT vAP1NGH "RAM value vAP1NGH" UWORD COMP_0068 1 100 0 65535 ECU_ADDRESS 0xFFFF5488 READ_WRITE /end MEASUREMENT
/begin MEASUREMENT vAP1NGL1 "RAM value vAP1NGL1" UBYTE COMP_0068 1 100 0 255 ECU_ADDRESS 0xFFFF548B READ_WRITE /end MEASUREMENT
/begin MEASUREMENT vAP1NGL2 "RAM value vAP1NGL2" UBYTE COMP_0068 1 100 0 255 ECU_ADDRESS 0xFFFF548C READ_WRITE /end MEASUREMENT
/begin MEASUREMENT vAP2NGH "RAM value vAP2NGH" UWORD COMP_0068 1 100 0 65535 ECU_ADDRESS 0xFFFF548E READ_WRITE /end MEASUREMENT
/begin MEASUREMENT vAP2NGL1 "RAM value vAP2NGL1" UBYTE COMP_0068 1 100 0 255 ECU_ADDRESS 0xFFFF5491 READ_WRITE /end MEASUREMENT
/begin MEASUREMENT vAP2NGL2 "RAM value vAP2NGL2" UBYTE COMP_0068 1 100 0 255 ECU_ADDRESS 0xFFFF5492 READ_WRITE /end MEASUREMENT
/begin MEASUREMENT vAP12NG "RAM value vAP12NG" UWORD COMP_0068 1 100 0 65535 ECU_ADDRESS 0xFFFF5494 READ_WRITE /end MEASUREMENT
/begin MEASUREMENT vTORPNG1 "RAM value vTORPNG1" UBYTE COMP_0068 1 100 0 255 ECU_ADDRESS 0xFFFF5497 READ_WRITE /end MEASUREMENT
/begin MEASUREMENT vTORPNG2 "RAM value vTORPNG2" UBYTE COMP_0068 1 100 0 255 ECU_ADDRESS 0xFFFF5498 READ_WRITE /end MEASUREMENT
/begin MEASUREMENT vEONVNG "RAM value vEONVNG" UWORD COMP_0068 1 100 0 65535 ECU_ADDRESS 0xFFFF549A READ_WRITE /end MEASUREMENT
/begin MEASUREMENT vAVCCSH1 "RAM value vAVCCSH1" UBYTE COMP_0068 1 100 0 255 ECU_ADDRESS 0xFFFF549D READ_WRITE /end MEASUREMENT
/begin MEASUREMENT vAVCCSH2 "RAM value vAVCCSH2" UBYTE COMP_0068 1 100 0 255 ECU_ADDRESS 0xFFFF549E READ_WRITE /end MEASUREMENT
/begin MEASUREMENT vTP1NGH "RAM value vTP1NGH" UWORD COMP_0068 1 100 0 65535 ECU_ADDRESS 0xFFFF54A0 READ_WRITE /end MEASUREMENT
/begin MEASUREMENT vTP1NGL1 "RAM value vTP1NGL1" UBYTE COMP_0068 1 100 0 255 ECU_ADDRESS 0xFFFF54A3 READ_WRITE /end MEASUREMENT
/begin MEASUREMENT vTP1NGL2 "RAM value vTP1NGL2" UBYTE COMP_0068 1 100 0 255 ECU_ADDRESS 0xFFFF54A4 READ_WRITE /end MEASUREMENT
/begin MEASUREMENT vTP2NGH "RAM value vTP2NGH" UWORD COMP_0068 1 100 0 65535 ECU_ADDRESS 0xFFFF54A6 READ_WRITE /end MEASUREMENT
/begin MEASUREMENT vTP2NGL1 "RAM value vTP2NGL1" UBYTE COMP_0068 1 100 0 255 ECU_ADDRESS 0xFFFF54A9 READ_WRITE /end MEASUREMENT
/begin MEASUREMENT vTP2NGL2 "RAM value vTP2NGL2" UBYTE COMP_0068 1 100 0 255 ECU_ADDRESS 0xFFFF54AA READ_WRITE /end MEASUREMENT
/begin MEASUREMENT vTP12NG "RAM value vTP12NG" UWORD COMP_0068 1 100 0 65535 ECU_ADDRESS 0xFFFF54AC READ_WRITE /end MEASUREMENT
/begin MEASUREMENT vTPLRLO1 "RAM value vTPLRLO1" UBYTE COMP_0068 1 100 0 255 ECU_ADDRESS 0xFFFF54AF READ_WRITE /end MEASUREMENT
/begin MEASUREMENT vTPLRLO2 "RAM value vTPLRLO2" UBYTE COMP_0068 1 100 0 255 ECU_ADDRESS 0xFFFF54B0 READ_WRITE /end MEASUREMENT
/begin MEASUREMENT vTPLRNO "RAM value vTPLRNO" UWORD COMP_0068 1 100 0 65535 ECU_ADDRESS 0xFFFF54B2 READ_WRITE /end MEASUREMENT
/begin MEASUREMENT vVMOOPN1 "RAM value vVMOOPN1" UBYTE COMP_0068 1 100 0 255 ECU_ADDRESS 0xFFFF54B5 READ_WRITE /end MEASUREMENT
/begin MEASUREMENT vVMOOPN2 "RAM value vVMOOPN2" UBYTE COMP_0068 1 100 0 255 ECU_ADDRESS 0xFFFF54B6 READ_WRITE /end MEASUREMENT
/begin MEASUREMENT vVMOSHT "RAM value vVMOSHT" UWORD COMP_0068 1 100 0 65535 ECU_ADDRESS 0xFFFF54B8 READ_WRITE /end MEASUREMENT
/begin MEASUREMENT vMOTOPN1 "RAM value vMOTOPN1" UBYTE COMP_0068 1 100 0 255 ECU_ADDRESS 0xFFFF54BB READ_WRITE /end MEASUREMENT
/begin MEASUREMENT vMOTOPN2 "RAM value vMOTOPN2" UBYTE COMP_0068 1 100 0 255 ECU_ADDRESS 0xFFFF54BC READ_WRITE /end MEASUREMENT
/begin MEASUREMENT vMOTSHT "RAM value vMOTSHT" UWORD COMP_0068 1 100 0 65535 ECU_ADDRESS 0xFFFF54BE READ_WRITE /end MEASUREMENT
/begin MEASUREMENT vGMOOPN1 "RAM value vGMOOPN1" UBYTE COMP_0068 1 100 0 255 ECU_ADDRESS 0xFFFF54C1 READ_WRITE /end MEASUREMENT
/begin MEASUREMENT vGMOOPN2 "RAM value vGMOOPN2" UBYTE COMP_0068 1 100 0 255 ECU_ADDRESS 0xFFFF54C2 READ_WRITE /end MEASUREMENT
/begin MEASUREMENT vAFLHZR "RAM value vAFLHZR" UWORD COMP_0068 1 100 0 65535 ECU_ADDRESS 0xFFFF54C4 READ_WRITE /end MEASUREMENT
/begin MEASUREMENT vAFLHZL1 "RAM value vAFLHZL1" UBYTE COMP_0068 1 100 0 255 ECU_ADDRESS 0xFFFF54C7 READ_WRITE /end MEASUREMENT
/begin MEASUREMENT vAFLHZL2 "RAM value vAFLHZL2" UBYTE COMP_0068 1 100 0 255 ECU_ADDRESS 0xFFFF54C8 READ_WRITE /end MEASUREMENT
/begin MEASUREMENT vAFHF1L "RAM value vAFHF1L" UWORD COMP_0068 1 100 0 65535 ECU_ADDRESS 0xFFFF54CA READ_WRITE /end MEASUREMENT
/begin MEASUREMENT vAFHF1H1 "RAM value vAFHF1H1" UBYTE COMP_0068 1 100 0 255 ECU_ADDRESS 0xFFFF54CD READ_WRITE /end MEASUREMENT
/begin MEASUREMENT vAFHF1H2 "RAM value vAFHF1H2" UBYTE COMP_0068 1 100 0 255 ECU_ADDRESS 0xFFFF54CE READ_WRITE /end MEASUREMENT
/begin MEASUREMENT vAFRLD1 "RAM value vAFRLD1" UWORD COMP_0068 1 100 0 65535 ECU_ADDRESS 0xFFFF54D0 READ_WRITE /end MEASUREMENT
/begin MEASUREMENT vAFLRD11 "RAM value vAFLRD11" UBYTE COMP_0068 1 100 0 255 ECU_ADDRESS 0xFFFF54D3 READ_WRITE /end MEASUREMENT
/begin MEASUREMENT vAFLRD12 "RAM value vAFLRD12" UBYTE COMP_0068 1 100 0 255 ECU_ADDRESS 0xFFFF54D4 READ_WRITE /end MEASUREMENT
/begin MEASUREMENT vSECPNG "RAM value vSECPNG" UWORD COMP_0068 1 100 0 65535 ECU_ADDRESS 0xFFFF54D6 READ_WRITE /end MEASUREMENT
/begin MEASUREMENT vPRIPNG1 "RAM value vPRIPNG1" UBYTE COMP_0068 1 100 0 255 ECU_ADDRESS 0xFFFF54D9 READ_WRITE /end MEASUREMENT
/begin MEASUREMENT vPRIPNG2 "RAM value vPRIPNG2" UBYTE COMP_0068 1 100 0 255 ECU_ADDRESS 0xFFFF54DA READ_WRITE /end MEASUREMENT
/begin MEASUREMENT vPSRANG "RAM value vPSRANG" UWORD COMP_0068 1 100 0 65535 ECU_ADDRESS 0xFFFF54DC READ_WRITE /end MEASUREMENT
/begin MEASUREMENT vBTSNGH1 "RAM value vBTSNGH1" UBYTE COMP_0068 1 100 0 255 ECU_ADDRESS 0xFFFF54DF READ_WRITE /end MEASUREMENT
/begin MEASUREMENT vBTSNGH2 "RAM value vBTSNGH2" UBYTE COMP_0068 1 100 0 255 ECU_ADDRESS 0xFFFF54E0 READ_WRITE /end MEASUREMENT
/begin MEASUREMENT vBTSNGL "RAM value vBTSNGL" UWORD COMP_0068 1 100 0 65535 ECU_ADDRESS 0xFFFF54E2 READ_WRITE /end MEASUREMENT
/begin MEASUREMENT vBCSNG21 "RAM value vBCSNG21" UBYTE COMP_0068 1 100 0 255 ECU_ADDRESS 0xFFFF54E5 READ_WRITE /end MEASUREMENT
/begin MEASUREMENT vBCSNG22 "RAM value vBCSNG22" UBYTE COMP_0068 1 100 0 255 ECU_ADDRESS 0xFFFF54E6 READ_WRITE /end MEASUREMENT
/begin MEASUREMENT vBCSNG1 "RAM value vBCSNG1" UWORD COMP_0068 1 100 0 65535 ECU_ADDRESS 0xFFFF54E8 READ_WRITE /end MEASUREMENT
/begin MEASUREMENT vBCSNGH1 "RAM value vBCSNGH1" UBYTE COMP_0068 1 100 0 255 ECU_ADDRESS 0xFFFF54EB READ_WRITE /end MEASUREMENT
/begin MEASUREMENT vBCSNGH2 "RAM value vBCSNGH2" UBYTE COMP_0068 1 100 0 255 ECU_ADDRESS 0xFFFF54EC READ_WRITE /end MEASUREMENT
/begin MEASUREMENT vBCSNGL "RAM value vBCSNGL" UWORD COMP_0068 1 100 0 65535 ECU_ADDRESS 0xFFFF54EE READ_WRITE /end MEASUREMENT
/begin MEASUREMENT vBCSNGC1 "RAM value vBCSNGC1" UBYTE COMP_0068 1 100 0 255 ECU_ADDRESS 0xFFFF54F1 READ_WRITE /end MEASUREMENT
/begin MEASUREMENT vBCSNGC2 "RAM value vBCSNGC2" UBYTE COMP_0068 1 100 0 255 ECU_ADDRESS 0xFFFF54F2 READ_WRITE /end MEASUREMENT
/begin MEASUREMENT vEVSNGE "RAM value vEVSNGE" UWORD COMP_0068 1 100 0 65535 ECU_ADDRESS 0xFFFF54F4 READ_WRITE /end MEASUREMENT
/begin MEASUREMENT vCANFNG1 "RAM value vCANFNG1" UBYTE COMP_0068 1 100 0 255 ECU_ADDRESS 0xFFFF54F7 READ_WRITE /end MEASUREMENT
/begin MEASUREMENT vCANFNG2 "RAM value vCANFNG2" UBYTE COMP_0068 1 100 0 255 ECU_ADDRESS 0xFFFF54F8 READ_WRITE /end MEASUREMENT
/begin MEASUREMENT vAFSNG1 "RAM value vAFSNG1" UWORD COMP_0068 1 100 0 65535 ECU_ADDRESS 0xFFFF54FA READ_WRITE /end MEASUREMENT
/begin MEASUREMENT vSTSYS1 "RAM value vSTSYS1" UBYTE COMP_0068 1 100 0 255 ECU_ADDRESS 0xFFFF54FD READ_WRITE /end MEASUREMENT
/begin MEASUREMENT vSTSYS2 "RAM value vSTSYS2" UBYTE COMP_0068 1 100 0 255 ECU_ADDRESS 0xFFFF54FE READ_WRITE /end MEASUREMENT
/begin MEASUREMENT vCUTLN "RAM value vCUTLN" UWORD COMP_0068 1 100 0 65535 ECU_ADDRESS 0xFFFF5500 READ_WRITE /end MEASUREMENT
/begin MEASUREMENT vSTRLON1 "RAM value vSTRLON1" UBYTE COMP_0068 1 100 0 255 ECU_ADDRESS 0xFFFF5503 READ_WRITE /end MEASUREMENT
/begin MEASUREMENT vSTRLON2 "RAM value vSTRLON2" UBYTE COMP_0068 1 100 0 255 ECU_ADDRESS 0xFFFF5504 READ_WRITE /end MEASUREMENT
/begin MEASUREMENT vSTRLOF "RAM value vSTRLOF" UWORD COMP_0068 1 100 0 65535 ECU_ADDRESS 0xFFFF5506 READ_WRITE /end MEASUREMENT
/begin MEASUREMENT vINHBON1 "RAM value vINHBON1" UBYTE COMP_0068 1 100 0 255 ECU_ADDRESS 0xFFFF5509 READ_WRITE /end MEASUREMENT
/begin MEASUREMENT vINHBON2 "RAM value vINHBON2" UBYTE COMP_0068 1 100 0 255 ECU_ADDRESS 0xFFFF550A READ_WRITE /end MEASUREMENT
/begin MEASUREMENT vSTROPN "RAM value vSTROPN" UWORD COMP_0068 1 100 0 65535 ECU_ADDRESS 0xFFFF550C READ_WRITE /end MEASUREMENT
/begin MEASUREMENT vVPBNGL1 "RAM value vVPBNGL1" UBYTE COMP_0068 1 100 0 255 ECU_ADDRESS 0xFFFF550F READ_WRITE /end MEASUREMENT
/begin MEASUREMENT vVPBNGL2 "RAM value vVPBNGL2" UBYTE COMP_0068 1 100 0 255 ECU_ADDRESS 0xFFFF5510 READ_WRITE /end MEASUREMENT
/begin MEASUREMENT vVPBNGH "RAM value vVPBNGH" UWORD COMP_0068 1 100 0 65535 ECU_ADDRESS 0xFFFF5512 READ_WRITE /end MEASUREMENT
/begin MEASUREMENT vOVBST11 "RAM value vOVBST11" UBYTE COMP_0068 1 100 0 255 ECU_ADDRESS 0xFFFF5515 READ_WRITE /end MEASUREMENT
/begin MEASUREMENT vOVBST12 "RAM value vOVBST12" UBYTE COMP_0068 1 100 0 255 ECU_ADDRESS 0xFFFF5516 READ_WRITE /end MEASUREMENT
/begin MEASUREMENT vTUBNG "RAM value vTUBNG" UWORD COMP_0068 1 100 0 65535 ECU_ADDRESS 0xFFFF5518 READ_WRITE /end MEASUREMENT
/begin MEASUREMENT vBCONG11 "RAM value vBCONG11" UBYTE COMP_0068 1 100 0 255 ECU_ADDRESS 0xFFFF551B READ_WRITE /end MEASUREMENT
/begin MEASUREMENT vBCONG12 "RAM value vBCONG12" UBYTE COMP_0068 1 100 0 255 ECU_ADDRESS 0xFFFF551C READ_WRITE /end MEASUREMENT
/begin MEASUREMENT vBCGNG1 "RAM value vBCGNG1" UWORD COMP_0068 1 100 0 65535 ECU_ADDRESS 0xFFFF551E READ_WRITE /end MEASUREMENT
/begin MEASUREMENT vTBSNG11 "RAM value vTBSNG11" UBYTE COMP_0068 1 100 0 255 ECU_ADDRESS 0xFFFF5521 READ_WRITE /end MEASUREMENT
/begin MEASUREMENT vTBSNG12 "RAM value vTBSNG12" UBYTE COMP_0068 1 100 0 255 ECU_ADDRESS 0xFFFF5522 READ_WRITE /end MEASUREMENT
/begin MEASUREMENT vTATHL "RAM value vTATHL" UWORD COMP_0068 1 100 0 65535 ECU_ADDRESS 0xFFFF5524 READ_WRITE /end MEASUREMENT
/begin MEASUREMENT vTATHH1 "RAM value vTATHH1" UBYTE COMP_0068 1 100 0 255 ECU_ADDRESS 0xFFFF5527 READ_WRITE /end MEASUREMENT
/begin MEASUREMENT vTATHH2 "RAM value vTATHH2" UBYTE COMP_0068 1 100 0 255 ECU_ADDRESS 0xFFFF5528 READ_WRITE /end MEASUREMENT
/begin MEASUREMENT vTWSTNG "RAM value vTWSTNG" UWORD COMP_0068 1 100 0 65535 ECU_ADDRESS 0xFFFF552A READ_WRITE /end MEASUREMENT
/begin MEASUREMENT vACRING1 "RAM value vACRING1" UBYTE COMP_0068 1 100 0 255 ECU_ADDRESS 0xFFFF552D READ_WRITE /end MEASUREMENT
/begin MEASUREMENT vACRING2 "RAM value vACRING2" UBYTE COMP_0068 1 100 0 255 ECU_ADDRESS 0xFFFF552E READ_WRITE /end MEASUREMENT
/begin MEASUREMENT vBCRING "RAM value vBCRING" UWORD COMP_0068 1 100 0 65535 ECU_ADDRESS 0xFFFF5530 READ_WRITE /end MEASUREMENT
/begin MEASUREMENT vATRING1 "RAM value vATRING1" UBYTE COMP_0068 1 100 0 255 ECU_ADDRESS 0xFFFF5533 READ_WRITE /end MEASUREMENT
/begin MEASUREMENT vATRING2 "RAM value vATRING2" UBYTE COMP_0068 1 100 0 255 ECU_ADDRESS 0xFFFF5534 READ_WRITE /end MEASUREMENT
/begin MEASUREMENT vRODRD1 "RAM value vRODRD1" UWORD COMP_0068 1 100 0 65535 ECU_ADDRESS 0xFFFF5536 READ_WRITE /end MEASUREMENT
/begin MEASUREMENT vFPHNG1 "RAM value vFPHNG1" UBYTE COMP_0068 1 100 0 255 ECU_ADDRESS 0xFFFF5539 READ_WRITE /end MEASUREMENT
/begin MEASUREMENT vFPHNG2 "RAM value vFPHNG2" UBYTE COMP_0068 1 100 0 255 ECU_ADDRESS 0xFFFF553A READ_WRITE /end MEASUREMENT
/begin MEASUREMENT vFPLNG "RAM value vFPLNG" UWORD COMP_0068 1 100 0 65535 ECU_ADDRESS 0xFFFF553C READ_WRITE /end MEASUREMENT
/begin MEASUREMENT vPSHNG1 "RAM value vPSHNG1" UBYTE COMP_0068 1 100 0 255 ECU_ADDRESS 0xFFFF553F READ_WRITE /end MEASUREMENT
/begin MEASUREMENT vPSHNG2 "RAM value vPSHNG2" UBYTE COMP_0068 1 100 0 255 ECU_ADDRESS 0xFFFF5540 READ_WRITE /end MEASUREMENT
/begin MEASUREMENT vPSLNG "RAM value vPSLNG" UWORD COMP_0068 1 100 0 65535 ECU_ADDRESS 0xFFFF5542 READ_WRITE /end MEASUREMENT
/begin MEASUREMENT vPSFNG1 "RAM value vPSFNG1" UBYTE COMP_0068 1 100 0 255 ECU_ADDRESS 0xFFFF5545 READ_WRITE /end MEASUREMENT
/begin MEASUREMENT vPSFNG2 "RAM value vPSFNG2" UBYTE COMP_0068 1 100 0 255 ECU_ADDRESS 0xFFFF5546 READ_WRITE /end MEASUREMENT
/begin MEASUREMENT vOPSNNG "RAM value vOPSNNG" UWORD COMP_0068 1 100 0 65535 ECU_ADDRESS 0xFFFF5548 READ_WRITE /end MEASUREMENT
/begin MEASUREMENT vFABRS1 "RAM value vFABRS1" UBYTE COMP_0068 1 100 0 255 ECU_ADDRESS 0xFFFF554B READ_WRITE /end MEASUREMENT
/begin MEASUREMENT vFABRS2 "RAM value vFABRS2" UBYTE COMP_0068 1 100 0 255 ECU_ADDRESS 0xFFFF554C READ_WRITE /end MEASUREMENT
/begin MEASUREMENT vCSSADV "RAM value vCSSADV" UWORD COMP_0068 1 100 0 65535 ECU_ADDRESS 0xFFFF554E READ_WRITE /end MEASUREMENT
/begin MEASUREMENT vCSSRPM1 "RAM value vCSSRPM1" UBYTE COMP_0068 1 100 0 255 ECU_ADDRESS 0xFFFF5551 READ_WRITE /end MEASUREMENT
/begin MEASUREMENT vCSSRPM2 "RAM value vCSSRPM2" UBYTE COMP_0068 1 100 0 255 ECU_ADDRESS 0xFFFF5552 READ_WRITE /end MEASUREMENT
/begin MEASUREMENT vCSSTNG "RAM value vCSSTNG" UWORD COMP_0068 1 100 0 65535 ECU_ADDRESS 0xFFFF5554 READ_WRITE /end MEASUREMENT
/begin MEASUREMENT vTANTRH1 "RAM value vTANTRH1" UBYTE COMP_0068 1 100 0 255 ECU_ADDRESS 0xFFFF5557 READ_WRITE /end MEASUREMENT
/begin MEASUREMENT vTANTRH2 "RAM value vTANTRH2" UBYTE COMP_0068 1 100 0 255 ECU_ADDRESS 0xFFFF5558 READ_WRITE /end MEASUREMENT
/begin MEASUREMENT vTANTRL "RAM value vTANTRL" UWORD COMP_0068 1 100 0 65535 ECU_ADDRESS 0xFFFF555A READ_WRITE /end MEASUREMENT
/begin MEASUREMENT vPSTNG31 "RAM value vPSTNG31" UBYTE COMP_0068 1 100 0 255 ECU_ADDRESS 0xFFFF555D READ_WRITE /end MEASUREMENT
/begin MEASUREMENT vPSTNG32 "RAM value vPSTNG32" UBYTE COMP_0068 1 100 0 255 ECU_ADDRESS 0xFFFF555E READ_WRITE /end MEASUREMENT
/begin MEASUREMENT vPSTNG2 "RAM value vPSTNG2" UWORD COMP_0068 1 100 0 65535 ECU_ADDRESS 0xFFFF5560 READ_WRITE /end MEASUREMENT
/begin MEASUREMENT vPSTNG11 "RAM value vPSTNG11" UBYTE COMP_0068 1 100 0 255 ECU_ADDRESS 0xFFFF5563 READ_WRITE /end MEASUREMENT
/begin MEASUREMENT vPSTNG12 "RAM value vPSTNG12" UBYTE COMP_0068 1 100 0 255 ECU_ADDRESS 0xFFFF5564 READ_WRITE /end MEASUREMENT
/begin MEASUREMENT vCSSIT "RAM value vCSSIT" UWORD COMP_0068 1 100 0 65535 ECU_ADDRESS 0xFFFF5566 READ_WRITE /end MEASUREMENT
/begin MEASUREMENT vCSSKRT1 "RAM value vCSSKRT1" UBYTE COMP_0068 1 100 0 255 ECU_ADDRESS 0xFFFF5569 READ_WRITE /end MEASUREMENT
/begin MEASUREMENT vCSSKRT2 "RAM value vCSSKRT2" UBYTE COMP_0068 1 100 0 255 ECU_ADDRESS 0xFFFF556A READ_WRITE /end MEASUREMENT
/begin MEASUREMENT vCSSDIG "RAM value vCSSDIG" UWORD COMP_0068 1 100 0 65535 ECU_ADDRESS 0xFFFF556C READ_WRITE /end MEASUREMENT
/begin MEASUREMENT vTHCLNG1 "RAM value vTHCLNG1" UBYTE COMP_0068 1 100 0 255 ECU_ADDRESS 0xFFFF556F READ_WRITE /end MEASUREMENT
/begin MEASUREMENT vTHCLNG2 "RAM value vTHCLNG2" UBYTE COMP_0068 1 100 0 255 ECU_ADDRESS 0xFFFF5570 READ_WRITE /end MEASUREMENT
/begin MEASUREMENT vTHNGH "RAM value vTHNGH" UWORD COMP_0068 1 100 0 65535 ECU_ADDRESS 0xFFFF5572 READ_WRITE /end MEASUREMENT
/begin MEASUREMENT vTHNGL1 "RAM value vTHNGL1" UBYTE COMP_0068 1 100 0 255 ECU_ADDRESS 0xFFFF5575 READ_WRITE /end MEASUREMENT
/begin MEASUREMENT vTHNGL2 "RAM value vTHNGL2" UBYTE COMP_0068 1 100 0 255 ECU_ADDRESS 0xFFFF5576 READ_WRITE /end MEASUREMENT
/begin MEASUREMENT vECMTMH "RAM value vECMTMH" UWORD COMP_0068 1 100 0 65535 ECU_ADDRESS 0xFFFF5578 READ_WRITE /end MEASUREMENT
/begin MEASUREMENT vAFMRM11 "RAM value vAFMRM11" UBYTE COMP_0068 1 100 0 255 ECU_ADDRESS 0xFFFF557B READ_WRITE /end MEASUREMENT
/begin MEASUREMENT vAFMRM12 "RAM value vAFMRM12" UBYTE COMP_0068 1 100 0 255 ECU_ADDRESS 0xFFFF557C READ_WRITE /end MEASUREMENT
/begin MEASUREMENT vAFMFS1 "RAM value vAFMFS1" UWORD COMP_0068 1 100 0 65535 ECU_ADDRESS 0xFFFF557E READ_WRITE /end MEASUREMENT
/begin MEASUREMENT vPLGSNG1 "RAM value vPLGSNG1" UBYTE COMP_0068 1 100 0 255 ECU_ADDRESS 0xFFFF5581 READ_WRITE /end MEASUREMENT
/begin MEASUREMENT vPLGSNG2 "RAM value vPLGSNG2" UBYTE COMP_0068 1 100 0 255 ECU_ADDRESS 0xFFFF5582 READ_WRITE /end MEASUREMENT
/begin MEASUREMENT vPRGSNG "RAM value vPRGSNG" UWORD COMP_0068 1 100 0 65535 ECU_ADDRESS 0xFFFF5584 READ_WRITE /end MEASUREMENT
/begin MEASUREMENT vMCTHNG1 "RAM value vMCTHNG1" UBYTE COMP_0068 1 100 0 255 ECU_ADDRESS 0xFFFF5587 READ_WRITE /end MEASUREMENT
/begin MEASUREMENT vMCTHNG2 "RAM value vMCTHNG2" UBYTE COMP_0068 1 100 0 255 ECU_ADDRESS 0xFFFF5588 READ_WRITE /end MEASUREMENT
/begin MEASUREMENT vDCMTDG "RAM value vDCMTDG" UWORD COMP_0068 1 100 0 65535 ECU_ADDRESS 0xFFFF558A READ_WRITE /end MEASUREMENT
/begin MEASUREMENT vMCTONG1 "RAM value vMCTONG1" UBYTE COMP_0068 1 100 0 255 ECU_ADDRESS 0xFFFF558D READ_WRITE /end MEASUREMENT
/begin MEASUREMENT vMCTONG2 "RAM value vMCTONG2" UBYTE COMP_0068 1 100 0 255 ECU_ADDRESS 0xFFFF558E READ_WRITE /end MEASUREMENT
/begin MEASUREMENT vMCTFNG "RAM value vMCTFNG" UWORD COMP_0068 1 100 0 65535 ECU_ADDRESS 0xFFFF5590 READ_WRITE /end MEASUREMENT
/begin MEASUREMENT vMCTANG1 "RAM value vMCTANG1" UBYTE COMP_0068 1 100 0 255 ECU_ADDRESS 0xFFFF5593 READ_WRITE /end MEASUREMENT
/begin MEASUREMENT vMCTANG2 "RAM value vMCTANG2" UBYTE COMP_0068 1 100 0 255 ECU_ADDRESS 0xFFFF5594 READ_WRITE /end MEASUREMENT
/begin MEASUREMENT vMCTWNG "RAM value vMCTWNG" UWORD COMP_0068 1 100 0 65535 ECU_ADDRESS 0xFFFF5596 READ_WRITE /end MEASUREMENT
/begin MEASUREMENT vVDRING1 "RAM value vVDRING1" UBYTE COMP_0068 1 100 0 255 ECU_ADDRESS 0xFFFF5599 READ_WRITE /end MEASUREMENT
/begin MEASUREMENT vVDRING2 "RAM value vVDRING2" UBYTE COMP_0068 1 100 0 255 ECU_ADDRESS 0xFFFF559A READ_WRITE /end MEASUREMENT
/begin MEASUREMENT vVSPLRA "RAM value vVSPLRA" UWORD COMP_0068 1 100 0 65535 ECU_ADDRESS 0xFFFF559C READ_WRITE /end MEASUREMENT
/begin MEASUREMENT vVSPLDR1 "RAM value vVSPLDR1" UBYTE COMP_0068 1 100 0 255 ECU_ADDRESS 0xFFFF559F READ_WRITE /end MEASUREMENT
/begin MEASUREMENT vVSPLDR2 "RAM value vVSPLDR2" UBYTE COMP_0068 1 100 0 255 ECU_ADDRESS 0xFFFF55A0 READ_WRITE /end MEASUREMENT
/begin MEASUREMENT vVSPLDL "RAM value vVSPLDL" UWORD COMP_0068 1 100 0 65535 ECU_ADDRESS 0xFFFF55A2 READ_WRITE /end MEASUREMENT
/begin MEASUREMENT vGCALNG1 "RAM value vGCALNG1" UBYTE COMP_0068 1 100 0 255 ECU_ADDRESS 0xFFFF55A5 READ_WRITE /end MEASUREMENT
/begin MEASUREMENT vGCALNG2 "RAM value vGCALNG2" UBYTE COMP_0068 1 100 0 255 ECU_ADDRESS 0xFFFF55A6 READ_WRITE /end MEASUREMENT
/begin MEASUREMENT vGRVRAT "RAM value vGRVRAT" UWORD COMP_0068 1 100 0 65535 ECU_ADDRESS 0xFFFF55A8 READ_WRITE /end MEASUREMENT
/begin MEASUREMENT vGRVOOR1 "RAM value vGRVOOR1" UBYTE COMP_0068 1 100 0 255 ECU_ADDRESS 0xFFFF55AB READ_WRITE /end MEASUREMENT
/begin MEASUREMENT vGRVOOR2 "RAM value vGRVOOR2" UBYTE COMP_0068 1 100 0 255 ECU_ADDRESS 0xFFFF55AC READ_WRITE /end MEASUREMENT
/begin MEASUREMENT vEPBPCR "RAM value vEPBPCR" UWORD COMP_0068 1 100 0 65535 ECU_ADDRESS 0xFFFF55AE READ_WRITE /end MEASUREMENT
/begin MEASUREMENT vGRVNGL1 "RAM value vGRVNGL1" UBYTE COMP_0068 1 100 0 255 ECU_ADDRESS 0xFFFF55B1 READ_WRITE /end MEASUREMENT
/begin MEASUREMENT vGRVNGL2 "RAM value vGRVNGL2" UBYTE COMP_0068 1 100 0 255 ECU_ADDRESS 0xFFFF55B2 READ_WRITE /end MEASUREMENT
/begin MEASUREMENT vGRVNGH "RAM value vGRVNGH" UWORD COMP_0068 1 100 0 65535 ECU_ADDRESS 0xFFFF55B4 READ_WRITE /end MEASUREMENT
/begin MEASUREMENT vBUSDBMA "RAM value vBUSDBMA" UBYTE COMP_0068 1 100 0 255 ECU_ADDRESS 0xffff5674 READ_WRITE /end MEASUREMENT
/begin MEASUREMENT P_HiROM_BG "RAM value P_HiROM_BG" ULONG COMP_0068 1 100 0 4294967295 ECU_ADDRESS 0x00022360 READ_WRITE /end MEASUREMENT
/begin MEASUREMENT P_HiROM_EN "RAM value P_HiROM_EN" ULONG COMP_0068 1 100 0 4294967295 ECU_ADDRESS 0x00022364 READ_WRITE /end MEASUREMENT
/begin MEASUREMENT P_ROMDG_BG "RAM value P_ROMDG_BG" ULONG COMP_0068 1 100 0 4294967295 ECU_ADDRESS 0x00022368 READ_WRITE /end MEASUREMENT
/begin MEASUREMENT P_ROMDG_EN "RAM value P_ROMDG_EN" ULONG COMP_0068 1 100 0 4294967295 ECU_ADDRESS 0x0002236C READ_WRITE /end MEASUREMENT
/begin MEASUREMENT P_CALIB_BG "RAM value P_CALIB_BG" ULONG COMP_0068 1 100 0 4294967295 ECU_ADDRESS 0x00008204 READ_WRITE /end MEASUREMENT
/begin MEASUREMENT P_CALIB_EN "RAM value P_CALIB_EN" ULONG COMP_0068 1 100 0 4294967295 ECU_ADDRESS 0x0001FFFF READ_WRITE /end MEASUREMENT
/begin MEASUREMENT P_PROGA_EN "RAM value P_PROGA_EN" ULONG COMP_0068 1 100 0 4294967295 ECU_ADDRESS 0x000FFFFF READ_WRITE /end MEASUREMENT
/begin MEASUREMENT vBUSDBSA "RAM value vBUSDBSA" UBYTE COMP_0068 1 100 0 255 ECU_ADDRESS 0xffff5706 READ_WRITE /end MEASUREMENT
/begin MEASUREMENT vTRIPRTS "RAM value vTRIPRTS" UBYTE COMP_0068 1 100 0 255 ECU_ADDRESS 0xFFFF5614 READ_WRITE /end MEASUREMENT
/begin MEASUREMENT vTRIPMES "RAM value vTRIPMES" UBYTE COMP_0068 1 100 0 255 ECU_ADDRESS 0xFFFF5618 READ_WRITE /end MEASUREMENT
/* COMPU_METHOD --------------------------------------------------------- */
/begin COMPU_METHOD COMP_0017 "1deg" RAT_FUNC "%8.2" "deg" COEFFS 0 1 0 0 0 1 /end COMPU_METHOD
/begin COMPU_METHOD COMP_0004 "1－" RAT_FUNC "%8.2" "－" COEFFS 0 1 0 0 0 1 /end COMPU_METHOD
/begin COMPU_METHOD COMP_0068 "1-" RAT_FUNC "%8.2" "-" COEFFS 0 1 0 0 0 1 /end COMPU_METHOD
/begin COMPU_METHOD COMP_0238 "100/128%" RAT_FUNC "%8.2" "%" COEFFS 0 1 0 0 0 0.78125 /end COMPU_METHOD
/begin COMPU_METHOD COMP_0014 "10ms" RAT_FUNC "%8.2" "ms" COEFFS 0 1 0 0 0 10 /end COMPU_METHOD
/begin COMPU_METHOD COMP_0045 "1/128-" RAT_FUNC "%8.4" "-" COEFFS 0 1 0 0 0 0.0078125 /end COMPU_METHOD
/begin COMPU_METHOD COMP_0009 "100/128%" RAT_FUNC "%8.2" "%" COEFFS 0 1 0 0 0 0.78125 /end COMPU_METHOD
/begin COMPU_METHOD COMP_0000 "25rpm" RAT_FUNC "%8.2" "rpm" COEFFS 0 1 0 0 0 25 /end COMPU_METHOD
/begin COMPU_METHOD COMP_0020 "50rpm" RAT_FUNC "%8.2" "rpm" COEFFS 0 1 0 0 0 50 /end COMPU_METHOD
/begin COMPU_METHOD COMP_0002 "0.35deg" RAT_FUNC "%8.2" "deg" COEFFS 0 1 0 0 0 0.35 /end COMPU_METHOD
/begin COMPU_METHOD COMP_0035 "X-50℃" RAT_FUNC "%8.2" "℃" COEFFS 0 1 50 0 0 1 /end COMPU_METHOD
/begin COMPU_METHOD COMP_0005 "0.11deg" RAT_FUNC "%8.2" "deg" COEFFS 0 1 0 0 0 0.11 /end COMPU_METHOD
/begin COMPU_METHOD COMP_0006 "12.5rpm" RAT_FUNC "%8.2" "rpm" COEFFS 0 1 0 0 0 12.5 /end COMPU_METHOD
/begin COMPU_METHOD COMP_0008 "100ms" RAT_FUNC "%8.2" "ms" COEFFS 0 1 0 0 0 100 /end COMPU_METHOD
/begin COMPU_METHOD COMP_0010 "0.003MPa" RAT_FUNC "%8.4" "MPa" COEFFS 0 1 0 0 0 0.003 /end COMPU_METHOD
/begin COMPU_METHOD COMP_0011 "0.02MPa" RAT_FUNC "%8.3" "MPa" COEFFS 0 1 0 0 0 0.02 /end COMPU_METHOD
/begin COMPU_METHOD COMP_0007 "2km/h" RAT_FUNC "%8.2" "km/h" COEFFS 0 1 0 0 0 2 /end COMPU_METHOD
/begin COMPU_METHOD COMP_0047 "0.5%" RAT_FUNC "%8.2" "%" COEFFS 0 1 0 0 0 0.5 /end COMPU_METHOD
/begin COMPU_METHOD COMP_0018 "1deg" RAT_FUNC "%8.2" "deg" COEFFS 0 1 0 0 0 1 /end COMPU_METHOD
/begin COMPU_METHOD COMP_0023 "5mV" RAT_FUNC "%8.2" "mV" COEFFS 0 1 0 0 0 5 /end COMPU_METHOD
/begin COMPU_METHOD COMP_0033 "80mV" RAT_FUNC "%8.2" "mV" COEFFS 0 1 0 0 0 80 /end COMPU_METHOD
/begin COMPU_METHOD COMP_0061 "5mv" RAT_FUNC "%8.2" "mv" COEFFS 0 1 0 0 0 5 /end COMPU_METHOD
/begin COMPU_METHOD COMP_0032 "1/256－" RAT_FUNC "%8.4" "－" COEFFS 0 1 0 0 0 0.00390625 /end COMPU_METHOD
/begin COMPU_METHOD COMP_0063 "1/256-" RAT_FUNC "%8.4" "-" COEFFS 0 1 0 0 0 0.00390625 /end COMPU_METHOD
/begin COMPU_METHOD COMP_0019_S "1/255-" RAT_FUNC "%8.4" "-" COEFFS 0 1 0 0 0 0.003921569 /end COMPU_METHOD
/begin COMPU_METHOD COMP_0030 "1回" RAT_FUNC "%8.2" "回" COEFFS 0 1 0 0 0 1 /end COMPU_METHOD
/begin COMPU_METHOD COMP_0016 "1count" RAT_FUNC "%8.2" "count" COEFFS 0 1 0 0 0 1 /end COMPU_METHOD
/begin COMPU_METHOD COMP_0443 "1rpm" RAT_FUNC "%8.2" "rpm" COEFFS 0 1 0 0 0 1 /end COMPU_METHOD
/begin COMPU_METHOD COMP_0228 "0.1Nm" RAT_FUNC "%8.2" "Nm" COEFFS 0 1 0 0 0 0.1 /end COMPU_METHOD
/begin COMPU_METHOD COMP_0436 "0.1km/h" RAT_FUNC "%8.2" "km/h" COEFFS 0 1 0 0 0 0.1 /end COMPU_METHOD
/begin COMPU_METHOD COMP_0026_S "0.35deg/150m" RAT_FUNC "%8.2" "deg/150m" COEFFS 0 1 0 0 0 0.35 /end COMPU_METHOD
/begin COMPU_METHOD COMP_0065 "3.125rpm" RAT_FUNC "%8.2" "rpm" COEFFS 0 1 0 0 0 3.125 /end COMPU_METHOD
/begin COMPU_METHOD COMP_0031_S "0.00061MPa" RAT_FUNC "%8.5" "MPa" COEFFS 0 1 0 0 0 0.00061 /end COMPU_METHOD
/begin COMPU_METHOD COMP_0032_S "0.125%" RAT_FUNC "%8.2" "%" COEFFS 0 1 0 0 0 0.125 /end COMPU_METHOD
/begin COMPU_METHOD COMP_0034_S "2^-8kPa" RAT_FUNC "%8.4" "kPa" COEFFS 0 1 0 0 0 0.00390625 /end COMPU_METHOD
/begin COMPU_METHOD COMP_0042 "0.0008cm**2" RAT_FUNC "%8.5" "cm**2" COEFFS 0 1 0 0 0 0.0008 /end COMPU_METHOD
/begin COMPU_METHOD COMP_0044 "1/128－" RAT_FUNC "%8.4" "－" COEFFS 0 1 0 0 0 0.0078125 /end COMPU_METHOD
/begin COMPU_METHOD COMP_0054 "20mV" RAT_FUNC "%8.2" "mV" COEFFS 0 1 0 0 0 20 /end COMPU_METHOD
/begin COMPU_METHOD COMP_0450 "1/1024-" RAT_FUNC "%8.5" "-" COEFFS 0 1 0 0 0 0.000976563 /end COMPU_METHOD
/begin COMPU_METHOD COMP_0144 "1/2048ms" RAT_FUNC "%8.5" "ms" COEFFS 0 1 0 0 0 0.000488281 /end COMPU_METHOD
/begin COMPU_METHOD COMP_0078_S "1/256L" RAT_FUNC "%8.4" "L" COEFFS 0 1 0 0 0 0.00390625 /end COMPU_METHOD
/begin COMPU_METHOD COMP_0090_S "0.2%" RAT_FUNC "%8.2" "%" COEFFS 0 1 0 0 0 0.2 /end COMPU_METHOD
/begin COMPU_METHOD COMP_0092_S "0.025kg/h" RAT_FUNC "%8.3" "kg/h" COEFFS 0 1 0 0 0 0.025 /end COMPU_METHOD
/begin COMPU_METHOD COMP_0050 "5/64mV" RAT_FUNC "%8.3" "mV" COEFFS 0 1 0 0 0 0.078125 /end COMPU_METHOD
/begin COMPU_METHOD COMP_0069 "1/(128*256)－" RAT_FUNC "%8.6" "－" COEFFS 0 1 0 0 0 0.0000305176 /end COMPU_METHOD
/begin COMPU_METHOD COMP_0104 "10mV" RAT_FUNC "%8.2" "mV" COEFFS 0 1 0 0 0 10 /end COMPU_METHOD
/begin COMPU_METHOD COMP_0120_S "0.25kPa" RAT_FUNC "%8.2" "kPa" COEFFS 0 1 0 0 0 0.25 /end COMPU_METHOD
/begin COMPU_METHOD COMP_0064 "1.5625rpm" RAT_FUNC "%8.2" "rpm" COEFFS 0 1 0 0 0 1.5625 /end COMPU_METHOD
/begin COMPU_METHOD COMP_0164 "0.000305MPa" RAT_FUNC "%8.5" "MPa" COEFFS 0 1 0 0 0 0.000305 /end COMPU_METHOD
/begin COMPU_METHOD COMP_0312 "0.5/256L" RAT_FUNC "%8.4" "L" COEFFS 0 1 0 0 0 0.001953125 /end COMPU_METHOD
/begin COMPU_METHOD COMP_0146 "100/256/256%" RAT_FUNC "%8.4" "%" COEFFS 0 1 0 0 0 0.001525879 /end COMPU_METHOD
/begin COMPU_METHOD COMP_0136_S "0.0037(X-511)G" RAT_FUNC "%8.4" "G" COEFFS 0 1 1.8907 0 0 0.0037 /end COMPU_METHOD
/begin COMPU_METHOD COMP_0158_S "0.125X-50℃" RAT_FUNC "%8.2" "℃" COEFFS 0 1 50 0 0 0.125 /end COMPU_METHOD
/begin COMPU_METHOD COMP_0028 "1/(100*256)-" RAT_FUNC "%8.6" "-" COEFFS 0 1 0 0 0 0.0000390625 /end COMPU_METHOD
/begin COMPU_METHOD COMP_0389 "1/2548km" RAT_FUNC "%8.5" "km" COEFFS 0 1 0 0 0 0.000392465 /end COMPU_METHOD
/begin COMPU_METHOD COMP_0198_S "2^-10%" RAT_FUNC "%8.5" "%" COEFFS 0 1 0 0 0 0.000976563 /end COMPU_METHOD
/begin COMPU_METHOD COMP_0024 "50ms" RAT_FUNC "%8.2" "ms" COEFFS 0 1 0 0 0 50 /end COMPU_METHOD
/begin COMPU_METHOD COMP_0476 "12.5/64rpm" RAT_FUNC "%8.2" "rpm" COEFFS 0 1 0 0 0 0.1953125 /end COMPU_METHOD
/begin COMPU_METHOD COMP_0238_S "0.01km/h" RAT_FUNC "%8.3" "km/h" COEFFS 0 1 0 0 0 0.01 /end COMPU_METHOD
/begin COMPU_METHOD COMP_0259_S "0.2℃" RAT_FUNC "%8.2" "℃" COEFFS 0 1 50 0 0 0.2 /end COMPU_METHOD
/begin COMPU_METHOD COMP_0356 "0.625X-40℃" RAT_FUNC "%8.2" "℃" COEFFS 0 1 40 0 0 0.625 /end COMPU_METHOD
/begin COMPU_METHOD COMP_0073 "3.2us" RAT_FUNC "%8.2" "us" COEFFS 0 1 0 0 0 3.2 /end COMPU_METHOD
/begin COMPU_METHOD COMP_0405_S "0.02degC" RAT_FUNC "%8.3" "degC" COEFFS 0 1 0 0 0 0.02 /end COMPU_METHOD
/begin COMPU_METHOD COMP_0428_S "0.01%" RAT_FUNC "%8.3" "%" COEFFS 0 1 327.68 0 0 0.01 /end COMPU_METHOD
/begin COMPU_METHOD COMP_0428 "X-40℃" RAT_FUNC "%8.2" "℃" COEFFS 0 1 40 0 0 1 /end COMPU_METHOD
/begin COMPU_METHOD COMP_0515 "1/2048ms" RAT_FUNC "%8.5" "ms" COEFFS 0 1 0 0 0 0.000488281 /end COMPU_METHOD
/begin COMPU_METHOD COMP_0127 "0.35X-0x80deg/30ms" RAT_FUNC "%8.2" "deg/30ms" COEFFS 0 1 44.8 0 0 0.35 /end COMPU_METHOD
/begin COMPU_METHOD COMP_0377 "0.11deg" RAT_FUNC "%8.2" "deg" COEFFS 0 1 0 0 0 0.11 /end COMPU_METHOD
/begin COMPU_METHOD COMP_0497_S "NmNm" RAT_FUNC "%8.2" "Nm" COEFFS 0 1 100 0 0 2 /end COMPU_METHOD
/begin COMPU_METHOD COMP_0533_S "rpmrpm" RAT_FUNC "%8.2" "rpm" COEFFS 0 1 0 0 0 0.1953125 /end COMPU_METHOD
/begin COMPU_METHOD COMP_0534_S "rpmrpm" RAT_FUNC "%8.2" "rpm" COEFFS 0 1 0 0 0 3.125 /end COMPU_METHOD
/begin COMPU_METHOD COMP_0541_S "mV/500msmV/500ms" RAT_FUNC "%8.2" "mV/500ms" COEFFS 0 1 0 0 0 10 /end COMPU_METHOD
/begin COMPU_METHOD COMP_0236 "0.25km/h" RAT_FUNC "%8.2" "km/h" COEFFS 0 1 0 0 0 0.25 /end COMPU_METHOD
/begin COMPU_METHOD COMP_0566_S "AA" RAT_FUNC "%8.6" "A" COEFFS 0 1 0 0 0 0.000007629 /end COMPU_METHOD
/begin COMPU_METHOD COMP_0385 "1.608km" RAT_FUNC "%8.2" "km" COEFFS 0 1 0 0 0 1.608 /end COMPU_METHOD
/begin COMPU_METHOD COMP_0607_S "rpmrpm" RAT_FUNC "%8.2" "rpm" COEFFS 0 1 0 0 0 75 /end COMPU_METHOD
/begin COMPU_METHOD COMP_0625_S "degdeg" RAT_FUNC "%8.4" "deg" COEFFS 0 1 14.08205 0 0 0.00171875 /end COMPU_METHOD
/end MODULE
/end PROJECT
