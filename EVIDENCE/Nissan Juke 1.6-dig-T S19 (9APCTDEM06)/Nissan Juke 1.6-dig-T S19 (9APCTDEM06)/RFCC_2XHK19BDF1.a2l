/begin PROJECT X12C_KH3DT_DI_NAM_R/C ""
/begin HEADER "" /* key HEADER ++ "comment" に Par.scomment */ PROJECT_NO X12C_KH3DT_DI_NAM_R/C /* key PROJECT_NO ++ project number に car_eng_desti_lot */ VERSION "0KHDCFDZ7" /* key VERSION ++ version number に mProgver */ /end HEADER
/begin MODULE DIM ""
/begin MOD_COMMON "" ALIGNMENT_BYTE 1 ALIGNMENT_WORD 2 ALIGNMENT_LONG 4 ALIGNMENT_FLOAT32_IEEE 4 ALIGNMENT_FLOAT64_IEEE 4 DEPOSIT ABSOLUTE BYTE_ORDER MSB_FIRST /* ﾊﾞｲﾄｵｰﾀﾞｰがﾘﾌﾟﾚｰｽされる */ /end MOD_COMMON
/begin MEASUREMENT fAJTRPFLG "0:(AJ)条件不成立  1:(AJ)条件成立" UBYTE COMP_0283 1 100 0 1 BIT_MASK 0x0001 ECU_ADDRESS 0xFFFF3C23 READ_WRITE /end MEASUREMENT
/begin MEASUREMENT fALINHTJG "0:不成立  1:成立" UBYTE COMP_0283 1 100 0 1 BIT_MASK 0x0080 ECU_ADDRESS 0xFFFF3C24 READ_WRITE /end MEASUREMENT
/begin MEASUREMENT fALPINIT "0:不成立  1:成立" UBYTE COMP_0283 1 100 0 1 BIT_MASK 0x0040 ECU_ADDRESS 0xFFFF3C24 READ_WRITE /end MEASUREMENT
/begin MEASUREMENT fALPLMMON "0:不成立  1:成立" UBYTE COMP_0283 1 100 0 1 BIT_MASK 0x0020 ECU_ADDRESS 0xFFFF3C24 READ_WRITE /end MEASUREMENT
/begin MEASUREMENT fALPRECRI "0:不成立  1:成立" UBYTE COMP_0283 1 100 0 1 BIT_MASK 0x0010 ECU_ADDRESS 0xFFFF3C24 READ_WRITE /end MEASUREMENT
/begin MEASUREMENT fALPTBS "0:要求  1:非要求" UBYTE COMP_0283 1 100 0 1 BIT_MASK 0x0008 ECU_ADDRESS 0xFFFF3C24 READ_WRITE /end MEASUREMENT
/begin MEASUREMENT fALPTBSDL "0:非ディレイ中  1:ディレイ中" UBYTE COMP_0283 1 100 0 1 BIT_MASK 0x0004 ECU_ADDRESS 0xFFFF3C24 READ_WRITE /end MEASUREMENT
/begin MEASUREMENT fALTCNTZ "0:オルタネータ発電電圧可変制御禁止  1:オルタネータ発電電圧可変制御許可" UBYTE COMP_0283 1 100 0 1 BIT_MASK 0x0002 ECU_ADDRESS 0xFFFF3C24 READ_WRITE /end MEASUREMENT
/begin MEASUREMENT fALTDMD "0:右記以外  1:ｵﾙﾀﾈｰﾀ要求発電優先" UBYTE COMP_0283 1 100 0 1 BIT_MASK 0x0001 ECU_ADDRESS 0xFFFF3C24 READ_WRITE /end MEASUREMENT
/begin MEASUREMENT fALTDMDNH "0:LNRPM_>_ALTDMDNH#_（ヒス_-200rpm  1:LNRPM_≦_ALTDMDNH#_（ヒス_-200rp" UBYTE COMP_0283 1 100 0 1 BIT_MASK 0x0080 ECU_ADDRESS 0xFFFF3C25 READ_WRITE /end MEASUREMENT
/begin MEASUREMENT fALTDMDNL "0:LNRPM_<_ALTDMDNL#（ヒス_-200rpm  1:LNRPM_≧_ALTDMDNL#（ヒス_-200rpm" UBYTE COMP_0283 1 100 0 1 BIT_MASK 0x0040 ECU_ADDRESS 0xFFFF3C25 READ_WRITE /end MEASUREMENT
/begin MEASUREMENT fALTFLH "0:燃料流量小  1:燃料流量大" UBYTE COMP_0283 1 100 0 1 BIT_MASK 0x0020 ECU_ADDRESS 0xFFFF3C25 READ_WRITE /end MEASUREMENT
/begin MEASUREMENT fALTTWMN "0:不成立  1:高地判定条件(7)_mALTTWMN(ヒス-3" UBYTE COMP_0283 1 100 0 1 BIT_MASK 0x0010 ECU_ADDRESS 0xFFFF3C25 READ_WRITE /end MEASUREMENT
/begin MEASUREMENT fALTTWMX "0:不成立  1:高地判定条件(7)_TWN＜mALTTWMX(ヒ" UBYTE COMP_0283 1 100 0 1 BIT_MASK 0x0008 ECU_ADDRESS 0xFFFF3C25 READ_WRITE /end MEASUREMENT
/begin MEASUREMENT fAPORAC "0:vAPO<mAPORAC(ﾋｽ-5.61deg)  1:vAPO≧mAPORAC(ﾋｽ-5.61deg)" UBYTE COMP_0283 1 100 0 1 BIT_MASK 0x0004 ECU_ADDRESS 0xFFFF3C25 READ_WRITE /end MEASUREMENT
/begin MEASUREMENT fAPP20MS "0:実行不許可  1:実行許可" UBYTE COMP_0283 1 100 0 1 BIT_MASK 0x0002 ECU_ADDRESS 0xFFFF3C25 READ_WRITE /end MEASUREMENT
/begin MEASUREMENT fAPP40MS "0:実行不許可  1:実行許可" UBYTE COMP_0283 1 100 0 1 BIT_MASK 0x0001 ECU_ADDRESS 0xFFFF3C25 READ_WRITE /end MEASUREMENT
/begin MEASUREMENT fARACT "0:非実行中  1:実行中" UBYTE COMP_0283 1 100 0 1 BIT_MASK 0x0080 ECU_ADDRESS 0xFFFF3C26 READ_WRITE /end MEASUREMENT
/begin MEASUREMENT fARAFSTP "0:正常  1:異常" UBYTE COMP_0283 1 100 0 1 BIT_MASK 0x0020 ECU_ADDRESS 0xFFFF3C26 READ_WRITE /end MEASUREMENT
/begin MEASUREMENT fARAPMT "0:不許可  1:許可" UBYTE COMP_0283 1 100 0 1 BIT_MASK 0x0008 ECU_ADDRESS 0xFFFF3C26 READ_WRITE /end MEASUREMENT
/begin MEASUREMENT fARFJ "0:非成立  1:成立" UBYTE COMP_0283 1 100 0 1 BIT_MASK 0x0002 ECU_ADDRESS 0xFFFF3C26 READ_WRITE /end MEASUREMENT
/begin MEASUREMENT fARFJC "0:不成立  1:成立" UBYTE COMP_0283 1 100 0 1 BIT_MASK 0x0001 ECU_ADDRESS 0xFFFF3C26 READ_WRITE /end MEASUREMENT
/begin MEASUREMENT fARPEM "0:不許可  1:許可" UBYTE COMP_0283 1 100 0 1 BIT_MASK 0x0080 ECU_ADDRESS 0xFFFF3C27 READ_WRITE /end MEASUREMENT
/begin MEASUREMENT fASCCOM "0:不成立  1:成立" UBYTE COMP_0283 1 100 0 1 BIT_MASK 0x0020 ECU_ADDRESS 0xFFFF3C27 READ_WRITE /end MEASUREMENT
/begin MEASUREMENT fASCDFAL2 "0:未ﾌｪｲﾙ  1:ﾌｪｲﾙ" UBYTE COMP_0283 1 100 0 1 BIT_MASK 0x0010 ECU_ADDRESS 0xFFFF3C27 READ_WRITE /end MEASUREMENT
/begin MEASUREMENT fASCDGN "0:不成立  1:成立" UBYTE COMP_0283 1 100 0 1 BIT_MASK 0x0008 ECU_ADDRESS 0xFFFF3C27 READ_WRITE /end MEASUREMENT
/begin MEASUREMENT fASCMSWCN "0:OFF  1:ON" UBYTE COMP_0283 1 100 0 1 BIT_MASK 0x0004 ECU_ADDRESS 0xFFFF3C27 READ_WRITE /end MEASUREMENT
/begin MEASUREMENT fASCOED "0:不成立  1:成立" UBYTE COMP_0283 1 100 0 1 BIT_MASK 0x0002 ECU_ADDRESS 0xFFFF3C27 READ_WRITE /end MEASUREMENT
/begin MEASUREMENT fASCSWCHK "0:MAINSW_1→0切り換え後  1:MAINSW_1→0切り換え中" UBYTE COMP_0283 1 100 0 1 BIT_MASK 0x0001 ECU_ADDRESS 0xFFFF3C27 READ_WRITE /end MEASUREMENT
/begin MEASUREMENT fASCVDCUT "0:OFF  1:ON" UBYTE COMP_0283 1 100 0 1 BIT_MASK 0x0080 ECU_ADDRESS 0xFFFF3C28 READ_WRITE /end MEASUREMENT
/begin MEASUREMENT fASCVLCUT "0:OFF  1:ON" UBYTE COMP_0283 1 100 0 1 BIT_MASK 0x0040 ECU_ADDRESS 0xFFFF3C28 READ_WRITE /end MEASUREMENT
/begin MEASUREMENT fASRVALID "0:無効  1:有効" UBYTE COMP_0283 1 100 0 1 BIT_MASK 0x0020 ECU_ADDRESS 0xFFFF3C28 READ_WRITE /end MEASUREMENT
/begin MEASUREMENT fATAPSNG "0:右記以外  1:APS1NG=1" UBYTE COMP_0283 1 100 0 1 BIT_MASK 0x0010 ECU_ADDRESS 0xFFFF3C28 READ_WRITE /end MEASUREMENT
/begin MEASUREMENT fATMPREOK "0:禁止  1:許可" UBYTE COMP_0283 1 100 0 1 BIT_MASK 0x0008 ECU_ADDRESS 0xFFFF3C28 READ_WRITE /end MEASUREMENT
/begin MEASUREMENT fATODMONI "0:OD以外  1:OD" UBYTE COMP_0283 1 100 0 1 BIT_MASK 0x0004 ECU_ADDRESS 0xFFFF3C28 READ_WRITE /end MEASUREMENT
/begin MEASUREMENT fATRNGZ "0:ATRNG前回値セット未  1:ATRNG前回値セット済み" UBYTE COMP_0283 1 100 0 1 BIT_MASK 0x0002 ECU_ADDRESS 0xFFFF3C28 READ_WRITE /end MEASUREMENT
/begin MEASUREMENT fATVSPNG "0:A/T側車速センサNG未判定  1:A/T側車速センサNG判定" UBYTE COMP_0283 1 100 0 1 BIT_MASK 0x0001 ECU_ADDRESS 0xFFFF3C28 READ_WRITE /end MEASUREMENT
/begin MEASUREMENT fBATDEG "0:非成立  1:成立" UBYTE COMP_0283 1 100 0 1 BIT_MASK 0x0080 ECU_ADDRESS 0xFFFF3C29 READ_WRITE /end MEASUREMENT
/begin MEASUREMENT fBATSC "0:不成立  1:成立" UBYTE COMP_0283 1 100 0 1 BIT_MASK 0x0040 ECU_ADDRESS 0xFFFF3C29 READ_WRITE /end MEASUREMENT
/begin MEASUREMENT fBATSCINI "0:初回  1:初回以外" UBYTE COMP_0283 1 100 0 1 BIT_MASK 0x0020 ECU_ADDRESS 0xFFFF3C29 READ_WRITE /end MEASUREMENT
/begin MEASUREMENT fBDTASOKZ "0:急速TAS学習クリア未終了  1:急速TAS学習クリア終了" UBYTE COMP_0283 1 100 0 1 BIT_MASK 0x0010 ECU_ADDRESS 0xFFFF3C29 READ_WRITE /end MEASUREMENT
/begin MEASUREMENT fBITCNT "0:1000rpm<N未完  1:1000rpm<N処理移行済み" UBYTE COMP_0283 1 100 0 1 BIT_MASK 0x0008 ECU_ADDRESS 0xFFFF3C29 READ_WRITE /end MEASUREMENT
/begin MEASUREMENT fBNOBNCNG "0:ブレーキSW正常判定  1:ブレーキSW不整合判定" UBYTE COMP_0283 1 100 0 1 BIT_MASK 0x0004 ECU_ADDRESS 0xFFFF3C29 READ_WRITE /end MEASUREMENT
/begin MEASUREMENT fBOSBKSW0 "0:BOSﾌﾞﾚｰｷSWﾃﾞｨﾚｲﾌﾗｸﾞ_OFF  1:BOSﾌﾞﾚｰｷSWﾃﾞｨﾚｲﾌﾗｸﾞ_ON" UBYTE COMP_0283 1 100 0 1 BIT_MASK 0x0002 ECU_ADDRESS 0xFFFF3C29 READ_WRITE /end MEASUREMENT
/begin MEASUREMENT fBOSBRKSW "0:BOSﾌﾞﾚｰｷSWﾌﾗｸﾞ_OFF  1:BOSﾌﾞﾚｰｷSWﾌﾗｸﾞ_ON" UBYTE COMP_0283 1 100 0 1 BIT_MASK 0x0001 ECU_ADDRESS 0xFFFF3C29 READ_WRITE /end MEASUREMENT
/begin MEASUREMENT fBOSCANCL "0:BOSﾌﾞﾚｰｷSWﾌｪｰﾙｾｰﾌﾌﾗｸﾞ2ｷｬﾝｾﾙ_OFF  1:BOSﾌﾞﾚｰｷSWﾌｪｰﾙｾｰﾌﾌﾗｸﾞ2ｷｬﾝｾﾙ_ON" UBYTE COMP_0283 1 100 0 1 BIT_MASK 0x0080 ECU_ADDRESS 0xFFFF3C2A READ_WRITE /end MEASUREMENT
/begin MEASUREMENT fBOSCHCND "0:不成立  1:成立" UBYTE COMP_0283 1 100 0 1 BIT_MASK 0x0040 ECU_ADDRESS 0xFFFF3C2A READ_WRITE /end MEASUREMENT
/begin MEASUREMENT fBOSCHEDGE "0:ｴｯｼﾞ未検出  1:ｴｯｼﾞ検出" UBYTE COMP_0283 1 100 0 1 BIT_MASK 0x0020 ECU_ADDRESS 0xFFFF3C2A READ_WRITE /end MEASUREMENT
/begin MEASUREMENT fBOSINTVL "0:BOSﾌﾞﾚｰｷSWｲﾝﾀｰﾊﾞﾙﾌﾗｸﾞ_OFF  1:BOSﾌﾞﾚｰｷSWｲﾝﾀｰﾊﾞﾙﾌﾗｸﾞ_ON" UBYTE COMP_0283 1 100 0 1 BIT_MASK 0x0010 ECU_ADDRESS 0xFFFF3C2A READ_WRITE /end MEASUREMENT
/begin MEASUREMENT fBOSLMT1 "0:BOSﾌﾞﾚｰｷSWﾌｪｰﾙｾｰﾌﾌﾗｸﾞ1_OFF  1:BOSﾌﾞﾚｰｷSWﾌｪｰﾙｾｰﾌﾌﾗｸﾞ1_ON" UBYTE COMP_0283 1 100 0 1 BIT_MASK 0x0008 ECU_ADDRESS 0xFFFF3C2A READ_WRITE /end MEASUREMENT
/begin MEASUREMENT fBOSLMT2 "0:BOSﾌﾞﾚｰｷSWﾌｪｰﾙｾｰﾌﾌﾗｸﾞ2_OFF  1:BOSﾌﾞﾚｰｷSWﾌｪｰﾙｾｰﾌﾌﾗｸﾞ2_ON" UBYTE COMP_0283 1 100 0 1 BIT_MASK 0x0004 ECU_ADDRESS 0xFFFF3C2A READ_WRITE /end MEASUREMENT
/begin MEASUREMENT fBSCHK "0:右以外  1:ﾍﾞｰｽﾁｪｯｸ中" UBYTE COMP_0283 1 100 0 1 BIT_MASK 0x0002 ECU_ADDRESS 0xFFFF3C2A READ_WRITE /end MEASUREMENT
/begin MEASUREMENT fBSERCND "0:不成立  1:成立" UBYTE COMP_0283 1 100 0 1 BIT_MASK 0x0001 ECU_ADDRESS 0xFFFF3C2A READ_WRITE /end MEASUREMENT
/begin MEASUREMENT fBTMP2FST "0:BATTMP2初回値設定未  1:BATTMP2初回値設定済み" UBYTE COMP_0283 1 100 0 1 BIT_MASK 0x0080 ECU_ADDRESS 0xFFFF3C2B READ_WRITE /end MEASUREMENT
/begin MEASUREMENT fBURAMCLR "0:非実行  1:実行済み" UBYTE COMP_0283 1 100 0 1 BIT_MASK 0x0040 ECU_ADDRESS 0xFFFF3C2B READ_WRITE /end MEASUREMENT
/begin MEASUREMENT fBUREND "0:ﾊﾞｯｸｱｯﾌﾟRAMｼｽﾃﾑ診断処理未完了  1:ﾊﾞｯｸｱｯﾌﾟRAMｼｽﾃﾑ診断処理完了" UBYTE COMP_0283 1 100 0 1 BIT_MASK 0x0020 ECU_ADDRESS 0xFFFF3C2B READ_WRITE /end MEASUREMENT
/begin MEASUREMENT fBURMON "0:ﾊﾞｯｸｱｯﾌﾟRAMｼｽﾃﾑ診断許可条件不成  1:ﾊﾞｯｸｱｯﾌﾟRAMｼｽﾃﾑ診断許可条件成立" UBYTE COMP_0283 1 100 0 1 BIT_MASK 0x0010 ECU_ADDRESS 0xFFFF3C2B READ_WRITE /end MEASUREMENT
/begin MEASUREMENT fCALPSTE "0:未  1:終了" UBYTE COMP_0283 1 100 0 1 BIT_MASK 0x0008 ECU_ADDRESS 0xFFFF3C2B READ_WRITE /end MEASUREMENT
/begin MEASUREMENT fCANMASKK "0:fCANMASK=1→0_経験無し  1:fCANMASK=1→0_経験有り" UBYTE COMP_0283 1 100 0 1 BIT_MASK 0x0004 ECU_ADDRESS 0xFFFF3C2B READ_WRITE /end MEASUREMENT
/begin MEASUREMENT fCAPWDMD "0:F/C警告灯点灯要求無  1:F/C警告灯点灯要求有" UBYTE COMP_0283 1 100 0 1 BIT_MASK 0x0002 ECU_ADDRESS 0xFFFF3C2B READ_WRITE /end MEASUREMENT
/begin MEASUREMENT fCARIBARI "0:ｷｬﾘﾌﾞﾚｰｼｮﾝ無し  1:ｷｬﾘﾌﾞﾚｰｼｮﾝ有り" UBYTE COMP_0283 1 100 0 1 BIT_MASK 0x0001 ECU_ADDRESS 0xFFFF3C2B READ_WRITE /end MEASUREMENT
/begin MEASUREMENT fCARIBGO "0:ｷｬﾘﾌﾞﾚｰｼｮﾝ不許可  1:ｷｬﾘﾌﾞﾚｰｼｮﾝ許可" UBYTE COMP_0283 1 100 0 1 BIT_MASK 0x0080 ECU_ADDRESS 0xFFFF3C2C READ_WRITE /end MEASUREMENT
/begin MEASUREMENT fCARIBGO2 "0:不成立  1:成立" UBYTE COMP_0283 1 100 0 1 BIT_MASK 0x0040 ECU_ADDRESS 0xFFFF3C2C READ_WRITE /end MEASUREMENT
/begin MEASUREMENT fCARIBGOB "0:不成立  1:成立" UBYTE COMP_0283 1 100 0 1 BIT_MASK 0x0020 ECU_ADDRESS 0xFFFF3C2C READ_WRITE /end MEASUREMENT
/begin MEASUREMENT fCARIBGOK "0:不成立  1:成立" UBYTE COMP_0283 1 100 0 1 BIT_MASK 0x0010 ECU_ADDRESS 0xFFFF3C2C READ_WRITE /end MEASUREMENT
/begin MEASUREMENT fCARIMODE "0:ﾊﾟｯｼﾌﾞｷｬﾘﾌﾞﾚｰｼｮﾝ  1:ｱｸﾃｨﾌﾞｷｬﾘﾌﾞﾚｰｼｮﾝ" UBYTE COMP_0283 1 100 0 1 BIT_MASK 0x0008 ECU_ADDRESS 0xFFFF3C2C READ_WRITE /end MEASUREMENT
/begin MEASUREMENT fCATAR "0:不成立  1:成立" UBYTE COMP_0283 1 100 0 1 BIT_MASK 0x0080 ECU_ADDRESS 0xFFFF3C2D READ_WRITE /end MEASUREMENT
/begin MEASUREMENT fCATEVPR "0:右記以外  1:パージカット条件(5)成立" UBYTE COMP_0283 1 100 0 1 BIT_MASK 0x0008 ECU_ADDRESS 0xFFFF3C2D READ_WRITE /end MEASUREMENT
/begin MEASUREMENT fCATMLEND "0:同一Ｔｒｉｐ内で最初の診断終了判  1:左記以外" UBYTE COMP_0283 1 100 0 1 BIT_MASK 0x0004 ECU_ADDRESS 0xFFFF3C2D READ_WRITE /end MEASUREMENT
/begin MEASUREMENT fCATRECL "0:残存率条件不成立  1:残存率条件成立" UBYTE COMP_0283 1 100 0 1 BIT_MASK 0x0002 ECU_ADDRESS 0xFFFF3C2D READ_WRITE /end MEASUREMENT
/begin MEASUREMENT fCATWAMTW "0:非許可  1:許可" UBYTE COMP_0283 1 100 0 1 BIT_MASK 0x0001 ECU_ADDRESS 0xFFFF3C2D READ_WRITE /end MEASUREMENT
/begin MEASUREMENT fCBTECNT "0:レジスタチェック許可  1:レジスタチェック非許可" UBYTE COMP_0283 1 100 0 1 BIT_MASK 0x0080 ECU_ADDRESS 0xFFFF3C2E READ_WRITE /end MEASUREMENT
/begin MEASUREMENT fCCHG "0:右記以外  1:発電電圧可変制御中充電要求" UBYTE COMP_0283 1 100 0 1 BIT_MASK 0x0040 ECU_ADDRESS 0xFFFF3C2E READ_WRITE /end MEASUREMENT
/begin MEASUREMENT fCCHGZ "0:右記以外  1:発電電圧可変制御中充電要求" UBYTE COMP_0283 1 100 0 1 BIT_MASK 0x0020 ECU_ADDRESS 0xFFFF3C2E READ_WRITE /end MEASUREMENT
/begin MEASUREMENT fCCSQEC "0:CTセンサ量子化誤差補償未  1:CTセンサ量子化誤差補償済" UBYTE COMP_0283 1 100 0 1 BIT_MASK 0x0010 ECU_ADDRESS 0xFFFF3C2E READ_WRITE /end MEASUREMENT
/begin MEASUREMENT fCDCCKOK1 "0:ﾄﾞﾚﾝｶｯﾄ診断許可条件未成立  1:ﾄﾞﾚﾝｶｯﾄ診断許可条件成立" UBYTE COMP_0283 1 100 0 1 BIT_MASK 0x0008 ECU_ADDRESS 0xFFFF3C2E READ_WRITE /end MEASUREMENT
/begin MEASUREMENT fCDCCKOK2 "0:ﾊﾟｰｼﾞ制御状態未成立  1:ﾊﾟｰｼﾞ制御状態成立" UBYTE COMP_0283 1 100 0 1 BIT_MASK 0x0004 ECU_ADDRESS 0xFFFF3C2E READ_WRITE /end MEASUREMENT
/begin MEASUREMENT fCERDC "0:不成立  1:成立" UBYTE COMP_0283 1 100 0 1 BIT_MASK 0x0002 ECU_ADDRESS 0xFFFF3C2E READ_WRITE /end MEASUREMENT
/begin MEASUREMENT fCHGNGNE "0:経験なし  1:経験あり" UBYTE COMP_0283 1 100 0 1 BIT_MASK 0x0001 ECU_ADDRESS 0xFFFF3C2E READ_WRITE /end MEASUREMENT
/begin MEASUREMENT fCHGNGNE0 "0:経験なし  1:経験あり" UBYTE COMP_0283 1 100 0 1 BIT_MASK 0x0080 ECU_ADDRESS 0xFFFF3C2F READ_WRITE /end MEASUREMENT
/begin MEASUREMENT fCHGOKHS2 "0:右記以外  1:BATCURK2_≦_CHGOK3__（ヒステリシ" UBYTE COMP_0283 1 100 0 1 BIT_MASK 0x0040 ECU_ADDRESS 0xFFFF3C2F READ_WRITE /end MEASUREMENT
/begin MEASUREMENT fCLCATS "0:不成立  1:触媒条件成立" UBYTE COMP_0283 1 100 0 1 BIT_MASK 0x0020 ECU_ADDRESS 0xFFFF3C2F READ_WRITE /end MEASUREMENT
/begin MEASUREMENT fCLDCLS "0:OPEN  1:CLOSE" UBYTE COMP_0283 1 100 0 1 BIT_MASK 0x0010 ECU_ADDRESS 0xFFFF3C2F READ_WRITE /end MEASUREMENT
/begin MEASUREMENT fCLDGNE "0:不成立  1:成立" UBYTE COMP_0283 1 100 0 1 BIT_MASK 0x0008 ECU_ADDRESS 0xFFFF3C2F READ_WRITE /end MEASUREMENT
/begin MEASUREMENT fCLDRVR "0:不成立  1:運転条件成立" UBYTE COMP_0283 1 100 0 1 BIT_MASK 0x0004 ECU_ADDRESS 0xFFFF3C2F READ_WRITE /end MEASUREMENT
/begin MEASUREMENT fCLDVDLY "0:使用不許可  1:使用許可" UBYTE COMP_0283 1 100 0 1 BIT_MASK 0x0002 ECU_ADDRESS 0xFFFF3C2F READ_WRITE /end MEASUREMENT
/begin MEASUREMENT fCLDVDLYE "0:使用不許可  1:使用許可" UBYTE COMP_0283 1 100 0 1 BIT_MASK 0x0001 ECU_ADDRESS 0xFFFF3C2F READ_WRITE /end MEASUREMENT
/begin MEASUREMENT fCLDVTNEL "0:不成立  1:成立" UBYTE COMP_0283 1 100 0 1 BIT_MASK 0x0080 ECU_ADDRESS 0xFFFF3C30 READ_WRITE /end MEASUREMENT
/begin MEASUREMENT fCLENV "0:不成立  1:環境条件成立" UBYTE COMP_0283 1 100 0 1 BIT_MASK 0x0040 ECU_ADDRESS 0xFFFF3C30 READ_WRITE /end MEASUREMENT
/begin MEASUREMENT fCLFBOK "0:不成立  1:成立" UBYTE COMP_0283 1 100 0 1 BIT_MASK 0x0020 ECU_ADDRESS 0xFFFF3C30 READ_WRITE /end MEASUREMENT
/begin MEASUREMENT fCLMLFC "0:故障無し  1:故障有り" UBYTE COMP_0283 1 100 0 1 BIT_MASK 0x0010 ECU_ADDRESS 0xFFFF3C30 READ_WRITE /end MEASUREMENT
/begin MEASUREMENT fCLMLFCV "0:不成立  1:診断条件成立" UBYTE COMP_0283 1 100 0 1 BIT_MASK 0x0008 ECU_ADDRESS 0xFFFF3C30 READ_WRITE /end MEASUREMENT
/begin MEASUREMENT fCNTCLR "0:ｸﾘｱ条件不成立  1:ｸﾘｱ条件成立" UBYTE COMP_0283 1 100 0 1 BIT_MASK 0x0004 ECU_ADDRESS 0xFFFF3C30 READ_WRITE /end MEASUREMENT
/begin MEASUREMENT fCNTCLRTM "0:ｸﾘｱ条件不成立  1:ｸﾘｱ条件成立" UBYTE COMP_0283 1 100 0 1 BIT_MASK 0x0002 ECU_ADDRESS 0xFFFF3C30 READ_WRITE /end MEASUREMENT
/begin MEASUREMENT fCNTLRNCH "0:未経験  1:経験" UBYTE COMP_0283 1 100 0 1 BIT_MASK 0x0001 ECU_ADDRESS 0xFFFF3C30 READ_WRITE /end MEASUREMENT
/begin MEASUREMENT fCNTUP "0:検出条件不成立  1:検出条件成立" UBYTE COMP_0283 1 100 0 1 BIT_MASK 0x0080 ECU_ADDRESS 0xFFFF3C31 READ_WRITE /end MEASUREMENT
/begin MEASUREMENT fCONAHEV "0:不成立  1:成立" UBYTE COMP_0283 1 100 0 1 BIT_MASK 0x0040 ECU_ADDRESS 0xFFFF3C31 READ_WRITE /end MEASUREMENT
/begin MEASUREMENT fCOV55 "0:EEPROMCO調整値書き込み処理でない  1:EEPROMCO調整値書き込み処理" UBYTE COMP_0283 1 100 0 1 BIT_MASK 0x0020 ECU_ADDRESS 0xFFFF3C31 READ_WRITE /end MEASUREMENT
/begin MEASUREMENT fCOV55OLD "0:EEPROMCO調整値書き込み要求でない  1:EEPROMCO調整値書き込み要求(前回" UBYTE COMP_0283 1 100 0 1 BIT_MASK 0x0010 ECU_ADDRESS 0xFFFF3C31 READ_WRITE /end MEASUREMENT
/begin MEASUREMENT fCPUBKUP "0:右記以外  1:ハードチェックCPUバックアップ要" UBYTE COMP_0283 1 100 0 1 BIT_MASK 0x0008 ECU_ADDRESS 0xFFFF3C31 READ_WRITE /end MEASUREMENT
/begin MEASUREMENT fCPUDGN "0:不成立  1:成立" UBYTE COMP_0283 1 100 0 1 BIT_MASK 0x0004 ECU_ADDRESS 0xFFFF3C31 READ_WRITE /end MEASUREMENT
/begin MEASUREMENT fCPWADRF "0:給油による警告灯消灯要求無  1:給油による警告灯消灯要求有" UBYTE COMP_0283 1 100 0 1 BIT_MASK 0x0002 ECU_ADDRESS 0xFFFF3C31 READ_WRITE /end MEASUREMENT
/begin MEASUREMENT fCRBBSTOK "0:ｷｬﾘﾌﾞ非許可  1:ｷｬﾘﾌﾞ許可" UBYTE COMP_0283 1 100 0 1 BIT_MASK 0x0001 ECU_ADDRESS 0xFFFF3C31 READ_WRITE /end MEASUREMENT
/begin MEASUREMENT fCRBDNSOK "0:不成立  1:成立" UBYTE COMP_0283 1 100 0 1 BIT_MASK 0x0080 ECU_ADDRESS 0xFFFF3C32 READ_WRITE /end MEASUREMENT
/begin MEASUREMENT fCRBFCTOK "0:不成立  1:成立" UBYTE COMP_0283 1 100 0 1 BIT_MASK 0x0040 ECU_ADDRESS 0xFFFF3C32 READ_WRITE /end MEASUREMENT
/begin MEASUREMENT fCRBGSOK "0:不成立  1:成立" UBYTE COMP_0283 1 100 0 1 BIT_MASK 0x0020 ECU_ADDRESS 0xFFFF3C32 READ_WRITE /end MEASUREMENT
/begin MEASUREMENT fCRBMFOK "0:不成立  1:成立" UBYTE COMP_0283 1 100 0 1 BIT_MASK 0x0010 ECU_ADDRESS 0xFFFF3C32 READ_WRITE /end MEASUREMENT
/begin MEASUREMENT fCRBPQOK "0:不成立  1:成立" UBYTE COMP_0283 1 100 0 1 BIT_MASK 0x0008 ECU_ADDRESS 0xFFFF3C32 READ_WRITE /end MEASUREMENT
/begin MEASUREMENT fCRBQH0OK "0:不成立  1:成立" UBYTE COMP_0283 1 100 0 1 BIT_MASK 0x0004 ECU_ADDRESS 0xFFFF3C32 READ_WRITE /end MEASUREMENT
/begin MEASUREMENT fCRBTGABF "0:不成立  1:成立" UBYTE COMP_0283 1 100 0 1 BIT_MASK 0x0002 ECU_ADDRESS 0xFFFF3C32 READ_WRITE /end MEASUREMENT
/begin MEASUREMENT fCRES1 "0:右記以外  1:COUNTRES=1となった" UBYTE COMP_0283 1 100 0 1 BIT_MASK 0x0001 ECU_ADDRESS 0xFFFF3C32 READ_WRITE /end MEASUREMENT
/begin MEASUREMENT fCRIKIN1 "0:不成立  1:成立" UBYTE COMP_0283 1 100 0 1 BIT_MASK 0x0080 ECU_ADDRESS 0xFFFF3C33 READ_WRITE /end MEASUREMENT
/begin MEASUREMENT fCRIPCT "0:不成立  1:成立" UBYTE COMP_0283 1 100 0 1 BIT_MASK 0x0040 ECU_ADDRESS 0xFFFF3C33 READ_WRITE /end MEASUREMENT
/begin MEASUREMENT fCRUISEZ "0:非ｸﾙｰｽﾞ中  1:ｸﾙｰｽﾞ中" UBYTE COMP_0283 1 100 0 1 BIT_MASK 0x0020 ECU_ADDRESS 0xFFFF3C33 READ_WRITE /end MEASUREMENT
/begin MEASUREMENT fCRULMPBR "0:ｸﾙｰｽﾞﾗﾝﾌﾟ消灯か点灯  1:ｸﾙｰｽﾞﾗﾝﾌﾟ点滅" UBYTE COMP_0283 1 100 0 1 BIT_MASK 0x0010 ECU_ADDRESS 0xFFFF3C33 READ_WRITE /end MEASUREMENT
/begin MEASUREMENT fCSADVDIG "0:診断不許可  1:診断許可" UBYTE COMP_0283 1 100 0 1 BIT_MASK 0x0008 ECU_ADDRESS 0xFFFF3C33 READ_WRITE /end MEASUREMENT
/begin MEASUREMENT fCSADVNDI "0:診断不許可  1:診断許可" UBYTE COMP_0283 1 100 0 1 BIT_MASK 0x0004 ECU_ADDRESS 0xFFFF3C33 READ_WRITE /end MEASUREMENT
/begin MEASUREMENT fCSDGN47 "0:診断不許可  1:診断許可" UBYTE COMP_0283 1 100 0 1 BIT_MASK 0x0002 ECU_ADDRESS 0xFFFF3C33 READ_WRITE /end MEASUREMENT
/begin MEASUREMENT fCSI "0:OFF  1:ON" UBYTE COMP_0283 1 100 0 1 BIT_MASK 0x0001 ECU_ADDRESS 0xFFFF3C33 READ_WRITE /end MEASUREMENT
/begin MEASUREMENT fCSIGNON "0:IGN_SW_ON経験なし  1:IGN_SW_ON経験あり" UBYTE COMP_0283 1 100 0 1 BIT_MASK 0x0080 ECU_ADDRESS 0xFFFF3C34 READ_WRITE /end MEASUREMENT
/begin MEASUREMENT fCSMDLY "0:非許可  1:許可" UBYTE COMP_0283 1 100 0 1 BIT_MASK 0x0040 ECU_ADDRESS 0xFFFF3C34 READ_WRITE /end MEASUREMENT
/begin MEASUREMENT fCSMDLYST "0:停止  1:開始" UBYTE COMP_0283 1 100 0 1 BIT_MASK 0x0020 ECU_ADDRESS 0xFFFF3C34 READ_WRITE /end MEASUREMENT
/begin MEASUREMENT fCSMNDDLY "0:非許可  1:許可" UBYTE COMP_0283 1 100 0 1 BIT_MASK 0x0010 ECU_ADDRESS 0xFFFF3C34 READ_WRITE /end MEASUREMENT
/begin MEASUREMENT fCSMSN "0:不成立  1:成立" UBYTE COMP_0283 1 100 0 1 BIT_MASK 0x0008 ECU_ADDRESS 0xFFFF3C34 READ_WRITE /end MEASUREMENT
/begin MEASUREMENT fCSMSNLOW "0:キャンセル要求無  1:キャンセル要求有" UBYTE COMP_0283 1 100 0 1 BIT_MASK 0x0004 ECU_ADDRESS 0xFFFF3C34 READ_WRITE /end MEASUREMENT
/begin MEASUREMENT fCSNDSLCT "0:NDセレクト無  1:NDセレクト有" UBYTE COMP_0283 1 100 0 1 BIT_MASK 0x0002 ECU_ADDRESS 0xFFFF3C34 READ_WRITE /end MEASUREMENT
/begin MEASUREMENT fCSNDTMOK "0:非許可  1:許可" UBYTE COMP_0283 1 100 0 1 BIT_MASK 0x0001 ECU_ADDRESS 0xFFFF3C34 READ_WRITE /end MEASUREMENT
/begin MEASUREMENT fCSRPMDIG "0:診断不許可  1:診断許可" UBYTE COMP_0283 1 100 0 1 BIT_MASK 0x0080 ECU_ADDRESS 0xFFFF3C35 READ_WRITE /end MEASUREMENT
/begin MEASUREMENT fCSRPMNDI "0:診断不許可  1:診断許可" UBYTE COMP_0283 1 100 0 1 BIT_MASK 0x0040 ECU_ADDRESS 0xFFFF3C35 READ_WRITE /end MEASUREMENT
/begin MEASUREMENT fCSSADVGO "0:診断不許可  1:診断許可" UBYTE COMP_0283 1 100 0 1 BIT_MASK 0x0020 ECU_ADDRESS 0xFFFF3C35 READ_WRITE /end MEASUREMENT
/begin MEASUREMENT fCSSADVNG "0:OK判定/または回転NG判定/または診  1:NG判定" UBYTE COMP_0283 1 100 0 1 BIT_MASK 0x0010 ECU_ADDRESS 0xFFFF3C35 READ_WRITE /end MEASUREMENT
/begin MEASUREMENT fCSSAREAA "0:エリアA未判定  1:エリアA判定" UBYTE COMP_0283 1 100 0 1 BIT_MASK 0x0008 ECU_ADDRESS 0xFFFF3C35 READ_WRITE /end MEASUREMENT
/begin MEASUREMENT fCSSAREAB "0:エリアB未判定  1:エリアB判定" UBYTE COMP_0283 1 100 0 1 BIT_MASK 0x0004 ECU_ADDRESS 0xFFFF3C35 READ_WRITE /end MEASUREMENT
/begin MEASUREMENT fCSSAREAC "0:エリアC未判定  1:エリアC判定" UBYTE COMP_0283 1 100 0 1 BIT_MASK 0x0002 ECU_ADDRESS 0xFFFF3C35 READ_WRITE /end MEASUREMENT
/begin MEASUREMENT fCSSCTD "0:冷却水系平衡判定未  1:冷却水系平衡判定済" UBYTE COMP_0283 1 100 0 1 BIT_MASK 0x0001 ECU_ADDRESS 0xFFFF3C35 READ_WRITE /end MEASUREMENT
/begin MEASUREMENT fCSSDLTTP "0:キャンセル要求無  1:キャンセル要求有" UBYTE COMP_0283 1 100 0 1 BIT_MASK 0x0080 ECU_ADDRESS 0xFFFF3C36 READ_WRITE /end MEASUREMENT
/begin MEASUREMENT fCSSEND "0:診断未終了  1:診断終了" UBYTE COMP_0283 1 100 0 1 BIT_MASK 0x0040 ECU_ADDRESS 0xFFFF3C36 READ_WRITE /end MEASUREMENT
/begin MEASUREMENT fCSSEXE "0:非許可  1:許可" UBYTE COMP_0283 1 100 0 1 BIT_MASK 0x0020 ECU_ADDRESS 0xFFFF3C36 READ_WRITE /end MEASUREMENT
/begin MEASUREMENT fCSSMACT "0:非許可  1:許可" UBYTE COMP_0283 1 100 0 1 BIT_MASK 0x0010 ECU_ADDRESS 0xFFFF3C36 READ_WRITE /end MEASUREMENT
/begin MEASUREMENT fCSSMOK "0:回転or点火NG判定/または診断未終  1:OK判定" UBYTE COMP_0283 1 100 0 1 BIT_MASK 0x0008 ECU_ADDRESS 0xFFFF3C36 READ_WRITE /end MEASUREMENT
/begin MEASUREMENT fCSSMSTP "0:部品故障無  1:部品故障有" UBYTE COMP_0283 1 100 0 1 BIT_MASK 0x0004 ECU_ADDRESS 0xFFFF3C36 READ_WRITE /end MEASUREMENT
/begin MEASUREMENT fCSSNEUT "0:NEUTSW_OFF  1:NEUTSW_ON" UBYTE COMP_0283 1 100 0 1 BIT_MASK 0x0002 ECU_ADDRESS 0xFFFF3C36 READ_WRITE /end MEASUREMENT
/begin MEASUREMENT fCSSOPE "0:制御非実行  1:制御実行中" UBYTE COMP_0283 1 100 0 1 BIT_MASK 0x0001 ECU_ADDRESS 0xFFFF3C36 READ_WRITE /end MEASUREMENT
/begin MEASUREMENT fCSSQNG "0:診断未終了/またはOK判定  1:NG判定" UBYTE COMP_0283 1 100 0 1 BIT_MASK 0x0080 ECU_ADDRESS 0xFFFF3C37 READ_WRITE /end MEASUREMENT
/begin MEASUREMENT fCSSQOK "0:診断未終了/またはNG判定  1:OK判定" UBYTE COMP_0283 1 100 0 1 BIT_MASK 0x0040 ECU_ADDRESS 0xFFFF3C37 READ_WRITE /end MEASUREMENT
/begin MEASUREMENT fCSSREVNG "0:OK判定/または点火NG判定/または診  1:NG判定" UBYTE COMP_0283 1 100 0 1 BIT_MASK 0x0020 ECU_ADDRESS 0xFFFF3C37 READ_WRITE /end MEASUREMENT
/begin MEASUREMENT fCSSRPMGO "0:診断不許可  1:診断許可" UBYTE COMP_0283 1 100 0 1 BIT_MASK 0x0010 ECU_ADDRESS 0xFFFF3C37 READ_WRITE /end MEASUREMENT
/begin MEASUREMENT fCSSTGO "0:診断不許可  1:診断許可" UBYTE COMP_0283 1 100 0 1 BIT_MASK 0x0008 ECU_ADDRESS 0xFFFF3C37 READ_WRITE /end MEASUREMENT
/begin MEASUREMENT fCSTACOK "0:ｺｰｽﾄA/Cｶｯﾄ禁止  1:ｺｰｽﾄA/Cｶｯﾄ許可" UBYTE COMP_0283 1 100 0 1 BIT_MASK 0x0004 ECU_ADDRESS 0xFFFF3C37 READ_WRITE /end MEASUREMENT
/begin MEASUREMENT fCSTACTRG "0:ｺｰｽﾄA/Cｶｯﾄ開始ﾀｲﾐﾝｸﾞ以外  1:ｺｰｽﾄA/Cｶｯﾄ開始ﾀｲﾐﾝｸﾞ" UBYTE COMP_0283 1 100 0 1 BIT_MASK 0x0002 ECU_ADDRESS 0xFFFF3C37 READ_WRITE /end MEASUREMENT
/begin MEASUREMENT fCSTDIG "0:診断不許可  1:診断許可" UBYTE COMP_0283 1 100 0 1 BIT_MASK 0x0001 ECU_ADDRESS 0xFFFF3C37 READ_WRITE /end MEASUREMENT
/begin MEASUREMENT fCSTNDI "0:診断不許可  1:診断許可" UBYTE COMP_0283 1 100 0 1 BIT_MASK 0x0080 ECU_ADDRESS 0xFFFF3C38 READ_WRITE /end MEASUREMENT
/begin MEASUREMENT fCTBFT1ST1 "0:ターボ無過給診断条件1～8が成立し  1:ターボ無過給診断条件1～8が成立し" UBYTE COMP_0283 1 100 0 1 BIT_MASK 0x0040 ECU_ADDRESS 0xFFFF3C38 READ_WRITE /end MEASUREMENT
/begin MEASUREMENT fCTFKNG "0:なし  1:あり" UBYTE COMP_0283 1 100 0 1 BIT_MASK 0x0020 ECU_ADDRESS 0xFFFF3C38 READ_WRITE /end MEASUREMENT
/begin MEASUREMENT fCTMPOK "0:不成立  1:成立" UBYTE COMP_0283 1 100 0 1 BIT_MASK 0x0010 ECU_ADDRESS 0xFFFF3C38 READ_WRITE /end MEASUREMENT
/begin MEASUREMENT fCVN2ED "0:CVN演算終了前  1:CVN演算終了後" UBYTE COMP_0283 1 100 0 1 BIT_MASK 0x0008 ECU_ADDRESS 0xFFFF3C38 READ_WRITE /end MEASUREMENT
/begin MEASUREMENT fCVN2ED2 "0:CVN演算終了前  1:CVN演算終了後" UBYTE COMP_0283 1 100 0 1 BIT_MASK 0x0004 ECU_ADDRESS 0xFFFF3C38 READ_WRITE /end MEASUREMENT
/begin MEASUREMENT fCVN2ST "0:CVN演算開始前  1:CVN演算開始後" UBYTE COMP_0283 1 100 0 1 BIT_MASK 0x0002 ECU_ADDRESS 0xFFFF3C38 READ_WRITE /end MEASUREMENT
/begin MEASUREMENT fCVTCNH "0:C-VTC始動時制御許可条件エンジン  1:C-VTC始動時制御許可条件エンジン" UBYTE COMP_0283 1 100 0 1 BIT_MASK 0x0001 ECU_ADDRESS 0xFFFF3C38 READ_WRITE /end MEASUREMENT
/begin MEASUREMENT fCVTCTW "0:C-VTC始動時制御許可条件上限水温  1:E-VTC始動時制御許可条件上限水温" UBYTE COMP_0283 1 100 0 1 BIT_MASK 0x0080 ECU_ADDRESS 0xFFFF3C39 READ_WRITE /end MEASUREMENT
/begin MEASUREMENT fCVTDSMOD "0:DSﾓｰﾄﾞ以外  1:DSﾓｰﾄﾞ時" UBYTE COMP_0283 1 100 0 1 BIT_MASK 0x0040 ECU_ADDRESS 0xFFFF3C39 READ_WRITE /end MEASUREMENT
/begin MEASUREMENT fCVTRNGZ "0:CVTRNG前回値セット未  1:CVTRNG前回値セット済み" UBYTE COMP_0283 1 100 0 1 BIT_MASK 0x0020 ECU_ADDRESS 0xFFFF3C39 READ_WRITE /end MEASUREMENT
/begin MEASUREMENT fD2LNCLR "0:学習値通常  1:学習値ｸﾘｱ" UBYTE COMP_0283 1 100 0 1 BIT_MASK 0x0010 ECU_ADDRESS 0xFFFF3C39 READ_WRITE /end MEASUREMENT
/begin MEASUREMENT fDAP1NG "0:APS1NG,AP1NGH,AP1NGLの#FLGFS=0  1:EAPS1NG,AP1NGH,AP1NGLのいずれか" UBYTE COMP_0283 1 100 0 1 BIT_MASK 0x0008 ECU_ADDRESS 0xFFFF3C39 READ_WRITE /end MEASUREMENT
/begin MEASUREMENT fDAP2NG "0:APS2NG,AP2NGH,AP2NGLの#FLGFS=0  1:EAPS2NG,AP2NGH,AP2NGLのいずれか" UBYTE COMP_0283 1 100 0 1 BIT_MASK 0x0004 ECU_ADDRESS 0xFFFF3C39 READ_WRITE /end MEASUREMENT
/begin MEASUREMENT fDCESTCTE "0:不成立  1:成立" UBYTE COMP_0283 1 100 0 1 BIT_MASK 0x0001 ECU_ADDRESS 0xFFFF3C39 READ_WRITE /end MEASUREMENT
/begin MEASUREMENT fDCFAULTJ "0:判定未  1:故障判定(DC方式)" UBYTE COMP_0283 1 100 0 1 BIT_MASK 0x0080 ECU_ADDRESS 0xFFFF3C3A READ_WRITE /end MEASUREMENT
/begin MEASUREMENT fDCFAULTS "0:判定未  1:故障信号有((DC方式)" UBYTE COMP_0283 1 100 0 1 BIT_MASK 0x0040 ECU_ADDRESS 0xFFFF3C3A READ_WRITE /end MEASUREMENT
/begin MEASUREMENT fDCNOMALS "0:判定未  1:正常信号有(DC方式)" UBYTE COMP_0283 1 100 0 1 BIT_MASK 0x0020 ECU_ADDRESS 0xFFFF3C3A READ_WRITE /end MEASUREMENT
/begin MEASUREMENT fDCRLTDBS "0:上限以外  1:上限" UBYTE COMP_0283 1 100 0 1 BIT_MASK 0x0010 ECU_ADDRESS 0xFFFF3C3A READ_WRITE /end MEASUREMENT
/begin MEASUREMENT fDCRUTDBS "0:上限以外  1:上限" UBYTE COMP_0283 1 100 0 1 BIT_MASK 0x0008 ECU_ADDRESS 0xFFFF3C3A READ_WRITE /end MEASUREMENT
/begin MEASUREMENT fDCTSAPC "0:不許可  1:診断許可" UBYTE COMP_0283 1 100 0 1 BIT_MASK 0x0004 ECU_ADDRESS 0xFFFF3C3A READ_WRITE /end MEASUREMENT
/begin MEASUREMENT fDCTSEC "0:不許可  1:診断許可" UBYTE COMP_0283 1 100 0 1 BIT_MASK 0x0002 ECU_ADDRESS 0xFFFF3C3A READ_WRITE /end MEASUREMENT
/begin MEASUREMENT fDCTSFC "0:診断許可  1:不許可" UBYTE COMP_0283 1 100 0 1 BIT_MASK 0x0001 ECU_ADDRESS 0xFFFF3C3A READ_WRITE /end MEASUREMENT
/begin MEASUREMENT fDCTSPC "0:不許可  1:診断許可" UBYTE COMP_0283 1 100 0 1 BIT_MASK 0x0080 ECU_ADDRESS 0xFFFF3C3B READ_WRITE /end MEASUREMENT
/begin MEASUREMENT fDCV1ST "0:未経験  1:経験した" UBYTE COMP_0283 1 100 0 1 BIT_MASK 0x0040 ECU_ADDRESS 0xFFFF3C3B READ_WRITE /end MEASUREMENT
/begin MEASUREMENT fDCVOTME "0:経験なし  1:経験あり" UBYTE COMP_0283 1 100 0 1 BIT_MASK 0x0020 ECU_ADDRESS 0xFFFF3C3B READ_WRITE /end MEASUREMENT
/begin MEASUREMENT fDDCESTCT "0:非成立  1:成立" UBYTE COMP_0283 1 100 0 1 BIT_MASK 0x0010 ECU_ADDRESS 0xFFFF3C3B READ_WRITE /end MEASUREMENT
/begin MEASUREMENT fDECELGO "0:不成立  1:成立" UBYTE COMP_0283 1 100 0 1 BIT_MASK 0x0008 ECU_ADDRESS 0xFFFF3C3B READ_WRITE /end MEASUREMENT
/begin MEASUREMENT fDERCTD "0:不成立  1:成立" UBYTE COMP_0283 1 100 0 1 BIT_MASK 0x0004 ECU_ADDRESS 0xFFFF3C3B READ_WRITE /end MEASUREMENT
/begin MEASUREMENT fDEVTMP0 "0:右記以外  1:DEVATMP≧DEVTMP0#" UBYTE COMP_0283 1 100 0 1 BIT_MASK 0x0002 ECU_ADDRESS 0xFFFF3C3B READ_WRITE /end MEASUREMENT
/begin MEASUREMENT fDEVTMP1 "0:右記以外  1:DEVATMP≧DEVTMP1#" UBYTE COMP_0283 1 100 0 1 BIT_MASK 0x0001 ECU_ADDRESS 0xFFFF3C3B READ_WRITE /end MEASUREMENT
/begin MEASUREMENT fDEVTMP2 "0:右記以外  1:DEVATMP≧DEVTMP2#" UBYTE COMP_0283 1 100 0 1 BIT_MASK 0x0080 ECU_ADDRESS 0xFFFF3C3C READ_WRITE /end MEASUREMENT
/begin MEASUREMENT fDGAKPCUT "0:右以外  1:ﾊﾟｰｼﾞ制御禁止要求" UBYTE COMP_0283 1 100 0 1 BIT_MASK 0x0040 ECU_ADDRESS 0xFFFF3C3C READ_WRITE /end MEASUREMENT
/begin MEASUREMENT fDGRAMADNG "0:RAM診断対象ｱﾄﾞﾚｽ格納ＲＡＭ_NG  1:RAM診断対象ｱﾄﾞﾚｽ格納ＲＡＭ_OK" UBYTE COMP_0283 1 100 0 1 BIT_MASK 0x0020 ECU_ADDRESS 0xFFFF3C3C READ_WRITE /end MEASUREMENT
/begin MEASUREMENT fDIGFAULT "0:故障なし  1:故障あり" UBYTE COMP_0283 1 100 0 1 BIT_MASK 0x0010 ECU_ADDRESS 0xFFFF3C3C READ_WRITE /end MEASUREMENT
/begin MEASUREMENT fDISA55 "0:EEPROM＿バッテリ放電電流積算モニ  1:EEPROM_バッテリ放電電流積算モニ" UBYTE COMP_0283 1 100 0 1 BIT_MASK 0x0008 ECU_ADDRESS 0xFFFF3C3C READ_WRITE /end MEASUREMENT
/begin MEASUREMENT fDISA55OL "0:EEPROM＿バッテリ放電電流積算モニ  1:EEPROM_バッテリ放電電流積算モニ" UBYTE COMP_0283 1 100 0 1 BIT_MASK 0x0004 ECU_ADDRESS 0xFFFF3C3C READ_WRITE /end MEASUREMENT
/begin MEASUREMENT fDISADIA0 "0:バッテリ放電電流積算モニタ出力値  1:バッテリ放電電流積算モニタ出力値" UBYTE COMP_0283 1 100 0 1 BIT_MASK 0x0002 ECU_ADDRESS 0xFFFF3C3C READ_WRITE /end MEASUREMENT
/begin MEASUREMENT fDISADIAG "0:バッテリ放電電流積算モニタ出力値  1:バッテリ放電電流積算モニタ出力値" UBYTE COMP_0283 1 100 0 1 BIT_MASK 0x0001 ECU_ADDRESS 0xFFFF3C3C READ_WRITE /end MEASUREMENT
/begin MEASUREMENT fDLTAFSOK "0:不成立  1:成立" UBYTE COMP_0283 1 100 0 1 BIT_MASK 0x0080 ECU_ADDRESS 0xFFFF3C3D READ_WRITE /end MEASUREMENT
/begin MEASUREMENT fDNORMALJ "0:判定未  1:正常判定(DC方式)" UBYTE COMP_0283 1 100 0 1 BIT_MASK 0x0040 ECU_ADDRESS 0xFFFF3C3D READ_WRITE /end MEASUREMENT
/begin MEASUREMENT fDRNCT "0:不成立  1:成立" UBYTE COMP_0283 1 100 0 1 BIT_MASK 0x0020 ECU_ADDRESS 0xFFFF3C3D READ_WRITE /end MEASUREMENT
/begin MEASUREMENT fDRNCTEND "0:不成立  1:成立" UBYTE COMP_0283 1 100 0 1 BIT_MASK 0x0010 ECU_ADDRESS 0xFFFF3C3D READ_WRITE /end MEASUREMENT
/begin MEASUREMENT fDRNCTON "0:不成立  1:成立" UBYTE COMP_0283 1 100 0 1 BIT_MASK 0x0008 ECU_ADDRESS 0xFFFF3C3D READ_WRITE /end MEASUREMENT
/begin MEASUREMENT fDRVMCHNG "0:右記以外  1:ペダル特性移行中" UBYTE COMP_0283 1 100 0 1 BIT_MASK 0x0004 ECU_ADDRESS 0xFFFF3C3D READ_WRITE /end MEASUREMENT
/begin MEASUREMENT fDRVMRAMP "0:右記以外  1:アクセル開度変化量リミッタ作動許" UBYTE COMP_0283 1 100 0 1 BIT_MASK 0x0002 ECU_ADDRESS 0xFFFF3C3D READ_WRITE /end MEASUREMENT
/begin MEASUREMENT fDRVTEHOS "0:不許可  1:許可" UBYTE COMP_0283 1 100 0 1 BIT_MASK 0x0001 ECU_ADDRESS 0xFFFF3C3D READ_WRITE /end MEASUREMENT
/begin MEASUREMENT fDRVTQAHY "0:右記以外  1:APOFSR＿＜＿DRVTQLAP#(ﾋｽﾃﾘｼｽ：-D" UBYTE COMP_0283 1 100 0 1 BIT_MASK 0x0080 ECU_ADDRESS 0xFFFF3C3E READ_WRITE /end MEASUREMENT
/begin MEASUREMENT fDRVTQLM "0:右記以外  1:トルクリミッタ作動許可" UBYTE COMP_0283 1 100 0 1 BIT_MASK 0x0040 ECU_ADDRESS 0xFFFF3C3E READ_WRITE /end MEASUREMENT
/begin MEASUREMENT fDSPCANNG "0:2000ms以内に受信  1:2000ms以上未受信" UBYTE COMP_0283 1 100 0 1 BIT_MASK 0x0020 ECU_ADDRESS 0xFFFF3C3E READ_WRITE /end MEASUREMENT
/begin MEASUREMENT fDSPDLINI "0:初回  1:初回以降" UBYTE COMP_0283 1 100 0 1 BIT_MASK 0x0010 ECU_ADDRESS 0xFFFF3C3E READ_WRITE /end MEASUREMENT
/begin MEASUREMENT fDTCLRPST "0:fDATACLR=0  1:fDATACLR=1" UBYTE COMP_0283 1 100 0 1 BIT_MASK 0x0008 ECU_ADDRESS 0xFFFF3C3E READ_WRITE /end MEASUREMENT
/begin MEASUREMENT fDTP1NG "0:TPS1NG,TP1NGH,TP1NGLの#FLGFS=0  1:ETPS1NG,TP1NGH,TP1NGLのいずれか" UBYTE COMP_0283 1 100 0 1 BIT_MASK 0x0004 ECU_ADDRESS 0xFFFF3C3E READ_WRITE /end MEASUREMENT
/begin MEASUREMENT fDTP2NG "0:TPS2NG,TP2NGH,TP2NGLの#FLGFS=0  1:ETPS2NG,TP2NGH,TP2NGLのいずれか" UBYTE COMP_0283 1 100 0 1 BIT_MASK 0x0002 ECU_ADDRESS 0xFFFF3C3E READ_WRITE /end MEASUREMENT
/begin MEASUREMENT fDTRPFLG "0:(d)条件不成立  1:(d)条件成立" UBYTE COMP_0283 1 100 0 1 BIT_MASK 0x0001 ECU_ADDRESS 0xFFFF3C3E READ_WRITE /end MEASUREMENT
/begin MEASUREMENT fDTVOPS "0:DTVO大  1:DTVO小" UBYTE COMP_0283 1 100 0 1 BIT_MASK 0x0080 ECU_ADDRESS 0xFFFF3C3F READ_WRITE /end MEASUREMENT
/begin MEASUREMENT fDUFAILAN "0:INJ_D/U低電圧系正常  1:INJ_D/U低電圧系故障" UBYTE COMP_0283 1 100 0 1 BIT_MASK 0x0040 ECU_ADDRESS 0xFFFF3C3F READ_WRITE /end MEASUREMENT
/begin MEASUREMENT fDUTYSET "0:不成立  1:成立" UBYTE COMP_0283 1 100 0 1 BIT_MASK 0x0020 ECU_ADDRESS 0xFFFF3C3F READ_WRITE /end MEASUREMENT
/begin MEASUREMENT fDVP0ST "0:演算済  1:演算要求" UBYTE COMP_0283 1 100 0 1 BIT_MASK 0x0010 ECU_ADDRESS 0xFFFF3C3F READ_WRITE /end MEASUREMENT
/begin MEASUREMENT fE02KIN "0:右記以外  1:φ0.02inchエバポリーク診断禁止中" UBYTE COMP_0283 1 100 0 1 BIT_MASK 0x0008 ECU_ADDRESS 0xFFFF3C3F READ_WRITE /end MEASUREMENT
/begin MEASUREMENT fE04KIN "0:右記以外  1:φ0.04inchエバポリーク診断禁止中" UBYTE COMP_0283 1 100 0 1 BIT_MASK 0x0004 ECU_ADDRESS 0xFFFF3C3F READ_WRITE /end MEASUREMENT
/begin MEASUREMENT fEARLY "0:早期化要求なし  1:早期化要求あり" UBYTE COMP_0283 1 100 0 1 BIT_MASK 0x0002 ECU_ADDRESS 0xFFFF3C3F READ_WRITE /end MEASUREMENT
/begin MEASUREMENT fECOAPOB1 "0:境界未満  1:境界以上状態" UBYTE COMP_0283 1 100 0 1 BIT_MASK 0x0001 ECU_ADDRESS 0xFFFF3C3F READ_WRITE /end MEASUREMENT
/begin MEASUREMENT fECOAPOB2 "0:境界未満  1:境界以上状態" UBYTE COMP_0283 1 100 0 1 BIT_MASK 0x0080 ECU_ADDRESS 0xFFFF3C40 READ_WRITE /end MEASUREMENT
/begin MEASUREMENT fECOMOFF "0:表示許可  1:非表示（ゼロ表示）" UBYTE COMP_0283 1 100 0 1 BIT_MASK 0x0040 ECU_ADDRESS 0xFFFF3C40 READ_WRITE /end MEASUREMENT
/begin MEASUREMENT fECOVSPB1 "0:境界未満  1:境界以上状態" UBYTE COMP_0283 1 100 0 1 BIT_MASK 0x0020 ECU_ADDRESS 0xFFFF3C40 READ_WRITE /end MEASUREMENT
/begin MEASUREMENT fECOVSPB2 "0:境界未満  1:境界以上状態" UBYTE COMP_0283 1 100 0 1 BIT_MASK 0x0010 ECU_ADDRESS 0xFFFF3C40 READ_WRITE /end MEASUREMENT
/begin MEASUREMENT fECOVSPB3 "0:境界未満  1:境界以上状態" UBYTE COMP_0283 1 100 0 1 BIT_MASK 0x0008 ECU_ADDRESS 0xFFFF3C40 READ_WRITE /end MEASUREMENT
/begin MEASUREMENT fEEPCHKM1 "0:処理移行未完  1:処理移行済み" UBYTE COMP_0283 1 100 0 1 BIT_MASK 0x0004 ECU_ADDRESS 0xFFFF3C40 READ_WRITE /end MEASUREMENT
/begin MEASUREMENT fEEPCLR1 "0:未完  1:完了" UBYTE COMP_0283 1 100 0 1 BIT_MASK 0x0002 ECU_ADDRESS 0xFFFF3C40 READ_WRITE /end MEASUREMENT
/begin MEASUREMENT fEEPINI1 "0:未完  1:完了" UBYTE COMP_0283 1 100 0 1 BIT_MASK 0x0001 ECU_ADDRESS 0xFFFF3C40 READ_WRITE /end MEASUREMENT
/begin MEASUREMENT fEEPINT1 "0:未完  1:完了" UBYTE COMP_0283 1 100 0 1 BIT_MASK 0x0080 ECU_ADDRESS 0xFFFF3C41 READ_WRITE /end MEASUREMENT
/begin MEASUREMENT fEEPINT4K "0:未完  1:完了" UBYTE COMP_0283 1 100 0 1 BIT_MASK 0x0040 ECU_ADDRESS 0xFFFF3C41 READ_WRITE /end MEASUREMENT
/begin MEASUREMENT fEEPQEND "0:TAS学習値EEPROM書込処理非完了  1:TAS学習値EEPROM書込処理完了" UBYTE COMP_0283 1 100 0 1 BIT_MASK 0x0020 ECU_ADDRESS 0xFFFF3C41 READ_WRITE /end MEASUREMENT
/begin MEASUREMENT fEEPRNG "0:EEPROM読み出しNGでない  1:EEPROM読み出しNG" UBYTE COMP_0283 1 100 0 1 BIT_MASK 0x0010 ECU_ADDRESS 0xFFFF3C41 READ_WRITE /end MEASUREMENT
/begin MEASUREMENT fEEPSUM1 "0:未完  1:完了" UBYTE COMP_0283 1 100 0 1 BIT_MASK 0x0008 ECU_ADDRESS 0xFFFF3C41 READ_WRITE /end MEASUREMENT
/begin MEASUREMENT fEEPW1ST_M "0:右記以外  1:1ショットデータサンプリング停止" UBYTE COMP_0283 1 100 0 1 BIT_MASK 0x0004 ECU_ADDRESS 0xFFFF3C41 READ_WRITE /end MEASUREMENT
/begin MEASUREMENT fEEPWNG "0:EEPROM書き込みNGでない  1:EEPROM書き込みNG" UBYTE COMP_0283 1 100 0 1 BIT_MASK 0x0002 ECU_ADDRESS 0xFFFF3C41 READ_WRITE /end MEASUREMENT
/begin MEASUREMENT fEEPWRT1 "0:未完  1:完了" UBYTE COMP_0283 1 100 0 1 BIT_MASK 0x0001 ECU_ADDRESS 0xFFFF3C41 READ_WRITE /end MEASUREMENT
/begin MEASUREMENT fEEPWSPL_M "0:右記以外  1:連続記録データサンプリング停止" UBYTE COMP_0283 1 100 0 1 BIT_MASK 0x0080 ECU_ADDRESS 0xFFFF3C42 READ_WRITE /end MEASUREMENT
/begin MEASUREMENT fEGEKNGJ "0:許可しない  1:許可する" UBYTE COMP_0283 1 100 0 1 BIT_MASK 0x0040 ECU_ADDRESS 0xFFFF3C42 READ_WRITE /end MEASUREMENT
/begin MEASUREMENT fEGRATRP "0:ｶｳﾝﾄ未済  1:ｶｳﾝﾄ済" UBYTE COMP_0283 1 100 0 1 BIT_MASK 0x0020 ECU_ADDRESS 0xFFFF3C42 READ_WRITE /end MEASUREMENT
/begin MEASUREMENT fEMFKNG "0:なし  1:あり" UBYTE COMP_0283 1 100 0 1 BIT_MASK 0x0010 ECU_ADDRESS 0xFFFF3C42 READ_WRITE /end MEASUREMENT
/begin MEASUREMENT fEMOKJG "0:不成立  1:成立" UBYTE COMP_0283 1 100 0 1 BIT_MASK 0x0008 ECU_ADDRESS 0xFFFF3C42 READ_WRITE /end MEASUREMENT
/begin MEASUREMENT fEMWCCT "0:なし  1:あり" UBYTE COMP_0283 1 100 0 1 BIT_MASK 0x0004 ECU_ADDRESS 0xFFFF3C42 READ_WRITE /end MEASUREMENT
/begin MEASUREMENT fENDJ "0:非完了  1:完了" UBYTE COMP_0283 1 100 0 1 BIT_MASK 0x0002 ECU_ADDRESS 0xFFFF3C42 READ_WRITE /end MEASUREMENT
/begin MEASUREMENT fENGSPON "0:ENG要求FASTトルクなし  1:ENG要求FASTトルクあり" UBYTE COMP_0283 1 100 0 1 BIT_MASK 0x0080 ECU_ADDRESS 0xFFFF3C43 READ_WRITE /end MEASUREMENT
/begin MEASUREMENT fEONVDOK "0:EONVOK判定無  1:EONVOK判定有" UBYTE COMP_0283 1 100 0 1 BIT_MASK 0x0040 ECU_ADDRESS 0xFFFF3C43 READ_WRITE /end MEASUREMENT
/begin MEASUREMENT fEONVGO "0:統合化診断EONV実行しない  1:統合化診断EONV実行する" UBYTE COMP_0283 1 100 0 1 BIT_MASK 0x0020 ECU_ADDRESS 0xFFFF3C43 READ_WRITE /end MEASUREMENT
/begin MEASUREMENT fEONVIMAG "0:統合化診断EONV仮想診断実行しない  1:統合化診断EONV仮想診断実行する" UBYTE COMP_0283 1 100 0 1 BIT_MASK 0x0010 ECU_ADDRESS 0xFFFF3C43 READ_WRITE /end MEASUREMENT
/begin MEASUREMENT fEPBPCRNG "0:ＮＧでない  1:ＮＧ" UBYTE COMP_0283 1 100 0 1 BIT_MASK 0x0008 ECU_ADDRESS 0xFFFF3C43 READ_WRITE /end MEASUREMENT
/begin MEASUREMENT fEPBPPMT "0:不成立  1:成立" UBYTE COMP_0283 1 100 0 1 BIT_MASK 0x0004 ECU_ADDRESS 0xFFFF3C43 READ_WRITE /end MEASUREMENT
/begin MEASUREMENT fEPCK4KM1 "0:処理移行未完  1:処理移行済み" UBYTE COMP_0283 1 100 0 1 BIT_MASK 0x0002 ECU_ADDRESS 0xFFFF3C43 READ_WRITE /end MEASUREMENT
/begin MEASUREMENT fEPCRSET "0:EEP-ROM診断ﾘｾｯﾄ要求なし  1:EEP-ROM診断ﾘｾｯﾄ処理中" UBYTE COMP_0283 1 100 0 1 BIT_MASK 0x0001 ECU_ADDRESS 0xFFFF3C43 READ_WRITE /end MEASUREMENT
/begin MEASUREMENT fEPLRSET "0:学習処理ﾘｾｯﾄ要求なし  1:学習処理ﾘｾｯﾄ処理中" UBYTE COMP_0283 1 100 0 1 BIT_MASK 0x0080 ECU_ADDRESS 0xFFFF3C44 READ_WRITE /end MEASUREMENT
/begin MEASUREMENT fEPLRUN "0:学習処理非実行  1:学習処理実行中" UBYTE COMP_0283 1 100 0 1 BIT_MASK 0x0040 ECU_ADDRESS 0xFFFF3C44 READ_WRITE /end MEASUREMENT
/begin MEASUREMENT fEPRNGDO "0:ライン圧センサ診断オープンNG判定  1:ライン圧センサ診断オープンNG判定" UBYTE COMP_0283 1 100 0 1 BIT_MASK 0x0020 ECU_ADDRESS 0xFFFF3C44 READ_WRITE /end MEASUREMENT
/begin MEASUREMENT fEPRNGDS "0:ライン圧センサ診断ショートNG判定  1:ライン圧センサ診断ショートNG判定" UBYTE COMP_0283 1 100 0 1 BIT_MASK 0x0010 ECU_ADDRESS 0xFFFF3C44 READ_WRITE /end MEASUREMENT
/begin MEASUREMENT fEPTAS "0:TAS学習値EEPROM書込非処理中  1:TAS学習値EEPROM書込処理中" UBYTE COMP_0283 1 100 0 1 BIT_MASK 0x0008 ECU_ADDRESS 0xFFFF3C44 READ_WRITE /end MEASUREMENT
/begin MEASUREMENT fERJOKOPE "0:未判定  1:正常判定" UBYTE COMP_0283 1 100 0 1 BIT_MASK 0x0004 ECU_ADDRESS 0xFFFF3C44 READ_WRITE /end MEASUREMENT
/begin MEASUREMENT fESPLNKNG "0:OK  1:NG" UBYTE COMP_0283 1 100 0 1 BIT_MASK 0x0002 ECU_ADDRESS 0xFFFF3C44 READ_WRITE /end MEASUREMENT
/begin MEASUREMENT fESTATUD "0:保持  1:更新" UBYTE COMP_0283 1 100 0 1 BIT_MASK 0x0001 ECU_ADDRESS 0xFFFF3C44 READ_WRITE /end MEASUREMENT
/begin MEASUREMENT fESTCTD "0:診断不許可  1:診断許可" UBYTE COMP_0283 1 100 0 1 BIT_MASK 0x0080 ECU_ADDRESS 0xFFFF3C45 READ_WRITE /end MEASUREMENT
/begin MEASUREMENT fESTRP "0:ｴﾝｼﾞﾝ始動後TRPｶｳﾝﾀｶｳﾝﾄしていない  1:ｴﾝｼﾞﾝ始動後TRPｶｳﾝﾀｶｳﾝﾄした" UBYTE COMP_0283 1 100 0 1 BIT_MASK 0x0040 ECU_ADDRESS 0xFFFF3C45 READ_WRITE /end MEASUREMENT
/begin MEASUREMENT fESTRP1 "0:ｶｳﾝﾄｱｯﾌﾟ未終了  1:ｶｳﾝﾄｱｯﾌﾟ終了" UBYTE COMP_0283 1 100 0 1 BIT_MASK 0x0020 ECU_ADDRESS 0xFFFF3C45 READ_WRITE /end MEASUREMENT
/begin MEASUREMENT fESTRP3EA "0:vVTEATRP1.vVTEATRP2＿ｶｳﾝﾄｱｯﾌﾟ未  1:vVTEATRP1.vVTEATRP2＿ｶｳﾝﾄｱｯﾌﾟ経" UBYTE COMP_0283 1 100 0 1 BIT_MASK 0x0010 ECU_ADDRESS 0xFFFF3C45 READ_WRITE /end MEASUREMENT
/begin MEASUREMENT fESTRP3EB "0:vVTEBTRP1.vVTEBTRP2＿ｶｳﾝﾄｱｯﾌﾟ未  1:vVTEBTRP1.vVTEBTRP2＿ｶｳﾝﾄｱｯﾌﾟ経" UBYTE COMP_0283 1 100 0 1 BIT_MASK 0x0008 ECU_ADDRESS 0xFFFF3C45 READ_WRITE /end MEASUREMENT
/begin MEASUREMENT fESTRP3IA "0:vVTIATRP1.vVTIATRP2＿ｶｳﾝﾄｱｯﾌﾟ未  1:vVTIATRP1.vVTIATRP2＿ｶｳﾝﾄｱｯﾌﾟ経" UBYTE COMP_0283 1 100 0 1 BIT_MASK 0x0004 ECU_ADDRESS 0xFFFF3C45 READ_WRITE /end MEASUREMENT
/begin MEASUREMENT fESTRP3IB "0:vVTIBTRP1.vVTIBTRP2＿ｶｳﾝﾄｱｯﾌﾟ未  1:vVTIBTRP1.vVTIBTRP2＿ｶｳﾝﾄｱｯﾌﾟ経" UBYTE COMP_0283 1 100 0 1 BIT_MASK 0x0002 ECU_ADDRESS 0xFFFF3C45 READ_WRITE /end MEASUREMENT
/begin MEASUREMENT fESTRP4 "0:ｶｳﾝﾄｱｯﾌﾟ未終了  1:ｶｳﾝﾄｱｯﾌﾟ終了" UBYTE COMP_0283 1 100 0 1 BIT_MASK 0x0001 ECU_ADDRESS 0xFFFF3C45 READ_WRITE /end MEASUREMENT
/begin MEASUREMENT fESTRP51 "0:ｴﾝｼﾞﾝ始動後TRPｶｳﾝﾀｶｳﾝﾄしていない  1:ｴﾝｼﾞﾝ始動後TRPｶｳﾝﾀｶｳﾝﾄした" UBYTE COMP_0283 1 100 0 1 BIT_MASK 0x0080 ECU_ADDRESS 0xFFFF3C46 READ_WRITE /end MEASUREMENT
/begin MEASUREMENT fESTRP52 "0:ｴﾝｼﾞﾝ始動後TRPｶｳﾝﾀｶｳﾝﾄしていない  1:ｴﾝｼﾞﾝ始動後TRPｶｳﾝﾀｶｳﾝﾄした" UBYTE COMP_0283 1 100 0 1 BIT_MASK 0x0040 ECU_ADDRESS 0xFFFF3C46 READ_WRITE /end MEASUREMENT
/begin MEASUREMENT fESTRP53 "0:ｴﾝｼﾞﾝ始動後TRPｶｳﾝﾀｶｳﾝﾄしていない  1:ｴﾝｼﾞﾝ始動後TRPｶｳﾝﾀｶｳﾝﾄした" UBYTE COMP_0283 1 100 0 1 BIT_MASK 0x0020 ECU_ADDRESS 0xFFFF3C46 READ_WRITE /end MEASUREMENT
/begin MEASUREMENT fESTRP54 "0:IGNSW_ON後RESTRP2のｶｳﾝﾄｱｯﾌﾟ未終  1:IGNSW_ON後RESTRP2のｶｳﾝﾄｱｯﾌﾟ終了" UBYTE COMP_0283 1 100 0 1 BIT_MASK 0x0010 ECU_ADDRESS 0xFFFF3C46 READ_WRITE /end MEASUREMENT
/begin MEASUREMENT fESTRP61 "0:ｶｳﾝﾄｱｯﾌﾟ未終了  1:ｶｳﾝﾄｱｯﾌﾟ終了" UBYTE COMP_0283 1 100 0 1 BIT_MASK 0x0008 ECU_ADDRESS 0xFFFF3C46 READ_WRITE /end MEASUREMENT
/begin MEASUREMENT fESTRPB "0:ｶｳﾝﾄｱｯﾌﾟ未終了  1:ｶｳﾝﾄｱｯﾌﾟ終了" UBYTE COMP_0283 1 100 0 1 BIT_MASK 0x0004 ECU_ADDRESS 0xFFFF3C46 READ_WRITE /end MEASUREMENT
/begin MEASUREMENT fESTRPC "0:ｶｳﾝﾄｱｯﾌﾟ未終了  1:ｶｳﾝﾄｱｯﾌﾟ終了" UBYTE COMP_0283 1 100 0 1 BIT_MASK 0x0002 ECU_ADDRESS 0xFFFF3C46 READ_WRITE /end MEASUREMENT
/begin MEASUREMENT fETCFAULT "0:正常  1:異常" UBYTE COMP_0283 1 100 0 1 BIT_MASK 0x0001 ECU_ADDRESS 0xFFFF3C46 READ_WRITE /end MEASUREMENT
/begin MEASUREMENT fETCOFF "0:非実行  1:実行" UBYTE COMP_0283 1 100 0 1 BIT_MASK 0x0080 ECU_ADDRESS 0xFFFF3C47 READ_WRITE /end MEASUREMENT
/begin MEASUREMENT fETCON2 "0:禁止状態  1:許可状態" UBYTE COMP_0283 1 100 0 1 BIT_MASK 0x0040 ECU_ADDRESS 0xFFFF3C47 READ_WRITE /end MEASUREMENT
/begin MEASUREMENT fETCSTV "0:VBAVE2<mETCSTV(ﾋｽ-ETCVHYS#)  1:VBAVE2>=mETCSTV(ﾋｽ-ETCVHYS#)" UBYTE COMP_0283 1 100 0 1 BIT_MASK 0x0020 ECU_ADDRESS 0xFFFF3C47 READ_WRITE /end MEASUREMENT
/begin MEASUREMENT fETEVSTP "0:要求無し  1:要求有り" UBYTE COMP_0283 1 100 0 1 BIT_MASK 0x0010 ECU_ADDRESS 0xFFFF3C47 READ_WRITE /end MEASUREMENT
/begin MEASUREMENT fETKBSTP "0:要求無し  1:要求有り" UBYTE COMP_0283 1 100 0 1 BIT_MASK 0x0008 ECU_ADDRESS 0xFFFF3C47 READ_WRITE /end MEASUREMENT
/begin MEASUREMENT fETKBSTPd "0:要求無し  1:要求有り" UBYTE COMP_0283 1 100 0 1 BIT_MASK 0x0004 ECU_ADDRESS 0xFFFF3C47 READ_WRITE /end MEASUREMENT
/begin MEASUREMENT fETRPFLG "0:(e)条件不成立  1:(e)条件成立" UBYTE COMP_0283 1 100 0 1 BIT_MASK 0x0002 ECU_ADDRESS 0xFFFF3C47 READ_WRITE /end MEASUREMENT
/begin MEASUREMENT fETSACKSR "0:OK  1:NG" UBYTE COMP_0283 1 100 0 1 BIT_MASK 0x0001 ECU_ADDRESS 0xFFFF3C47 READ_WRITE /end MEASUREMENT
/begin MEASUREMENT fETSIVDNG "0:OK  1:NG" UBYTE COMP_0283 1 100 0 1 BIT_MASK 0x0080 ECU_ADDRESS 0xFFFF3C48 READ_WRITE /end MEASUREMENT
/begin MEASUREMENT fETSIVDWA "0:ETSInvalidトルク要求非ワーニング  1:ETSInvalidトルク要求ワーニング" UBYTE COMP_0283 1 100 0 1 BIT_MASK 0x0040 ECU_ADDRESS 0xFFFF3C48 READ_WRITE /end MEASUREMENT
/begin MEASUREMENT fETSLNKCA "0:OK  1:NG" UBYTE COMP_0283 1 100 0 1 BIT_MASK 0x0020 ECU_ADDRESS 0xFFFF3C48 READ_WRITE /end MEASUREMENT
/begin MEASUREMENT fETSLNKNG "0:OK  1:NG" UBYTE COMP_0283 1 100 0 1 BIT_MASK 0x0010 ECU_ADDRESS 0xFFFF3C48 READ_WRITE /end MEASUREMENT
/begin MEASUREMENT fEVCNJUDG "0:ﾊﾟｰｼﾞｺﾝﾄﾛｰﾙﾊﾞﾙﾌﾞ機能診断許可条件  1:ﾊﾟｰｼﾞｺﾝﾄﾛｰﾙﾊﾞﾙﾌﾞ機能診断許可条件" UBYTE COMP_0283 1 100 0 1 BIT_MASK 0x0008 ECU_ADDRESS 0xFFFF3C48 READ_WRITE /end MEASUREMENT
/begin MEASUREMENT fEVCNNGD "0:パージコントロールバルブ診断NGで  1:パージコントロール診断NG" UBYTE COMP_0283 1 100 0 1 BIT_MASK 0x0004 ECU_ADDRESS 0xFFFF3C48 READ_WRITE /end MEASUREMENT
/begin MEASUREMENT fEVCNOKD "0:パージコントロールバルブ診断OKで  1:パージコントロール診断OK" UBYTE COMP_0283 1 100 0 1 BIT_MASK 0x0002 ECU_ADDRESS 0xFFFF3C48 READ_WRITE /end MEASUREMENT
/begin MEASUREMENT fEVGEEND "0:診断未終了  1:診断終了" UBYTE COMP_0283 1 100 0 1 BIT_MASK 0x0001 ECU_ADDRESS 0xFFFF3C48 READ_WRITE /end MEASUREMENT
/begin MEASUREMENT fEVGROK "0:診断未終了/またはNG  1:OK判定" UBYTE COMP_0283 1 100 0 1 BIT_MASK 0x0080 ECU_ADDRESS 0xFFFF3C49 READ_WRITE /end MEASUREMENT
/begin MEASUREMENT fEVNGECT "0:経験なし  1:経験あり" UBYTE COMP_0283 1 100 0 1 BIT_MASK 0x0040 ECU_ADDRESS 0xFFFF3C49 READ_WRITE /end MEASUREMENT
/begin MEASUREMENT fEVP2JUG "0:－  1:－" UBYTE COMP_0283 1 100 0 1 BIT_MASK 0x0020 ECU_ADDRESS 0xFFFF3C49 READ_WRITE /end MEASUREMENT
/begin MEASUREMENT fEVPCANCEL "0:ｷｬﾝｾﾙ無  1:ｷｬﾝｾﾙ有" UBYTE COMP_0283 1 100 0 1 BIT_MASK 0x0010 ECU_ADDRESS 0xFFFF3C49 READ_WRITE /end MEASUREMENT
/begin MEASUREMENT fEVPDGNED "0:診断未了  1:診断終了" UBYTE COMP_0283 1 100 0 1 BIT_MASK 0x0008 ECU_ADDRESS 0xFFFF3C49 READ_WRITE /end MEASUREMENT
/begin MEASUREMENT fEVPDGNEN "0:診断禁止  1:診断許可" UBYTE COMP_0283 1 100 0 1 BIT_MASK 0x0004 ECU_ADDRESS 0xFFFF3C49 READ_WRITE /end MEASUREMENT
/begin MEASUREMENT fEVPNBCAN "0:ｴﾊﾞﾎﾟﾘｰｸ診断統括NBCAN不成立  1:ｴﾊﾞﾎﾟﾘｰｸ診断統括NBCAN成立" UBYTE COMP_0283 1 100 0 1 BIT_MASK 0x0002 ECU_ADDRESS 0xFFFF3C49 READ_WRITE /end MEASUREMENT
/begin MEASUREMENT fEVPRSIN "0:初期化済  1:初期化要求" UBYTE COMP_0283 1 100 0 1 BIT_MASK 0x0001 ECU_ADDRESS 0xFFFF3C49 READ_WRITE /end MEASUREMENT
/begin MEASUREMENT fEVPS1NG "0:右記以外  1:機能診断(3)一発NGの時" UBYTE COMP_0283 1 100 0 1 BIT_MASK 0x0080 ECU_ADDRESS 0xFFFF3C4A READ_WRITE /end MEASUREMENT
/begin MEASUREMENT fEVSCTEND "0:未終了  1:1回演算終了" UBYTE COMP_0283 1 100 0 1 BIT_MASK 0x0040 ECU_ADDRESS 0xFFFF3C4A READ_WRITE /end MEASUREMENT
/begin MEASUREMENT fEVSGEOK "0:許可しない  1:許可する" UBYTE COMP_0283 1 100 0 1 BIT_MASK 0x0020 ECU_ADDRESS 0xFFFF3C4A READ_WRITE /end MEASUREMENT
/begin MEASUREMENT fEVSKOK "0:許可しない  1:許可する" UBYTE COMP_0283 1 100 0 1 BIT_MASK 0x0010 ECU_ADDRESS 0xFFFF3C4A READ_WRITE /end MEASUREMENT
/begin MEASUREMENT fEVSLDOK "0:ｴﾊﾞﾎﾟﾘｰｸ診断OK判定無  1:ｴﾊﾞﾎﾟﾘｰｸ診断OK判定有" UBYTE COMP_0283 1 100 0 1 BIT_MASK 0x0008 ECU_ADDRESS 0xFFFF3C4A READ_WRITE /end MEASUREMENT
/begin MEASUREMENT fEVSNG "0:NG不成立  1:NG成立" UBYTE COMP_0283 1 100 0 1 BIT_MASK 0x0004 ECU_ADDRESS 0xFFFF3C4A READ_WRITE /end MEASUREMENT
/begin MEASUREMENT fEVSNGTP "0:仮NG判定不成立  1:仮NG判定成立" UBYTE COMP_0283 1 100 0 1 BIT_MASK 0x0002 ECU_ADDRESS 0xFFFF3C4A READ_WRITE /end MEASUREMENT
/begin MEASUREMENT fF04IKOU "0:右記以外  1:0.02inchエバポリーク診断から0.04" UBYTE COMP_0283 1 100 0 1 BIT_MASK 0x0001 ECU_ADDRESS 0xFFFF3C4A READ_WRITE /end MEASUREMENT
/begin MEASUREMENT fFAARAS "0:記憶なし  1:記憶あり" UBYTE COMP_0283 1 100 0 1 BIT_MASK 0x0080 ECU_ADDRESS 0xFFFF3C4B READ_WRITE /end MEASUREMENT
/begin MEASUREMENT fFABRSLT "0:機能要求油圧正常判定  1:機能要求油圧異常判定" UBYTE COMP_0283 1 100 0 1 BIT_MASK 0x0040 ECU_ADDRESS 0xFFFF3C4B READ_WRITE /end MEASUREMENT
/begin MEASUREMENT fFABRSNG "0:メタル保障油圧正常判定  1:メタル保障油圧異常判定" UBYTE COMP_0283 1 100 0 1 BIT_MASK 0x0020 ECU_ADDRESS 0xFFFF3C4B READ_WRITE /end MEASUREMENT
/begin MEASUREMENT fFAFASOK "0:不成立  1:成立" UBYTE COMP_0283 1 100 0 1 BIT_MASK 0x0010 ECU_ADDRESS 0xFFFF3C4B READ_WRITE /end MEASUREMENT
/begin MEASUREMENT fFAFHMAXS1 "0:A/Fｾﾝｻﾋｰﾀﾊﾟﾗﾒｰﾀｽﾄｱ中止  1:A/Fｾﾝｻﾋｰﾀﾊﾟﾗﾒｰﾀｽﾄｱ実行" UBYTE COMP_0283 1 100 0 1 BIT_MASK 0x0004 ECU_ADDRESS 0xFFFF3C4B READ_WRITE /end MEASUREMENT
/begin MEASUREMENT fFAFHMINS1 "0:A/Fｾﾝｻﾋｰﾀﾊﾟﾗﾒｰﾀｽﾄｱ中止  1:A/Fｾﾝｻﾋｰﾀﾊﾟﾗﾒｰﾀｽﾄｱ実行" UBYTE COMP_0283 1 100 0 1 BIT_MASK 0x0002 ECU_ADDRESS 0xFFFF3C4B READ_WRITE /end MEASUREMENT
/begin MEASUREMENT fFANHPFNC "0:不成立  1:成立" UBYTE COMP_0283 1 100 0 1 BIT_MASK 0x0001 ECU_ADDRESS 0xFFFF3C4B READ_WRITE /end MEASUREMENT
/begin MEASUREMENT fFAPLT2H "0:2速ｽﾄｰﾙﾄﾙｸﾀﾞｳﾝ制御ﾘｶﾊﾞｰ終了  1:2速ｽﾄｰﾙﾄﾙｸﾀﾞｳﾝ制御ﾘｶﾊﾞｰ中" UBYTE COMP_0283 1 100 0 1 BIT_MASK 0x0080 ECU_ADDRESS 0xFFFF3C4C READ_WRITE /end MEASUREMENT
/begin MEASUREMENT fFAPLT3H "0:1速ｽﾄｰﾙﾄﾙｸﾀﾞｳﾝ制御ﾘｶﾊﾞｰ終了  1:1速ｽﾄｰﾙﾄﾙｸﾀﾞｳﾝ制御ﾘｶﾊﾞｰ中" UBYTE COMP_0283 1 100 0 1 BIT_MASK 0x0040 ECU_ADDRESS 0xFFFF3C4C READ_WRITE /end MEASUREMENT
/begin MEASUREMENT fFAPLT4H "0:ﾘﾊﾞｰｽｽﾄｰﾙﾄﾙｸﾀﾞｳﾝ制御ﾘｶﾊﾞｰ終了  1:ﾘﾊﾞｰｽｽﾄｰﾙﾄﾙｸﾀﾞｳﾝ制御ﾘｶﾊﾞｰ中" UBYTE COMP_0283 1 100 0 1 BIT_MASK 0x0020 ECU_ADDRESS 0xFFFF3C4C READ_WRITE /end MEASUREMENT
/begin MEASUREMENT fFAPLTAH "0:全域トルクダウン制御ﾘｶﾊﾞｰ終了  1:全域トルクダウン制御ﾘｶﾊﾞｰ中" UBYTE COMP_0283 1 100 0 1 BIT_MASK 0x0010 ECU_ADDRESS 0xFFFF3C4C READ_WRITE /end MEASUREMENT
/begin MEASUREMENT fFASCD "0:条件不成立  1:条件成立" UBYTE COMP_0283 1 100 0 1 BIT_MASK 0x0008 ECU_ADDRESS 0xFFFF3C4C READ_WRITE /end MEASUREMENT
/begin MEASUREMENT fFASCD1 "0:条件不成立  1:条件成立" UBYTE COMP_0283 1 100 0 1 BIT_MASK 0x0004 ECU_ADDRESS 0xFFFF3C4C READ_WRITE /end MEASUREMENT
/begin MEASUREMENT fFASCD2 "0:条件不成立  1:条件成立" UBYTE COMP_0283 1 100 0 1 BIT_MASK 0x0002 ECU_ADDRESS 0xFFFF3C4C READ_WRITE /end MEASUREMENT
/begin MEASUREMENT fFASCD3 "0:条件不成立  1:条件成立" UBYTE COMP_0283 1 100 0 1 BIT_MASK 0x0001 ECU_ADDRESS 0xFFFF3C4C READ_WRITE /end MEASUREMENT
/begin MEASUREMENT fFASMCC "0:不成立  1:成立" UBYTE COMP_0283 1 100 0 1 BIT_MASK 0x0080 ECU_ADDRESS 0xFFFF3C4D READ_WRITE /end MEASUREMENT
/begin MEASUREMENT fFASMCF "0:不成立  1:成立" UBYTE COMP_0283 1 100 0 1 BIT_MASK 0x0040 ECU_ADDRESS 0xFFFF3C4D READ_WRITE /end MEASUREMENT
/begin MEASUREMENT fFATCDN21 "0:右記以外  1:ENINNG診断許可条件成立" UBYTE COMP_0283 1 100 0 1 BIT_MASK 0x0020 ECU_ADDRESS 0xFFFF3C4D READ_WRITE /end MEASUREMENT
/begin MEASUREMENT fFATCDN31 "0:右記以外  1:ENINNG診断許可条件成立" UBYTE COMP_0283 1 100 0 1 BIT_MASK 0x0010 ECU_ADDRESS 0xFFFF3C4D READ_WRITE /end MEASUREMENT
/begin MEASUREMENT fFATCDN42 "0:右記以外  1:ENINNG診断許可条件成立" UBYTE COMP_0283 1 100 0 1 BIT_MASK 0x0008 ECU_ADDRESS 0xFFFF3C4D READ_WRITE /end MEASUREMENT
/begin MEASUREMENT fFATIJOC "0:右記以外  1:通信異常" UBYTE COMP_0283 1 100 0 1 BIT_MASK 0x0004 ECU_ADDRESS 0xFFFF3C4D READ_WRITE /end MEASUREMENT
/begin MEASUREMENT fFAULTJ "0:判定未  1:故障判定(通常判定方式)" UBYTE COMP_0283 1 100 0 1 BIT_MASK 0x0002 ECU_ADDRESS 0xFFFF3C4D READ_WRITE /end MEASUREMENT
/begin MEASUREMENT fFAULTS "0:判定未  1:故障信号有(通常判定方式)" UBYTE COMP_0283 1 100 0 1 BIT_MASK 0x0001 ECU_ADDRESS 0xFFFF3C4D READ_WRITE /end MEASUREMENT
/begin MEASUREMENT fFBEVPS "0:右記以外  1:プルダウンF/B制御要求によるEVPS" UBYTE COMP_0283 1 100 0 1 BIT_MASK 0x0080 ECU_ADDRESS 0xFFFF3C4E READ_WRITE /end MEASUREMENT
/begin MEASUREMENT fFBEVPS4 "0:右記以外  1:プルダウンF/B制御要求によるEVPS_" UBYTE COMP_0283 1 100 0 1 BIT_MASK 0x0040 ECU_ADDRESS 0xFFFF3C4E READ_WRITE /end MEASUREMENT
/begin MEASUREMENT fFBIADDNG "0:加算許可  1:加算禁止" UBYTE COMP_0283 1 100 0 1 BIT_MASK 0x0020 ECU_ADDRESS 0xFFFF3C4E READ_WRITE /end MEASUREMENT
/begin MEASUREMENT fFBISUBNG "0:減算許可  1:減算禁止" UBYTE COMP_0283 1 100 0 1 BIT_MASK 0x0010 ECU_ADDRESS 0xFFFF3C4E READ_WRITE /end MEASUREMENT
/begin MEASUREMENT fFBJUDG "0:ｽﾛｯﾄﾙF/B系異常診断許可  1:ｽﾛｯﾄﾙF/B系異常診断禁止" UBYTE COMP_0283 1 100 0 1 BIT_MASK 0x0008 ECU_ADDRESS 0xFFFF3C4E READ_WRITE /end MEASUREMENT
/begin MEASUREMENT fFBSMCE "0:不成立  1:成立" UBYTE COMP_0283 1 100 0 1 BIT_MASK 0x0004 ECU_ADDRESS 0xFFFF3C4E READ_WRITE /end MEASUREMENT
/begin MEASUREMENT fFBSMCF "0:不成立  1:成立" UBYTE COMP_0283 1 100 0 1 BIT_MASK 0x0002 ECU_ADDRESS 0xFFFF3C4E READ_WRITE /end MEASUREMENT
/begin MEASUREMENT fFCATCT "0:なし  1:あり" UBYTE COMP_0283 1 100 0 1 BIT_MASK 0x0001 ECU_ADDRESS 0xFFFF3C4E READ_WRITE /end MEASUREMENT
/begin MEASUREMENT fFCCTRLON "0:ｶｯﾄﾘｶﾊﾞ非対応  1:ｶｯﾄﾘｶﾊﾞ対応中" UBYTE COMP_0283 1 100 0 1 BIT_MASK 0x0080 ECU_ADDRESS 0xFFFF3C4F READ_WRITE /end MEASUREMENT
/begin MEASUREMENT fFCDTCT3 "0:右記以外  1:ITAFSCHR≧FCDTCT#" UBYTE COMP_0283 1 100 0 1 BIT_MASK 0x0040 ECU_ADDRESS 0xFFFF3C4F READ_WRITE /end MEASUREMENT
/begin MEASUREMENT fFCHGOK "0:バッテリ充電未完了  1:バッテリ充電完了" UBYTE COMP_0283 1 100 0 1 BIT_MASK 0x0020 ECU_ADDRESS 0xFFFF3C4F READ_WRITE /end MEASUREMENT
/begin MEASUREMENT fFCIN "0:ﾘｾｯﾄ要求無し  1:ﾘｾｯﾄ要求あり" UBYTE COMP_0283 1 100 0 1 BIT_MASK 0x0010 ECU_ADDRESS 0xFFFF3C4F READ_WRITE /end MEASUREMENT
/begin MEASUREMENT fFCSMCE "0:不成立  1:成立" UBYTE COMP_0283 1 100 0 1 BIT_MASK 0x0008 ECU_ADDRESS 0xFFFF3C4F READ_WRITE /end MEASUREMENT
/begin MEASUREMENT fFCSMCF "0:不成立  1:成立" UBYTE COMP_0283 1 100 0 1 BIT_MASK 0x0004 ECU_ADDRESS 0xFFFF3C4F READ_WRITE /end MEASUREMENT
/begin MEASUREMENT fFCTARA "0:領域外  1:領域内" UBYTE COMP_0283 1 100 0 1 BIT_MASK 0x0002 ECU_ADDRESS 0xFFFF3C4F READ_WRITE /end MEASUREMENT
/begin MEASUREMENT fFCVBVST "0:診断でない  1:診断中" UBYTE COMP_0283 1 100 0 1 BIT_MASK 0x0001 ECU_ADDRESS 0xFFFF3C4F READ_WRITE /end MEASUREMENT
/begin MEASUREMENT fFCVTCST "0:C-VTC始動時制御許可条件不成立  1:C-VTC始動時制御許可条件成立" UBYTE COMP_0283 1 100 0 1 BIT_MASK 0x0080 ECU_ADDRESS 0xFFFF3C50 READ_WRITE /end MEASUREMENT
/begin MEASUREMENT fFDCV1ST "0:診断でない  1:診断中" UBYTE COMP_0283 1 100 0 1 BIT_MASK 0x0040 ECU_ADDRESS 0xFFFF3C50 READ_WRITE /end MEASUREMENT
/begin MEASUREMENT fFDCV2END "0:機能診断(2)未終了  1:機能診断(2)終了" UBYTE COMP_0283 1 100 0 1 BIT_MASK 0x0020 ECU_ADDRESS 0xFFFF3C50 READ_WRITE /end MEASUREMENT
/begin MEASUREMENT fFDCV3END "0:機能診断(3)未終了  1:機能診断(3)終了" UBYTE COMP_0283 1 100 0 1 BIT_MASK 0x0010 ECU_ADDRESS 0xFFFF3C50 READ_WRITE /end MEASUREMENT
/begin MEASUREMENT fFDCVOPN "0:右記以外  1:ライン圧モニタ中" UBYTE COMP_0283 1 100 0 1 BIT_MASK 0x0008 ECU_ADDRESS 0xFFFF3C50 READ_WRITE /end MEASUREMENT
/begin MEASUREMENT fFDCVOPN2 "0:右記以外  1:ライン圧モニタ中" UBYTE COMP_0283 1 100 0 1 BIT_MASK 0x0004 ECU_ADDRESS 0xFFFF3C50 READ_WRITE /end MEASUREMENT
/begin MEASUREMENT fFDENST_M "0:非エンスト  1:エンスト" UBYTE COMP_0283 1 100 0 1 BIT_MASK 0x0002 ECU_ADDRESS 0xFFFF3C50 READ_WRITE /end MEASUREMENT
/begin MEASUREMENT fFDEPWRT_M "0:右記以外  1:FFD記録開始トリガ" UBYTE COMP_0283 1 100 0 1 BIT_MASK 0x0001 ECU_ADDRESS 0xFFFF3C50 READ_WRITE /end MEASUREMENT
/begin MEASUREMENT fFDGSTD "0:自己診断機能禁止  1:自己診断機能許可" UBYTE COMP_0283 1 100 0 1 BIT_MASK 0x0080 ECU_ADDRESS 0xFFFF3C51 READ_WRITE /end MEASUREMENT
/begin MEASUREMENT fFDINTVAL "0:許可  1:禁止" UBYTE COMP_0283 1 100 0 1 BIT_MASK 0x0040 ECU_ADDRESS 0xFFFF3C51 READ_WRITE /end MEASUREMENT
/begin MEASUREMENT fFDIRE6 "0:右記以外  1:判定後制御DIREI6使用" UBYTE COMP_0283 1 100 0 1 BIT_MASK 0x0020 ECU_ADDRESS 0xFFFF3C51 READ_WRITE /end MEASUREMENT
/begin MEASUREMENT fFDJGCT "0:不成立  1:成立" UBYTE COMP_0283 1 100 0 1 BIT_MASK 0x0010 ECU_ADDRESS 0xFFFF3C51 READ_WRITE /end MEASUREMENT
/begin MEASUREMENT fFDLEPX1 "0:DLEPX1モニタしていない  1:DLEPX1モニタした" UBYTE COMP_0283 1 100 0 1 BIT_MASK 0x0008 ECU_ADDRESS 0xFFFF3C51 READ_WRITE /end MEASUREMENT
/begin MEASUREMENT fFDLEPX2 "0:モニタ末  1:モニタ済み" UBYTE COMP_0283 1 100 0 1 BIT_MASK 0x0004 ECU_ADDRESS 0xFFFF3C51 READ_WRITE /end MEASUREMENT
/begin MEASUREMENT fFDRPMD "0:Δrpm加速or急減速  1:デルタrpm減速中" UBYTE COMP_0283 1 100 0 1 BIT_MASK 0x0002 ECU_ADDRESS 0xFFFF3C51 READ_WRITE /end MEASUREMENT
/begin MEASUREMENT fFDVC "0:未経験  1:経験" UBYTE COMP_0283 1 100 0 1 BIT_MASK 0x0001 ECU_ADDRESS 0xFFFF3C51 READ_WRITE /end MEASUREMENT
/begin MEASUREMENT fFDWRED_M "0:右記以外  1:通常FFD書込み終了" UBYTE COMP_0283 1 100 0 1 BIT_MASK 0x0080 ECU_ADDRESS 0xFFFF3C52 READ_WRITE /end MEASUREMENT
/begin MEASUREMENT fFDWRST_M "0:右記以外  1:通常FFD書込み開始" UBYTE COMP_0283 1 100 0 1 BIT_MASK 0x0040 ECU_ADDRESS 0xFFFF3C52 READ_WRITE /end MEASUREMENT
/begin MEASUREMENT fFEDTAS3 "0:学習未終了  1:学習終了" UBYTE COMP_0283 1 100 0 1 BIT_MASK 0x0020 ECU_ADDRESS 0xFFFF3C52 READ_WRITE /end MEASUREMENT
/begin MEASUREMENT fFEEPINI "0:右記以外  1:キーON直後EEPROM診断終了" UBYTE COMP_0283 1 100 0 1 BIT_MASK 0x0010 ECU_ADDRESS 0xFFFF3C52 READ_WRITE /end MEASUREMENT
/begin MEASUREMENT fFEGTLC "0:右記以外  1:低燃温時EGRカット" UBYTE COMP_0283 1 100 0 1 BIT_MASK 0x0008 ECU_ADDRESS 0xFFFF3C52 READ_WRITE /end MEASUREMENT
/begin MEASUREMENT fFEM1ST "0:診断未経験  1:診断１回経験" UBYTE COMP_0283 1 100 0 1 BIT_MASK 0x0004 ECU_ADDRESS 0xFFFF3C52 READ_WRITE /end MEASUREMENT
/begin MEASUREMENT fFEM2ND "0:診断未経験  1:診断２回経験" UBYTE COMP_0283 1 100 0 1 BIT_MASK 0x0002 ECU_ADDRESS 0xFFFF3C52 READ_WRITE /end MEASUREMENT
/begin MEASUREMENT fFEMP "0:右記以外  1:FGAGE2>FEMP#(ヒス-OFEMP#)" UBYTE COMP_0283 1 100 0 1 BIT_MASK 0x0001 ECU_ADDRESS 0xFFFF3C52 READ_WRITE /end MEASUREMENT
/begin MEASUREMENT fFEPRSEND "0:ライン圧センサ診断終了していない  1:ライン圧センサ診断終了した" UBYTE COMP_0283 1 100 0 1 BIT_MASK 0x0080 ECU_ADDRESS 0xFFFF3C53 READ_WRITE /end MEASUREMENT
/begin MEASUREMENT fFEPRSOK "0:ライン圧センサ診断OK判定していな  1:ライン圧センサ診断OK判定した" UBYTE COMP_0283 1 100 0 1 BIT_MASK 0x0040 ECU_ADDRESS 0xFFFF3C53 READ_WRITE /end MEASUREMENT
/begin MEASUREMENT fFESYSEND "0:システム診断未終了  1:システム診断終了" UBYTE COMP_0283 1 100 0 1 BIT_MASK 0x0020 ECU_ADDRESS 0xFFFF3C53 READ_WRITE /end MEASUREMENT
/begin MEASUREMENT fFESYSENDV "0:パージシステム診断未終了  1:パージシステム診断終了" UBYTE COMP_0283 1 100 0 1 BIT_MASK 0x0010 ECU_ADDRESS 0xFFFF3C53 READ_WRITE /end MEASUREMENT
/begin MEASUREMENT fFESYSST "0:診断でない  1:診断中" UBYTE COMP_0283 1 100 0 1 BIT_MASK 0x0008 ECU_ADDRESS 0xFFFF3C53 READ_WRITE /end MEASUREMENT
/begin MEASUREMENT fFETALCL "0:要求無し  1:要求有り" UBYTE COMP_0283 1 100 0 1 BIT_MASK 0x0004 ECU_ADDRESS 0xFFFF3C53 READ_WRITE /end MEASUREMENT
/begin MEASUREMENT fFEVARE "0:診断領域条件不成立  1:診断領域条件不成立" UBYTE COMP_0283 1 100 0 1 BIT_MASK 0x0002 ECU_ADDRESS 0xFFFF3C53 READ_WRITE /end MEASUREMENT
/begin MEASUREMENT fFEVCNEND "0:パージコントロールバルブ診断末終  1:パージコントロール診断終了" UBYTE COMP_0283 1 100 0 1 BIT_MASK 0x0001 ECU_ADDRESS 0xFFFF3C53 READ_WRITE /end MEASUREMENT
/begin MEASUREMENT fFEVCNOK "0:パージコントロールバルブ診断OKで  1:パージコントロール診断OK" UBYTE COMP_0283 1 100 0 1 BIT_MASK 0x0080 ECU_ADDRESS 0xFFFF3C54 READ_WRITE /end MEASUREMENT
/begin MEASUREMENT fFEVPCJ1 "0:条件成立  1:条件不成立" UBYTE COMP_0283 1 100 0 1 BIT_MASK 0x0040 ECU_ADDRESS 0xFFFF3C54 READ_WRITE /end MEASUREMENT
/begin MEASUREMENT fFEVPCJ1S "0:ﾊﾟｰｼﾞｺﾝﾄﾛｰﾙ/V診断条件不成立  1:ﾊﾟｰｼﾞｺﾝﾄﾛｰﾙ/V診断条件成立" UBYTE COMP_0283 1 100 0 1 BIT_MASK 0x0020 ECU_ADDRESS 0xFFFF3C54 READ_WRITE /end MEASUREMENT
/begin MEASUREMENT fFEVPCJ2 "0:条件成立  1:条件不成立" UBYTE COMP_0283 1 100 0 1 BIT_MASK 0x0010 ECU_ADDRESS 0xFFFF3C54 READ_WRITE /end MEASUREMENT
/begin MEASUREMENT fFEVPCJ2S "0:条件不成立(圧力ｾﾝｻ統合化)  1:条件成立(圧力ｾﾝｻ統合化)" UBYTE COMP_0283 1 100 0 1 BIT_MASK 0x0008 ECU_ADDRESS 0xFFFF3C54 READ_WRITE /end MEASUREMENT
/begin MEASUREMENT fFEVPDCK "0:右記以外  1:プルダウン時基準圧力計測済み" UBYTE COMP_0283 1 100 0 1 BIT_MASK 0x0004 ECU_ADDRESS 0xFFFF3C54 READ_WRITE /end MEASUREMENT
/begin MEASUREMENT fFEVPEND "0:右記以外  1:診断終了" UBYTE COMP_0283 1 100 0 1 BIT_MASK 0x0002 ECU_ADDRESS 0xFFFF3C54 READ_WRITE /end MEASUREMENT
/begin MEASUREMENT fFEVPRSCK "0:右記以外  1:燃料タンク正圧チェック開始" UBYTE COMP_0283 1 100 0 1 BIT_MASK 0x0001 ECU_ADDRESS 0xFFFF3C54 READ_WRITE /end MEASUREMENT
/begin MEASUREMENT fFEVSREND "0:未終了  1:終了" UBYTE COMP_0283 1 100 0 1 BIT_MASK 0x0080 ECU_ADDRESS 0xFFFF3C55 READ_WRITE /end MEASUREMENT
/begin MEASUREMENT fFEVSTG12V "0:ステージ1→仮想ｽﾃｰｼﾞ2未開始  1:ステージ1→仮想ｽﾃｰｼﾞ2開始" UBYTE COMP_0283 1 100 0 1 BIT_MASK 0x0040 ECU_ADDRESS 0xFFFF3C55 READ_WRITE /end MEASUREMENT
/begin MEASUREMENT fFEVSYSOK "0:システム診断OK未判定  1:システム診断OK判定" UBYTE COMP_0283 1 100 0 1 BIT_MASK 0x0020 ECU_ADDRESS 0xFFFF3C55 READ_WRITE /end MEASUREMENT
/begin MEASUREMENT fFFCIND "0:右記以外  1:F/Cインディレイ中" UBYTE COMP_0283 1 100 0 1 BIT_MASK 0x0010 ECU_ADDRESS 0xFFFF3C55 READ_WRITE /end MEASUREMENT
/begin MEASUREMENT fFFDBRK1 "0:FFD読出し車両条件不適合  1:FFD読出し車両条件適合" UBYTE COMP_0283 1 100 0 1 BIT_MASK 0x0008 ECU_ADDRESS 0xFFFF3C55 READ_WRITE /end MEASUREMENT
/begin MEASUREMENT fFFDBUCP "0:右記以外  1:ﾊﾞｯｸｱｯﾌﾟRAMへのﾃﾞｰﾀｺﾋﾟｰ終了" UBYTE COMP_0283 1 100 0 1 BIT_MASK 0x0004 ECU_ADDRESS 0xFFFF3C55 READ_WRITE /end MEASUREMENT
/begin MEASUREMENT fFFDCLRMS "0:FFDクリア（SUB領域）未実行  1:FFDクリア（SUB領域）実行" UBYTE COMP_0283 1 100 0 1 BIT_MASK 0x0002 ECU_ADDRESS 0xFFFF3C55 READ_WRITE /end MEASUREMENT
/begin MEASUREMENT fFFDRD_M "0:右記以外  1:EEPROM書き込み" UBYTE COMP_0283 1 100 0 1 BIT_MASK 0x0001 ECU_ADDRESS 0xFFFF3C55 READ_WRITE /end MEASUREMENT
/begin MEASUREMENT fFFDREF "0:F.F.ﾃﾞｰﾀ参照許可  1:F.F.ﾃﾞｰﾀ参照禁止" UBYTE COMP_0283 1 100 0 1 BIT_MASK 0x0080 ECU_ADDRESS 0xFFFF3C56 READ_WRITE /end MEASUREMENT
/begin MEASUREMENT fFFDSMOD "0:FFD読出し車両条件不適合  1:FFD読出し車両条件適合" UBYTE COMP_0283 1 100 0 1 BIT_MASK 0x0040 ECU_ADDRESS 0xFFFF3C56 READ_WRITE /end MEASUREMENT
/begin MEASUREMENT fFFETIM "0:始動後@回まで  1:始動後@回以降" UBYTE COMP_0283 1 100 0 1 BIT_MASK 0x0020 ECU_ADDRESS 0xFFFF3C56 READ_WRITE /end MEASUREMENT
/begin MEASUREMENT fFFGNST "0:パラメータ条件(a)～(c)いずれか不  1:パラメータ条件(a)～(c)全て成立" UBYTE COMP_0283 1 100 0 1 BIT_MASK 0x0010 ECU_ADDRESS 0xFFFF3C56 READ_WRITE /end MEASUREMENT
/begin MEASUREMENT fFFGNSTS "0:－  1:vFGNST=wvFGAGE2" UBYTE COMP_0283 1 100 0 1 BIT_MASK 0x0008 ECU_ADDRESS 0xFFFF3C56 READ_WRITE /end MEASUREMENT
/begin MEASUREMENT fFFUKCT "0:なし  1:あり" UBYTE COMP_0283 1 100 0 1 BIT_MASK 0x0004 ECU_ADDRESS 0xFFFF3C56 READ_WRITE /end MEASUREMENT
/begin MEASUREMENT fFGCNTEND "0:燃料ﾚﾍﾞﾙｹﾞｰｼﾞ診断RATEｶｳﾝﾄｱｯﾌﾟ未  1:燃料ﾚﾍﾞﾙｹﾞｰｼﾞ診断RATEｶｳﾝﾄｱｯﾌﾟ完" UBYTE COMP_0283 1 100 0 1 BIT_MASK 0x0002 ECU_ADDRESS 0xFFFF3C56 READ_WRITE /end MEASUREMENT
/begin MEASUREMENT fFGNLPS "0:不許可  1:許可" UBYTE COMP_0283 1 100 0 1 BIT_MASK 0x0001 ECU_ADDRESS 0xFFFF3C56 READ_WRITE /end MEASUREMENT
/begin MEASUREMENT fFGNLSS "0:不許可  1:許可" UBYTE COMP_0283 1 100 0 1 BIT_MASK 0x0080 ECU_ADDRESS 0xFFFF3C57 READ_WRITE /end MEASUREMENT
/begin MEASUREMENT fFGPVTMP "0:#FSCKON_=_0_||_NE_<_NINPAT_の時  1:#FSCKON=1_&&_CURGPV_>_CURGPVz_&&" UBYTE COMP_0283 1 100 0 1 BIT_MASK 0x0040 ECU_ADDRESS 0xFFFF3C57 READ_WRITE /end MEASUREMENT
/begin MEASUREMENT fFIMRDY "0:右記以外  1:触媒診断終了" UBYTE COMP_0283 1 100 0 1 BIT_MASK 0x0020 ECU_ADDRESS 0xFFFF3C57 READ_WRITE /end MEASUREMENT
/begin MEASUREMENT fFIROK "0:制御非実行  1:制御実行中" UBYTE COMP_0283 1 100 0 1 BIT_MASK 0x0010 ECU_ADDRESS 0xFFFF3C57 READ_WRITE /end MEASUREMENT
/begin MEASUREMENT fFISCENDH "0:右記以外  1:ISC_High_rpm診断終了" UBYTE COMP_0283 1 100 0 1 BIT_MASK 0x0008 ECU_ADDRESS 0xFFFF3C57 READ_WRITE /end MEASUREMENT
/begin MEASUREMENT fFISCENDL "0:右記以外  1:ISC_Low_rpm診断終了" UBYTE COMP_0283 1 100 0 1 BIT_MASK 0x0004 ECU_ADDRESS 0xFFFF3C57 READ_WRITE /end MEASUREMENT
/begin MEASUREMENT fFISCPB "0:右記以外  1:IGN_SW_OFFまでISCPB=PBNGHO#" UBYTE COMP_0283 1 100 0 1 BIT_MASK 0x0002 ECU_ADDRESS 0xFFFF3C57 READ_WRITE /end MEASUREMENT
/begin MEASUREMENT fFISCTA "0:右記以外  1:IGN_SW_OFFまでISCTA=TANGHO#" UBYTE COMP_0283 1 100 0 1 BIT_MASK 0x0001 ECU_ADDRESS 0xFFFF3C57 READ_WRITE /end MEASUREMENT
/begin MEASUREMENT fFIVTDTW "0:成立  1:不成立" UBYTE COMP_0283 1 100 0 1 BIT_MASK 0x0080 ECU_ADDRESS 0xFFFF3C58 READ_WRITE /end MEASUREMENT
/begin MEASUREMENT fFJTRIGER "0:故障シグナル非出力  1:故障シグナル出力" UBYTE COMP_0283 1 100 0 1 BIT_MASK 0x0040 ECU_ADDRESS 0xFFFF3C58 READ_WRITE /end MEASUREMENT
/begin MEASUREMENT fFLEAKOK "0:右記以外  1:リーク診断OK" UBYTE COMP_0283 1 100 0 1 BIT_MASK 0x0010 ECU_ADDRESS 0xFFFF3C58 READ_WRITE /end MEASUREMENT
/begin MEASUREMENT fFLEAKOK2 "0:右記以外  1:リーク診断負圧OK" UBYTE COMP_0283 1 100 0 1 BIT_MASK 0x0008 ECU_ADDRESS 0xFFFF3C58 READ_WRITE /end MEASUREMENT
/begin MEASUREMENT fFLGAFSV "0:PCV駆動Duty=0%（診断頻度が多い）  1:PCV駆動Duty>0%（診断頻度が少ない" UBYTE COMP_0283 1 100 0 1 BIT_MASK 0x0004 ECU_ADDRESS 0xFFFF3C58 READ_WRITE /end MEASUREMENT
/begin MEASUREMENT fFLJSVTC "0:VTCフル判定でない  1:VTCフル判定" UBYTE COMP_0283 1 100 0 1 BIT_MASK 0x0002 ECU_ADDRESS 0xFFFF3C58 READ_WRITE /end MEASUREMENT
/begin MEASUREMENT fFLK02ST "0:診断でない  1:診断中" UBYTE COMP_0283 1 100 0 1 BIT_MASK 0x0001 ECU_ADDRESS 0xFFFF3C58 READ_WRITE /end MEASUREMENT
/begin MEASUREMENT fFLK04ST "0:診断でない  1:診断中" UBYTE COMP_0283 1 100 0 1 BIT_MASK 0x0080 ECU_ADDRESS 0xFFFF3C59 READ_WRITE /end MEASUREMENT
/begin MEASUREMENT fFLOCK1 "0:急減速時制御1終了  1:急減速時制御1開始" UBYTE COMP_0283 1 100 0 1 BIT_MASK 0x0040 ECU_ADDRESS 0xFFFF3C59 READ_WRITE /end MEASUREMENT
/begin MEASUREMENT fFMCARA "0:領域外  1:領域内" UBYTE COMP_0283 1 100 0 1 BIT_MASK 0x0020 ECU_ADDRESS 0xFFFF3C59 READ_WRITE /end MEASUREMENT
/begin MEASUREMENT fFMCTH3D "0:判定実施  1:判定ｷｬﾝｾﾙ" UBYTE COMP_0283 1 100 0 1 BIT_MASK 0x0010 ECU_ADDRESS 0xFFFF3C59 READ_WRITE /end MEASUREMENT
/begin MEASUREMENT fFMFAST "0:条件不成立  1:条件成立" UBYTE COMP_0283 1 100 0 1 BIT_MASK 0x0008 ECU_ADDRESS 0xFFFF3C59 READ_WRITE /end MEASUREMENT
/begin MEASUREMENT fFMFCLD "0:条件不成立  1:条件成立" UBYTE COMP_0283 1 100 0 1 BIT_MASK 0x0004 ECU_ADDRESS 0xFFFF3C59 READ_WRITE /end MEASUREMENT
/begin MEASUREMENT fFMFCLD2 "0:ｶｳﾝﾄｱｯﾌﾟ許可  1:ｶｳﾝﾄｱｯﾌﾟ不許可" UBYTE COMP_0283 1 100 0 1 BIT_MASK 0x0002 ECU_ADDRESS 0xFFFF3C59 READ_WRITE /end MEASUREMENT
/begin MEASUREMENT fFMFDRPM "0:失火ｷｬﾝｾﾙΔNRPM条件不成立  1:失火ｷｬﾝｾﾙΔNRPM条件成立" UBYTE COMP_0283 1 100 0 1 BIT_MASK 0x0001 ECU_ADDRESS 0xFFFF3C59 READ_WRITE /end MEASUREMENT
/begin MEASUREMENT fFMFDRPMD "0:判定実施  1:判定ｷｬﾝｾﾙ" UBYTE COMP_0283 1 100 0 1 BIT_MASK 0x0080 ECU_ADDRESS 0xFFFF3C5A READ_WRITE /end MEASUREMENT
/begin MEASUREMENT fFMFJAR2D "0:診断許可  1:診断不許可" UBYTE COMP_0283 1 100 0 1 BIT_MASK 0x0040 ECU_ADDRESS 0xFFFF3C5A READ_WRITE /end MEASUREMENT
/begin MEASUREMENT fFMFNAE "0:非カウント  1:カウント" UBYTE COMP_0283 1 100 0 1 BIT_MASK 0x0020 ECU_ADDRESS 0xFFFF3C5A READ_WRITE /end MEASUREMENT
/begin MEASUREMENT fFMFNEM "0:非カウント  1:カウント" UBYTE COMP_0283 1 100 0 1 BIT_MASK 0x0010 ECU_ADDRESS 0xFFFF3C5A READ_WRITE /end MEASUREMENT
/begin MEASUREMENT fFMILCT "0:要求なし  1:要求あり" UBYTE COMP_0283 1 100 0 1 BIT_MASK 0x0008 ECU_ADDRESS 0xFFFF3C5A READ_WRITE /end MEASUREMENT
/begin MEASUREMENT fFMILID "0:要求なし  1:要求あり" UBYTE COMP_0283 1 100 0 1 BIT_MASK 0x0004 ECU_ADDRESS 0xFFFF3C5A READ_WRITE /end MEASUREMENT
/begin MEASUREMENT fFMLTNC "0:第２水準自己診断NG未検出  1:第２水準自己診断NG検出" UBYTE COMP_0283 1 100 0 1 BIT_MASK 0x0002 ECU_ADDRESS 0xFFFF3C5A READ_WRITE /end MEASUREMENT
/begin MEASUREMENT fFMLTRTFG "0:カウントアップしてない  1:一度カウントアップした" UBYTE COMP_0283 1 100 0 1 BIT_MASK 0x0001 ECU_ADDRESS 0xFFFF3C5A READ_WRITE /end MEASUREMENT
/begin MEASUREMENT fFMRDGNC "0:右記以外  1:パージカット条件(4)成立" UBYTE COMP_0283 1 100 0 1 BIT_MASK 0x0080 ECU_ADDRESS 0xFFFF3C5B READ_WRITE /end MEASUREMENT
/begin MEASUREMENT fFMSAHOTI "0:非成立  1:成立" UBYTE COMP_0283 1 100 0 1 BIT_MASK 0x0040 ECU_ADDRESS 0xFFFF3C5B READ_WRITE /end MEASUREMENT
/begin MEASUREMENT fFMSATCHG "0:非成立  1:成立" UBYTE COMP_0283 1 100 0 1 BIT_MASK 0x0020 ECU_ADDRESS 0xFFFF3C5B READ_WRITE /end MEASUREMENT
/begin MEASUREMENT fFNBCNA "0:当該TRIPでNGなし  1:当該TRIPでNG発生" UBYTE COMP_0283 1 100 0 1 BIT_MASK 0x0010 ECU_ADDRESS 0xFFFF3C5B READ_WRITE /end MEASUREMENT
/begin MEASUREMENT fFNBCNB "0:当該TRIPでNGなし  1:当該TRIPでNG発生" UBYTE COMP_0283 1 100 0 1 BIT_MASK 0x0008 ECU_ADDRESS 0xFFFF3C5B READ_WRITE /end MEASUREMENT
/begin MEASUREMENT fFNBCNC "0:当該TRIPでNGなし  1:当該TRIPでNG発生" UBYTE COMP_0283 1 100 0 1 BIT_MASK 0x0004 ECU_ADDRESS 0xFFFF3C5B READ_WRITE /end MEASUREMENT
/begin MEASUREMENT fFNDATRNG "0:N→D切り替わり無し  1:N→D切り替わり有り" UBYTE COMP_0283 1 100 0 1 BIT_MASK 0x0002 ECU_ADDRESS 0xFFFF3C5B READ_WRITE /end MEASUREMENT
/begin MEASUREMENT fFNDSHK "0:制御条件不成立  1:制御条件成立" UBYTE COMP_0283 1 100 0 1 BIT_MASK 0x0001 ECU_ADDRESS 0xFFFF3C5B READ_WRITE /end MEASUREMENT
/begin MEASUREMENT fFNENSENG "0:不成立  1:成立" UBYTE COMP_0283 1 100 0 1 BIT_MASK 0x0080 ECU_ADDRESS 0xFFFF3C5C READ_WRITE /end MEASUREMENT
/begin MEASUREMENT fFNGATV "0:車速ｾﾝｻ正常  1:車速ｾﾝｻNG" UBYTE COMP_0283 1 100 0 1 BIT_MASK 0x0040 ECU_ADDRESS 0xFFFF3C5C READ_WRITE /end MEASUREMENT
/begin MEASUREMENT fFNGSLSH "0:パラメータ条件(a)～(d)いずれか不  1:パラメータ条件(a)～(d)全て成立" UBYTE COMP_0283 1 100 0 1 BIT_MASK 0x0020 ECU_ADDRESS 0xFFFF3C5C READ_WRITE /end MEASUREMENT
/begin MEASUREMENT fFNTASED "0:右記以外  1:1ショットクリア済" UBYTE COMP_0283 1 100 0 1 BIT_MASK 0x0010 ECU_ADDRESS 0xFFFF3C5C READ_WRITE /end MEASUREMENT
/begin MEASUREMENT fFOPWR "0:OPS領域油圧正常判定  1:OPS領域油圧異常判定" UBYTE COMP_0283 1 100 0 1 BIT_MASK 0x0008 ECU_ADDRESS 0xFFFF3C5C READ_WRITE /end MEASUREMENT
/begin MEASUREMENT fFPCFL1 "0:TIPS×HNRPM＜FPCFL1#(ヒス-FPCPS1  1:TIPS×HNRPM≧FPCFL1#(ヒス-FPCPS1" UBYTE COMP_0283 1 100 0 1 BIT_MASK 0x0004 ECU_ADDRESS 0xFFFF3C5C READ_WRITE /end MEASUREMENT
/begin MEASUREMENT fFPCFL2 "0:TIPS×HNRPM＜FPCFL2#(ヒス-FPCPS2  1:TIPS×HNRPM≧FPCFL2#(ヒス-FPCPS2" UBYTE COMP_0283 1 100 0 1 BIT_MASK 0x0002 ECU_ADDRESS 0xFFFF3C5C READ_WRITE /end MEASUREMENT
/begin MEASUREMENT fFPCMEND "0:FPCM診断未了  1:FPCM診断終了" UBYTE COMP_0283 1 100 0 1 BIT_MASK 0x0001 ECU_ADDRESS 0xFFFF3C5C READ_WRITE /end MEASUREMENT
/begin MEASUREMENT fFPCND1 "0:FPRｺﾝﾃﾞｨｼｮﾝ1_OFF  1:FPRｺﾝﾃﾞｨｼｮﾝ1_ON" UBYTE COMP_0283 1 100 0 1 BIT_MASK 0x0080 ECU_ADDRESS 0xFFFF3C5D READ_WRITE /end MEASUREMENT
/begin MEASUREMENT fFPCND2 "0:FPRｺﾝﾃﾞｨｼｮﾝ2_OFF  1:FPRｺﾝﾃﾞｨｼｮﾝ2_ON" UBYTE COMP_0283 1 100 0 1 BIT_MASK 0x0040 ECU_ADDRESS 0xFFFF3C5D READ_WRITE /end MEASUREMENT
/begin MEASUREMENT fFPCND3 "0:FPRｺﾝﾃﾞｨｼｮﾝ3_ON  1:FPRｺﾝﾃﾞｨｼｮﾝ3_OFF" UBYTE COMP_0283 1 100 0 1 BIT_MASK 0x0020 ECU_ADDRESS 0xFFFF3C5D READ_WRITE /end MEASUREMENT
/begin MEASUREMENT fFPCND4 "0:FPRｺﾝﾃﾞｨｼｮﾝ4_ON  1:FPRｺﾝﾃﾞｨｼｮﾝ4_OFF" UBYTE COMP_0283 1 100 0 1 BIT_MASK 0x0010 ECU_ADDRESS 0xFFFF3C5D READ_WRITE /end MEASUREMENT
/begin MEASUREMENT fFPHIRPM "0:HNRPM＜FPHIRPM#（ヒス-FPHHRPM#）  1:HNRPM≧FPHIRPM#（ヒス-FPHHRPM#）" UBYTE COMP_0283 1 100 0 1 BIT_MASK 0x0008 ECU_ADDRESS 0xFFFF3C5D READ_WRITE /end MEASUREMENT
/begin MEASUREMENT fFPSCETC "0:不成立  1:成立" UBYTE COMP_0283 1 100 0 1 BIT_MASK 0x0004 ECU_ADDRESS 0xFFFF3C5D READ_WRITE /end MEASUREMENT
/begin MEASUREMENT fFPSFDCL "0:不成立  1:成立" UBYTE COMP_0283 1 100 0 1 BIT_MASK 0x0002 ECU_ADDRESS 0xFFFF3C5D READ_WRITE /end MEASUREMENT
/begin MEASUREMENT fFPSTWPB "0:ラジファンPSコマンド許可  1:ラジファンPSコマンド禁止" UBYTE COMP_0283 1 100 0 1 BIT_MASK 0x0001 ECU_ADDRESS 0xFFFF3C5D READ_WRITE /end MEASUREMENT
/begin MEASUREMENT fFPTFL1 "0:TP＜FPTFL1#(ヒス-FPTPS1#)  1:TP≧FPTFL1#(ヒス-FPTPS1#)" UBYTE COMP_0283 1 100 0 1 BIT_MASK 0x0080 ECU_ADDRESS 0xFFFF3C5E READ_WRITE /end MEASUREMENT
/begin MEASUREMENT fFPTFL2 "0:TP＜FPTFL2#(ヒス-FPTPS2#)  1:TP≧FPTFL2#(ヒス-FPTPS2#)" UBYTE COMP_0283 1 100 0 1 BIT_MASK 0x0040 ECU_ADDRESS 0xFFFF3C5E READ_WRITE /end MEASUREMENT
/begin MEASUREMENT fFPTWL1 "0:TWN≧FPTWL#(ヒス-5℃)  1:TWN＜FPTWL#(ヒス-5℃)" UBYTE COMP_0283 1 100 0 1 BIT_MASK 0x0020 ECU_ADDRESS 0xFFFF3C5E READ_WRITE /end MEASUREMENT
/begin MEASUREMENT fFPURGE "0:パージ中でない  1:パージ中" UBYTE COMP_0283 1 100 0 1 BIT_MASK 0x0010 ECU_ADDRESS 0xFFFF3C5E READ_WRITE /end MEASUREMENT
/begin MEASUREMENT fFQLRNCAN "0:不成立  1:成立" UBYTE COMP_0283 1 100 0 1 BIT_MASK 0x0008 ECU_ADDRESS 0xFFFF3C5E READ_WRITE /end MEASUREMENT
/begin MEASUREMENT fFQLRNJG "0:不成立  1:成立" UBYTE COMP_0283 1 100 0 1 BIT_MASK 0x0004 ECU_ADDRESS 0xFFFF3C5E READ_WRITE /end MEASUREMENT
/begin MEASUREMENT fFQLRNZ "0:実行中でない  1:実行中" UBYTE COMP_0283 1 100 0 1 BIT_MASK 0x0002 ECU_ADDRESS 0xFFFF3C5E READ_WRITE /end MEASUREMENT
/begin MEASUREMENT fFQLSRTD "0:空気量学習(低速急速モード)未収束  1:空気量学習(低速急速モード)収束" UBYTE COMP_0283 1 100 0 1 BIT_MASK 0x0001 ECU_ADDRESS 0xFFFF3C5E READ_WRITE /end MEASUREMENT
/begin MEASUREMENT fFQLSTD "0:空気量学習(低速通常モード)未収束  1:空気量学習(低速通常モード)収束" UBYTE COMP_0283 1 100 0 1 BIT_MASK 0x0080 ECU_ADDRESS 0xFFFF3C5F READ_WRITE /end MEASUREMENT
/begin MEASUREMENT fFQLTD "0:空気量学習(高速)未収束  1:空気量学習(高速)収束" UBYTE COMP_0283 1 100 0 1 BIT_MASK 0x0040 ECU_ADDRESS 0xFFFF3C5F READ_WRITE /end MEASUREMENT
/begin MEASUREMENT fFROHCMNS1 "0:後O2/Sﾊﾟﾗﾒｰﾀｽﾄｱ中止  1:後O2/Sﾊﾟﾗﾒｰﾀｽﾄｱ実行" UBYTE COMP_0283 1 100 0 1 BIT_MASK 0x0020 ECU_ADDRESS 0xFFFF3C5F READ_WRITE /end MEASUREMENT
/begin MEASUREMENT fFROHCMXS1 "0:後O2/Sﾊﾟﾗﾒｰﾀｽﾄｱ中止  1:後O2/Sﾊﾟﾗﾒｰﾀｽﾄｱ実行" UBYTE COMP_0283 1 100 0 1 BIT_MASK 0x0010 ECU_ADDRESS 0xFFFF3C5F READ_WRITE /end MEASUREMENT
/begin MEASUREMENT fFRPMKIN "0:許可  1:禁止" UBYTE COMP_0283 1 100 0 1 BIT_MASK 0x0008 ECU_ADDRESS 0xFFFF3C5F READ_WRITE /end MEASUREMENT
/begin MEASUREMENT fFRRTVOD "0:判定実施  1:判定ｷｬﾝｾﾙ" UBYTE COMP_0283 1 100 0 1 BIT_MASK 0x0004 ECU_ADDRESS 0xFFFF3C5F READ_WRITE /end MEASUREMENT
/begin MEASUREMENT fFSCEMI "0:なし  1:あり" UBYTE COMP_0283 1 100 0 1 BIT_MASK 0x0002 ECU_ADDRESS 0xFFFF3C5F READ_WRITE /end MEASUREMENT
/begin MEASUREMENT fFSCKON "0:右記以外  1:許可" UBYTE COMP_0283 1 100 0 1 BIT_MASK 0x0001 ECU_ADDRESS 0xFFFF3C5F READ_WRITE /end MEASUREMENT
/begin MEASUREMENT fFSDIG "0:非実行  1:実行" UBYTE COMP_0283 1 100 0 1 BIT_MASK 0x0080 ECU_ADDRESS 0xFFFF3C60 READ_WRITE /end MEASUREMENT
/begin MEASUREMENT fFSHDP5 "0:不成立  1:成立" UBYTE COMP_0283 1 100 0 1 BIT_MASK 0x0040 ECU_ADDRESS 0xFFFF3C60 READ_WRITE /end MEASUREMENT
/begin MEASUREMENT fFSIMCA "0:不成立  1:成立" UBYTE COMP_0283 1 100 0 1 BIT_MASK 0x0020 ECU_ADDRESS 0xFFFF3C60 READ_WRITE /end MEASUREMENT
/begin MEASUREMENT fFSIMCB "0:不成立  1:成立" UBYTE COMP_0283 1 100 0 1 BIT_MASK 0x0010 ECU_ADDRESS 0xFFFF3C60 READ_WRITE /end MEASUREMENT
/begin MEASUREMENT fFSIMCC "0:不成立  1:成立" UBYTE COMP_0283 1 100 0 1 BIT_MASK 0x0008 ECU_ADDRESS 0xFFFF3C60 READ_WRITE /end MEASUREMENT
/begin MEASUREMENT fFSKTCL "0:クリア要求なし  1:クリア要求あり" UBYTE COMP_0283 1 100 0 1 BIT_MASK 0x0004 ECU_ADDRESS 0xFFFF3C60 READ_WRITE /end MEASUREMENT
/begin MEASUREMENT fFSMD1ST "0:初回  1:初回以降" UBYTE COMP_0283 1 100 0 1 BIT_MASK 0x0002 ECU_ADDRESS 0xFFFF3C60 READ_WRITE /end MEASUREMENT
/begin MEASUREMENT fFSMILON "0:非実行  1:実行" UBYTE COMP_0283 1 100 0 1 BIT_MASK 0x0001 ECU_ADDRESS 0xFFFF3C60 READ_WRITE /end MEASUREMENT
/begin MEASUREMENT fFSPFTCV "0:右記以外  1:成層始動用TCV閉/目標燃圧設定" UBYTE COMP_0283 1 100 0 1 BIT_MASK 0x0080 ECU_ADDRESS 0xFFFF3C61 READ_WRITE /end MEASUREMENT
/begin MEASUREMENT fFSRTMD "0:右記以外  1:SRTモード中" UBYTE COMP_0283 1 100 0 1 BIT_MASK 0x0040 ECU_ADDRESS 0xFFFF3C61 READ_WRITE /end MEASUREMENT
/begin MEASUREMENT fFSRTZ "0:前回SRTﾓｰﾄﾞ中ではない  1:前回SRTﾓｰﾄﾞ中" UBYTE COMP_0283 1 100 0 1 BIT_MASK 0x0020 ECU_ADDRESS 0xFFFF3C61 READ_WRITE /end MEASUREMENT
/begin MEASUREMENT fFSTOBEND "0:未経験  1:経験" UBYTE COMP_0283 1 100 0 1 BIT_MASK 0x0010 ECU_ADDRESS 0xFFFF3C61 READ_WRITE /end MEASUREMENT
/begin MEASUREMENT fFSTRETYUZ_1 "0:右記以外  1:切り替え中" UBYTE COMP_0283 1 100 0 1 BIT_MASK 0x0008 ECU_ADDRESS 0xFFFF3C61 READ_WRITE /end MEASUREMENT
/begin MEASUREMENT fFSTRKIR "0:右記以外  1:均質->超リタード切り替え" UBYTE COMP_0283 1 100 0 1 BIT_MASK 0x0004 ECU_ADDRESS 0xFFFF3C61 READ_WRITE /end MEASUREMENT
/begin MEASUREMENT fFSTRST "0:右記以外  1:成層始動空気先行入力" UBYTE COMP_0283 1 100 0 1 BIT_MASK 0x0002 ECU_ADDRESS 0xFFFF3C61 READ_WRITE /end MEASUREMENT
/begin MEASUREMENT fFSTRSTOB "0:均質始動許可  1:成層始動許可" UBYTE COMP_0283 1 100 0 1 BIT_MASK 0x0001 ECU_ADDRESS 0xFFFF3C61 READ_WRITE /end MEASUREMENT
/begin MEASUREMENT fFSTRSTZN "0:OFF  1:ON" UBYTE COMP_0283 1 100 0 1 BIT_MASK 0x0080 ECU_ADDRESS 0xFFFF3C62 READ_WRITE /end MEASUREMENT
/begin MEASUREMENT fFTANUP "0:推定外気温度下降ゲインを選択する  1:推定外気温度上昇ゲインを選択する" UBYTE COMP_0283 1 100 0 1 BIT_MASK 0x0040 ECU_ADDRESS 0xFFFF3C62 READ_WRITE /end MEASUREMENT
/begin MEASUREMENT fFTANVSP "0:右記以外  1:VSP>=TANVSP#となってからTANVDY#" UBYTE COMP_0283 1 100 0 1 BIT_MASK 0x0020 ECU_ADDRESS 0xFFFF3C62 READ_WRITE /end MEASUREMENT
/begin MEASUREMENT fFTPCH "0:Not＿transient  1:Transient" UBYTE COMP_0283 1 100 0 1 BIT_MASK 0x0010 ECU_ADDRESS 0xFFFF3C62 READ_WRITE /end MEASUREMENT
/begin MEASUREMENT fFTQUPOK1 "0:AGBトルクアップ許可判定1_非成立  1:AGBトルクアップ許可判定1_成立" UBYTE COMP_0283 1 100 0 1 BIT_MASK 0x0008 ECU_ADDRESS 0xFFFF3C62 READ_WRITE /end MEASUREMENT
/begin MEASUREMENT fFTQUPOK2 "0:AGBトルクアップ許可判定2_非成立  1:AGBトルクアップ許可判定2_成立" UBYTE COMP_0283 1 100 0 1 BIT_MASK 0x0004 ECU_ADDRESS 0xFFFF3C62 READ_WRITE /end MEASUREMENT
/begin MEASUREMENT fFTQUPOK3 "0:AGBトルクアップ許可判定3_非成立  1:AGBトルクアップ許可判定3_成立" UBYTE COMP_0283 1 100 0 1 BIT_MASK 0x0002 ECU_ADDRESS 0xFFFF3C62 READ_WRITE /end MEASUREMENT
/begin MEASUREMENT fFTRIP10 "0:ﾄﾘｯﾌﾟ10未突入  1:ﾄﾘｯﾌﾟ10突入済み" UBYTE COMP_0283 1 100 0 1 BIT_MASK 0x0001 ECU_ADDRESS 0xFFFF3C62 READ_WRITE /end MEASUREMENT
/begin MEASUREMENT fFTRIP10A "0:右記以外  1:ﾄﾘｯﾌﾟ10用個別条件成立" UBYTE COMP_0283 1 100 0 1 BIT_MASK 0x0080 ECU_ADDRESS 0xFFFF3C63 READ_WRITE /end MEASUREMENT
/begin MEASUREMENT fFTRIP4 "0:ﾄﾘｯﾌﾟ4未突入  1:ﾄﾘｯﾌﾟ4突入済み" UBYTE COMP_0283 1 100 0 1 BIT_MASK 0x0040 ECU_ADDRESS 0xFFFF3C63 READ_WRITE /end MEASUREMENT
/begin MEASUREMENT fFTRIP4A "0:右記以外  1:始動後EVCLD1#経過かつ#FTW70条件" UBYTE COMP_0283 1 100 0 1 BIT_MASK 0x0020 ECU_ADDRESS 0xFFFF3C63 READ_WRITE /end MEASUREMENT
/begin MEASUREMENT fFTRIP5 "0:ﾄﾘｯﾌﾟ5未突入  1:ﾄﾘｯﾌﾟ5突入済み" UBYTE COMP_0283 1 100 0 1 BIT_MASK 0x0010 ECU_ADDRESS 0xFFFF3C63 READ_WRITE /end MEASUREMENT
/begin MEASUREMENT fFTRIP5A "0:右記以外  1:#FTW70条件成立後ISCDDLY#経過" UBYTE COMP_0283 1 100 0 1 BIT_MASK 0x0008 ECU_ADDRESS 0xFFFF3C63 READ_WRITE /end MEASUREMENT
/begin MEASUREMENT fFTRIP6 "0:ﾄﾘｯﾌﾟ6未突入  1:ﾄﾘｯﾌﾟ6突入済み" UBYTE COMP_0283 1 100 0 1 BIT_MASK 0x0004 ECU_ADDRESS 0xFFFF3C63 READ_WRITE /end MEASUREMENT
/begin MEASUREMENT fFTRIP7 "0:ﾄﾘｯﾌﾟ7未突入  1:ﾄﾘｯﾌﾟ7突入済み" UBYTE COMP_0283 1 100 0 1 BIT_MASK 0x0002 ECU_ADDRESS 0xFFFF3C63 READ_WRITE /end MEASUREMENT
/begin MEASUREMENT fFTRIP7A "0:右記以外  1:最低水温(TWKMIN)が診断ｸﾗｲﾃﾘｱ(TWN" UBYTE COMP_0283 1 100 0 1 BIT_MASK 0x0001 ECU_ADDRESS 0xFFFF3C63 READ_WRITE /end MEASUREMENT
/begin MEASUREMENT fFTRIP8 "0:ﾄﾘｯﾌﾟ8未突入  1:ﾄﾘｯﾌﾟ8突入済み" UBYTE COMP_0283 1 100 0 1 BIT_MASK 0x0080 ECU_ADDRESS 0xFFFF3C64 READ_WRITE /end MEASUREMENT
/begin MEASUREMENT fFTRIP8A "0:右記以外  1:ﾄﾘｯﾌﾟ8用個別条件成立" UBYTE COMP_0283 1 100 0 1 BIT_MASK 0x0040 ECU_ADDRESS 0xFFFF3C64 READ_WRITE /end MEASUREMENT
/begin MEASUREMENT fFTRPFLG "0:(f)条件不成立  1:(f)条件成立" UBYTE COMP_0283 1 100 0 1 BIT_MASK 0x0020 ECU_ADDRESS 0xFFFF3C64 READ_WRITE /end MEASUREMENT
/begin MEASUREMENT fFTSACC "0:加速中でない  1:加速中" UBYTE COMP_0283 1 100 0 1 BIT_MASK 0x0010 ECU_ADDRESS 0xFFFF3C64 READ_WRITE /end MEASUREMENT
/begin MEASUREMENT fFTSDCC "0:減速中でない  1:減速中" UBYTE COMP_0283 1 100 0 1 BIT_MASK 0x0008 ECU_ADDRESS 0xFFFF3C64 READ_WRITE /end MEASUREMENT
/begin MEASUREMENT fFTVQLSR "0:不成立  1:成立" UBYTE COMP_0283 1 100 0 1 BIT_MASK 0x0004 ECU_ADDRESS 0xFFFF3C64 READ_WRITE /end MEASUREMENT
/begin MEASUREMENT fFTWCLEND "0:右記以外  1:水温センサ診断終了" UBYTE COMP_0283 1 100 0 1 BIT_MASK 0x0002 ECU_ADDRESS 0xFFFF3C64 READ_WRITE /end MEASUREMENT
/begin MEASUREMENT fFTWCLGO "0:右記以外  1:診断開始条件成立" UBYTE COMP_0283 1 100 0 1 BIT_MASK 0x0001 ECU_ADDRESS 0xFFFF3C64 READ_WRITE /end MEASUREMENT
/begin MEASUREMENT fFTWSTEND "0:右記以外  1:水温ｾﾝｻｽﾀｯｸ診断終了" UBYTE COMP_0283 1 100 0 1 BIT_MASK 0x0080 ECU_ADDRESS 0xFFFF3C65 READ_WRITE /end MEASUREMENT
/begin MEASUREMENT fFTWSTGO "0:右記以外  1:診断開始条件成立" UBYTE COMP_0283 1 100 0 1 BIT_MASK 0x0040 ECU_ADDRESS 0xFFFF3C65 READ_WRITE /end MEASUREMENT
/begin MEASUREMENT fFUELSTAT "0:非成立  1:成立" UBYTE COMP_0283 1 100 0 1 BIT_MASK 0x0020 ECU_ADDRESS 0xFFFF3C65 READ_WRITE /end MEASUREMENT
/begin MEASUREMENT fFVBLN1 "0:バッテリ電圧12.08[V]以下１０秒継  1:バッテリ電圧12.08[V]以下１０秒継" UBYTE COMP_0283 1 100 0 1 BIT_MASK 0x0010 ECU_ADDRESS 0xFFFF3C65 READ_WRITE /end MEASUREMENT
/begin MEASUREMENT fFVBLN2 "0:バッテリ電圧12.00[V]以下１０秒継  1:バッテリ電圧12.00[V]以下１０秒継" UBYTE COMP_0283 1 100 0 1 BIT_MASK 0x0008 ECU_ADDRESS 0xFFFF3C65 READ_WRITE /end MEASUREMENT
/begin MEASUREMENT fFVBLN3 "0:バッテリ電圧11.92[V]以下１０秒継  1:バッテリ電圧11.92[V]以下１０秒継" UBYTE COMP_0283 1 100 0 1 BIT_MASK 0x0004 ECU_ADDRESS 0xFFFF3C65 READ_WRITE /end MEASUREMENT
/begin MEASUREMENT fFVSP5S "0:経験無し  1:経験有り" UBYTE COMP_0283 1 100 0 1 BIT_MASK 0x0002 ECU_ADDRESS 0xFFFF3C65 READ_WRITE /end MEASUREMENT
/begin MEASUREMENT fFVTCGK "0:不許可  1:許可" UBYTE COMP_0283 1 100 0 1 BIT_MASK 0x0001 ECU_ADDRESS 0xFFFF3C65 READ_WRITE /end MEASUREMENT
/begin MEASUREMENT fFVTCGKE "0:不許可  1:許可" UBYTE COMP_0283 1 100 0 1 BIT_MASK 0x0080 ECU_ADDRESS 0xFFFF3C66 READ_WRITE /end MEASUREMENT
/begin MEASUREMENT fFVTCLEDE "0:未終了  1:終了" UBYTE COMP_0283 1 100 0 1 BIT_MASK 0x0040 ECU_ADDRESS 0xFFFF3C66 READ_WRITE /end MEASUREMENT
/begin MEASUREMENT fFVTCLEDI "0:未終了  1:終了" UBYTE COMP_0283 1 100 0 1 BIT_MASK 0x0020 ECU_ADDRESS 0xFFFF3C66 READ_WRITE /end MEASUREMENT
/begin MEASUREMENT fFVTCLEND "0:未終了  1:終了" UBYTE COMP_0283 1 100 0 1 BIT_MASK 0x0010 ECU_ADDRESS 0xFFFF3C66 READ_WRITE /end MEASUREMENT
/begin MEASUREMENT fFVTCNG "0:即戻し要求なし  1:即戻し要求あり" UBYTE COMP_0283 1 100 0 1 BIT_MASK 0x0008 ECU_ADDRESS 0xFFFF3C66 READ_WRITE /end MEASUREMENT
/begin MEASUREMENT fFVTCNGE "0:即戻し要求なし  1:即戻し要求あり" UBYTE COMP_0283 1 100 0 1 BIT_MASK 0x0004 ECU_ADDRESS 0xFFFF3C66 READ_WRITE /end MEASUREMENT
/begin MEASUREMENT fFVTLNCEB "0:収束していない  1:収束している" UBYTE COMP_0283 1 100 0 1 BIT_MASK 0x0002 ECU_ADDRESS 0xFFFF3C66 READ_WRITE /end MEASUREMENT
/begin MEASUREMENT fFVTLRNCE "0:収束していない  1:収束している" UBYTE COMP_0283 1 100 0 1 BIT_MASK 0x0001 ECU_ADDRESS 0xFFFF3C66 READ_WRITE /end MEASUREMENT
/begin MEASUREMENT fFVTLRNCI "0:収束していない  1:収束している" UBYTE COMP_0283 1 100 0 1 BIT_MASK 0x0080 ECU_ADDRESS 0xFFFF3C67 READ_WRITE /end MEASUREMENT
/begin MEASUREMENT fFVTMPREF "0:インクリメント許可  1:インクリメント不許可" UBYTE COMP_0283 1 100 0 1 BIT_MASK 0x0040 ECU_ADDRESS 0xFFFF3C67 READ_WRITE /end MEASUREMENT
/begin MEASUREMENT fFVTMPRFE "0:インクリメント許可  1:インクリメント不許可" UBYTE COMP_0283 1 100 0 1 BIT_MASK 0x0020 ECU_ADDRESS 0xFFFF3C67 READ_WRITE /end MEASUREMENT
/begin MEASUREMENT fFVTTANL "0:wvTANST_≧_mVTMINTAN_  1:wvTANST_<_mVTMINTAN_" UBYTE COMP_0283 1 100 0 1 BIT_MASK 0x0010 ECU_ADDRESS 0xFFFF3C67 READ_WRITE /end MEASUREMENT
/begin MEASUREMENT fGAFAVJG "0:不成立  1:成立" UBYTE COMP_0283 1 100 0 1 BIT_MASK 0x0008 ECU_ADDRESS 0xFFFF3C67 READ_WRITE /end MEASUREMENT
/begin MEASUREMENT fGAFDJG "0:不成立  1:成立" UBYTE COMP_0283 1 100 0 1 BIT_MASK 0x0004 ECU_ADDRESS 0xFFFF3C67 READ_WRITE /end MEASUREMENT
/begin MEASUREMENT fGAFSFTJG "0:不成立  1:成立" UBYTE COMP_0283 1 100 0 1 BIT_MASK 0x0002 ECU_ADDRESS 0xFFFF3C67 READ_WRITE /end MEASUREMENT
/begin MEASUREMENT fGALENG "0:更新未  1:更新済" UBYTE COMP_0283 1 100 0 1 BIT_MASK 0x0080 ECU_ADDRESS 0xFFFF3C68 READ_WRITE /end MEASUREMENT
/begin MEASUREMENT fGALEOK "0:更新未  1:更新済" UBYTE COMP_0283 1 100 0 1 BIT_MASK 0x0020 ECU_ADDRESS 0xFFFF3C68 READ_WRITE /end MEASUREMENT
/begin MEASUREMENT fGALMNG "0:更新未  1:更新済" UBYTE COMP_0283 1 100 0 1 BIT_MASK 0x0008 ECU_ADDRESS 0xFFFF3C68 READ_WRITE /end MEASUREMENT
/begin MEASUREMENT fGALMOK "0:更新未  1:更新済" UBYTE COMP_0283 1 100 0 1 BIT_MASK 0x0002 ECU_ADDRESS 0xFFFF3C68 READ_WRITE /end MEASUREMENT
/begin MEASUREMENT fGCVTCAJG "0:許可条件不成立  1:許可条件成立" UBYTE COMP_0283 1 100 0 1 BIT_MASK 0x0080 ECU_ADDRESS 0xFFFF3C69 READ_WRITE /end MEASUREMENT
/begin MEASUREMENT fGCVTCDJG "0:許可条件不成立  1:許可条件成立" UBYTE COMP_0283 1 100 0 1 BIT_MASK 0x0040 ECU_ADDRESS 0xFFFF3C69 READ_WRITE /end MEASUREMENT
/begin MEASUREMENT fGMFCMNG "0:未経験  1:経験" UBYTE COMP_0283 1 100 0 1 BIT_MASK 0x0020 ECU_ADDRESS 0xFFFF3C69 READ_WRITE /end MEASUREMENT
/begin MEASUREMENT fGMFCMNGZ "0:未経験  1:経験" UBYTE COMP_0283 1 100 0 1 BIT_MASK 0x0010 ECU_ADDRESS 0xFFFF3C69 READ_WRITE /end MEASUREMENT
/begin MEASUREMENT fGMFCTNG "0:未経験  1:経験" UBYTE COMP_0283 1 100 0 1 BIT_MASK 0x0008 ECU_ADDRESS 0xFFFF3C69 READ_WRITE /end MEASUREMENT
/begin MEASUREMENT fGMFCTNGZ "0:未経験  1:経験" UBYTE COMP_0283 1 100 0 1 BIT_MASK 0x0004 ECU_ADDRESS 0xFFFF3C69 READ_WRITE /end MEASUREMENT
/begin MEASUREMENT fGMFFUNG "0:未経験  1:経験" UBYTE COMP_0283 1 100 0 1 BIT_MASK 0x0002 ECU_ADDRESS 0xFFFF3C69 READ_WRITE /end MEASUREMENT
/begin MEASUREMENT fGMFFUNGZ "0:未経験  1:経験" UBYTE COMP_0283 1 100 0 1 BIT_MASK 0x0001 ECU_ADDRESS 0xFFFF3C69 READ_WRITE /end MEASUREMENT
/begin MEASUREMENT fGMFIAEX "0:未経験  1:経験" UBYTE COMP_0283 1 100 0 1 BIT_MASK 0x0080 ECU_ADDRESS 0xFFFF3C6A READ_WRITE /end MEASUREMENT
/begin MEASUREMENT fGMFIAEXZ "0:未経験  1:経験" UBYTE COMP_0283 1 100 0 1 BIT_MASK 0x0040 ECU_ADDRESS 0xFFFF3C6A READ_WRITE /end MEASUREMENT
/begin MEASUREMENT fGMFIANG "0:未経験  1:経験" UBYTE COMP_0283 1 100 0 1 BIT_MASK 0x0020 ECU_ADDRESS 0xFFFF3C6A READ_WRITE /end MEASUREMENT
/begin MEASUREMENT fGMFIANGZ "0:未経験  1:経験" UBYTE COMP_0283 1 100 0 1 BIT_MASK 0x0010 ECU_ADDRESS 0xFFFF3C6A READ_WRITE /end MEASUREMENT
/begin MEASUREMENT fGNTRP2 "0:ｴﾝｼﾞﾝ始動後GNRTRP2ｶｳﾝﾄしていない  1:ｴﾝｼﾞﾝ始動後GNRTRP2ｶｳﾝﾄした" UBYTE COMP_0283 1 100 0 1 BIT_MASK 0x0008 ECU_ADDRESS 0xFFFF3C6A READ_WRITE /end MEASUREMENT
/begin MEASUREMENT fGO2EXPC "0:不成立  1:成立" UBYTE COMP_0283 1 100 0 1 BIT_MASK 0x0004 ECU_ADDRESS 0xFFFF3C6A READ_WRITE /end MEASUREMENT
/begin MEASUREMENT fGOVTW "0:TWN<GOVTW  1:TWN>=GOVTW" UBYTE COMP_0283 1 100 0 1 BIT_MASK 0x0002 ECU_ADDRESS 0xFFFF3C6A READ_WRITE /end MEASUREMENT
/begin MEASUREMENT fGOVTW2 "0:TWN<GOVTW2  1:TWN>=GOVTW2" UBYTE COMP_0283 1 100 0 1 BIT_MASK 0x0001 ECU_ADDRESS 0xFFFF3C6A READ_WRITE /end MEASUREMENT
/begin MEASUREMENT fGRO2DRJG "0:不成立  1:成立" UBYTE COMP_0283 1 100 0 1 BIT_MASK 0x0080 ECU_ADDRESS 0xFFFF3C6B READ_WRITE /end MEASUREMENT
/begin MEASUREMENT fGRO2JG "0:不成立  1:成立" UBYTE COMP_0283 1 100 0 1 BIT_MASK 0x0040 ECU_ADDRESS 0xFFFF3C6B READ_WRITE /end MEASUREMENT
/begin MEASUREMENT fGRVOONG "0:ＮＧ  1:ＮＧでない" UBYTE COMP_0283 1 100 0 1 BIT_MASK 0x0020 ECU_ADDRESS 0xFFFF3C6B READ_WRITE /end MEASUREMENT
/begin MEASUREMENT fGRVOONGH "0:ＮＧ  1:ＮＧでない" UBYTE COMP_0283 1 100 0 1 BIT_MASK 0x0010 ECU_ADDRESS 0xFFFF3C6B READ_WRITE /end MEASUREMENT
/begin MEASUREMENT fGRVOONGL "0:ＮＧ  1:ＮＧでない" UBYTE COMP_0283 1 100 0 1 BIT_MASK 0x0008 ECU_ADDRESS 0xFFFF3C6B READ_WRITE /end MEASUREMENT
/begin MEASUREMENT fGRVRANG "0:ＮＧ  1:ＮＧでない" UBYTE COMP_0283 1 100 0 1 BIT_MASK 0x0004 ECU_ADDRESS 0xFFFF3C6B READ_WRITE /end MEASUREMENT
/begin MEASUREMENT fGRVRTPMT "0:許可  1:許可でない" UBYTE COMP_0283 1 100 0 1 BIT_MASK 0x0002 ECU_ADDRESS 0xFFFF3C6B READ_WRITE /end MEASUREMENT
/begin MEASUREMENT fGSIOK "0:0  1:1" UBYTE COMP_0283 1 100 0 1 BIT_MASK 0x0001 ECU_ADDRESS 0xFFFF3C6B READ_WRITE /end MEASUREMENT
/begin MEASUREMENT fGSIUPHIL "0:アップヒル以外  1:アップヒル" UBYTE COMP_0283 1 100 0 1 BIT_MASK 0x0080 ECU_ADDRESS 0xFFFF3C6C READ_WRITE /end MEASUREMENT
/begin MEASUREMENT fGSIVLVC "0:0  1:1" UBYTE COMP_0283 1 100 0 1 BIT_MASK 0x0040 ECU_ADDRESS 0xFFFF3C6C READ_WRITE /end MEASUREMENT
/begin MEASUREMENT fGTRPFLG "0:(g)条件不成立  1:(g)条件成立" UBYTE COMP_0283 1 100 0 1 BIT_MASK 0x0020 ECU_ADDRESS 0xFFFF3C6C READ_WRITE /end MEASUREMENT
/begin MEASUREMENT fGUIEND "0:未作動  1:作動済" UBYTE COMP_0283 1 100 0 1 BIT_MASK 0x0010 ECU_ADDRESS 0xFFFF3C6C READ_WRITE /end MEASUREMENT
/begin MEASUREMENT fGUIENDE "0:未作動  1:作動済" UBYTE COMP_0283 1 100 0 1 BIT_MASK 0x0008 ECU_ADDRESS 0xFFFF3C6C READ_WRITE /end MEASUREMENT
/begin MEASUREMENT fGVTCAJG "0:許可条件不成立  1:許可条件成立" UBYTE COMP_0283 1 100 0 1 BIT_MASK 0x0004 ECU_ADDRESS 0xFFFF3C6C READ_WRITE /end MEASUREMENT
/begin MEASUREMENT fGVTCDJG "0:許可条件不成立  1:許可条件成立" UBYTE COMP_0283 1 100 0 1 BIT_MASK 0x0002 ECU_ADDRESS 0xFFFF3C6C READ_WRITE /end MEASUREMENT
/begin MEASUREMENT fHCTDST "0:非成立  1:成立" UBYTE COMP_0283 1 100 0 1 BIT_MASK 0x0001 ECU_ADDRESS 0xFFFF3C6C READ_WRITE /end MEASUREMENT
/begin MEASUREMENT fHDCHKAC "0:OFF  1:ON" UBYTE COMP_0283 1 100 0 1 BIT_MASK 0x0080 ECU_ADDRESS 0xFFFF3C6D READ_WRITE /end MEASUREMENT
/begin MEASUREMENT fHDCHKREQ "0:無し  1:有り" UBYTE COMP_0283 1 100 0 1 BIT_MASK 0x0020 ECU_ADDRESS 0xFFFF3C6D READ_WRITE /end MEASUREMENT
/begin MEASUREMENT fHEVCTBJ "0:不成立  1:成立" UBYTE COMP_0283 1 100 0 1 BIT_MASK 0x0010 ECU_ADDRESS 0xFFFF3C6D READ_WRITE /end MEASUREMENT
/begin MEASUREMENT fHFPCOF "0:流量状態(高)  1:流量状態(低)" UBYTE COMP_0283 1 100 0 1 BIT_MASK 0x0008 ECU_ADDRESS 0xFFFF3C6D READ_WRITE /end MEASUREMENT
/begin MEASUREMENT fHIOVER "0:不成立  1:成立" UBYTE COMP_0283 1 100 0 1 BIT_MASK 0x0004 ECU_ADDRESS 0xFFFF3C6D READ_WRITE /end MEASUREMENT
/begin MEASUREMENT fHNCEHKF "0:経験無  1:経験有" UBYTE COMP_0283 1 100 0 1 BIT_MASK 0x0001 ECU_ADDRESS 0xFFFF3C6D READ_WRITE /end MEASUREMENT
/begin MEASUREMENT fHOSWLRC "0:TWN>=HOSWLRC(-3℃ﾋｽ）でない  1:TWN>=HOSWLRC(-3℃ﾋｽ）である" UBYTE COMP_0283 1 100 0 1 BIT_MASK 0x0080 ECU_ADDRESS 0xFFFF3C6E READ_WRITE /end MEASUREMENT
/begin MEASUREMENT fHOSWLRH "0:TWN<HOSWLRH(-3℃ﾋｽ）でない  1:TWN<HOSWLRC(-3℃ﾋｽ）である" UBYTE COMP_0283 1 100 0 1 BIT_MASK 0x0040 ECU_ADDRESS 0xFFFF3C6E READ_WRITE /end MEASUREMENT
/begin MEASUREMENT fHPACSOK "0:油圧低下判定不許可  1:油圧低下判定許可" UBYTE COMP_0283 1 100 0 1 BIT_MASK 0x0020 ECU_ADDRESS 0xFFFF3C6E READ_WRITE /end MEASUREMENT
/begin MEASUREMENT fHPFULCT "0:不成立  1:成立" UBYTE COMP_0283 1 100 0 1 BIT_MASK 0x0010 ECU_ADDRESS 0xFFFF3C6E READ_WRITE /end MEASUREMENT
/begin MEASUREMENT fHPGNDNG "0:不成立  1:成立" UBYTE COMP_0283 1 100 0 1 BIT_MASK 0x0008 ECU_ADDRESS 0xFFFF3C6E READ_WRITE /end MEASUREMENT
/begin MEASUREMENT fHPVBSNG "0:不成立  1:成立" UBYTE COMP_0283 1 100 0 1 BIT_MASK 0x0004 ECU_ADDRESS 0xFFFF3C6E READ_WRITE /end MEASUREMENT
/begin MEASUREMENT fHQFSKN "0:非成立  1:成立" UBYTE COMP_0283 1 100 0 1 BIT_MASK 0x0002 ECU_ADDRESS 0xFFFF3C6E READ_WRITE /end MEASUREMENT
/begin MEASUREMENT fHQFSKP "0:非成立  1:成立" UBYTE COMP_0283 1 100 0 1 BIT_MASK 0x0001 ECU_ADDRESS 0xFFFF3C6E READ_WRITE /end MEASUREMENT
/begin MEASUREMENT fHRVDLINI "0:初回  1:初回以降" UBYTE COMP_0283 1 100 0 1 BIT_MASK 0x0080 ECU_ADDRESS 0xFFFF3C6F READ_WRITE /end MEASUREMENT
/begin MEASUREMENT fHSOSQCHG "0:HSOSQ,LSOSQ切り替え不成立  1:HSOSQ,LSOSQ切り替え成立" UBYTE COMP_0283 1 100 0 1 BIT_MASK 0x0040 ECU_ADDRESS 0xFFFF3C6F READ_WRITE /end MEASUREMENT
/begin MEASUREMENT fHTRPFLG "0:(h)条件不成立  1:(h)条件成立" UBYTE COMP_0283 1 100 0 1 BIT_MASK 0x0020 ECU_ADDRESS 0xFFFF3C6F READ_WRITE /end MEASUREMENT
/begin MEASUREMENT fHTWVSP "0:条件不成立  1:条件成立" UBYTE COMP_0283 1 100 0 1 BIT_MASK 0x0010 ECU_ADDRESS 0xFFFF3C6F READ_WRITE /end MEASUREMENT
/begin MEASUREMENT fIC3CHKR "0:右記以外  1:ハードチェックIC3停止要求" UBYTE COMP_0283 1 100 0 1 BIT_MASK 0x0008 ECU_ADDRESS 0xFFFF3C6F READ_WRITE /end MEASUREMENT
/begin MEASUREMENT fIC3COMNG "0:通信正常  1:通信失敗" UBYTE COMP_0283 1 100 0 1 BIT_MASK 0x0004 ECU_ADDRESS 0xFFFF3C6F READ_WRITE /end MEASUREMENT
/begin MEASUREMENT fIDCFALTS "0:判定未  1:故障信号有(IDC方式)" UBYTE COMP_0283 1 100 0 1 BIT_MASK 0x0002 ECU_ADDRESS 0xFFFF3C6F READ_WRITE /end MEASUREMENT
/begin MEASUREMENT fIDLEJGOK "0:不成立  1:成立" UBYTE COMP_0283 1 100 0 1 BIT_MASK 0x0001 ECU_ADDRESS 0xFFFF3C6F READ_WRITE /end MEASUREMENT
/begin MEASUREMENT fIDLJGOKB "0:不成立  1:成立" UBYTE COMP_0283 1 100 0 1 BIT_MASK 0x0080 ECU_ADDRESS 0xFFFF3C70 READ_WRITE /end MEASUREMENT
/begin MEASUREMENT fIDMASJG "0:アイドルストップマスク条件成立  1:アイドルストップマスク条件不成立" UBYTE COMP_0283 1 100 0 1 BIT_MASK 0x0040 ECU_ADDRESS 0xFFFF3C70 READ_WRITE /end MEASUREMENT
/begin MEASUREMENT fIESTCTOK "0:不成立  1:成立" UBYTE COMP_0283 1 100 0 1 BIT_MASK 0x0020 ECU_ADDRESS 0xFFFF3C70 READ_WRITE /end MEASUREMENT
/begin MEASUREMENT fIFSTLN "0:ﾘｰﾝ許可  1:ﾘｰﾝ不許可" UBYTE COMP_0283 1 100 0 1 BIT_MASK 0x0010 ECU_ADDRESS 0xFFFF3C70 READ_WRITE /end MEASUREMENT
/begin MEASUREMENT fIHMCHK1 "0:処理移行未完  1:処理移行済み" UBYTE COMP_0283 1 100 0 1 BIT_MASK 0x0008 ECU_ADDRESS 0xFFFF3C70 READ_WRITE /end MEASUREMENT
/begin MEASUREMENT fIHMNG "0:OK  1:NG" UBYTE COMP_0283 1 100 0 1 BIT_MASK 0x0004 ECU_ADDRESS 0xFFFF3C70 READ_WRITE /end MEASUREMENT
/begin MEASUREMENT fINCDMACC "0:急加速要求ﾅｼ  1:急加速要求ｱﾘ" UBYTE COMP_0283 1 100 0 1 BIT_MASK 0x0002 ECU_ADDRESS 0xFFFF3C70 READ_WRITE /end MEASUREMENT
/begin MEASUREMENT fINJD600 "0:インジェクタ断線診断600usマスク  1:インジェクタ断線診断600usマスク" UBYTE COMP_0283 1 100 0 1 BIT_MASK 0x0001 ECU_ADDRESS 0xFFFF3C70 READ_WRITE /end MEASUREMENT
/begin MEASUREMENT fINTVAL "0:通常燃料ｶｯﾄ要求  1:多気筒燃料ｶｯﾄ要求" UBYTE COMP_0283 1 100 0 1 BIT_MASK 0x0080 ECU_ADDRESS 0xFFFF3C71 READ_WRITE /end MEASUREMENT
/begin MEASUREMENT fIOCALPF "0:アクティブテスト要求なし  1:アクティブテスト要求中" UBYTE COMP_0283 1 100 0 1 BIT_MASK 0x0040 ECU_ADDRESS 0xFFFF3C71 READ_WRITE /end MEASUREMENT
/begin MEASUREMENT fIOCEVDYF "0:アクティブテスト要求なし  1:アクティブテスト要求中" UBYTE COMP_0283 1 100 0 1 BIT_MASK 0x0020 ECU_ADDRESS 0xFFFF3C71 READ_WRITE /end MEASUREMENT
/begin MEASUREMENT fIQTSEP1 "0:TAS学習値(反転値)EEPROM書込非処  1:TAS学習値(反転値)EEPROM書込処理" UBYTE COMP_0283 1 100 0 1 BIT_MASK 0x0010 ECU_ADDRESS 0xFFFF3C71 READ_WRITE /end MEASUREMENT
/begin MEASUREMENT fIRAMNGF1 "0:１回目NG判定あり  1:1回目NG判定なし" UBYTE COMP_0283 1 100 0 1 BIT_MASK 0x0008 ECU_ADDRESS 0xFFFF3C71 READ_WRITE /end MEASUREMENT
/begin MEASUREMENT fIRAMNGF2 "0:1回目NG判定あり  1:1回目NG判定なし" UBYTE COMP_0283 1 100 0 1 BIT_MASK 0x0004 ECU_ADDRESS 0xFFFF3C71 READ_WRITE /end MEASUREMENT
/begin MEASUREMENT fISCCNEND "0:右記以外  1:ｶｳﾝﾄｱｯﾌﾟ終了" UBYTE COMP_0283 1 100 0 1 BIT_MASK 0x0002 ECU_ADDRESS 0xFFFF3C71 READ_WRITE /end MEASUREMENT
/begin MEASUREMENT fISCFBOK "0:非許可  1:許可" UBYTE COMP_0283 1 100 0 1 BIT_MASK 0x0001 ECU_ADDRESS 0xFFFF3C71 READ_WRITE /end MEASUREMENT
/begin MEASUREMENT fISLRNJG "0:条件非成立  1:条件成立" UBYTE COMP_0283 1 100 0 1 BIT_MASK 0x0080 ECU_ADDRESS 0xFFFF3C72 READ_WRITE /end MEASUREMENT
/begin MEASUREMENT fISQCIMSK "0:アイドルストップ再始動時QFBIリミ  1:アイドルストップ再始動時QFBIリミ" UBYTE COMP_0283 1 100 0 1 BIT_MASK 0x0040 ECU_ADDRESS 0xFFFF3C72 READ_WRITE /end MEASUREMENT
/begin MEASUREMENT fISRCHTG "0:不成立  1:成立" UBYTE COMP_0283 1 100 0 1 BIT_MASK 0x0020 ECU_ADDRESS 0xFFFF3C72 READ_WRITE /end MEASUREMENT
/begin MEASUREMENT fITAM "0:ISCI分溜め込み制御条件不成立  1:左記以外" UBYTE COMP_0283 1 100 0 1 BIT_MASK 0x0010 ECU_ADDRESS 0xFFFF3C72 READ_WRITE /end MEASUREMENT
/begin MEASUREMENT fJIZOKU "0:右記以外  1:エンジン回転持続判定成立" UBYTE COMP_0283 1 100 0 1 BIT_MASK 0x0008 ECU_ADDRESS 0xFFFF3C72 READ_WRITE /end MEASUREMENT
/begin MEASUREMENT fJKCTTMOV "0:成立  1:不成立" UBYTE COMP_0283 1 100 0 1 BIT_MASK 0x0004 ECU_ADDRESS 0xFFFF3C72 READ_WRITE /end MEASUREMENT
/begin MEASUREMENT fJKULVSP "0:回転数制御非実行  1:回転数制御実行" UBYTE COMP_0283 1 100 0 1 BIT_MASK 0x0002 ECU_ADDRESS 0xFFFF3C72 READ_WRITE /end MEASUREMENT
/begin MEASUREMENT fJTRPFLG "0:(ｊ)条件不成立  1:(ｊ)条件成立" UBYTE COMP_0283 1 100 0 1 BIT_MASK 0x0001 ECU_ADDRESS 0xFFFF3C72 READ_WRITE /end MEASUREMENT
/begin MEASUREMENT fKHDGCN "0:高水温増量診断診断実行  1:高水温増量診断診断キャンセル" UBYTE COMP_0283 1 100 0 1 BIT_MASK 0x0080 ECU_ADDRESS 0xFFFF3C73 READ_WRITE /end MEASUREMENT
/begin MEASUREMENT fKMRJOJO "0:徐々ｸﾗﾝﾌﾟ無効  1:徐々ｸﾗﾝﾌﾟ有効" UBYTE COMP_0283 1 100 0 1 BIT_MASK 0x0040 ECU_ADDRESS 0xFFFF3C73 READ_WRITE /end MEASUREMENT
/begin MEASUREMENT fKMRLMC "0:右記以外  1:KMR_λｺﾝ中" UBYTE COMP_0283 1 100 0 1 BIT_MASK 0x0020 ECU_ADDRESS 0xFFFF3C73 READ_WRITE /end MEASUREMENT
/begin MEASUREMENT fKMRRLMT "0:範囲内  1:ﾘｯﾁ限界ｵｰﾊﾞｰ" UBYTE COMP_0283 1 100 0 1 BIT_MASK 0x0010 ECU_ADDRESS 0xFFFF3C73 READ_WRITE /end MEASUREMENT
/begin MEASUREMENT fKNKADVOK "0:禁止  1:許可" UBYTE COMP_0283 1 100 0 1 BIT_MASK 0x0008 ECU_ADDRESS 0xFFFF3C73 READ_WRITE /end MEASUREMENT
/begin MEASUREMENT fKNQLHYS "0:条件不成立  1:条件成立" UBYTE COMP_0283 1 100 0 1 BIT_MASK 0x0004 ECU_ADDRESS 0xFFFF3C73 READ_WRITE /end MEASUREMENT
/begin MEASUREMENT fKTRPFLG "0:(k)条件不成立  1:(k)条件成立" UBYTE COMP_0283 1 100 0 1 BIT_MASK 0x0002 ECU_ADDRESS 0xFFFF3C73 READ_WRITE /end MEASUREMENT
/begin MEASUREMENT fLARAIN "0:領域外  1:領域内" UBYTE COMP_0283 1 100 0 1 BIT_MASK 0x0001 ECU_ADDRESS 0xFFFF3C73 READ_WRITE /end MEASUREMENT
/begin MEASUREMENT fLEAKCEND "0:未更新  1:更新済み" UBYTE COMP_0283 1 100 0 1 BIT_MASK 0x0080 ECU_ADDRESS 0xFFFF3C74 READ_WRITE /end MEASUREMENT
/begin MEASUREMENT fLEAKCNTE1 "0:未経験  1:経験済み" UBYTE COMP_0283 1 100 0 1 BIT_MASK 0x0040 ECU_ADDRESS 0xFFFF3C74 READ_WRITE /end MEASUREMENT
/begin MEASUREMENT fLEAKCNTE2 "0:未経験  1:経験済み" UBYTE COMP_0283 1 100 0 1 BIT_MASK 0x0020 ECU_ADDRESS 0xFFFF3C74 READ_WRITE /end MEASUREMENT
/begin MEASUREMENT fLEKC2END "0:未更新  1:更新済み" UBYTE COMP_0283 1 100 0 1 BIT_MASK 0x0010 ECU_ADDRESS 0xFFFF3C74 READ_WRITE /end MEASUREMENT
/begin MEASUREMENT fLEKC3END "0:未更新  1:更新済み" UBYTE COMP_0283 1 100 0 1 BIT_MASK 0x0008 ECU_ADDRESS 0xFFFF3C74 READ_WRITE /end MEASUREMENT
/begin MEASUREMENT fLFPFUSOK "0:判定非成立  1:判定成立" UBYTE COMP_0283 1 100 0 1 BIT_MASK 0x0004 ECU_ADDRESS 0xFFFF3C74 READ_WRITE /end MEASUREMENT
/begin MEASUREMENT fLKDGN02 "0:Φ0.04inchリークダウン中  1:Φ0.02inchリークダウン中" UBYTE COMP_0283 1 100 0 1 BIT_MASK 0x0002 ECU_ADDRESS 0xFFFF3C74 READ_WRITE /end MEASUREMENT
/begin MEASUREMENT fLMDCNT "0:未ｶｳﾝﾄ  1:ｶｳﾝﾄ済み" UBYTE COMP_0283 1 100 0 1 BIT_MASK 0x0001 ECU_ADDRESS 0xFFFF3C74 READ_WRITE /end MEASUREMENT
/begin MEASUREMENT fLOOVER "0:不成立  1:成立" UBYTE COMP_0283 1 100 0 1 BIT_MASK 0x0080 ECU_ADDRESS 0xFFFF3C75 READ_WRITE /end MEASUREMENT
/begin MEASUREMENT fLSENEND "0:未終了  1:1回演算終了" UBYTE COMP_0283 1 100 0 1 BIT_MASK 0x0020 ECU_ADDRESS 0xFFFF3C75 READ_WRITE /end MEASUREMENT
/begin MEASUREMENT fLTRPFLG "0:(l)条件不成立  1:(l)条件成立" UBYTE COMP_0283 1 100 0 1 BIT_MASK 0x0010 ECU_ADDRESS 0xFFFF3C75 READ_WRITE /end MEASUREMENT
/begin MEASUREMENT fLUHTW "0:条件不成立  1:条件成立" UBYTE COMP_0283 1 100 0 1 BIT_MASK 0x0008 ECU_ADDRESS 0xFFFF3C75 READ_WRITE /end MEASUREMENT
/begin MEASUREMENT fLVSPPCT "0:非パージカット中  1:パージカット中" UBYTE COMP_0283 1 100 0 1 BIT_MASK 0x0004 ECU_ADDRESS 0xFFFF3C75 READ_WRITE /end MEASUREMENT
/begin MEASUREMENT fM2IDLE "0:不成立  1:成立" UBYTE COMP_0283 1 100 0 1 BIT_MASK 0x0002 ECU_ADDRESS 0xFFFF3C75 READ_WRITE /end MEASUREMENT
/begin MEASUREMENT fM8CSLT1 "0:右記以外  1:DDL2_MODE08実行中" UBYTE COMP_0283 1 100 0 1 BIT_MASK 0x0001 ECU_ADDRESS 0xFFFF3C75 READ_WRITE /end MEASUREMENT
/begin MEASUREMENT fM8CSLT2 "0:右記以外  1:DDL2_MODE08実行中" UBYTE COMP_0283 1 100 0 1 BIT_MASK 0x0080 ECU_ADDRESS 0xFFFF3C76 READ_WRITE /end MEASUREMENT
/begin MEASUREMENT fM8GST1 "0:右記以外  1:GST_MODE08実行中" UBYTE COMP_0283 1 100 0 1 BIT_MASK 0x0040 ECU_ADDRESS 0xFFFF3C76 READ_WRITE /end MEASUREMENT
/begin MEASUREMENT fM8GST2 "0:右記以外  1:GST_MODE08実行中" UBYTE COMP_0283 1 100 0 1 BIT_MASK 0x0020 ECU_ADDRESS 0xFFFF3C76 READ_WRITE /end MEASUREMENT
/begin MEASUREMENT fM8OPN "0:クローズ許可  1:オープン許可" UBYTE COMP_0283 1 100 0 1 BIT_MASK 0x0010 ECU_ADDRESS 0xFFFF3C76 READ_WRITE /end MEASUREMENT
/begin MEASUREMENT fMAFDGCTV "0:MAFDGCTｶｳﾝﾄｱｯﾌﾟ未終了  1:MAFDGCTｶｳﾝﾄｱｯﾌﾟ終了" UBYTE COMP_0283 1 100 0 1 BIT_MASK 0x0008 ECU_ADDRESS 0xFFFF3C76 READ_WRITE /end MEASUREMENT
/begin MEASUREMENT fMAINSWSZ "0:SLﾒｲﾝSW_OFF  1:SLﾒｲﾝSW_ON" UBYTE COMP_0283 1 100 0 1 BIT_MASK 0x0004 ECU_ADDRESS 0xFFFF3C76 READ_WRITE /end MEASUREMENT
/begin MEASUREMENT fMAINSWZ "0:ﾒｲﾝSW_OFF  1:ﾒｲﾝSW_ON" UBYTE COMP_0283 1 100 0 1 BIT_MASK 0x0002 ECU_ADDRESS 0xFFFF3C76 READ_WRITE /end MEASUREMENT
/begin MEASUREMENT fMANISTP "0:条件不成立  1:条件成立" UBYTE COMP_0283 1 100 0 1 BIT_MASK 0x0001 ECU_ADDRESS 0xFFFF3C76 READ_WRITE /end MEASUREMENT
/begin MEASUREMENT fMANISTP0 "0:条件不成立  1:条件成立" UBYTE COMP_0283 1 100 0 1 BIT_MASK 0x0080 ECU_ADDRESS 0xFFFF3C77 READ_WRITE /end MEASUREMENT
/begin MEASUREMENT fMANISTP1 "0:条件不成立  1:条件成立" UBYTE COMP_0283 1 100 0 1 BIT_MASK 0x0040 ECU_ADDRESS 0xFFFF3C77 READ_WRITE /end MEASUREMENT
/begin MEASUREMENT fMANISTP5 "0:条件不成立  1:条件成立" UBYTE COMP_0283 1 100 0 1 BIT_MASK 0x0020 ECU_ADDRESS 0xFFFF3C77 READ_WRITE /end MEASUREMENT
/begin MEASUREMENT fMCMGO "0:条件不成立  1:条件成立" UBYTE COMP_0283 1 100 0 1 BIT_MASK 0x0010 ECU_ADDRESS 0xFFFF3C77 READ_WRITE /end MEASUREMENT
/begin MEASUREMENT fMCMRECON "0:条件不成立  1:条件成立" UBYTE COMP_0283 1 100 0 1 BIT_MASK 0x0008 ECU_ADDRESS 0xFFFF3C77 READ_WRITE /end MEASUREMENT
/begin MEASUREMENT fMCMTAENB "0:条件不成立  1:条件成立" UBYTE COMP_0283 1 100 0 1 BIT_MASK 0x0004 ECU_ADDRESS 0xFFFF3C77 READ_WRITE /end MEASUREMENT
/begin MEASUREMENT fMCMTANGH "0:NGでない  1:NG" UBYTE COMP_0283 1 100 0 1 BIT_MASK 0x0002 ECU_ADDRESS 0xFFFF3C77 READ_WRITE /end MEASUREMENT
/begin MEASUREMENT fMCMTANGL "0:NGでない  1:NG" UBYTE COMP_0283 1 100 0 1 BIT_MASK 0x0001 ECU_ADDRESS 0xFFFF3C77 READ_WRITE /end MEASUREMENT
/begin MEASUREMENT fMCMTAOK "0:OKでない  1:OK" UBYTE COMP_0283 1 100 0 1 BIT_MASK 0x0080 ECU_ADDRESS 0xFFFF3C78 READ_WRITE /end MEASUREMENT
/begin MEASUREMENT fMCMTFENB "0:条件不成立  1:条件成立" UBYTE COMP_0283 1 100 0 1 BIT_MASK 0x0040 ECU_ADDRESS 0xFFFF3C78 READ_WRITE /end MEASUREMENT
/begin MEASUREMENT fMCMTFNGH "0:NGでない  1:NG" UBYTE COMP_0283 1 100 0 1 BIT_MASK 0x0020 ECU_ADDRESS 0xFFFF3C78 READ_WRITE /end MEASUREMENT
/begin MEASUREMENT fMCMTFNGL "0:NGでない  1:NG" UBYTE COMP_0283 1 100 0 1 BIT_MASK 0x0010 ECU_ADDRESS 0xFFFF3C78 READ_WRITE /end MEASUREMENT
/begin MEASUREMENT fMCMTFOK "0:OKでない  1:OK" UBYTE COMP_0283 1 100 0 1 BIT_MASK 0x0008 ECU_ADDRESS 0xFFFF3C78 READ_WRITE /end MEASUREMENT
/begin MEASUREMENT fMCMTHENB "0:条件不成立  1:条件成立" UBYTE COMP_0283 1 100 0 1 BIT_MASK 0x0004 ECU_ADDRESS 0xFFFF3C78 READ_WRITE /end MEASUREMENT
/begin MEASUREMENT fMCMTHNGH "0:NGでない  1:NG" UBYTE COMP_0283 1 100 0 1 BIT_MASK 0x0002 ECU_ADDRESS 0xFFFF3C78 READ_WRITE /end MEASUREMENT
/begin MEASUREMENT fMCMTHNGL "0:NGでない  1:NG" UBYTE COMP_0283 1 100 0 1 BIT_MASK 0x0001 ECU_ADDRESS 0xFFFF3C78 READ_WRITE /end MEASUREMENT
/begin MEASUREMENT fMCMTHOK "0:OKでない  1:OK" UBYTE COMP_0283 1 100 0 1 BIT_MASK 0x0080 ECU_ADDRESS 0xFFFF3C79 READ_WRITE /end MEASUREMENT
/begin MEASUREMENT fMCMTOENB "0:条件不成立  1:条件成立" UBYTE COMP_0283 1 100 0 1 BIT_MASK 0x0040 ECU_ADDRESS 0xFFFF3C79 READ_WRITE /end MEASUREMENT
/begin MEASUREMENT fMCMTONGH "0:NGでない  1:NG" UBYTE COMP_0283 1 100 0 1 BIT_MASK 0x0020 ECU_ADDRESS 0xFFFF3C79 READ_WRITE /end MEASUREMENT
/begin MEASUREMENT fMCMTONGL "0:NGでない  1:NG" UBYTE COMP_0283 1 100 0 1 BIT_MASK 0x0010 ECU_ADDRESS 0xFFFF3C79 READ_WRITE /end MEASUREMENT
/begin MEASUREMENT fMCMTOOK "0:OKでない  1:OK" UBYTE COMP_0283 1 100 0 1 BIT_MASK 0x0008 ECU_ADDRESS 0xFFFF3C79 READ_WRITE /end MEASUREMENT
/begin MEASUREMENT fMCMTRP "0:条件不成立  1:条件成立" UBYTE COMP_0283 1 100 0 1 BIT_MASK 0x0004 ECU_ADDRESS 0xFFFF3C79 READ_WRITE /end MEASUREMENT
/begin MEASUREMENT fMCMTWENB "0:条件不成立  1:条件成立" UBYTE COMP_0283 1 100 0 1 BIT_MASK 0x0002 ECU_ADDRESS 0xFFFF3C79 READ_WRITE /end MEASUREMENT
/begin MEASUREMENT fMCMTWNGH "0:NGでない  1:NG" UBYTE COMP_0283 1 100 0 1 BIT_MASK 0x0001 ECU_ADDRESS 0xFFFF3C79 READ_WRITE /end MEASUREMENT
/begin MEASUREMENT fMCMTWNGL "0:NGでない  1:NG" UBYTE COMP_0283 1 100 0 1 BIT_MASK 0x0080 ECU_ADDRESS 0xFFFF3C7A READ_WRITE /end MEASUREMENT
/begin MEASUREMENT fMCMTWOK "0:OKでない  1:OK" UBYTE COMP_0283 1 100 0 1 BIT_MASK 0x0040 ECU_ADDRESS 0xFFFF3C7A READ_WRITE /end MEASUREMENT
/begin MEASUREMENT fMCTACOMP "0:診断未完了  1:診断完了" UBYTE COMP_0283 1 100 0 1 BIT_MASK 0x0020 ECU_ADDRESS 0xFFFF3C7A READ_WRITE /end MEASUREMENT
/begin MEASUREMENT fMCTASOAK "0:条件不成立  1:条件成立" UBYTE COMP_0283 1 100 0 1 BIT_MASK 0x0010 ECU_ADDRESS 0xFFFF3C7A READ_WRITE /end MEASUREMENT
/begin MEASUREMENT fMCTFCOMP "0:診断未完了  1:診断完了" UBYTE COMP_0283 1 100 0 1 BIT_MASK 0x0008 ECU_ADDRESS 0xFFFF3C7A READ_WRITE /end MEASUREMENT
/begin MEASUREMENT fMCTFSOAK "0:条件不成立  1:条件成立" UBYTE COMP_0283 1 100 0 1 BIT_MASK 0x0004 ECU_ADDRESS 0xFFFF3C7A READ_WRITE /end MEASUREMENT
/begin MEASUREMENT fMCTHCOMP "0:診断未完了  1:診断完了" UBYTE COMP_0283 1 100 0 1 BIT_MASK 0x0002 ECU_ADDRESS 0xFFFF3C7A READ_WRITE /end MEASUREMENT
/begin MEASUREMENT fMCTHSOAK "0:条件不成立  1:条件成立" UBYTE COMP_0283 1 100 0 1 BIT_MASK 0x0001 ECU_ADDRESS 0xFFFF3C7A READ_WRITE /end MEASUREMENT
/begin MEASUREMENT fMCTOCOMP "0:診断未完了  1:診断完了" UBYTE COMP_0283 1 100 0 1 BIT_MASK 0x0080 ECU_ADDRESS 0xFFFF3C7B READ_WRITE /end MEASUREMENT
/begin MEASUREMENT fMCTOSOAK "0:条件不成立  1:条件成立" UBYTE COMP_0283 1 100 0 1 BIT_MASK 0x0040 ECU_ADDRESS 0xFFFF3C7B READ_WRITE /end MEASUREMENT
/begin MEASUREMENT fMCTWCOMP "0:診断未完了  1:診断完了" UBYTE COMP_0283 1 100 0 1 BIT_MASK 0x0020 ECU_ADDRESS 0xFFFF3C7B READ_WRITE /end MEASUREMENT
/begin MEASUREMENT fMCTWSOAK "0:条件不成立  1:条件成立" UBYTE COMP_0283 1 100 0 1 BIT_MASK 0x0010 ECU_ADDRESS 0xFFFF3C7B READ_WRITE /end MEASUREMENT
/begin MEASUREMENT fMECHAST "0:動作中  1:非動作中" UBYTE COMP_0283 1 100 0 1 BIT_MASK 0x0008 ECU_ADDRESS 0xFFFF3C7B READ_WRITE /end MEASUREMENT
/begin MEASUREMENT fMFACTRQ "0:非要求  1:要求" UBYTE COMP_0283 1 100 0 1 BIT_MASK 0x0004 ECU_ADDRESS 0xFFFF3C7B READ_WRITE /end MEASUREMENT
/begin MEASUREMENT fMFAICLR "0:要求なし  1:消去要求" UBYTE COMP_0283 1 100 0 1 BIT_MASK 0x0002 ECU_ADDRESS 0xFFFF3C7B READ_WRITE /end MEASUREMENT
/begin MEASUREMENT fMFCATCLR "0:要求なし  1:消去要求" UBYTE COMP_0283 1 100 0 1 BIT_MASK 0x0001 ECU_ADDRESS 0xFFFF3C7B READ_WRITE /end MEASUREMENT
/begin MEASUREMENT fMFCEMCLR "0:要求なし  1:消去要求" UBYTE COMP_0283 1 100 0 1 BIT_MASK 0x0080 ECU_ADDRESS 0xFFFF3C7C READ_WRITE /end MEASUREMENT
/begin MEASUREMENT fMFCLTA "0:ｶｳﾝﾄｱｯﾌﾟ許可  1:ｶｳﾝﾄｱｯﾌﾟ不許可" UBYTE COMP_0283 1 100 0 1 BIT_MASK 0x0040 ECU_ADDRESS 0xFFFF3C7C READ_WRITE /end MEASUREMENT
/begin MEASUREMENT fMFCLTW "0:ｶｳﾝﾄｱｯﾌﾟ許可  1:ｶｳﾝﾄｱｯﾌﾟ不許可" UBYTE COMP_0283 1 100 0 1 BIT_MASK 0x0020 ECU_ADDRESS 0xFFFF3C7C READ_WRITE /end MEASUREMENT
/begin MEASUREMENT fMFCLTWI "0:ｶｳﾝﾄｱｯﾌﾟ許可  1:ｶｳﾝﾄｱｯﾌﾟ不許可" UBYTE COMP_0283 1 100 0 1 BIT_MASK 0x0010 ECU_ADDRESS 0xFFFF3C7C READ_WRITE /end MEASUREMENT
/begin MEASUREMENT fMFCRSD "0:診断許可  1:診断不許可" UBYTE COMP_0283 1 100 0 1 BIT_MASK 0x0008 ECU_ADDRESS 0xFFFF3C7C READ_WRITE /end MEASUREMENT
/begin MEASUREMENT fMFCSTD "0:判定実施  1:判定ｷｬﾝｾﾙ" UBYTE COMP_0283 1 100 0 1 BIT_MASK 0x0004 ECU_ADDRESS 0xFFFF3C7C READ_WRITE /end MEASUREMENT
/begin MEASUREMENT fMFCTD "0:判定実施  1:判定ｷｬﾝｾﾙ" UBYTE COMP_0283 1 100 0 1 BIT_MASK 0x0002 ECU_ADDRESS 0xFFFF3C7C READ_WRITE /end MEASUREMENT
/begin MEASUREMENT fMFDGND "0:診断許可  1:診断不許可" UBYTE COMP_0283 1 100 0 1 BIT_MASK 0x0001 ECU_ADDRESS 0xFFFF3C7C READ_WRITE /end MEASUREMENT
/begin MEASUREMENT fMFHOSNG "0:補正許可  1:補正禁止" UBYTE COMP_0283 1 100 0 1 BIT_MASK 0x0080 ECU_ADDRESS 0xFFFF3C7D READ_WRITE /end MEASUREMENT
/begin MEASUREMENT fMFMAD "0:判定実施  1:判定ｷｬﾝｾﾙ" UBYTE COMP_0283 1 100 0 1 BIT_MASK 0x0040 ECU_ADDRESS 0xFFFF3C7D READ_WRITE /end MEASUREMENT
/begin MEASUREMENT fMFMASK "0:診断実施  1:診断ﾏｽｸ" UBYTE COMP_0283 1 100 0 1 BIT_MASK 0x0020 ECU_ADDRESS 0xFFFF3C7D READ_WRITE /end MEASUREMENT
/begin MEASUREMENT fMFMASKM "0:診断実施  1:診断ﾏｽｸ" UBYTE COMP_0283 1 100 0 1 BIT_MASK 0x0010 ECU_ADDRESS 0xFFFF3C7D READ_WRITE /end MEASUREMENT
/begin MEASUREMENT fMFMASKS "0:診断実施  1:診断ﾏｽｸ" UBYTE COMP_0283 1 100 0 1 BIT_MASK 0x0008 ECU_ADDRESS 0xFFFF3C7D READ_WRITE /end MEASUREMENT
/begin MEASUREMENT fMFMGD "0:判定実施  1:判定ｷｬﾝｾﾙ" UBYTE COMP_0283 1 100 0 1 BIT_MASK 0x0004 ECU_ADDRESS 0xFFFF3C7D READ_WRITE /end MEASUREMENT
/begin MEASUREMENT fMFNEUTD "0:判定実施  1:判定ｷｬﾝｾﾙ" UBYTE COMP_0283 1 100 0 1 BIT_MASK 0x0002 ECU_ADDRESS 0xFFFF3C7D READ_WRITE /end MEASUREMENT
/begin MEASUREMENT fMFNINE "0:なし  1:あり" UBYTE COMP_0283 1 100 0 1 BIT_MASK 0x0001 ECU_ADDRESS 0xFFFF3C7D READ_WRITE /end MEASUREMENT
/begin MEASUREMENT fMFNINF "0:なし  1:あり" UBYTE COMP_0283 1 100 0 1 BIT_MASK 0x0080 ECU_ADDRESS 0xFFFF3C7E READ_WRITE /end MEASUREMENT
/begin MEASUREMENT fMFNRPMD "0:診断許可  1:診断不許可" UBYTE COMP_0283 1 100 0 1 BIT_MASK 0x0040 ECU_ADDRESS 0xFFFF3C7E READ_WRITE /end MEASUREMENT
/begin MEASUREMENT fMFNTRQD "0:判定実施  1:判定ｷｬﾝｾﾙ" UBYTE COMP_0283 1 100 0 1 BIT_MASK 0x0020 ECU_ADDRESS 0xFFFF3C7E READ_WRITE /end MEASUREMENT
/begin MEASUREMENT fMFNWAREA1 "0:不成立  1:成立" UBYTE COMP_0283 1 100 0 1 BIT_MASK 0x0010 ECU_ADDRESS 0xFFFF3C7E READ_WRITE /end MEASUREMENT
/begin MEASUREMENT fMFNWAREA2 "0:不成立  1:成立" UBYTE COMP_0283 1 100 0 1 BIT_MASK 0x0008 ECU_ADDRESS 0xFFFF3C7E READ_WRITE /end MEASUREMENT
/begin MEASUREMENT fMFNWAREA3 "0:不成立  1:成立" UBYTE COMP_0283 1 100 0 1 BIT_MASK 0x0004 ECU_ADDRESS 0xFFFF3C7E READ_WRITE /end MEASUREMENT
/begin MEASUREMENT fMFNWAREA4 "0:不成立  1:成立" UBYTE COMP_0283 1 100 0 1 BIT_MASK 0x0002 ECU_ADDRESS 0xFFFF3C7E READ_WRITE /end MEASUREMENT
/begin MEASUREMENT fMFREQ1 "0:右記以外  1:MFREQ≧MFDTYの成立トリガ" UBYTE COMP_0283 1 100 0 1 BIT_MASK 0x0001 ECU_ADDRESS 0xFFFF3C7E READ_WRITE /end MEASUREMENT
/begin MEASUREMENT fMFREQ2 "0:右記以外  1:MFREQ＜MFDTYの成立トリガ" UBYTE COMP_0283 1 100 0 1 BIT_MASK 0x0080 ECU_ADDRESS 0xFFFF3C7F READ_WRITE /end MEASUREMENT
/begin MEASUREMENT fMFRR "0:診断実施  1:診断ﾏｽｸ" UBYTE COMP_0283 1 100 0 1 BIT_MASK 0x0040 ECU_ADDRESS 0xFFFF3C7F READ_WRITE /end MEASUREMENT
/begin MEASUREMENT fMFRRMFP "0:判定実施  1:判定ｷｬﾝｾﾙ" UBYTE COMP_0283 1 100 0 1 BIT_MASK 0x0020 ECU_ADDRESS 0xFFFF3C7F READ_WRITE /end MEASUREMENT
/begin MEASUREMENT fMFRRMFPM "0:診断実施  1:診断ﾏｽｸ" UBYTE COMP_0283 1 100 0 1 BIT_MASK 0x0010 ECU_ADDRESS 0xFFFF3C7F READ_WRITE /end MEASUREMENT
/begin MEASUREMENT fMFRRMFPS "0:診断実施  1:診断ﾏｽｸ" UBYTE COMP_0283 1 100 0 1 BIT_MASK 0x0008 ECU_ADDRESS 0xFFFF3C7F READ_WRITE /end MEASUREMENT
/begin MEASUREMENT fMFSMA1D "0:判定実施  1:判定ｷｬﾝｾﾙ" UBYTE COMP_0283 1 100 0 1 BIT_MASK 0x0004 ECU_ADDRESS 0xFFFF3C7F READ_WRITE /end MEASUREMENT
/begin MEASUREMENT fMFSMA2D "0:判定実施  1:判定ｷｬﾝｾﾙ" UBYTE COMP_0283 1 100 0 1 BIT_MASK 0x0002 ECU_ADDRESS 0xFFFF3C7F READ_WRITE /end MEASUREMENT
/begin MEASUREMENT fMFTINTD "0:診断許可  1:診断不許可" UBYTE COMP_0283 1 100 0 1 BIT_MASK 0x0001 ECU_ADDRESS 0xFFFF3C7F READ_WRITE /end MEASUREMENT
/begin MEASUREMENT fMFVBD "0:診断許可  1:診断不許可" UBYTE COMP_0283 1 100 0 1 BIT_MASK 0x0080 ECU_ADDRESS 0xFFFF3C80 READ_WRITE /end MEASUREMENT
/begin MEASUREMENT fMILFC "0:燃料カット  1:燃料カットリカバ" UBYTE COMP_0283 1 100 0 1 BIT_MASK 0x0040 ECU_ADDRESS 0xFFFF3C80 READ_WRITE /end MEASUREMENT
/begin MEASUREMENT fMILFCF "0:監視機構異常時燃料ｶｯﾄﾘｶﾊﾞ中また  1:監視機構異常時燃料ｶｯﾄ中" UBYTE COMP_0283 1 100 0 1 BIT_MASK 0x0020 ECU_ADDRESS 0xFFFF3C80 READ_WRITE /end MEASUREMENT
/begin MEASUREMENT fMILNGF "0:ﾌﾗｸﾞ1のとき以外  1:ﾌｪーﾙｾｰﾌ判定されている、かつ、MI" UBYTE COMP_0283 1 100 0 1 BIT_MASK 0x0010 ECU_ADDRESS 0xFFFF3C80 READ_WRITE /end MEASUREMENT
/begin MEASUREMENT fMODECAN "0:不成立  1:成立" UBYTE COMP_0283 1 100 0 1 BIT_MASK 0x0008 ECU_ADDRESS 0xFFFF3C80 READ_WRITE /end MEASUREMENT
/begin MEASUREMENT fMODEEND "0:未終了  1:終了" UBYTE COMP_0283 1 100 0 1 BIT_MASK 0x0004 ECU_ADDRESS 0xFFFF3C80 READ_WRITE /end MEASUREMENT
/begin MEASUREMENT fMODETH "0:不成立  1:成立" UBYTE COMP_0283 1 100 0 1 BIT_MASK 0x0002 ECU_ADDRESS 0xFFFF3C80 READ_WRITE /end MEASUREMENT
/begin MEASUREMENT fMODETHH "0:不成立  1:成立" UBYTE COMP_0283 1 100 0 1 BIT_MASK 0x0001 ECU_ADDRESS 0xFFFF3C80 READ_WRITE /end MEASUREMENT
/begin MEASUREMENT fMONFSMEM "0:FLGFS処理  1:FLGMEM処理" UBYTE COMP_0283 1 100 0 1 BIT_MASK 0x0080 ECU_ADDRESS 0xFFFF3C81 READ_WRITE /end MEASUREMENT
/begin MEASUREMENT fMOPSINI "0:初回  1:初回以外" UBYTE COMP_0283 1 100 0 1 BIT_MASK 0x0040 ECU_ADDRESS 0xFFFF3C81 READ_WRITE /end MEASUREMENT
/begin MEASUREMENT fMOVEJDGE "0:許可  1:禁止" UBYTE COMP_0283 1 100 0 1 BIT_MASK 0x0020 ECU_ADDRESS 0xFFFF3C81 READ_WRITE /end MEASUREMENT
/begin MEASUREMENT fMRDCL "0:燃料ｼｽﾃﾑLEAN側診断ｼﾐｭﾗｰｺﾝﾃﾞｨｼｮﾝ2  1:燃料ｼｽﾃﾑLEAN側診断ｼﾐｭﾗｰｺﾝﾃﾞｨｼｮﾝ2" UBYTE COMP_0283 1 100 0 1 BIT_MASK 0x0010 ECU_ADDRESS 0xFFFF3C81 READ_WRITE /end MEASUREMENT
/begin MEASUREMENT fMRDCR "0:燃料ｼｽﾃﾑRICH側診断ｼﾐｭﾗｰｺﾝﾃﾞｨｼｮﾝ2  1:燃料ｼｽﾃﾑRICH側診断ｼﾐｭﾗｰｺﾝﾃﾞｨｼｮﾝ2" UBYTE COMP_0283 1 100 0 1 BIT_MASK 0x0008 ECU_ADDRESS 0xFFFF3C81 READ_WRITE /end MEASUREMENT
/begin MEASUREMENT fMRDNCL "0:燃料ｼｽﾃﾑLEAN側診断NG未検出  1:燃料ｼｽﾃﾑLEAN側診断NG検出" UBYTE COMP_0283 1 100 0 1 BIT_MASK 0x0004 ECU_ADDRESS 0xFFFF3C81 READ_WRITE /end MEASUREMENT
/begin MEASUREMENT fMRDNCR "0:燃料ｼｽﾃﾑRICH側診断NG未検出  1:燃料ｼｽﾃﾑRICH側診断NG検出" UBYTE COMP_0283 1 100 0 1 BIT_MASK 0x0002 ECU_ADDRESS 0xFFFF3C81 READ_WRITE /end MEASUREMENT
/begin MEASUREMENT fMRENST "0:空燃比異常時耐エンストフェール未  1:空燃比異常時耐エンストフェール許" UBYTE COMP_0283 1 100 0 1 BIT_MASK 0x0001 ECU_ADDRESS 0xFFFF3C81 READ_WRITE /end MEASUREMENT
/begin MEASUREMENT fMRTNCL "0:燃料ｼｽﾃﾑLEAN側診断ｼﾐｭﾗｰｺﾝﾃﾞｨｼｮﾝ1  1:燃料ｼｽﾃﾑLEAN側診断ｼﾐｭﾗｰｺﾝﾃﾞｨｼｮﾝ1" UBYTE COMP_0283 1 100 0 1 BIT_MASK 0x0080 ECU_ADDRESS 0xFFFF3C82 READ_WRITE /end MEASUREMENT
/begin MEASUREMENT fMRTNCR "0:燃料ｼｽﾃﾑRICH側診断ｼﾐｭﾗｰｺﾝﾃﾞｨｼｮﾝ1  1:燃料ｼｽﾃﾑRICH側診断ｼﾐｭﾗｰｺﾝﾃﾞｨｼｮﾝ1" UBYTE COMP_0283 1 100 0 1 BIT_MASK 0x0040 ECU_ADDRESS 0xFFFF3C82 READ_WRITE /end MEASUREMENT
/begin MEASUREMENT fMSRACTOK "0:MSR制御不許可  1:MSR制御許可" UBYTE COMP_0283 1 100 0 1 BIT_MASK 0x0020 ECU_ADDRESS 0xFFFF3C82 READ_WRITE /end MEASUREMENT
/begin MEASUREMENT fMSRACTOK0 "0:MSR制御不許可  1:MSR制御許可" UBYTE COMP_0283 1 100 0 1 BIT_MASK 0x0010 ECU_ADDRESS 0xFFFF3C82 READ_WRITE /end MEASUREMENT
/begin MEASUREMENT fMSRCHG "0:MSR要求開始でない  1:MSR要求開始" UBYTE COMP_0283 1 100 0 1 BIT_MASK 0x0008 ECU_ADDRESS 0xFFFF3C82 READ_WRITE /end MEASUREMENT
/begin MEASUREMENT fMSRREQNG "0:正常  1:異常" UBYTE COMP_0283 1 100 0 1 BIT_MASK 0x0004 ECU_ADDRESS 0xFFFF3C82 READ_WRITE /end MEASUREMENT
/begin MEASUREMENT fMSRSTINH0 "0:MSR開始許可  1:MSR開始禁止" UBYTE COMP_0283 1 100 0 1 BIT_MASK 0x0002 ECU_ADDRESS 0xFFFF3C82 READ_WRITE /end MEASUREMENT
/begin MEASUREMENT fMSRVALID "0:無効  1:有効" UBYTE COMP_0283 1 100 0 1 BIT_MASK 0x0001 ECU_ADDRESS 0xFFFF3C82 READ_WRITE /end MEASUREMENT
/begin MEASUREMENT fMSTPEXP "0:条件不成立  1:条件成立" UBYTE COMP_0283 1 100 0 1 BIT_MASK 0x0080 ECU_ADDRESS 0xFFFF3C83 READ_WRITE /end MEASUREMENT
/begin MEASUREMENT fMTRPFLG "0:(m)条件不成立  1:(m)条件成立" UBYTE COMP_0283 1 100 0 1 BIT_MASK 0x0040 ECU_ADDRESS 0xFFFF3C83 READ_WRITE /end MEASUREMENT
/begin MEASUREMENT fMVREQ "0:右記以外  1:負圧要求有り" UBYTE COMP_0283 1 100 0 1 BIT_MASK 0x0020 ECU_ADDRESS 0xFFFF3C83 READ_WRITE /end MEASUREMENT
/begin MEASUREMENT fNEUTMON "0:NEUT_SW_ON固着診断許可条件不成立  1:NEUT_SW_ON固着診断許可条件成立中" UBYTE COMP_0283 1 100 0 1 BIT_MASK 0x0010 ECU_ADDRESS 0xFFFF3C83 READ_WRITE /end MEASUREMENT
/begin MEASUREMENT fNEUTNG "0:通常NEUT＿SW診断正常  1:通常NEUT＿SW診断NG" UBYTE COMP_0283 1 100 0 1 BIT_MASK 0x0008 ECU_ADDRESS 0xFFFF3C83 READ_WRITE /end MEASUREMENT
/begin MEASUREMENT fNEWQCAL "0:次世代吸気計量ﾛｼﾞｯｸ以外  1:次世代吸気計量ﾛｼﾞｯｸ" UBYTE COMP_0283 1 100 0 1 BIT_MASK 0x0004 ECU_ADDRESS 0xFFFF3C83 READ_WRITE /end MEASUREMENT
/begin MEASUREMENT fNG1CNT1 "0:右記以外  1:診断カウンタカウント禁止１（バン" UBYTE COMP_0283 1 100 0 1 BIT_MASK 0x0002 ECU_ADDRESS 0xFFFF3C83 READ_WRITE /end MEASUREMENT
/begin MEASUREMENT fNG1CNT2 "0:右記以外  1:診断カウンタカウント禁止１（バン" UBYTE COMP_0283 1 100 0 1 BIT_MASK 0x0001 ECU_ADDRESS 0xFFFF3C83 READ_WRITE /end MEASUREMENT
/begin MEASUREMENT fNG2CNT1 "0:右記以外  1:診断カウンタカウント禁止２（バン" UBYTE COMP_0283 1 100 0 1 BIT_MASK 0x0080 ECU_ADDRESS 0xFFFF3C84 READ_WRITE /end MEASUREMENT
/begin MEASUREMENT fNG2CNT2 "0:右記以外  1:診断カウンタカウント禁止２（バン" UBYTE COMP_0283 1 100 0 1 BIT_MASK 0x0040 ECU_ADDRESS 0xFFFF3C84 READ_WRITE /end MEASUREMENT
/begin MEASUREMENT fNGANSRQ "0:不成立  1:成立" UBYTE COMP_0283 1 100 0 1 BIT_MASK 0x0020 ECU_ADDRESS 0xFFFF3C84 READ_WRITE /end MEASUREMENT
/begin MEASUREMENT fNOMALJ "0:判定未  1:正常判定(通常判定方式)" UBYTE COMP_0283 1 100 0 1 BIT_MASK 0x0010 ECU_ADDRESS 0xFFFF3C84 READ_WRITE /end MEASUREMENT
/begin MEASUREMENT fNORMALS "0:判定未  1:正常信号有(通常判定方式)" UBYTE COMP_0283 1 100 0 1 BIT_MASK 0x0008 ECU_ADDRESS 0xFFFF3C84 READ_WRITE /end MEASUREMENT
/begin MEASUREMENT fNOVHFC "0:MNRPM＜NOVHFC#(ﾋｽ-OFCHYS#)  1:MNRPM≧NOVHFC#(ﾋｽ-OFCHYS#)" UBYTE COMP_0283 1 100 0 1 BIT_MASK 0x0004 ECU_ADDRESS 0xFFFF3C84 READ_WRITE /end MEASUREMENT
/begin MEASUREMENT fNSOFF "0:NEUT_SWがOFFとなった事がない  1:NEUT_SWがOFFとなった事がある" UBYTE COMP_0283 1 100 0 1 BIT_MASK 0x0002 ECU_ADDRESS 0xFFFF3C84 READ_WRITE /end MEASUREMENT
/begin MEASUREMENT fNSON "0:NEUT_SWがONとなった事がない  1:NEUT_SWがONとなった事がある" UBYTE COMP_0283 1 100 0 1 BIT_MASK 0x0001 ECU_ADDRESS 0xFFFF3C84 READ_WRITE /end MEASUREMENT
/begin MEASUREMENT fNST55 "0:EEPROMエンジン回転数調整値書き込  1:EEPROMエンジン回転数調整値書き込" UBYTE COMP_0283 1 100 0 1 BIT_MASK 0x0080 ECU_ADDRESS 0xFFFF3C85 READ_WRITE /end MEASUREMENT
/begin MEASUREMENT fNST55OLD "0:EEPROMエンジン回転数調整値書き込  1:EEPROMエンジン回転数調整値書き込" UBYTE COMP_0283 1 100 0 1 BIT_MASK 0x0040 ECU_ADDRESS 0xFFFF3C85 READ_WRITE /end MEASUREMENT
/begin MEASUREMENT fNSTADJ "0:エンジン回転数調整でない  1:エンジン回転数調整である" UBYTE COMP_0283 1 100 0 1 BIT_MASK 0x0020 ECU_ADDRESS 0xFFFF3C85 READ_WRITE /end MEASUREMENT
/begin MEASUREMENT fNSTADJWT "0:右記以外  1:NSTEPN値EEPROM書込み要求" UBYTE COMP_0283 1 100 0 1 BIT_MASK 0x0010 ECU_ADDRESS 0xFFFF3C85 READ_WRITE /end MEASUREMENT
/begin MEASUREMENT fNSTCYO "0:エンジン回転数調整でない  1:エンジン回転数調整である" UBYTE COMP_0283 1 100 0 1 BIT_MASK 0x0008 ECU_ADDRESS 0xFFFF3C85 READ_WRITE /end MEASUREMENT
/begin MEASUREMENT fNSTDDL "0:エンジン回転数調整でない  1:エンジン回転数調整である" UBYTE COMP_0283 1 100 0 1 BIT_MASK 0x0004 ECU_ADDRESS 0xFFFF3C85 READ_WRITE /end MEASUREMENT
/begin MEASUREMENT fNSTSW "0:ST/SW_ON_→OFF_時車速4km以上  1:ST/SW_ON_→OFF_時車速4km以下" UBYTE COMP_0283 1 100 0 1 BIT_MASK 0x0002 ECU_ADDRESS 0xFFFF3C85 READ_WRITE /end MEASUREMENT
/begin MEASUREMENT fNTAS "0:右記以外  1:アイドル回転数学習回転数条件範囲" UBYTE COMP_0283 1 100 0 1 BIT_MASK 0x0001 ECU_ADDRESS 0xFFFF3C85 READ_WRITE /end MEASUREMENT
/begin MEASUREMENT fNTDGCNT "0:未ｶｳﾝﾄ  1:ｶｳﾝﾄ済み" UBYTE COMP_0283 1 100 0 1 BIT_MASK 0x0080 ECU_ADDRESS 0xFFFF3C86 READ_WRITE /end MEASUREMENT
/begin MEASUREMENT fNTRPFLG "0:(n)条件不成立  1:(n)条件成立" UBYTE COMP_0283 1 100 0 1 BIT_MASK 0x0040 ECU_ADDRESS 0xFFFF3C86 READ_WRITE /end MEASUREMENT
/begin MEASUREMENT fO2HMLOK "0:O2ﾋｰﾀ診断未終了  1:O2ﾋｰﾀ診断終了" UBYTE COMP_0283 1 100 0 1 BIT_MASK 0x0020 ECU_ADDRESS 0xFFFF3C86 READ_WRITE /end MEASUREMENT
/begin MEASUREMENT fO2HQM40 "0:SUMQM40条件不成立  1:SUMQM40条件成立" UBYTE COMP_0283 1 100 0 1 BIT_MASK 0x0010 ECU_ADDRESS 0xFFFF3C86 READ_WRITE /end MEASUREMENT
/begin MEASUREMENT fO2HRDY "0:不成立  1:成立" UBYTE COMP_0283 1 100 0 1 BIT_MASK 0x0008 ECU_ADDRESS 0xFFFF3C86 READ_WRITE /end MEASUREMENT
/begin MEASUREMENT fO2HRN "0:不成立  1:成立" UBYTE COMP_0283 1 100 0 1 BIT_MASK 0x0004 ECU_ADDRESS 0xFFFF3C86 READ_WRITE /end MEASUREMENT
/begin MEASUREMENT fO2HRTP "0:不成立  1:成立" UBYTE COMP_0283 1 100 0 1 BIT_MASK 0x0002 ECU_ADDRESS 0xFFFF3C86 READ_WRITE /end MEASUREMENT
/begin MEASUREMENT fO2HRVB "0:不成立  1:成立" UBYTE COMP_0283 1 100 0 1 BIT_MASK 0x0001 ECU_ADDRESS 0xFFFF3C86 READ_WRITE /end MEASUREMENT
/begin MEASUREMENT fO2HTCR "0:不成立  1:成立" UBYTE COMP_0283 1 100 0 1 BIT_MASK 0x0080 ECU_ADDRESS 0xFFFF3C87 READ_WRITE /end MEASUREMENT
/begin MEASUREMENT fO2HTWN5 "0:未経験  1:経験" UBYTE COMP_0283 1 100 0 1 BIT_MASK 0x0040 ECU_ADDRESS 0xFFFF3C87 READ_WRITE /end MEASUREMENT
/begin MEASUREMENT fO2HTWNCHK "0:無し  1:有り" UBYTE COMP_0283 1 100 0 1 BIT_MASK 0x0020 ECU_ADDRESS 0xFFFF3C87 READ_WRITE /end MEASUREMENT
/begin MEASUREMENT fO2SMLOK "0:O2ｾﾝｻ診断未終了  1:O2ｾﾝｻ診断終了" UBYTE COMP_0283 1 100 0 1 BIT_MASK 0x0010 ECU_ADDRESS 0xFFFF3C87 READ_WRITE /end MEASUREMENT
/begin MEASUREMENT fOBNG1 "0:ｵｰﾊﾞｰﾌﾞｰｽﾄ開始許可  1:ｵｰﾊﾞｰﾌﾞｰｽﾄ開始禁止" UBYTE COMP_0283 1 100 0 1 BIT_MASK 0x0008 ECU_ADDRESS 0xFFFF3C87 READ_WRITE /end MEASUREMENT
/begin MEASUREMENT fOBNG2 "0:ｵｰﾊﾞｰﾌﾞｰｽﾄ継続許可  1:ｵｰﾊﾞｰﾌﾞｰｽﾄ強制終了" UBYTE COMP_0283 1 100 0 1 BIT_MASK 0x0004 ECU_ADDRESS 0xFFFF3C87 READ_WRITE /end MEASUREMENT
/begin MEASUREMENT fOBNGTMP1 "0:許可  1:禁止" UBYTE COMP_0283 1 100 0 1 BIT_MASK 0x0002 ECU_ADDRESS 0xFFFF3C87 READ_WRITE /end MEASUREMENT
/begin MEASUREMENT fOBNGTMP2 "0:許可  1:禁止" UBYTE COMP_0283 1 100 0 1 BIT_MASK 0x0001 ECU_ADDRESS 0xFFFF3C87 READ_WRITE /end MEASUREMENT
/begin MEASUREMENT fODBAN "0:右記以外  1:最大駆動力仮学習禁止" UBYTE COMP_0283 1 100 0 1 BIT_MASK 0x0080 ECU_ADDRESS 0xFFFF3C88 READ_WRITE /end MEASUREMENT
/begin MEASUREMENT fODLEAR "0:右記以外  1:仮学習完了" UBYTE COMP_0283 1 100 0 1 BIT_MASK 0x0020 ECU_ADDRESS 0xFFFF3C88 READ_WRITE /end MEASUREMENT
/begin MEASUREMENT fODLEAR0 "0:仮学習不可  1:仮学習可" UBYTE COMP_0283 1 100 0 1 BIT_MASK 0x0010 ECU_ADDRESS 0xFFFF3C88 READ_WRITE /end MEASUREMENT
/begin MEASUREMENT fODLNED "0:右記以外  1:学習確定" UBYTE COMP_0283 1 100 0 1 BIT_MASK 0x0008 ECU_ADDRESS 0xFFFF3C88 READ_WRITE /end MEASUREMENT
/begin MEASUREMENT fOIHPSFC "0:不成立  1:成立" UBYTE COMP_0283 1 100 0 1 BIT_MASK 0x0004 ECU_ADDRESS 0xFFFF3C88 READ_WRITE /end MEASUREMENT
/begin MEASUREMENT fOILJDG1 "0:水温判定時間経過なし  1:水温判定時間経過あり" UBYTE COMP_0283 1 100 0 1 BIT_MASK 0x0002 ECU_ADDRESS 0xFFFF3C88 READ_WRITE /end MEASUREMENT
/begin MEASUREMENT fOILJDG4 "0:ｴﾝｼﾞﾝ回転累積時間経過なし  1:ｴﾝｼﾞﾝ回転累積時間経過あり" UBYTE COMP_0283 1 100 0 1 BIT_MASK 0x0001 ECU_ADDRESS 0xFFFF3C88 READ_WRITE /end MEASUREMENT
/begin MEASUREMENT fOK1CNT1 "0:右記以外  1:診断カウンタカウント許可１（バン" UBYTE COMP_0283 1 100 0 1 BIT_MASK 0x0080 ECU_ADDRESS 0xFFFF3C89 READ_WRITE /end MEASUREMENT
/begin MEASUREMENT fOK1CNT2 "0:右記以外  1:診断カウンタカウント許可１（バン" UBYTE COMP_0283 1 100 0 1 BIT_MASK 0x0040 ECU_ADDRESS 0xFFFF3C89 READ_WRITE /end MEASUREMENT
/begin MEASUREMENT fOK2CNT1 "0:右記以外  1:診断カウンタカウント許可２（バン" UBYTE COMP_0283 1 100 0 1 BIT_MASK 0x0020 ECU_ADDRESS 0xFFFF3C89 READ_WRITE /end MEASUREMENT
/begin MEASUREMENT fOK2CNT2 "0:右記以外  1:診断カウンタカウント許可２（バン" UBYTE COMP_0283 1 100 0 1 BIT_MASK 0x0010 ECU_ADDRESS 0xFFFF3C89 READ_WRITE /end MEASUREMENT
/begin MEASUREMENT fOKFPCM "0:未経験  1:経験" UBYTE COMP_0283 1 100 0 1 BIT_MASK 0x0008 ECU_ADDRESS 0xFFFF3C89 READ_WRITE /end MEASUREMENT
/begin MEASUREMENT fOTRPFLG "0:(o)条件不成立  1:(o)条件成立" UBYTE COMP_0283 1 100 0 1 BIT_MASK 0x0004 ECU_ADDRESS 0xFFFF3C89 READ_WRITE /end MEASUREMENT
/begin MEASUREMENT fOUTCHK1 "0:処理移行未完  1:処理移行済み" UBYTE COMP_0283 1 100 0 1 BIT_MASK 0x0002 ECU_ADDRESS 0xFFFF3C89 READ_WRITE /end MEASUREMENT
/begin MEASUREMENT fOVECHGTV "0:過充電時発電ﾓｰﾄﾞ切り替えなし  1:過充電時発電ﾓｰﾄﾞ切り替えあり" UBYTE COMP_0283 1 100 0 1 BIT_MASK 0x0001 ECU_ADDRESS 0xFFFF3C89 READ_WRITE /end MEASUREMENT
/begin MEASUREMENT fOVHFC "0:ｵｰﾊﾞｰﾋｰﾄ時燃料ｶｯﾄ条件不成立  1:ｵｰﾊﾞｰﾋｰﾄ時燃料ｶｯﾄ条件成立" UBYTE COMP_0283 1 100 0 1 BIT_MASK 0x0080 ECU_ADDRESS 0xFFFF3C8A READ_WRITE /end MEASUREMENT
/begin MEASUREMENT fOVHMEM "0:ｵｰﾊﾞｰﾋｰﾄ経験なし  1:ｵｰﾊﾞｰﾋｰﾄ経験あり" UBYTE COMP_0283 1 100 0 1 BIT_MASK 0x0040 ECU_ADDRESS 0xFFFF3C8A READ_WRITE /end MEASUREMENT
/begin MEASUREMENT fOVLOAD1 "0:右記以外  1:バッテリ充電完了判定用電気負荷過" UBYTE COMP_0283 1 100 0 1 BIT_MASK 0x0020 ECU_ADDRESS 0xFFFF3C8A READ_WRITE /end MEASUREMENT
/begin MEASUREMENT fOVTWNG "0:水温ｾﾝｻ正常  1:水温ｾﾝｻ異常" UBYTE COMP_0283 1 100 0 1 BIT_MASK 0x0010 ECU_ADDRESS 0xFFFF3C8A READ_WRITE /end MEASUREMENT
/begin MEASUREMENT fPAKNDHC "0:非成立  1:成立" UBYTE COMP_0283 1 100 0 1 BIT_MASK 0x0008 ECU_ADDRESS 0xFFFF3C8A READ_WRITE /end MEASUREMENT
/begin MEASUREMENT fPCEVPS "0:右記以外  1:低車速プルダウン制御要求によるEV" UBYTE COMP_0283 1 100 0 1 BIT_MASK 0x0004 ECU_ADDRESS 0xFFFF3C8A READ_WRITE /end MEASUREMENT
/begin MEASUREMENT fPCONK0 "0:右記以外  1:キャニスタパージ制御即KDUTY=0要" UBYTE COMP_0283 1 100 0 1 BIT_MASK 0x0002 ECU_ADDRESS 0xFFFF3C8A READ_WRITE /end MEASUREMENT
/begin MEASUREMENT fPCONKD "0:右記以外  1:キャニスタパージ制御徐々にKDUTY=" UBYTE COMP_0283 1 100 0 1 BIT_MASK 0x0001 ECU_ADDRESS 0xFFFF3C8A READ_WRITE /end MEASUREMENT
/begin MEASUREMENT fPCONS1 "0:右記以外  1:エバポ診断EVPSST=PCVST1#固定要求" UBYTE COMP_0283 1 100 0 1 BIT_MASK 0x0080 ECU_ADDRESS 0xFFFF3C8B READ_WRITE /end MEASUREMENT
/begin MEASUREMENT fPCONS2 "0:右記以外  1:エバポ診断EVPSST=PCVST2#固定要求" UBYTE COMP_0283 1 100 0 1 BIT_MASK 0x0040 ECU_ADDRESS 0xFFFF3C8B READ_WRITE /end MEASUREMENT
/begin MEASUREMENT fPCONS3 "0:コントロール/V_PCVST3開度要求無  1:コントロール/V_PCVST3開度要求有" UBYTE COMP_0283 1 100 0 1 BIT_MASK 0x0020 ECU_ADDRESS 0xFFFF3C8B READ_WRITE /end MEASUREMENT
/begin MEASUREMENT fPCONS4 "0:PCVST4開度未要求  1:PCVST4開度要求" UBYTE COMP_0283 1 100 0 1 BIT_MASK 0x0010 ECU_ADDRESS 0xFFFF3C8B READ_WRITE /end MEASUREMENT
/begin MEASUREMENT fPCONS5 "0:PCVST5開度未要求  1:PCVST5開度要求" UBYTE COMP_0283 1 100 0 1 BIT_MASK 0x0008 ECU_ADDRESS 0xFFFF3C8B READ_WRITE /end MEASUREMENT
/begin MEASUREMENT fPCUT1ST "0:未経験  1:経験した" UBYTE COMP_0283 1 100 0 1 BIT_MASK 0x0004 ECU_ADDRESS 0xFFFF3C8B READ_WRITE /end MEASUREMENT
/begin MEASUREMENT fPCVEND "0:未終了  1:終了" UBYTE COMP_0283 1 100 0 1 BIT_MASK 0x0002 ECU_ADDRESS 0xFFFF3C8B READ_WRITE /end MEASUREMENT
/begin MEASUREMENT fPDLLHDFT "0:正常  1:異常" UBYTE COMP_0283 1 100 0 1 BIT_MASK 0x0001 ECU_ADDRESS 0xFFFF3C8B READ_WRITE /end MEASUREMENT
/begin MEASUREMENT fPDTCGTRP "0:経験していない  1:経験した" UBYTE COMP_0283 1 100 0 1 BIT_MASK 0x0080 ECU_ADDRESS 0xFFFF3C8C READ_WRITE /end MEASUREMENT
/begin MEASUREMENT fPEEPERR "0:経験していない  1:経験した" UBYTE COMP_0283 1 100 0 1 BIT_MASK 0x0040 ECU_ADDRESS 0xFFFF3C8C READ_WRITE /end MEASUREMENT
/begin MEASUREMENT fPERTFB2 "0:算出  1:非算出" UBYTE COMP_0283 1 100 0 1 BIT_MASK 0x0020 ECU_ADDRESS 0xFFFF3C8C READ_WRITE /end MEASUREMENT
/begin MEASUREMENT fPERTFB4 "0:算出  1:非算出" UBYTE COMP_0283 1 100 0 1 BIT_MASK 0x0010 ECU_ADDRESS 0xFFFF3C8C READ_WRITE /end MEASUREMENT
/begin MEASUREMENT fPFDGJG3 "0:不成立  1:成立" UBYTE COMP_0283 1 100 0 1 BIT_MASK 0x0008 ECU_ADDRESS 0xFFFF3C8C READ_WRITE /end MEASUREMENT
/begin MEASUREMENT fPIDLETRP "0:条件不成立  1:条件成立" UBYTE COMP_0283 1 100 0 1 BIT_MASK 0x0004 ECU_ADDRESS 0xFFFF3C8C READ_WRITE /end MEASUREMENT
/begin MEASUREMENT fPIMNG "0:OK  1:NG" UBYTE COMP_0283 1 100 0 1 BIT_MASK 0x0002 ECU_ADDRESS 0xFFFF3C8C READ_WRITE /end MEASUREMENT
/begin MEASUREMENT fPKDCL "0:不成立  1:成立" UBYTE COMP_0283 1 100 0 1 BIT_MASK 0x0001 ECU_ADDRESS 0xFFFF3C8C READ_WRITE /end MEASUREMENT
/begin MEASUREMENT fPKDGNDMD "0:不成立  1:成立" UBYTE COMP_0283 1 100 0 1 BIT_MASK 0x0080 ECU_ADDRESS 0xFFFF3C8D READ_WRITE /end MEASUREMENT
/begin MEASUREMENT fPKHTOFID "0:不成立  1:成立" UBYTE COMP_0283 1 100 0 1 BIT_MASK 0x0040 ECU_ADDRESS 0xFFFF3C8D READ_WRITE /end MEASUREMENT
/begin MEASUREMENT fPKLMDCLS "0:不成立  1:成立" UBYTE COMP_0283 1 100 0 1 BIT_MASK 0x0020 ECU_ADDRESS 0xFFFF3C8D READ_WRITE /end MEASUREMENT
/begin MEASUREMENT fPKTWN "0:不成立  1:成立" UBYTE COMP_0283 1 100 0 1 BIT_MASK 0x0010 ECU_ADDRESS 0xFFFF3C8D READ_WRITE /end MEASUREMENT
/begin MEASUREMENT fPLDWARAL "0:低車速ﾌﾟﾙﾀﾞｳﾝ領域条件不成立  1:低車速ﾌﾟﾙﾀﾞｳﾝ領域条件成立" UBYTE COMP_0283 1 100 0 1 BIT_MASK 0x0008 ECU_ADDRESS 0xFFFF3C8D READ_WRITE /end MEASUREMENT
/begin MEASUREMENT fPLDWKYO "0:－  1:－" UBYTE COMP_0283 1 100 0 1 BIT_MASK 0x0004 ECU_ADDRESS 0xFFFF3C8D READ_WRITE /end MEASUREMENT
/begin MEASUREMENT fPMCAF1NG1 "0:許可  1:禁止" UBYTE COMP_0283 1 100 0 1 BIT_MASK 0x0002 ECU_ADDRESS 0xFFFF3C8D READ_WRITE /end MEASUREMENT
/begin MEASUREMENT fPMCAF1NG2 "0:許可  1:禁止" UBYTE COMP_0283 1 100 0 1 BIT_MASK 0x0001 ECU_ADDRESS 0xFFFF3C8D READ_WRITE /end MEASUREMENT
/begin MEASUREMENT fPMCAF1NG5 "0:許可  1:禁止" UBYTE COMP_0283 1 100 0 1 BIT_MASK 0x0080 ECU_ADDRESS 0xFFFF3C8E READ_WRITE /end MEASUREMENT
/begin MEASUREMENT fPMCPRES1O "0:右記以外  1:診断許可条件の状態、２[S]以上継" UBYTE COMP_0283 1 100 0 1 BIT_MASK 0x0040 ECU_ADDRESS 0xFFFF3C8E READ_WRITE /end MEASUREMENT
/begin MEASUREMENT fPMCPRES1S "0:右記以外  1:診断許可条件の状態、２[S]以上継" UBYTE COMP_0283 1 100 0 1 BIT_MASK 0x0020 ECU_ADDRESS 0xFFFF3C8E READ_WRITE /end MEASUREMENT
/begin MEASUREMENT fPORTMAIN "0:5連照合結果Low  1:5連照合結果High" UBYTE COMP_0283 1 100 0 1 BIT_MASK 0x0010 ECU_ADDRESS 0xFFFF3C8E READ_WRITE /end MEASUREMENT
/begin MEASUREMENT fPRGCTME "0:経験なし  1:経験あり" UBYTE COMP_0283 1 100 0 1 BIT_MASK 0x0008 ECU_ADDRESS 0xFFFF3C8E READ_WRITE /end MEASUREMENT
/begin MEASUREMENT fPRGSYSWS "0:ﾓｰﾄﾞ中でない  1:ﾓｰﾄﾞ中" UBYTE COMP_0283 1 100 0 1 BIT_MASK 0x0004 ECU_ADDRESS 0xFFFF3C8E READ_WRITE /end MEASUREMENT
/begin MEASUREMENT fPRGWSACT "0:なし  1:あり" UBYTE COMP_0283 1 100 0 1 BIT_MASK 0x0002 ECU_ADDRESS 0xFFFF3C8E READ_WRITE /end MEASUREMENT
/begin MEASUREMENT fPSFDWIT "0:不成立  1:成立" UBYTE COMP_0283 1 100 0 1 BIT_MASK 0x0001 ECU_ADDRESS 0xFFFF3C8E READ_WRITE /end MEASUREMENT
/begin MEASUREMENT fPSFHSTP "0:診断継続  1:診断終了" UBYTE COMP_0283 1 100 0 1 BIT_MASK 0x0080 ECU_ADDRESS 0xFFFF3C8F READ_WRITE /end MEASUREMENT
/begin MEASUREMENT fPSFLSTP "0:診断継続  1:診断終了" UBYTE COMP_0283 1 100 0 1 BIT_MASK 0x0040 ECU_ADDRESS 0xFFFF3C8F READ_WRITE /end MEASUREMENT
/begin MEASUREMENT fPSFQLRN2 "0:ｸﾘｱ未  1:ｸﾘｱ済" UBYTE COMP_0283 1 100 0 1 BIT_MASK 0x0020 ECU_ADDRESS 0xFFFF3C8F READ_WRITE /end MEASUREMENT
/begin MEASUREMENT fPSSTR "0:右記以外  1:PS強制成層アイドル条件成立" UBYTE COMP_0283 1 100 0 1 BIT_MASK 0x0010 ECU_ADDRESS 0xFFFF3C8F READ_WRITE /end MEASUREMENT
/begin MEASUREMENT fPSSTRV "0:右記以外  1:PS強制均質固定条件成立(VTC)" UBYTE COMP_0283 1 100 0 1 BIT_MASK 0x0008 ECU_ADDRESS 0xFFFF3C8F READ_WRITE /end MEASUREMENT
/begin MEASUREMENT fPSTSWTRP "0:条件不成立  1:条件成立" UBYTE COMP_0283 1 100 0 1 BIT_MASK 0x0004 ECU_ADDRESS 0xFFFF3C8F READ_WRITE /end MEASUREMENT
/begin MEASUREMENT fPSYSDGN "0:パージシステム診断NG未判定  1:パージシステム診断NG判定" UBYTE COMP_0283 1 100 0 1 BIT_MASK 0x0002 ECU_ADDRESS 0xFFFF3C8F READ_WRITE /end MEASUREMENT
/begin MEASUREMENT fPTRPFLG "0:(p)条件不成立  1:(p)条件成立" UBYTE COMP_0283 1 100 0 1 BIT_MASK 0x0001 ECU_ADDRESS 0xFFFF3C8F READ_WRITE /end MEASUREMENT
/begin MEASUREMENT fPUPAFNG "0:不成立  1:成立" UBYTE COMP_0283 1 100 0 1 BIT_MASK 0x0080 ECU_ADDRESS 0xFFFF3C90 READ_WRITE /end MEASUREMENT
/begin MEASUREMENT fPUSDGN2E "0:不成立  1:成立" UBYTE COMP_0283 1 100 0 1 BIT_MASK 0x0040 ECU_ADDRESS 0xFFFF3C90 READ_WRITE /end MEASUREMENT
/begin MEASUREMENT fPUSDGNE "0:不成立  1:成立" UBYTE COMP_0283 1 100 0 1 BIT_MASK 0x0020 ECU_ADDRESS 0xFFFF3C90 READ_WRITE /end MEASUREMENT
/begin MEASUREMENT fPVCNDOK "0:未成立  1:成立" UBYTE COMP_0283 1 100 0 1 BIT_MASK 0x0010 ECU_ADDRESS 0xFFFF3C90 READ_WRITE /end MEASUREMENT
/begin MEASUREMENT fPVGO "0:実行中でない  1:実行中" UBYTE COMP_0283 1 100 0 1 BIT_MASK 0x0008 ECU_ADDRESS 0xFFFF3C90 READ_WRITE /end MEASUREMENT
/begin MEASUREMENT fPVGOEX "0:不成立  1:成立" UBYTE COMP_0283 1 100 0 1 BIT_MASK 0x0004 ECU_ADDRESS 0xFFFF3C90 READ_WRITE /end MEASUREMENT
/begin MEASUREMENT fPVLNG "0:NG判定以外  1:NG判定" UBYTE COMP_0283 1 100 0 1 BIT_MASK 0x0002 ECU_ADDRESS 0xFFFF3C90 READ_WRITE /end MEASUREMENT
/begin MEASUREMENT fPVLOK "0:OK判定以外  1:OK判定" UBYTE COMP_0283 1 100 0 1 BIT_MASK 0x0001 ECU_ADDRESS 0xFFFF3C90 READ_WRITE /end MEASUREMENT
/begin MEASUREMENT fPVRFERR "0:経験していない  1:経験した" UBYTE COMP_0283 1 100 0 1 BIT_MASK 0x0080 ECU_ADDRESS 0xFFFF3C91 READ_WRITE /end MEASUREMENT
/begin MEASUREMENT fPVSPTRP "0:条件不成立  1:条件成立" UBYTE COMP_0283 1 100 0 1 BIT_MASK 0x0040 ECU_ADDRESS 0xFFFF3C91 READ_WRITE /end MEASUREMENT
/begin MEASUREMENT fPVTCTRG "0:右記以外  1:PS-VTCTRGアクティブテスト要求" UBYTE COMP_0283 1 100 0 1 BIT_MASK 0x0020 ECU_ADDRESS 0xFFFF3C91 READ_WRITE /end MEASUREMENT
/begin MEASUREMENT fPVTCTRG2 "0:右記以外  1:PS-VTCTRG2アクティブテスト要求" UBYTE COMP_0283 1 100 0 1 BIT_MASK 0x0010 ECU_ADDRESS 0xFFFF3C91 READ_WRITE /end MEASUREMENT
/begin MEASUREMENT fPWRBLNC "0:DDLﾊﾟﾜｰﾊﾞﾗﾝｽ制御中でない  1:DDLﾊﾟﾜｰﾊﾞﾗﾝｽ制御中" UBYTE COMP_0283 1 100 0 1 BIT_MASK 0x0008 ECU_ADDRESS 0xFFFF3C91 READ_WRITE /end MEASUREMENT
/begin MEASUREMENT fPWTSPFL "0:パワートレインセットポイントFULL  1:パワートレインセットポイントFULL" UBYTE COMP_0283 1 100 0 1 BIT_MASK 0x0004 ECU_ADDRESS 0xFFFF3C91 READ_WRITE /end MEASUREMENT
/begin MEASUREMENT fPWTSPUP "0:パワートレインセットポイントIDLE  1:パワートレインセットポイントIDLE" UBYTE COMP_0283 1 100 0 1 BIT_MASK 0x0002 ECU_ADDRESS 0xFFFF3C91 READ_WRITE /end MEASUREMENT
/begin MEASUREMENT fQH0DWNOS "0:O/S非判定中  1:O/S判定中" UBYTE COMP_0283 1 100 0 1 BIT_MASK 0x0001 ECU_ADDRESS 0xFFFF3C91 READ_WRITE /end MEASUREMENT
/begin MEASUREMENT fQTASCAN "0:条件非成立  1:条件成立" UBYTE COMP_0283 1 100 0 1 BIT_MASK 0x0080 ECU_ADDRESS 0xFFFF3C92 READ_WRITE /end MEASUREMENT
/begin MEASUREMENT fQTRPFLG "0:(q)条件不成立  1:(q)条件成立" UBYTE COMP_0283 1 100 0 1 BIT_MASK 0x0040 ECU_ADDRESS 0xFFFF3C92 READ_WRITE /end MEASUREMENT
/begin MEASUREMENT fRAM1STEND "0:始動時RAM診断未終了  1:始動時RAM診断完了" UBYTE COMP_0283 1 100 0 1 BIT_MASK 0x0020 ECU_ADDRESS 0xFFFF3C92 READ_WRITE /end MEASUREMENT
/begin MEASUREMENT fRAMCHK1 "0:未完  1:完了" UBYTE COMP_0283 1 100 0 1 BIT_MASK 0x0010 ECU_ADDRESS 0xFFFF3C92 READ_WRITE /end MEASUREMENT
/begin MEASUREMENT fRATEW1ST "0:初回以降  1:初回" UBYTE COMP_0283 1 100 0 1 BIT_MASK 0x0008 ECU_ADDRESS 0xFFFF3C92 READ_WRITE /end MEASUREMENT
/begin MEASUREMENT fRATEWRT "0:未終了  1:終了" UBYTE COMP_0283 1 100 0 1 BIT_MASK 0x0004 ECU_ADDRESS 0xFFFF3C92 READ_WRITE /end MEASUREMENT
/begin MEASUREMENT fRECARIB "0:要求なし  1:要求あり" UBYTE COMP_0283 1 100 0 1 BIT_MASK 0x0002 ECU_ADDRESS 0xFFFF3C92 READ_WRITE /end MEASUREMENT
/begin MEASUREMENT fREFC1ST "0:ｾﾞﾛｸﾘｱ未実行  1:ｾﾞﾛｸﾘｱ済み" UBYTE COMP_0283 1 100 0 1 BIT_MASK 0x0001 ECU_ADDRESS 0xFFFF3C92 READ_WRITE /end MEASUREMENT
/begin MEASUREMENT fREFCANOK "0:非成立  1:成立" UBYTE COMP_0283 1 100 0 1 BIT_MASK 0x0080 ECU_ADDRESS 0xFFFF3C93 READ_WRITE /end MEASUREMENT
/begin MEASUREMENT fREFLTS "0:非給油判定  1:給油判定" UBYTE COMP_0283 1 100 0 1 BIT_MASK 0x0040 ECU_ADDRESS 0xFFFF3C93 READ_WRITE /end MEASUREMENT
/begin MEASUREMENT fREFUELP "0:非成立  1:成立" UBYTE COMP_0283 1 100 0 1 BIT_MASK 0x0020 ECU_ADDRESS 0xFFFF3C93 READ_WRITE /end MEASUREMENT
/begin MEASUREMENT fREFUELS "0:非成立  1:成立" UBYTE COMP_0283 1 100 0 1 BIT_MASK 0x0010 ECU_ADDRESS 0xFFFF3C93 READ_WRITE /end MEASUREMENT
/begin MEASUREMENT fREGBRKS1 "0:ブレーキスイッチON未経験  1:ブレーキスイッチON経験" UBYTE COMP_0283 1 100 0 1 BIT_MASK 0x0008 ECU_ADDRESS 0xFFFF3C93 READ_WRITE /end MEASUREMENT
/begin MEASUREMENT fREGIDLE1 "0:アイドルスイッチON未経験  1:アイドルスイッチON経験" UBYTE COMP_0283 1 100 0 1 BIT_MASK 0x0004 ECU_ADDRESS 0xFFFF3C93 READ_WRITE /end MEASUREMENT
/begin MEASUREMENT fREGLOWG "0:強い減速Gが好ましい  1:弱い減速Gが好ましい" UBYTE COMP_0283 1 100 0 1 BIT_MASK 0x0002 ECU_ADDRESS 0xFFFF3C93 READ_WRITE /end MEASUREMENT
/begin MEASUREMENT fREGUPHIL "0:上り勾配でない  1:上り勾配" UBYTE COMP_0283 1 100 0 1 BIT_MASK 0x0001 ECU_ADDRESS 0xFFFF3C93 READ_WRITE /end MEASUREMENT
/begin MEASUREMENT fREGUPMSK "0:上り勾配判定許可  1:上り勾配判定禁止" UBYTE COMP_0283 1 100 0 1 BIT_MASK 0x0080 ECU_ADDRESS 0xFFFF3C94 READ_WRITE /end MEASUREMENT
/begin MEASUREMENT fREPROEX "0:経験していない  1:経験した" UBYTE COMP_0283 1 100 0 1 BIT_MASK 0x0040 ECU_ADDRESS 0xFFFF3C94 READ_WRITE /end MEASUREMENT
/begin MEASUREMENT fREQFULL "0:非実行  1:実行" UBYTE COMP_0283 1 100 0 1 BIT_MASK 0x0020 ECU_ADDRESS 0xFFFF3C94 READ_WRITE /end MEASUREMENT
/begin MEASUREMENT fREQMAX "0:非実行  1:実行" UBYTE COMP_0283 1 100 0 1 BIT_MASK 0x0010 ECU_ADDRESS 0xFFFF3C94 READ_WRITE /end MEASUREMENT
/begin MEASUREMENT fREQMIN "0:非実行  1:実行" UBYTE COMP_0283 1 100 0 1 BIT_MASK 0x0008 ECU_ADDRESS 0xFFFF3C94 READ_WRITE /end MEASUREMENT
/begin MEASUREMENT fREQREV0 "0:回転数制御非実行  1:回転数制御実行" UBYTE COMP_0283 1 100 0 1 BIT_MASK 0x0004 ECU_ADDRESS 0xFFFF3C94 READ_WRITE /end MEASUREMENT
/begin MEASUREMENT fREQREV00 "0:回転数制御非実行  1:回転数制御実行" UBYTE COMP_0283 1 100 0 1 BIT_MASK 0x0002 ECU_ADDRESS 0xFFFF3C94 READ_WRITE /end MEASUREMENT
/begin MEASUREMENT fRES "0:ﾀｯﾌﾟｱｯﾌﾟ中  1:ﾀｯﾌﾟﾀﾞｳﾝ中" UBYTE COMP_0283 1 100 0 1 BIT_MASK 0x0001 ECU_ADDRESS 0xFFFF3C94 READ_WRITE /end MEASUREMENT
/begin MEASUREMENT fRESNECUT "0:燃料カット要求なし  1:燃料カット要求あり" UBYTE COMP_0283 1 100 0 1 BIT_MASK 0x0080 ECU_ADDRESS 0xFFFF3C95 READ_WRITE /end MEASUREMENT
/begin MEASUREMENT fRESRUN "0:非ﾘｼﾞｭｰﾑ中  1:ﾘｼﾞｭｰﾑ中" UBYTE COMP_0283 1 100 0 1 BIT_MASK 0x0040 ECU_ADDRESS 0xFFFF3C95 READ_WRITE /end MEASUREMENT
/begin MEASUREMENT fRESSW "0:OFF  1:ON" UBYTE COMP_0283 1 100 0 1 BIT_MASK 0x0020 ECU_ADDRESS 0xFFFF3C95 READ_WRITE /end MEASUREMENT
/begin MEASUREMENT fRFNDLY2 "0:ﾗｼﾞﾌｧﾝﾃﾞｨﾚｲ2ｶｳﾝﾄ中以外  1:ﾗｼﾞﾌｧﾝﾃﾞｨﾚｲ2ｶｳﾝﾄ中" UBYTE COMP_0283 1 100 0 1 BIT_MASK 0x0008 ECU_ADDRESS 0xFFFF3C95 READ_WRITE /end MEASUREMENT
/begin MEASUREMENT fRFOEVPR "0:－  1:－" UBYTE COMP_0283 1 100 0 1 BIT_MASK 0x0004 ECU_ADDRESS 0xFFFF3C95 READ_WRITE /end MEASUREMENT
/begin MEASUREMENT fRFQDLY2 "0:ISC負荷補正ﾃﾞｨﾚｲ2ｶｳﾝﾄ中以外  1:ISC負荷補正ﾃﾞｨﾚｲ2ｶｳﾝﾄ中" UBYTE COMP_0283 1 100 0 1 BIT_MASK 0x0002 ECU_ADDRESS 0xFFFF3C95 READ_WRITE /end MEASUREMENT
/begin MEASUREMENT fRFUELPV "0:給油判定以外  1:給油判定" UBYTE COMP_0283 1 100 0 1 BIT_MASK 0x0001 ECU_ADDRESS 0xFFFF3C95 READ_WRITE /end MEASUREMENT
/begin MEASUREMENT fRFUELR "0:給油判定不成立  1:給油判定成立" UBYTE COMP_0283 1 100 0 1 BIT_MASK 0x0080 ECU_ADDRESS 0xFFFF3C96 READ_WRITE /end MEASUREMENT
/begin MEASUREMENT fRINJON3 "0:不許可  1:許可" UBYTE COMP_0283 1 100 0 1 BIT_MASK 0x0040 ECU_ADDRESS 0xFFFF3C96 READ_WRITE /end MEASUREMENT
/begin MEASUREMENT fRJPOK "0:不許可  1:許可" UBYTE COMP_0283 1 100 0 1 BIT_MASK 0x0020 ECU_ADDRESS 0xFFFF3C96 READ_WRITE /end MEASUREMENT
/begin MEASUREMENT fRJSOK "0:非成立  1:成立" UBYTE COMP_0283 1 100 0 1 BIT_MASK 0x0010 ECU_ADDRESS 0xFFFF3C96 READ_WRITE /end MEASUREMENT
/begin MEASUREMENT fRLTDBS "0:上限以外  1:上限" UBYTE COMP_0283 1 100 0 1 BIT_MASK 0x0008 ECU_ADDRESS 0xFFFF3C96 READ_WRITE /end MEASUREMENT
/begin MEASUREMENT fRO2MCNTE "0:未終了  1:終了" UBYTE COMP_0283 1 100 0 1 BIT_MASK 0x0004 ECU_ADDRESS 0xFFFF3C96 READ_WRITE /end MEASUREMENT
/begin MEASUREMENT fRO2PRGO "0:ST/SW_ON/OFFﾃﾞｨﾚｲ時間未経過  1:ST/SW_ON/OFFﾃﾞｨﾚｲ時間経過" UBYTE COMP_0283 1 100 0 1 BIT_MASK 0x0002 ECU_ADDRESS 0xFFFF3C96 READ_WRITE /end MEASUREMENT
/begin MEASUREMENT fRODMOPEN "0:成立(fMOPEN=1未経験)  1:不成立(fMOPEN=1経験)" UBYTE COMP_0283 1 100 0 1 BIT_MASK 0x0001 ECU_ADDRESS 0xFFFF3C96 READ_WRITE /end MEASUREMENT
/begin MEASUREMENT fRODRDED "0:判定未終了  1:判定終了" UBYTE COMP_0283 1 100 0 1 BIT_MASK 0x0080 ECU_ADDRESS 0xFFFF3C97 READ_WRITE /end MEASUREMENT
/begin MEASUREMENT fRODROK "0:未判定  1:OK判定" UBYTE COMP_0283 1 100 0 1 BIT_MASK 0x0040 ECU_ADDRESS 0xFFFF3C97 READ_WRITE /end MEASUREMENT
/begin MEASUREMENT fROM1STEND "0:始動時ROM診断未終了  1:始動時ROM診断完了" UBYTE COMP_0283 1 100 0 1 BIT_MASK 0x0020 ECU_ADDRESS 0xFFFF3C97 READ_WRITE /end MEASUREMENT
/begin MEASUREMENT fROMCHK1 "0:未完  1:完了" UBYTE COMP_0283 1 100 0 1 BIT_MASK 0x0010 ECU_ADDRESS 0xFFFF3C97 READ_WRITE /end MEASUREMENT
/begin MEASUREMENT fROMNGF "0:ROM診断1回目NG以外  1:ROM診断1回目NG" UBYTE COMP_0283 1 100 0 1 BIT_MASK 0x0008 ECU_ADDRESS 0xFFFF3C97 READ_WRITE /end MEASUREMENT
/begin MEASUREMENT fROMTRPNG "0:ROM診断NG判定以外  1:ROM診断NG判定" UBYTE COMP_0283 1 100 0 1 BIT_MASK 0x0004 ECU_ADDRESS 0xFFFF3C97 READ_WRITE /end MEASUREMENT
/begin MEASUREMENT fRONCAL "0:禁止  1:許可" UBYTE COMP_0283 1 100 0 1 BIT_MASK 0x0002 ECU_ADDRESS 0xFFFF3C97 READ_WRITE /end MEASUREMENT
/begin MEASUREMENT fRRO2AC "0:RrO2/S診断PSｺﾏﾝﾄﾞ実行していない  1:RrO2/S診断PSｺﾏﾝﾄﾞ実行中" UBYTE COMP_0283 1 100 0 1 BIT_MASK 0x0001 ECU_ADDRESS 0xFFFF3C97 READ_WRITE /end MEASUREMENT
/begin MEASUREMENT fRSTIDLON "0:非継続  1:継続" UBYTE COMP_0283 1 100 0 1 BIT_MASK 0x0080 ECU_ADDRESS 0xFFFF3C98 READ_WRITE /end MEASUREMENT
/begin MEASUREMENT fRSTRQEX "0:未経験  1:経験" UBYTE COMP_0283 1 100 0 1 BIT_MASK 0x0040 ECU_ADDRESS 0xFFFF3C98 READ_WRITE /end MEASUREMENT
/begin MEASUREMENT fRT1CNG "0:NGなし  1:NG有" UBYTE COMP_0283 1 100 0 1 BIT_MASK 0x0020 ECU_ADDRESS 0xFFFF3C98 READ_WRITE /end MEASUREMENT
/begin MEASUREMENT fRT2CNG "0:NGなし  1:NG有" UBYTE COMP_0283 1 100 0 1 BIT_MASK 0x0010 ECU_ADDRESS 0xFFFF3C98 READ_WRITE /end MEASUREMENT
/begin MEASUREMENT fRT3CNG "0:NGなし  1:NG有" UBYTE COMP_0283 1 100 0 1 BIT_MASK 0x0008 ECU_ADDRESS 0xFFFF3C98 READ_WRITE /end MEASUREMENT
/begin MEASUREMENT fRT4CNG "0:NGなし  1:NG有" UBYTE COMP_0283 1 100 0 1 BIT_MASK 0x0004 ECU_ADDRESS 0xFFFF3C98 READ_WRITE /end MEASUREMENT
/begin MEASUREMENT fRTMCNG "0:NGなし  1:NG有" UBYTE COMP_0283 1 100 0 1 BIT_MASK 0x0002 ECU_ADDRESS 0xFFFF3C98 READ_WRITE /end MEASUREMENT
/begin MEASUREMENT fRTRPFLG "0:(r)条件不成立  1:(r)条件成立" UBYTE COMP_0283 1 100 0 1 BIT_MASK 0x0001 ECU_ADDRESS 0xFFFF3C98 READ_WRITE /end MEASUREMENT
/begin MEASUREMENT fRUTDBS "0:上限以外  1:上限" UBYTE COMP_0283 1 100 0 1 BIT_MASK 0x0080 ECU_ADDRESS 0xFFFF3C99 READ_WRITE /end MEASUREMENT
/begin MEASUREMENT fSALMST "0:λｺﾝ開始許可中でない  1:λｺﾝ開始許可中である" UBYTE COMP_0283 1 100 0 1 BIT_MASK 0x0040 ECU_ADDRESS 0xFFFF3C99 READ_WRITE /end MEASUREMENT
/begin MEASUREMENT fSCAPWCLR "0:CAP警告灯リセット要求無  1:CAP警告灯リセット要求有" UBYTE COMP_0283 1 100 0 1 BIT_MASK 0x0020 ECU_ADDRESS 0xFFFF3C99 READ_WRITE /end MEASUREMENT
/begin MEASUREMENT fSCVFCUT "0:燃料ｶｯﾄﾘｶﾊﾞ  1:燃料ｶｯﾄ" UBYTE COMP_0283 1 100 0 1 BIT_MASK 0x0010 ECU_ADDRESS 0xFFFF3C99 READ_WRITE /end MEASUREMENT
/begin MEASUREMENT fSCVZ "0:ｿﾚﾉｲﾄﾞOFF  1:ｿﾚﾉｲﾄﾞON" UBYTE COMP_0283 1 100 0 1 BIT_MASK 0x0008 ECU_ADDRESS 0xFFFF3C99 READ_WRITE /end MEASUREMENT
/begin MEASUREMENT fSETDTCLR "0:DATA_CLEAR_コマンド非セット  1:DATA_CLEAR_コマンドセット" UBYTE COMP_0283 1 100 0 1 BIT_MASK 0x0004 ECU_ADDRESS 0xFFFF3C99 READ_WRITE /end MEASUREMENT
/begin MEASUREMENT fSETLMPSL "0:ｾｯﾄﾗﾝﾌﾟ消灯  1:ｾｯﾄﾗﾝﾌﾟ点灯" UBYTE COMP_0283 1 100 0 1 BIT_MASK 0x0002 ECU_ADDRESS 0xFFFF3C99 READ_WRITE /end MEASUREMENT
/begin MEASUREMENT fSETLMPSL0 "0:ｾｯﾄﾗﾝﾌﾟ消灯  1:ｾｯﾄﾗﾝﾌﾟ点灯" UBYTE COMP_0283 1 100 0 1 BIT_MASK 0x0001 ECU_ADDRESS 0xFFFF3C99 READ_WRITE /end MEASUREMENT
/begin MEASUREMENT fSETON "0:許可  1:禁止" UBYTE COMP_0283 1 100 0 1 BIT_MASK 0x0080 ECU_ADDRESS 0xFFFF3C9A READ_WRITE /end MEASUREMENT
/begin MEASUREMENT fSETRFL "0:停車もしくは駐車中給油判定不成立  1:停車もしくは駐車中給油判定成立" UBYTE COMP_0283 1 100 0 1 BIT_MASK 0x0040 ECU_ADDRESS 0xFFFF3C9A READ_WRITE /end MEASUREMENT
/begin MEASUREMENT fSETSW "0:OFF  1:ON" UBYTE COMP_0283 1 100 0 1 BIT_MASK 0x0020 ECU_ADDRESS 0xFFFF3C9A READ_WRITE /end MEASUREMENT
/begin MEASUREMENT fSFTUPOS "0:O/S非判定中  1:O/S判定中" UBYTE COMP_0283 1 100 0 1 BIT_MASK 0x0008 ECU_ADDRESS 0xFFFF3C9A READ_WRITE /end MEASUREMENT
/begin MEASUREMENT fSGONTMP "0:SGADV制御停止  1:SGADV制御開始" UBYTE COMP_0283 1 100 0 1 BIT_MASK 0x0004 ECU_ADDRESS 0xFFFF3C9A READ_WRITE /end MEASUREMENT
/begin MEASUREMENT fSHAGAIR2 "0:アクセル戻し中以外  1:アクセル戻し中" UBYTE COMP_0283 1 100 0 1 BIT_MASK 0x0002 ECU_ADDRESS 0xFFFF3C9A READ_WRITE /end MEASUREMENT
/begin MEASUREMENT fSISTEX "0:未経験  1:経験" UBYTE COMP_0283 1 100 0 1 BIT_MASK 0x0001 ECU_ADDRESS 0xFFFF3C9A READ_WRITE /end MEASUREMENT
/begin MEASUREMENT fSLACK "0:不成立  1:成立" UBYTE COMP_0283 1 100 0 1 BIT_MASK 0x0080 ECU_ADDRESS 0xFFFF3C9B READ_WRITE /end MEASUREMENT
/begin MEASUREMENT fSLARBONC "0:非成立  1:成立" UBYTE COMP_0283 1 100 0 1 BIT_MASK 0x0040 ECU_ADDRESS 0xFFFF3C9B READ_WRITE /end MEASUREMENT
/begin MEASUREMENT fSLCLUOFF "0:右記以外  1:wfNEUT==1_&&_fASCDC5SW==1_&&_mfS" UBYTE COMP_0283 1 100 0 1 BIT_MASK 0x0020 ECU_ADDRESS 0xFFFF3C9B READ_WRITE /end MEASUREMENT
/begin MEASUREMENT fSLCLWRN "0:ﾀｲﾏ非経過  1:ﾀｲﾏ経過" UBYTE COMP_0283 1 100 0 1 BIT_MASK 0x0010 ECU_ADDRESS 0xFFFF3C9B READ_WRITE /end MEASUREMENT
/begin MEASUREMENT fSLCTLOFF "0:ｷｬﾝｾﾙ条件不成立  1:ｷｬﾝｾﾙ条件成立" UBYTE COMP_0283 1 100 0 1 BIT_MASK 0x0008 ECU_ADDRESS 0xFFFF3C9B READ_WRITE /end MEASUREMENT
/begin MEASUREMENT fSLCTLON "0:条件不成立  1:条件成立" UBYTE COMP_0283 1 100 0 1 BIT_MASK 0x0004 ECU_ADDRESS 0xFFFF3C9B READ_WRITE /end MEASUREMENT
/begin MEASUREMENT fSLFAIL "0:正常  1:異常" UBYTE COMP_0283 1 100 0 1 BIT_MASK 0x0002 ECU_ADDRESS 0xFFFF3C9B READ_WRITE /end MEASUREMENT
/begin MEASUREMENT fSLHIGRIH "0:tmp_>=_mSLHGIDF2_||_!TSTBIT(_fSL  1:tmp_<=_mSLHGIDF1" UBYTE COMP_0283 1 100 0 1 BIT_MASK 0x0001 ECU_ADDRESS 0xFFFF3C9B READ_WRITE /end MEASUREMENT
/begin MEASUREMENT fSLIGGACC "0:クリア  1:セット" UBYTE COMP_0283 1 100 0 1 BIT_MASK 0x0080 ECU_ADDRESS 0xFFFF3C9C READ_WRITE /end MEASUREMENT
/begin MEASUREMENT fSLINH "0:正常  1:異常" UBYTE COMP_0283 1 100 0 1 BIT_MASK 0x0040 ECU_ADDRESS 0xFFFF3C9C READ_WRITE /end MEASUREMENT
/begin MEASUREMENT fSLINHCTL "0:正常  1:異常" UBYTE COMP_0283 1 100 0 1 BIT_MASK 0x0020 ECU_ADDRESS 0xFFFF3C9C READ_WRITE /end MEASUREMENT
/begin MEASUREMENT fSLMTHOGO "0:不成立  1:成立" UBYTE COMP_0283 1 100 0 1 BIT_MASK 0x0010 ECU_ADDRESS 0xFFFF3C9C READ_WRITE /end MEASUREMENT
/begin MEASUREMENT fSLODOFF "0:クリア  1:セット" UBYTE COMP_0283 1 100 0 1 BIT_MASK 0x0008 ECU_ADDRESS 0xFFFF3C9C READ_WRITE /end MEASUREMENT
/begin MEASUREMENT fSLOPKIN "0:許可  1:禁止" UBYTE COMP_0283 1 100 0 1 BIT_MASK 0x0004 ECU_ADDRESS 0xFFFF3C9C READ_WRITE /end MEASUREMENT
/begin MEASUREMENT fSLQH0LMT "0:ｽﾋﾟｰﾄﾞﾘﾐｯﾀQH0ﾘﾐｯﾄでない  1:ｽﾋﾟｰﾄﾞﾘﾐｯﾀQH0ﾘﾐｯﾄ中" UBYTE COMP_0283 1 100 0 1 BIT_MASK 0x0002 ECU_ADDRESS 0xFFFF3C9C READ_WRITE /end MEASUREMENT
/begin MEASUREMENT fSLRESNOT "0:条件不成立  1:条件成立" UBYTE COMP_0283 1 100 0 1 BIT_MASK 0x0001 ECU_ADDRESS 0xFFFF3C9C READ_WRITE /end MEASUREMENT
/begin MEASUREMENT fSLRESON "0:ﾌﾗｸﾞOFF  1:ﾌﾗｸﾞON" UBYTE COMP_0283 1 100 0 1 BIT_MASK 0x0080 ECU_ADDRESS 0xFFFF3C9D READ_WRITE /end MEASUREMENT
/begin MEASUREMENT fSLSETON "0:ﾌﾗｸﾞOFF  1:ﾌﾗｸﾞON" UBYTE COMP_0283 1 100 0 1 BIT_MASK 0x0040 ECU_ADDRESS 0xFFFF3C9D READ_WRITE /end MEASUREMENT
/begin MEASUREMENT fSLSUSPND "0:ｷｬﾝｾﾙ条件不成立  1:ｷｬﾝｾﾙ条件成立" UBYTE COMP_0283 1 100 0 1 BIT_MASK 0x0020 ECU_ADDRESS 0xFFFF3C9D READ_WRITE /end MEASUREMENT
/begin MEASUREMENT fSLSWMAIN "0:SLSW_OFF  1:SLSW_ON" UBYTE COMP_0283 1 100 0 1 BIT_MASK 0x0010 ECU_ADDRESS 0xFFFF3C9D READ_WRITE /end MEASUREMENT
/begin MEASUREMENT fSLSWMAIZ "0:SLSW_OFF  1:SLSW_ON" UBYTE COMP_0283 1 100 0 1 BIT_MASK 0x0008 ECU_ADDRESS 0xFFFF3C9D READ_WRITE /end MEASUREMENT
/begin MEASUREMENT fSLTAPDN1 "0:ﾌﾗｸﾞOFF  1:ﾌﾗｸﾞON" UBYTE COMP_0283 1 100 0 1 BIT_MASK 0x0004 ECU_ADDRESS 0xFFFF3C9D READ_WRITE /end MEASUREMENT
/begin MEASUREMENT fSLTAPDN2 "0:ﾌﾗｸﾞOFF  1:ﾌﾗｸﾞON" UBYTE COMP_0283 1 100 0 1 BIT_MASK 0x0002 ECU_ADDRESS 0xFFFF3C9D READ_WRITE /end MEASUREMENT
/begin MEASUREMENT fSLTAPUP1 "0:ﾌﾗｸﾞOFF  1:ﾌﾗｸﾞON" UBYTE COMP_0283 1 100 0 1 BIT_MASK 0x0001 ECU_ADDRESS 0xFFFF3C9D READ_WRITE /end MEASUREMENT
/begin MEASUREMENT fSLTAPUP2 "0:ﾌﾗｸﾞOFF  1:ﾌﾗｸﾞON" UBYTE COMP_0283 1 100 0 1 BIT_MASK 0x0080 ECU_ADDRESS 0xFFFF3C9E READ_WRITE /end MEASUREMENT
/begin MEASUREMENT fSLTQSATU "0:右記以外  1:ｽﾋﾟｰﾄﾞﾘﾐｯﾀﾄﾙｸ飽和判定条件成立" UBYTE COMP_0283 1 100 0 1 BIT_MASK 0x0040 ECU_ADDRESS 0xFFFF3C9E READ_WRITE /end MEASUREMENT
/begin MEASUREMENT fSLVAPU11 "0:クリア  1:セット" UBYTE COMP_0283 1 100 0 1 BIT_MASK 0x0020 ECU_ADDRESS 0xFFFF3C9E READ_WRITE /end MEASUREMENT
/begin MEASUREMENT fSLVAPU12 "0:クリア  1:セット" UBYTE COMP_0283 1 100 0 1 BIT_MASK 0x0010 ECU_ADDRESS 0xFFFF3C9E READ_WRITE /end MEASUREMENT
/begin MEASUREMENT fSLVAPU21 "0:クリア  1:セット" UBYTE COMP_0283 1 100 0 1 BIT_MASK 0x0008 ECU_ADDRESS 0xFFFF3C9E READ_WRITE /end MEASUREMENT
/begin MEASUREMENT fSLVAPUP1 "0:クリア  1:セット" UBYTE COMP_0283 1 100 0 1 BIT_MASK 0x0004 ECU_ADDRESS 0xFFFF3C9E READ_WRITE /end MEASUREMENT
/begin MEASUREMENT fSLVAPUP2 "0:クリア  1:セット" UBYTE COMP_0283 1 100 0 1 BIT_MASK 0x0002 ECU_ADDRESS 0xFFFF3C9E READ_WRITE /end MEASUREMENT
/begin MEASUREMENT fSLVSPCLR "0:ﾌﾗｸﾞOFF  1:ﾌﾗｸﾞON" UBYTE COMP_0283 1 100 0 1 BIT_MASK 0x0001 ECU_ADDRESS 0xFFFF3C9E READ_WRITE /end MEASUREMENT
/begin MEASUREMENT fSLVSPDWN "0:ﾌﾗｸﾞOFF  1:ﾌﾗｸﾞON" UBYTE COMP_0283 1 100 0 1 BIT_MASK 0x0080 ECU_ADDRESS 0xFFFF3C9F READ_WRITE /end MEASUREMENT
/begin MEASUREMENT fSLVSPDWNZ "0:ﾌﾗｸﾞOFF  1:ﾌﾗｸﾞON" UBYTE COMP_0283 1 100 0 1 BIT_MASK 0x0040 ECU_ADDRESS 0xFFFF3C9F READ_WRITE /end MEASUREMENT
/begin MEASUREMENT fSLVSPFAL "0:正常  1:異常" UBYTE COMP_0283 1 100 0 1 BIT_MASK 0x0020 ECU_ADDRESS 0xFFFF3C9F READ_WRITE /end MEASUREMENT
/begin MEASUREMENT fSLVSPON "0:ﾌﾗｸﾞOFF  1:ﾌﾗｸﾞON" UBYTE COMP_0283 1 100 0 1 BIT_MASK 0x0010 ECU_ADDRESS 0xFFFF3C9F READ_WRITE /end MEASUREMENT
/begin MEASUREMENT fSLVSPONZ "0:ﾌﾗｸﾞOFF  1:ﾌﾗｸﾞON" UBYTE COMP_0283 1 100 0 1 BIT_MASK 0x0008 ECU_ADDRESS 0xFFFF3C9F READ_WRITE /end MEASUREMENT
/begin MEASUREMENT fSLVSPRMP "0:ｽﾋﾟｰﾄﾞﾘﾐｯﾀﾘﾐｯﾄ車速変更でない  1:ｽﾋﾟｰﾄﾞﾘﾐｯﾀﾘﾐｯﾄ車速変更" UBYTE COMP_0283 1 100 0 1 BIT_MASK 0x0004 ECU_ADDRESS 0xFFFF3C9F READ_WRITE /end MEASUREMENT
/begin MEASUREMENT fSLVSPSET "0:ﾌﾗｸﾞOFF  1:ﾌﾗｸﾞON" UBYTE COMP_0283 1 100 0 1 BIT_MASK 0x0002 ECU_ADDRESS 0xFFFF3C9F READ_WRITE /end MEASUREMENT
/begin MEASUREMENT fSLVSPUP "0:ﾌﾗｸﾞOFF  1:ﾌﾗｸﾞON" UBYTE COMP_0283 1 100 0 1 BIT_MASK 0x0001 ECU_ADDRESS 0xFFFF3C9F READ_WRITE /end MEASUREMENT
/begin MEASUREMENT fSLVSPUPZ "0:ﾌﾗｸﾞOFF  1:ﾌﾗｸﾞON" UBYTE COMP_0283 1 100 0 1 BIT_MASK 0x0080 ECU_ADDRESS 0xFFFF3CA0 READ_WRITE /end MEASUREMENT
/begin MEASUREMENT fSNWMOD "0:SNOWモードSWが操作された場合の開  1:SNOWモードSWが操作された場合の開" UBYTE COMP_0283 1 100 0 1 BIT_MASK 0x0040 ECU_ADDRESS 0xFFFF3CA0 READ_WRITE /end MEASUREMENT
/begin MEASUREMENT fSOLDGNE "0:不成立  1:成立" UBYTE COMP_0283 1 100 0 1 BIT_MASK 0x0020 ECU_ADDRESS 0xFFFF3CA0 READ_WRITE /end MEASUREMENT
/begin MEASUREMENT fSPDCTTWN "0:不成立  1:成立" UBYTE COMP_0283 1 100 0 1 BIT_MASK 0x0010 ECU_ADDRESS 0xFFFF3CA0 READ_WRITE /end MEASUREMENT
/begin MEASUREMENT fSPDCTVSP "0:不成立  1:成立" UBYTE COMP_0283 1 100 0 1 BIT_MASK 0x0008 ECU_ADDRESS 0xFFFF3CA0 READ_WRITE /end MEASUREMENT
/begin MEASUREMENT fSRLRNCLR "0:ｸﾘｱ未  1:ｸﾘｱ済" UBYTE COMP_0283 1 100 0 1 BIT_MASK 0x0004 ECU_ADDRESS 0xFFFF3CA0 READ_WRITE /end MEASUREMENT
/begin MEASUREMENT fSRVOINIT "0:車速ｻｰﾎﾞ初期化済み  1:車速ｻｰﾎﾞ初期化要求" UBYTE COMP_0283 1 100 0 1 BIT_MASK 0x0002 ECU_ADDRESS 0xFFFF3CA0 READ_WRITE /end MEASUREMENT
/begin MEASUREMENT fSSFMON "0:S/S/OFFｼｽﾃﾑ診断許可条件不成立中  1:S/S/OFFｼｽﾃﾑ診断許可条件成立中" UBYTE COMP_0283 1 100 0 1 BIT_MASK 0x0001 ECU_ADDRESS 0xFFFF3CA0 READ_WRITE /end MEASUREMENT
/begin MEASUREMENT fSSFTRG "0:S/S/OFFｼｽﾃﾑ診断ｶｳﾝﾀｶｳﾝﾄｱｯﾌﾟ済み  1:S/S/OFFｼｽﾃﾑ診断ｶｳﾝﾀ未ｶｳﾝﾄｱｯﾌﾟ" UBYTE COMP_0283 1 100 0 1 BIT_MASK 0x0080 ECU_ADDRESS 0xFFFF3CA1 READ_WRITE /end MEASUREMENT
/begin MEASUREMENT fSTAERCNT "0:プログラム実行時間計測許可  1:プログラム実行時間計測非許可" UBYTE COMP_0283 1 100 0 1 BIT_MASK 0x0040 ECU_ADDRESS 0xFFFF3CA1 READ_WRITE /end MEASUREMENT
/begin MEASUREMENT fSTROPNNG "0:NG未判定  1:NG判定済み" UBYTE COMP_0283 1 100 0 1 BIT_MASK 0x0020 ECU_ADDRESS 0xFFFF3CA1 READ_WRITE /end MEASUREMENT
/begin MEASUREMENT fSTRPFLG "0:(s)条件不成立  1:(s)条件成立" UBYTE COMP_0283 1 100 0 1 BIT_MASK 0x0010 ECU_ADDRESS 0xFFFF3CA1 READ_WRITE /end MEASUREMENT
/begin MEASUREMENT fSTRSTLM "0:条件不成立  1:条件成立" UBYTE COMP_0283 1 100 0 1 BIT_MASK 0x0008 ECU_ADDRESS 0xFFFF3CA1 READ_WRITE /end MEASUREMENT
/begin MEASUREMENT fSTRSTOKE "0:右記以外  1:成層始動許可" UBYTE COMP_0283 1 100 0 1 BIT_MASK 0x0004 ECU_ADDRESS 0xFFFF3CA1 READ_WRITE /end MEASUREMENT
/begin MEASUREMENT fSTRSTOKQ "0:右記以外  1:成層始動許可" UBYTE COMP_0283 1 100 0 1 BIT_MASK 0x0002 ECU_ADDRESS 0xFFFF3CA1 READ_WRITE /end MEASUREMENT
/begin MEASUREMENT fSTRSTOKS "0:右記以外  1:成層始動許可" UBYTE COMP_0283 1 100 0 1 BIT_MASK 0x0001 ECU_ADDRESS 0xFFFF3CA1 READ_WRITE /end MEASUREMENT
/begin MEASUREMENT fSTRSTOKT "0:成層始動不許可  1:成層始動許可" UBYTE COMP_0283 1 100 0 1 BIT_MASK 0x0080 ECU_ADDRESS 0xFFFF3CA2 READ_WRITE /end MEASUREMENT
/begin MEASUREMENT fSTRTONOF "0:START_SW_ON_→_OFF未経験  1:START_SW_ON_→_OFF経験済" UBYTE COMP_0283 1 100 0 1 BIT_MASK 0x0040 ECU_ADDRESS 0xFFFF3CA2 READ_WRITE /end MEASUREMENT
/begin MEASUREMENT fSTRWNG "0:正常判定  1:異常判定" UBYTE COMP_0283 1 100 0 1 BIT_MASK 0x0020 ECU_ADDRESS 0xFFFF3CA2 READ_WRITE /end MEASUREMENT
/begin MEASUREMENT fSTSW1ST "0:未経験  1:経験した" UBYTE COMP_0283 1 100 0 1 BIT_MASK 0x0010 ECU_ADDRESS 0xFFFF3CA2 READ_WRITE /end MEASUREMENT
/begin MEASUREMENT fSTSWDLY "0:ディレイ中  1:ディレイ終了" UBYTE COMP_0283 1 100 0 1 BIT_MASK 0x0008 ECU_ADDRESS 0xFFFF3CA2 READ_WRITE /end MEASUREMENT
/begin MEASUREMENT fSTSWEXP "0:fSTSW_=_0_→_1未経験  1:fSTSW_=_0_→_1経験" UBYTE COMP_0283 1 100 0 1 BIT_MASK 0x0004 ECU_ADDRESS 0xFFFF3CA2 READ_WRITE /end MEASUREMENT
/begin MEASUREMENT fSUMPTYNG "0:ｻﾑﾊﾟﾘﾃｨ演算値正常  1:ｻﾑﾊﾟﾘﾃｨ演算値異常" UBYTE COMP_0283 1 100 0 1 BIT_MASK 0x0002 ECU_ADDRESS 0xFFFF3CA2 READ_WRITE /end MEASUREMENT
/begin MEASUREMENT fSUMQM40 "0:SUMQM40演算不許可  1:SUMQM40演算許可" UBYTE COMP_0283 1 100 0 1 BIT_MASK 0x0001 ECU_ADDRESS 0xFFFF3CA2 READ_WRITE /end MEASUREMENT
/begin MEASUREMENT fSWKNLRN "0:禁止  1:許可" UBYTE COMP_0283 1 100 0 1 BIT_MASK 0x0080 ECU_ADDRESS 0xFFFF3CA3 READ_WRITE /end MEASUREMENT
/begin MEASUREMENT fSWMDNG1 "0:OK  1:NG" UBYTE COMP_0283 1 100 0 1 BIT_MASK 0x0040 ECU_ADDRESS 0xFFFF3CA3 READ_WRITE /end MEASUREMENT
/begin MEASUREMENT fSWMDNG3 "0:OK  1:NG" UBYTE COMP_0283 1 100 0 1 BIT_MASK 0x0020 ECU_ADDRESS 0xFFFF3CA3 READ_WRITE /end MEASUREMENT
/begin MEASUREMENT fSYDGNE "0:不成立  1:成立" UBYTE COMP_0283 1 100 0 1 BIT_MASK 0x0010 ECU_ADDRESS 0xFFFF3CA3 READ_WRITE /end MEASUREMENT
/begin MEASUREMENT fSYDGNS "0:不成立  1:成立" UBYTE COMP_0283 1 100 0 1 BIT_MASK 0x0008 ECU_ADDRESS 0xFFFF3CA3 READ_WRITE /end MEASUREMENT
/begin MEASUREMENT fSYSNGD "0:システム診断NG未判定  1:システム診断NG判定" UBYTE COMP_0283 1 100 0 1 BIT_MASK 0x0004 ECU_ADDRESS 0xFFFF3CA3 READ_WRITE /end MEASUREMENT
/begin MEASUREMENT fSYSOKD "0:システム診断OK未判定  1:システム診断OK判定" UBYTE COMP_0283 1 100 0 1 BIT_MASK 0x0002 ECU_ADDRESS 0xFFFF3CA3 READ_WRITE /end MEASUREMENT
/begin MEASUREMENT fTACNTED "0:カウントアップ前  1:カウントアップ後" UBYTE COMP_0283 1 100 0 1 BIT_MASK 0x0001 ECU_ADDRESS 0xFFFF3CA3 READ_WRITE /end MEASUREMENT
/begin MEASUREMENT fTANTHHEN "0:不許可  1:許可" UBYTE COMP_0283 1 100 0 1 BIT_MASK 0x0080 ECU_ADDRESS 0xFFFF3CA4 READ_WRITE /end MEASUREMENT
/begin MEASUREMENT fTANTHHER "0:正常  1:異常" UBYTE COMP_0283 1 100 0 1 BIT_MASK 0x0040 ECU_ADDRESS 0xFFFF3CA4 READ_WRITE /end MEASUREMENT
/begin MEASUREMENT fTANTHLEN "0:不許可  1:許可" UBYTE COMP_0283 1 100 0 1 BIT_MASK 0x0020 ECU_ADDRESS 0xFFFF3CA4 READ_WRITE /end MEASUREMENT
/begin MEASUREMENT fTANTHRH "0:診断OK  1:診断NG" UBYTE COMP_0283 1 100 0 1 BIT_MASK 0x0010 ECU_ADDRESS 0xFFFF3CA4 READ_WRITE /end MEASUREMENT
/begin MEASUREMENT fTANTHRL "0:診断OK  1:診断NG" UBYTE COMP_0283 1 100 0 1 BIT_MASK 0x0008 ECU_ADDRESS 0xFFFF3CA4 READ_WRITE /end MEASUREMENT
/begin MEASUREMENT fTAPDWN "0:ﾀｯﾌﾟﾀﾞｳﾝﾓｰﾄﾞ中でない  1:ﾀｯﾌﾟﾀﾞｳﾝﾓｰﾄﾞ中" UBYTE COMP_0283 1 100 0 1 BIT_MASK 0x0004 ECU_ADDRESS 0xFFFF3CA4 READ_WRITE /end MEASUREMENT
/begin MEASUREMENT fTAPUP "0:ﾀｯﾌﾟｱｯﾌﾟﾓｰﾄﾞ中でない  1:ﾀｯﾌﾟｱｯﾌﾟﾓｰﾄﾞ中" UBYTE COMP_0283 1 100 0 1 BIT_MASK 0x0002 ECU_ADDRESS 0xFFFF3CA4 READ_WRITE /end MEASUREMENT
/begin MEASUREMENT fTARTTAL "0:TAN≦TARTTAL#(ヒス-2℃)  1:TAN＞TARTTAL#(ヒス-2℃)" UBYTE COMP_0283 1 100 0 1 BIT_MASK 0x0001 ECU_ADDRESS 0xFFFF3CA4 READ_WRITE /end MEASUREMENT
/begin MEASUREMENT fTASHAC "0:急速TAS学習  1:工場用急速TAS学習" UBYTE COMP_0283 1 100 0 1 BIT_MASK 0x0080 ECU_ADDRESS 0xFFFF3CA5 READ_WRITE /end MEASUREMENT
/begin MEASUREMENT fTATHDGNH "0:TATH_High_Input診断OK  1:TATH_High_Input診断NG" UBYTE COMP_0283 1 100 0 1 BIT_MASK 0x0040 ECU_ADDRESS 0xFFFF3CA5 READ_WRITE /end MEASUREMENT
/begin MEASUREMENT fTATHDGNL "0:TATH_Low_Input診断OK  1:TATH_Low_Input診断ＮＧ" UBYTE COMP_0283 1 100 0 1 BIT_MASK 0x0020 ECU_ADDRESS 0xFFFF3CA5 READ_WRITE /end MEASUREMENT
/begin MEASUREMENT fTCSAT "0:右記以外  1:-" UBYTE COMP_0283 1 100 0 1 BIT_MASK 0x0010 ECU_ADDRESS 0xFFFF3CA5 READ_WRITE /end MEASUREMENT
/begin MEASUREMENT fTCSAT2 "0:右記以外  1:-" UBYTE COMP_0283 1 100 0 1 BIT_MASK 0x0008 ECU_ADDRESS 0xFFFF3CA5 READ_WRITE /end MEASUREMENT
/begin MEASUREMENT fTCSDGC "0:自己診断許可  1:自己診断禁止" UBYTE COMP_0283 1 100 0 1 BIT_MASK 0x0004 ECU_ADDRESS 0xFFFF3CA5 READ_WRITE /end MEASUREMENT
/begin MEASUREMENT fTCVBNRQ "0:不成立  1:成立" UBYTE COMP_0283 1 100 0 1 BIT_MASK 0x0002 ECU_ADDRESS 0xFFFF3CA5 READ_WRITE /end MEASUREMENT
/begin MEASUREMENT fTCVDIRCL "0:閉駆動不許可  1:閉駆動許可" UBYTE COMP_0283 1 100 0 1 BIT_MASK 0x0001 ECU_ADDRESS 0xFFFF3CA5 READ_WRITE /end MEASUREMENT
/begin MEASUREMENT fTCVDIROP "0:開駆動不許可  1:開駆動許可" UBYTE COMP_0283 1 100 0 1 BIT_MASK 0x0080 ECU_ADDRESS 0xFFFF3CA6 READ_WRITE /end MEASUREMENT
/begin MEASUREMENT fTCVHDCL "0:閉方向保持通電不許可  1:閉方向保持通電許可" UBYTE COMP_0283 1 100 0 1 BIT_MASK 0x0040 ECU_ADDRESS 0xFFFF3CA6 READ_WRITE /end MEASUREMENT
/begin MEASUREMENT fTCVHDOP "0:開方向保持通電不許可  1:開方向保持通電許可" UBYTE COMP_0283 1 100 0 1 BIT_MASK 0x0020 ECU_ADDRESS 0xFFFF3CA6 READ_WRITE /end MEASUREMENT
/begin MEASUREMENT fTCVNREND "0:不成立  1:成立" UBYTE COMP_0283 1 100 0 1 BIT_MASK 0x0010 ECU_ADDRESS 0xFFFF3CA6 READ_WRITE /end MEASUREMENT
/begin MEASUREMENT fTEXGO "0:初期値設定  1:計算開始" UBYTE COMP_0283 1 100 0 1 BIT_MASK 0x0008 ECU_ADDRESS 0xFFFF3CA6 READ_WRITE /end MEASUREMENT
/begin MEASUREMENT fTFCNTED "0:カウントアップ前  1:カウントアップ後" UBYTE COMP_0283 1 100 0 1 BIT_MASK 0x0004 ECU_ADDRESS 0xFFFF3CA6 READ_WRITE /end MEASUREMENT
/begin MEASUREMENT fTH "0:右以外  1:耐熱判定" UBYTE COMP_0283 1 100 0 1 BIT_MASK 0x0002 ECU_ADDRESS 0xFFFF3CA6 READ_WRITE /end MEASUREMENT
/begin MEASUREMENT fTHBSNG "0:ﾍﾞｰｽ空燃比がずれなし  1:ﾍﾞｰｽ空燃比ずれあり" UBYTE COMP_0283 1 100 0 1 BIT_MASK 0x0001 ECU_ADDRESS 0xFFFF3CA6 READ_WRITE /end MEASUREMENT
/begin MEASUREMENT fTHMOD "0:いずれか成立  1:すべて成立" UBYTE COMP_0283 1 100 0 1 BIT_MASK 0x0080 ECU_ADDRESS 0xFFFF3CA7 READ_WRITE /end MEASUREMENT
/begin MEASUREMENT fTHTFN "0:右以外  1:耐熱判定" UBYTE COMP_0283 1 100 0 1 BIT_MASK 0x0040 ECU_ADDRESS 0xFFFF3CA7 READ_WRITE /end MEASUREMENT
/begin MEASUREMENT fTISMIN "0:リミッタ制御されていない  1:リミッタ制御されている" UBYTE COMP_0283 1 100 0 1 BIT_MASK 0x0020 ECU_ADDRESS 0xFFFF3CA7 READ_WRITE /end MEASUREMENT
/begin MEASUREMENT fTIVTDTW "0:成立  1:不成立" UBYTE COMP_0283 1 100 0 1 BIT_MASK 0x0010 ECU_ADDRESS 0xFFFF3CA7 READ_WRITE /end MEASUREMENT
/begin MEASUREMENT fTMLOF "0:MIL消灯条件成立経験  1:MIL消灯条件成立未経験" UBYTE COMP_0283 1 100 0 1 BIT_MASK 0x0008 ECU_ADDRESS 0xFFFF3CA7 READ_WRITE /end MEASUREMENT
/begin MEASUREMENT fTMMFCN "0:判定実施  1:判定ｷｬﾝｾﾙ" UBYTE COMP_0283 1 100 0 1 BIT_MASK 0x0004 ECU_ADDRESS 0xFFFF3CA7 READ_WRITE /end MEASUREMENT
/begin MEASUREMENT fTMMFEM "0:判定実施  1:判定ｷｬﾝｾﾙ" UBYTE COMP_0283 1 100 0 1 BIT_MASK 0x0002 ECU_ADDRESS 0xFFFF3CA7 READ_WRITE /end MEASUREMENT
/begin MEASUREMENT fTMSMOKST "0:STSW_ON→OFF経験無し  1:STSW_ON→OFF経験あり" UBYTE COMP_0283 1 100 0 1 BIT_MASK 0x0001 ECU_ADDRESS 0xFFFF3CA7 READ_WRITE /end MEASUREMENT
/begin MEASUREMENT fTOESD1 "0:ｴﾝｼﾞﾝ回転累積時間経過なし  1:ｴﾝｼﾞﾝ回転累積時間経過あり" UBYTE COMP_0283 1 100 0 1 BIT_MASK 0x0080 ECU_ADDRESS 0xFFFF3CA8 READ_WRITE /end MEASUREMENT
/begin MEASUREMENT fTOESOK "0:推定油温NG判定  1:推定油温OK判定" UBYTE COMP_0283 1 100 0 1 BIT_MASK 0x0040 ECU_ADDRESS 0xFFFF3CA8 READ_WRITE /end MEASUREMENT
/begin MEASUREMENT fTOPMITH "0:ﾘﾐｯﾀ解除条件不成立  1:ﾘﾐｯﾀ解除条件成立" UBYTE COMP_0283 1 100 0 1 BIT_MASK 0x0020 ECU_ADDRESS 0xFFFF3CA8 READ_WRITE /end MEASUREMENT
/begin MEASUREMENT fTORPNG12 "0:TORPNG診断NG経験なし  1:TORPNG診断NG経験あり" UBYTE COMP_0283 1 100 0 1 BIT_MASK 0x0010 ECU_ADDRESS 0xFFFF3CA8 READ_WRITE /end MEASUREMENT
/begin MEASUREMENT fTORPNG3 "0:TORPNG3診断NG経験なし  1:TORPNG3診断NG経験あり" UBYTE COMP_0283 1 100 0 1 BIT_MASK 0x0008 ECU_ADDRESS 0xFFFF3CA8 READ_WRITE /end MEASUREMENT
/begin MEASUREMENT fTPOLOV "0:正常  1:ｵｰﾊﾞｰ" UBYTE COMP_0283 1 100 0 1 BIT_MASK 0x0004 ECU_ADDRESS 0xFFFF3CA8 READ_WRITE /end MEASUREMENT
/begin MEASUREMENT fTPS4BJG1 "0:判定OK  1:判定NG" UBYTE COMP_0283 1 100 0 1 BIT_MASK 0x0002 ECU_ADDRESS 0xFFFF3CA8 READ_WRITE /end MEASUREMENT
/begin MEASUREMENT fTPS4BJG2 "0:判定OK  1:判定NG" UBYTE COMP_0283 1 100 0 1 BIT_MASK 0x0001 ECU_ADDRESS 0xFFFF3CA8 READ_WRITE /end MEASUREMENT
/begin MEASUREMENT fTQDIGNG "0:制限要求なし  1:制限要求あり" UBYTE COMP_0283 1 100 0 1 BIT_MASK 0x0080 ECU_ADDRESS 0xFFFF3CA9 READ_WRITE /end MEASUREMENT
/begin MEASUREMENT fTRACOFSH "0:強制終了しない  1:強制終了する" UBYTE COMP_0283 1 100 0 1 BIT_MASK 0x0040 ECU_ADDRESS 0xFFFF3CA9 READ_WRITE /end MEASUREMENT
/begin MEASUREMENT fTRAREAF "0:トラノック領域内  1:トラノック領域外" UBYTE COMP_0283 1 100 0 1 BIT_MASK 0x0020 ECU_ADDRESS 0xFFFF3CA9 READ_WRITE /end MEASUREMENT
/begin MEASUREMENT fTRARETST "0:トラノック制御非領域  1:トラノック制御領域" UBYTE COMP_0283 1 100 0 1 BIT_MASK 0x0010 ECU_ADDRESS 0xFFFF3CA9 READ_WRITE /end MEASUREMENT
/begin MEASUREMENT fTRMTLRQ "0:右以外  1:空然比学習禁止" UBYTE COMP_0283 1 100 0 1 BIT_MASK 0x0008 ECU_ADDRESS 0xFFFF3CA9 READ_WRITE /end MEASUREMENT
/begin MEASUREMENT fTRQLMOVB "0:トルク制限要求無し  1:トルク制限要求有り" UBYTE COMP_0283 1 100 0 1 BIT_MASK 0x0004 ECU_ADDRESS 0xFFFF3CA9 READ_WRITE /end MEASUREMENT
/begin MEASUREMENT fTRREFSH "0:トラノックリタード未終了  1:トラノックリタード終了" UBYTE COMP_0283 1 100 0 1 BIT_MASK 0x0002 ECU_ADDRESS 0xFFFF3CA9 READ_WRITE /end MEASUREMENT
/begin MEASUREMENT fTSCNSTOK "0:上記以外  1:ﾀｰﾎﾞSOFIS用過渡判定終了許可" UBYTE COMP_0283 1 100 0 1 BIT_MASK 0x0001 ECU_ADDRESS 0xFFFF3CA9 READ_WRITE /end MEASUREMENT
/begin MEASUREMENT fTSEC "0:不許可  1:診断許可" UBYTE COMP_0283 1 100 0 1 BIT_MASK 0x0080 ECU_ADDRESS 0xFFFF3CAA READ_WRITE /end MEASUREMENT
/begin MEASUREMENT fTSFAULT "0:判定未  1:故障判定" UBYTE COMP_0283 1 100 0 1 BIT_MASK 0x0040 ECU_ADDRESS 0xFFFF3CAA READ_WRITE /end MEASUREMENT
/begin MEASUREMENT fTSFC "0:診断許可  1:不許可" UBYTE COMP_0283 1 100 0 1 BIT_MASK 0x0020 ECU_ADDRESS 0xFFFF3CAA READ_WRITE /end MEASUREMENT
/begin MEASUREMENT fTSK200MS "0:実行不許可  1:実行許可" UBYTE COMP_0283 1 100 0 1 BIT_MASK 0x0010 ECU_ADDRESS 0xFFFF3CAA READ_WRITE /end MEASUREMENT
/begin MEASUREMENT fTSK20MS "0:実行不許可  1:実行許可" UBYTE COMP_0283 1 100 0 1 BIT_MASK 0x0008 ECU_ADDRESS 0xFFFF3CAA READ_WRITE /end MEASUREMENT
/begin MEASUREMENT fTSK40MS "0:実行不許可  1:実行許可" UBYTE COMP_0283 1 100 0 1 BIT_MASK 0x0004 ECU_ADDRESS 0xFFFF3CAA READ_WRITE /end MEASUREMENT
/begin MEASUREMENT fTSLLVSPC "0:不成立  1:成立" UBYTE COMP_0283 1 100 0 1 BIT_MASK 0x0002 ECU_ADDRESS 0xFFFF3CAA READ_WRITE /end MEASUREMENT
/begin MEASUREMENT fTSNOMAL "0:判定未  1:正常判定" UBYTE COMP_0283 1 100 0 1 BIT_MASK 0x0001 ECU_ADDRESS 0xFFFF3CAA READ_WRITE /end MEASUREMENT
/begin MEASUREMENT fTSOFCNST "0:上記以外  1:ﾀｰﾎﾞSOFIS用過渡判定終了" UBYTE COMP_0283 1 100 0 1 BIT_MASK 0x0080 ECU_ADDRESS 0xFFFF3CAB READ_WRITE /end MEASUREMENT
/begin MEASUREMENT fTSOFPST "0:上記以外  1:Boost収束判定中" UBYTE COMP_0283 1 100 0 1 BIT_MASK 0x0040 ECU_ADDRESS 0xFFFF3CAB READ_WRITE /end MEASUREMENT
/begin MEASUREMENT fTSOFQST "0:上記以外  1:流量収束判定中" UBYTE COMP_0283 1 100 0 1 BIT_MASK 0x0020 ECU_ADDRESS 0xFFFF3CAB READ_WRITE /end MEASUREMENT
/begin MEASUREMENT fTSPC "0:不許可  1:診断許可" UBYTE COMP_0283 1 100 0 1 BIT_MASK 0x0010 ECU_ADDRESS 0xFFFF3CAB READ_WRITE /end MEASUREMENT
/begin MEASUREMENT fTSULNRPM "0:不成立  1:成立" UBYTE COMP_0283 1 100 0 1 BIT_MASK 0x0008 ECU_ADDRESS 0xFFFF3CAB READ_WRITE /end MEASUREMENT
/begin MEASUREMENT fTTPSTNG "0:不成立  1:成立" UBYTE COMP_0283 1 100 0 1 BIT_MASK 0x0004 ECU_ADDRESS 0xFFFF3CAB READ_WRITE /end MEASUREMENT
/begin MEASUREMENT fTTRPFLG "0:(t)条件不成立  1:(t)条件成立" UBYTE COMP_0283 1 100 0 1 BIT_MASK 0x0002 ECU_ADDRESS 0xFFFF3CAB READ_WRITE /end MEASUREMENT
/begin MEASUREMENT fTTWINED "0:右記以外  1:vTWINTF演算終了" UBYTE COMP_0283 1 100 0 1 BIT_MASK 0x0001 ECU_ADDRESS 0xFFFF3CAB READ_WRITE /end MEASUREMENT
/begin MEASUREMENT fTVOFQLDQ "0:未経験  1:経験" UBYTE COMP_0283 1 100 0 1 BIT_MASK 0x0080 ECU_ADDRESS 0xFFFF3CAC READ_WRITE /end MEASUREMENT
/begin MEASUREMENT fTVOFQLJB "0:不成立  1:成立" UBYTE COMP_0283 1 100 0 1 BIT_MASK 0x0040 ECU_ADDRESS 0xFFFF3CAC READ_WRITE /end MEASUREMENT
/begin MEASUREMENT fTVOFQLJG "0:不成立  1:成立" UBYTE COMP_0283 1 100 0 1 BIT_MASK 0x0020 ECU_ADDRESS 0xFFFF3CAC READ_WRITE /end MEASUREMENT
/begin MEASUREMENT fTVOFQLJG6 "0:不成立  1:成立" UBYTE COMP_0283 1 100 0 1 BIT_MASK 0x0010 ECU_ADDRESS 0xFFFF3CAC READ_WRITE /end MEASUREMENT
/begin MEASUREMENT fTVOFQLJQ "0:不成立  1:成立" UBYTE COMP_0283 1 100 0 1 BIT_MASK 0x0008 ECU_ADDRESS 0xFFFF3CAC READ_WRITE /end MEASUREMENT
/begin MEASUREMENT fTWASCOFF "0:クルーズキャンセル水温条件成立  1:クルーズキャンセル水温条件不成立" UBYTE COMP_0283 1 100 0 1 BIT_MASK 0x0004 ECU_ADDRESS 0xFFFF3CAC READ_WRITE /end MEASUREMENT
/begin MEASUREMENT fTWCNTED "0:カウントアップ前  1:カウントアップ後" UBYTE COMP_0283 1 100 0 1 BIT_MASK 0x0002 ECU_ADDRESS 0xFFFF3CAC READ_WRITE /end MEASUREMENT
/begin MEASUREMENT fTWNFAN1 "0:右記以外  1:TWN≧TWNFAN1#" UBYTE COMP_0283 1 100 0 1 BIT_MASK 0x0001 ECU_ADDRESS 0xFFFF3CAC READ_WRITE /end MEASUREMENT
/begin MEASUREMENT fTWNFAN2 "0:右記以外  1:TWN≧TWNFAN2#" UBYTE COMP_0283 1 100 0 1 BIT_MASK 0x0080 ECU_ADDRESS 0xFFFF3CAD READ_WRITE /end MEASUREMENT
/begin MEASUREMENT fTWNFAN3 "0:右記以外  1:TWN≧TWNFAN3#" UBYTE COMP_0283 1 100 0 1 BIT_MASK 0x0040 ECU_ADDRESS 0xFFFF3CAD READ_WRITE /end MEASUREMENT
/begin MEASUREMENT fTWOVH "0:TWN＜TWOVH#(ﾋｽ-10℃)  1:TWN≧TWOVH#(ﾋｽ-10℃)" UBYTE COMP_0283 1 100 0 1 BIT_MASK 0x0020 ECU_ADDRESS 0xFFFF3CAD READ_WRITE /end MEASUREMENT
/begin MEASUREMENT fTWQLH "0:右記以外  1:TWN<TWQLH#(ヒス-3℃)" UBYTE COMP_0283 1 100 0 1 BIT_MASK 0x0010 ECU_ADDRESS 0xFFFF3CAD READ_WRITE /end MEASUREMENT
/begin MEASUREMENT fTWQLL "0:右記以外  1:TWQLL#(ヒス-3℃)≦TWN" UBYTE COMP_0283 1 100 0 1 BIT_MASK 0x0008 ECU_ADDRESS 0xFFFF3CAD READ_WRITE /end MEASUREMENT
/begin MEASUREMENT fTWVTSLL "0:低水温マップ使用  1:通常マップ使用" UBYTE COMP_0283 1 100 0 1 BIT_MASK 0x0004 ECU_ADDRESS 0xFFFF3CAD READ_WRITE /end MEASUREMENT
/begin MEASUREMENT fTXAPH2 "0:VAPO＜TXAPH2#(ﾋｽ-TXAPHY#)  1:VAPO≧TXAPH2#(ﾋｽ-TXAPHY#)" UBYTE COMP_0283 1 100 0 1 BIT_MASK 0x0002 ECU_ADDRESS 0xFFFF3CAD READ_WRITE /end MEASUREMENT
/begin MEASUREMENT fTXAPOH "0:VAPO＜TXAPOH#(ﾋｽ-TXAPHY#)  1:VAPO≧TXAPOH#(ﾋｽ-TXAPHY#)" UBYTE COMP_0283 1 100 0 1 BIT_MASK 0x0001 ECU_ADDRESS 0xFFFF3CAD READ_WRITE /end MEASUREMENT
/begin MEASUREMENT fTXFS5 "0:LAN通信系(通信中断)正常  1:LAN通信系(通信中断)異常" UBYTE COMP_0283 1 100 0 1 BIT_MASK 0x0080 ECU_ADDRESS 0xFFFF3CAE READ_WRITE /end MEASUREMENT
/begin MEASUREMENT fTXNEH "0:MNRPM＜TXNEH#(ﾋｽ-TXNEHY#)  1:MNRPM≧TXNEH#(ﾋｽ-TXNEHY#)" UBYTE COMP_0283 1 100 0 1 BIT_MASK 0x0040 ECU_ADDRESS 0xFFFF3CAE READ_WRITE /end MEASUREMENT
/begin MEASUREMENT fTXNEH2 "0:MNRPM＜TXNEH2#(ﾋｽ-TXNEHY#)  1:MNRPM≧TXNEH2#(ﾋｽ-TXNEHY#)" UBYTE COMP_0283 1 100 0 1 BIT_MASK 0x0020 ECU_ADDRESS 0xFFFF3CAE READ_WRITE /end MEASUREMENT
/begin MEASUREMENT fTXNEL1H "0:LNRPM>TXNEL3+TXNEL1#(ﾋｽ+50rpm)  1:LNRPM≦TXNEL3+TXNEL1#(ﾋｽ+50rpm)" UBYTE COMP_0283 1 100 0 1 BIT_MASK 0x0010 ECU_ADDRESS 0xFFFF3CAE READ_WRITE /end MEASUREMENT
/begin MEASUREMENT fTXNEL2H "0:LNRPM>TXNEL3+TXNEL2#(ﾋｽ+50rpm)  1:LNRPM≦TXNEL3+TXNEL2#(ﾋｽ+50rpm)" UBYTE COMP_0283 1 100 0 1 BIT_MASK 0x0008 ECU_ADDRESS 0xFFFF3CAE READ_WRITE /end MEASUREMENT
/begin MEASUREMENT fTXNEL3H "0:LNRPM>TXNEL3(ﾋｽ+50rpm)  1:LNRPM≦TXNEL3(ﾋｽ+50rpm)" UBYTE COMP_0283 1 100 0 1 BIT_MASK 0x0004 ECU_ADDRESS 0xFFFF3CAE READ_WRITE /end MEASUREMENT
/begin MEASUREMENT fTXTQREC "0:ﾘﾀｰﾄﾞﾘｶﾊﾞｰ条件不成立  1:ﾘﾀｰﾄﾞﾘｶﾊﾞｰ条件成立" UBYTE COMP_0283 1 100 0 1 BIT_MASK 0x0002 ECU_ADDRESS 0xFFFF3CAE READ_WRITE /end MEASUREMENT
/begin MEASUREMENT fTXVAPLH "0:VAPO>TXVAPL#(ﾋｽ+0.55deg)  1:VAPO≦TXVAPL#(ﾋｽ+0.55deg)" UBYTE COMP_0283 1 100 0 1 BIT_MASK 0x0001 ECU_ADDRESS 0xFFFF3CAE READ_WRITE /end MEASUREMENT
/begin MEASUREMENT fUTRPFLG "0:(u)条件不成立  1:(u)条件成立" UBYTE COMP_0283 1 100 0 1 BIT_MASK 0x0080 ECU_ADDRESS 0xFFFF3CAF READ_WRITE /end MEASUREMENT
/begin MEASUREMENT fVAERRDE "0:負  1:正" UBYTE COMP_0283 1 100 0 1 BIT_MASK 0x0040 ECU_ADDRESS 0xFFFF3CAF READ_WRITE /end MEASUREMENT
/begin MEASUREMENT fVAERRDEK "0:負  1:正" UBYTE COMP_0283 1 100 0 1 BIT_MASK 0x0020 ECU_ADDRESS 0xFFFF3CAF READ_WRITE /end MEASUREMENT
/begin MEASUREMENT fVAERRDI "0:負  1:正" UBYTE COMP_0283 1 100 0 1 BIT_MASK 0x0010 ECU_ADDRESS 0xFFFF3CAF READ_WRITE /end MEASUREMENT
/begin MEASUREMENT fVAERRDIK "0:VTC＿F/B制御禁止  1:VTC＿F/B制御許可" UBYTE COMP_0283 1 100 0 1 BIT_MASK 0x0008 ECU_ADDRESS 0xFFFF3CAF READ_WRITE /end MEASUREMENT
/begin MEASUREMENT fVAERRRE "0:負  1:正" UBYTE COMP_0283 1 100 0 1 BIT_MASK 0x0004 ECU_ADDRESS 0xFFFF3CAF READ_WRITE /end MEASUREMENT
/begin MEASUREMENT fVAERRREK "0:負  1:正" UBYTE COMP_0283 1 100 0 1 BIT_MASK 0x0002 ECU_ADDRESS 0xFFFF3CAF READ_WRITE /end MEASUREMENT
/begin MEASUREMENT fVAERRRI "0:負  1:正" UBYTE COMP_0283 1 100 0 1 BIT_MASK 0x0001 ECU_ADDRESS 0xFFFF3CAF READ_WRITE /end MEASUREMENT
/begin MEASUREMENT fVAERRRIK "0:負  1:正" UBYTE COMP_0283 1 100 0 1 BIT_MASK 0x0080 ECU_ADDRESS 0xFFFF3CB0 READ_WRITE /end MEASUREMENT
/begin MEASUREMENT fVALCHK "0:油圧警告灯バルブチェック未実行  1:油圧警告灯バルブチェック実行中" UBYTE COMP_0283 1 100 0 1 BIT_MASK 0x0040 ECU_ADDRESS 0xFFFF3CB0 READ_WRITE /end MEASUREMENT
/begin MEASUREMENT fVAPOZ1ST "0:初回  1:2回目以降" UBYTE COMP_0283 1 100 0 1 BIT_MASK 0x0020 ECU_ADDRESS 0xFFFF3CB0 READ_WRITE /end MEASUREMENT
/begin MEASUREMENT fVBCLREF "0:非成立  1:成立" UBYTE COMP_0283 1 100 0 1 BIT_MASK 0x0010 ECU_ADDRESS 0xFFFF3CB0 READ_WRITE /end MEASUREMENT
/begin MEASUREMENT fVBHTCV "0:不成立  1:成立" UBYTE COMP_0283 1 100 0 1 BIT_MASK 0x0008 ECU_ADDRESS 0xFFFF3CB0 READ_WRITE /end MEASUREMENT
/begin MEASUREMENT fVBLTCV "0:不成立  1:成立" UBYTE COMP_0283 1 100 0 1 BIT_MASK 0x0004 ECU_ADDRESS 0xFFFF3CB0 READ_WRITE /end MEASUREMENT
/begin MEASUREMENT fVCLNENA "0:クリーニングモード不許可  1:クリーニングモード許可" UBYTE COMP_0283 1 100 0 1 BIT_MASK 0x0002 ECU_ADDRESS 0xFFFF3CB0 READ_WRITE /end MEASUREMENT
/begin MEASUREMENT fVCLNENAE "0:クリーニングモード不許可  1:クリーニングモード許可" UBYTE COMP_0283 1 100 0 1 BIT_MASK 0x0001 ECU_ADDRESS 0xFFFF3CB0 READ_WRITE /end MEASUREMENT
/begin MEASUREMENT fVELCPC "0:非VELｼｽﾃﾑ  1:VELｼｽﾃﾑ" UBYTE COMP_0283 1 100 0 1 BIT_MASK 0x0080 ECU_ADDRESS 0xFFFF3CB1 READ_WRITE /end MEASUREMENT
/begin MEASUREMENT fVINDDL "0:VIN書込み条件不成立  1:VIN書込み条件成立" UBYTE COMP_0283 1 100 0 1 BIT_MASK 0x0040 ECU_ADDRESS 0xFFFF3CB1 READ_WRITE /end MEASUREMENT
/begin MEASUREMENT fVOPSNNG "0:油圧センサ断線ショート診断OK  1:油圧センサ断線ショート診断NG" UBYTE COMP_0283 1 100 0 1 BIT_MASK 0x0020 ECU_ADDRESS 0xFFFF3CB1 READ_WRITE /end MEASUREMENT
/begin MEASUREMENT fVOPSOK_H "0:油圧センサ異常HIGH電圧  1:油圧センサ電圧正常範囲" UBYTE COMP_0283 1 100 0 1 BIT_MASK 0x0010 ECU_ADDRESS 0xFFFF3CB1 READ_WRITE /end MEASUREMENT
/begin MEASUREMENT fVOPSOK_L "0:油圧センサ異常LOW電圧  1:油圧センサ電圧正常範囲" UBYTE COMP_0283 1 100 0 1 BIT_MASK 0x0008 ECU_ADDRESS 0xFFFF3CB1 READ_WRITE /end MEASUREMENT
/begin MEASUREMENT fVSLDTCHG "0:車速変化ずれ率  1:車速変化ずれ量" UBYTE COMP_0283 1 100 0 1 BIT_MASK 0x0004 ECU_ADDRESS 0xFFFF3CB1 READ_WRITE /end MEASUREMENT
/begin MEASUREMENT fVSLNG "0:車速正常  1:車速異常" UBYTE COMP_0283 1 100 0 1 BIT_MASK 0x0002 ECU_ADDRESS 0xFFFF3CB1 READ_WRITE /end MEASUREMENT
/begin MEASUREMENT fVSLNGT "0:車速正常  1:車速異常" UBYTE COMP_0283 1 100 0 1 BIT_MASK 0x0001 ECU_ADDRESS 0xFFFF3CB1 READ_WRITE /end MEASUREMENT
/begin MEASUREMENT fVSP1EX "0:未経験  1:経験した" UBYTE COMP_0283 1 100 0 1 BIT_MASK 0x0080 ECU_ADDRESS 0xFFFF3CB2 READ_WRITE /end MEASUREMENT
/begin MEASUREMENT fVSP2ZSET "0:VSP2S前データ未セット  1:VSP2S前データセット済み" UBYTE COMP_0283 1 100 0 1 BIT_MASK 0x0040 ECU_ADDRESS 0xFFFF3CB2 READ_WRITE /end MEASUREMENT
/begin MEASUREMENT fVSPDGCHK "0:PTD車速ｾﾝｻ不整合診断条件不成立  1:PTD車速ｾﾝｻ不整合診断条件成立" UBYTE COMP_0283 1 100 0 1 BIT_MASK 0x0020 ECU_ADDRESS 0xFFFF3CB2 READ_WRITE /end MEASUREMENT
/begin MEASUREMENT fVSPIGN "0:カウントアップ前  1:カウントアップ後" UBYTE COMP_0283 1 100 0 1 BIT_MASK 0x0010 ECU_ADDRESS 0xFFFF3CB2 READ_WRITE /end MEASUREMENT
/begin MEASUREMENT fVSPLDNGL "0:ＮＧでない  1:ＮＧ" UBYTE COMP_0283 1 100 0 1 BIT_MASK 0x0008 ECU_ADDRESS 0xFFFF3CB2 READ_WRITE /end MEASUREMENT
/begin MEASUREMENT fVSPLDNGR "0:ＮＧでない  1:ＮＧ" UBYTE COMP_0283 1 100 0 1 BIT_MASK 0x0004 ECU_ADDRESS 0xFFFF3CB2 READ_WRITE /end MEASUREMENT
/begin MEASUREMENT fVSPLRAT "0:不許可  1:許可" UBYTE COMP_0283 1 100 0 1 BIT_MASK 0x0002 ECU_ADDRESS 0xFFFF3CB2 READ_WRITE /end MEASUREMENT
/begin MEASUREMENT fVSPLRTNG "0:ＮＧでない  1:ＮＧ" UBYTE COMP_0283 1 100 0 1 BIT_MASK 0x0080 ECU_ADDRESS 0xFFFF3CB3 READ_WRITE /end MEASUREMENT
/begin MEASUREMENT fVSPOVCC "0:点滅無  1:点滅有" UBYTE COMP_0283 1 100 0 1 BIT_MASK 0x0040 ECU_ADDRESS 0xFFFF3CB3 READ_WRITE /end MEASUREMENT
/begin MEASUREMENT fVSPOVSL "0:点滅無  1:点滅有" UBYTE COMP_0283 1 100 0 1 BIT_MASK 0x0020 ECU_ADDRESS 0xFFFF3CB3 READ_WRITE /end MEASUREMENT
/begin MEASUREMENT fVSPSNG "0:NG判定なし  1:NG判定(含む1stTripNG)" UBYTE COMP_0283 1 100 0 1 BIT_MASK 0x0010 ECU_ADDRESS 0xFFFF3CB3 READ_WRITE /end MEASUREMENT
/begin MEASUREMENT fVSPSNG20 "0:20ms未経過  1:20ms経過" UBYTE COMP_0283 1 100 0 1 BIT_MASK 0x0008 ECU_ADDRESS 0xFFFF3CB3 READ_WRITE /end MEASUREMENT
/begin MEASUREMENT fVSPTME "0:経験なし  1:経験あり" UBYTE COMP_0283 1 100 0 1 BIT_MASK 0x0004 ECU_ADDRESS 0xFFFF3CB3 READ_WRITE /end MEASUREMENT
/begin MEASUREMENT fVTC3NG "0:NG未判定  1:NG判定" UBYTE COMP_0283 1 100 0 1 BIT_MASK 0x0002 ECU_ADDRESS 0xFFFF3CB3 READ_WRITE /end MEASUREMENT
/begin MEASUREMENT fVTC3OK "0:OK未判定  1:OK判定" UBYTE COMP_0283 1 100 0 1 BIT_MASK 0x0080 ECU_ADDRESS 0xFFFF3CB4 READ_WRITE /end MEASUREMENT
/begin MEASUREMENT fVTC4ANG "0:NG未判定  1:NG判定" UBYTE COMP_0283 1 100 0 1 BIT_MASK 0x0020 ECU_ADDRESS 0xFFFF3CB4 READ_WRITE /end MEASUREMENT
/begin MEASUREMENT fVTC4AOK "0:OK未判定  1:OK判定" UBYTE COMP_0283 1 100 0 1 BIT_MASK 0x0008 ECU_ADDRESS 0xFFFF3CB4 READ_WRITE /end MEASUREMENT
/begin MEASUREMENT fVTC6ANG "0:NG未判定  1:NG判定" UBYTE COMP_0283 1 100 0 1 BIT_MASK 0x0002 ECU_ADDRESS 0xFFFF3CB4 READ_WRITE /end MEASUREMENT
/begin MEASUREMENT fVTC6AOK "0:OK未判定  1:OK判定" UBYTE COMP_0283 1 100 0 1 BIT_MASK 0x0080 ECU_ADDRESS 0xFFFF3CB5 READ_WRITE /end MEASUREMENT
/begin MEASUREMENT fVTC6DNG "0:NG未判定  1:NG判定" UBYTE COMP_0283 1 100 0 1 BIT_MASK 0x0020 ECU_ADDRESS 0xFFFF3CB5 READ_WRITE /end MEASUREMENT
/begin MEASUREMENT fVTC6DOK "0:OK未判定  1:OK判定" UBYTE COMP_0283 1 100 0 1 BIT_MASK 0x0008 ECU_ADDRESS 0xFFFF3CB5 READ_WRITE /end MEASUREMENT
/begin MEASUREMENT fVTCCNEL "0:VTC駆動異常診断許可エンジン回転  1:VTC駆動異常診断許可エンジン回転" UBYTE COMP_0283 1 100 0 1 BIT_MASK 0x0002 ECU_ADDRESS 0xFFFF3CB5 READ_WRITE /end MEASUREMENT
/begin MEASUREMENT fVTCCTWH "0:VTC駆動異常診断許可水温上限以上  1:VTC駆動異常診断許可水温上限未満" UBYTE COMP_0283 1 100 0 1 BIT_MASK 0x0001 ECU_ADDRESS 0xFFFF3CB5 READ_WRITE /end MEASUREMENT
/begin MEASUREMENT fVTCCTWL "0:VTC駆動異常診断許可水温下限以下  1:VTC駆動異常診断許可水温下限より" UBYTE COMP_0283 1 100 0 1 BIT_MASK 0x0080 ECU_ADDRESS 0xFFFF3CB6 READ_WRITE /end MEASUREMENT
/begin MEASUREMENT fVTCDGE7 "0:不成立  1:成立" UBYTE COMP_0283 1 100 0 1 BIT_MASK 0x0040 ECU_ADDRESS 0xFFFF3CB6 READ_WRITE /end MEASUREMENT
/begin MEASUREMENT fVTCDGN2E "0:不成立  1:成立" UBYTE COMP_0283 1 100 0 1 BIT_MASK 0x0020 ECU_ADDRESS 0xFFFF3CB6 READ_WRITE /end MEASUREMENT
/begin MEASUREMENT fVTCDGN7E "0:不成立  1:成立" UBYTE COMP_0283 1 100 0 1 BIT_MASK 0x0010 ECU_ADDRESS 0xFFFF3CB6 READ_WRITE /end MEASUREMENT
/begin MEASUREMENT fVTCDGNE "0:不成立  1:成立" UBYTE COMP_0283 1 100 0 1 BIT_MASK 0x0008 ECU_ADDRESS 0xFFFF3CB6 READ_WRITE /end MEASUREMENT
/begin MEASUREMENT fVTCDNE "0:不成立  1:成立" UBYTE COMP_0283 1 100 0 1 BIT_MASK 0x0004 ECU_ADDRESS 0xFFFF3CB6 READ_WRITE /end MEASUREMENT
/begin MEASUREMENT fVTCDTMAX "0:不成立  1:成立" UBYTE COMP_0283 1 100 0 1 BIT_MASK 0x0002 ECU_ADDRESS 0xFFFF3CB6 READ_WRITE /end MEASUREMENT
/begin MEASUREMENT fVTCDTMIN "0:不成立  1:成立" UBYTE COMP_0283 1 100 0 1 BIT_MASK 0x0001 ECU_ADDRESS 0xFFFF3CB6 READ_WRITE /end MEASUREMENT
/begin MEASUREMENT fVTCDTMNE "0:不成立  1:成立" UBYTE COMP_0283 1 100 0 1 BIT_MASK 0x0080 ECU_ADDRESS 0xFFFF3CB7 READ_WRITE /end MEASUREMENT
/begin MEASUREMENT fVTCDTMXE "0:不成立  1:成立" UBYTE COMP_0283 1 100 0 1 BIT_MASK 0x0040 ECU_ADDRESS 0xFFFF3CB7 READ_WRITE /end MEASUREMENT
/begin MEASUREMENT fVTCENA2 "0:VTC_F/B制御禁止  1:VTC_F/B制御許可" UBYTE COMP_0283 1 100 0 1 BIT_MASK 0x0020 ECU_ADDRESS 0xFFFF3CB7 READ_WRITE /end MEASUREMENT
/begin MEASUREMENT fVTCENAE2 "0:排気VTC＿F/B制御禁止  1:排気VTC＿F/B制御許可" UBYTE COMP_0283 1 100 0 1 BIT_MASK 0x0010 ECU_ADDRESS 0xFFFF3CB7 READ_WRITE /end MEASUREMENT
/begin MEASUREMENT fVTCINEL "0:VTCオフセット診断許可エンジン回  1:VTCオフセット診断許可エンジン回" UBYTE COMP_0283 1 100 0 1 BIT_MASK 0x0008 ECU_ADDRESS 0xFFFF3CB7 READ_WRITE /end MEASUREMENT
/begin MEASUREMENT fVTCINELG "0:条件不成立  1:条件成立" UBYTE COMP_0283 1 100 0 1 BIT_MASK 0x0004 ECU_ADDRESS 0xFFFF3CB7 READ_WRITE /end MEASUREMENT
/begin MEASUREMENT fVTCITWL "0:VTCオフセット診断許可水温下限以  1:VTCオフセット診断許可水温下限よ" UBYTE COMP_0283 1 100 0 1 BIT_MASK 0x0002 ECU_ADDRESS 0xFFFF3CB7 READ_WRITE /end MEASUREMENT
/begin MEASUREMENT fVTCITWLG "0:条件不成立  1:条件成立" UBYTE COMP_0283 1 100 0 1 BIT_MASK 0x0001 ECU_ADDRESS 0xFFFF3CB7 READ_WRITE /end MEASUREMENT
/begin MEASUREMENT fVTCLEXP "0:クリーニングモードが実行されてい  1:クリーニングモードが実行された" UBYTE COMP_0283 1 100 0 1 BIT_MASK 0x0080 ECU_ADDRESS 0xFFFF3CB8 READ_WRITE /end MEASUREMENT
/begin MEASUREMENT fVTCLEXPE "0:クリーニングモードが実行されてい  1:クリーニングモードが実行された" UBYTE COMP_0283 1 100 0 1 BIT_MASK 0x0040 ECU_ADDRESS 0xFFFF3CB8 READ_WRITE /end MEASUREMENT
/begin MEASUREMENT fVTCMDNE "0:成立  1:不成立" UBYTE COMP_0283 1 100 0 1 BIT_MASK 0x0020 ECU_ADDRESS 0xFFFF3CB8 READ_WRITE /end MEASUREMENT
/begin MEASUREMENT fVTCMDNE2 "0:成立  1:不成立" UBYTE COMP_0283 1 100 0 1 BIT_MASK 0x0010 ECU_ADDRESS 0xFFFF3CB8 READ_WRITE /end MEASUREMENT
/begin MEASUREMENT fVTCMDVSP "0:成立  1:不成立" UBYTE COMP_0283 1 100 0 1 BIT_MASK 0x0008 ECU_ADDRESS 0xFFFF3CB8 READ_WRITE /end MEASUREMENT
/begin MEASUREMENT fVTCME1E "0:未終了  1:終了" UBYTE COMP_0283 1 100 0 1 BIT_MASK 0x0004 ECU_ADDRESS 0xFFFF3CB8 READ_WRITE /end MEASUREMENT
/begin MEASUREMENT fVTCMI1E "0:未終了  1:終了" UBYTE COMP_0283 1 100 0 1 BIT_MASK 0x0002 ECU_ADDRESS 0xFFFF3CB8 READ_WRITE /end MEASUREMENT
/begin MEASUREMENT fVTCNG "0:故障時制御不要  1:故障時制御起動" UBYTE COMP_0283 1 100 0 1 BIT_MASK 0x0001 ECU_ADDRESS 0xFFFF3CB8 READ_WRITE /end MEASUREMENT
/begin MEASUREMENT fVTCONEHG "0:条件不成立  1:条件成立" UBYTE COMP_0283 1 100 0 1 BIT_MASK 0x0080 ECU_ADDRESS 0xFFFF3CB9 READ_WRITE /end MEASUREMENT
/begin MEASUREMENT fVTCONEL "0:VTCオフセット診断許可エンジン回  1:VTCオフセット診断許可エンジン回" UBYTE COMP_0283 1 100 0 1 BIT_MASK 0x0040 ECU_ADDRESS 0xFFFF3CB9 READ_WRITE /end MEASUREMENT
/begin MEASUREMENT fVTCONELG "0:条件不成立  1:条件成立" UBYTE COMP_0283 1 100 0 1 BIT_MASK 0x0020 ECU_ADDRESS 0xFFFF3CB9 READ_WRITE /end MEASUREMENT
/begin MEASUREMENT fVTCOPNL "0:条件不成立  1:条件成立" UBYTE COMP_0283 1 100 0 1 BIT_MASK 0x0010 ECU_ADDRESS 0xFFFF3CB9 READ_WRITE /end MEASUREMENT
/begin MEASUREMENT fVTCOTWH "0:VTCオフセット診断許可水温上限以  1:VTCオフセット診断許可水温上限未" UBYTE COMP_0283 1 100 0 1 BIT_MASK 0x0008 ECU_ADDRESS 0xFFFF3CB9 READ_WRITE /end MEASUREMENT
/begin MEASUREMENT fVTCOTWHG "0:条件不成立  1:条件成立" UBYTE COMP_0283 1 100 0 1 BIT_MASK 0x0004 ECU_ADDRESS 0xFFFF3CB9 READ_WRITE /end MEASUREMENT
/begin MEASUREMENT fVTCOTWL "0:VTCオフセット診断許可水温下限以  1:VTCオフセット診断許可水温下限よ" UBYTE COMP_0283 1 100 0 1 BIT_MASK 0x0002 ECU_ADDRESS 0xFFFF3CB9 READ_WRITE /end MEASUREMENT
/begin MEASUREMENT fVTCOTWLG "0:条件不成立  1:条件成立" UBYTE COMP_0283 1 100 0 1 BIT_MASK 0x0001 ECU_ADDRESS 0xFFFF3CB9 READ_WRITE /end MEASUREMENT
/begin MEASUREMENT fVTCVSPG "0:条件不成立  1:条件成立" UBYTE COMP_0283 1 100 0 1 BIT_MASK 0x0080 ECU_ADDRESS 0xFFFF3CBA READ_WRITE /end MEASUREMENT
/begin MEASUREMENT fVTDGN4OKE "0:正常判定未  1:正常判定済" UBYTE COMP_0283 1 100 0 1 BIT_MASK 0x0040 ECU_ADDRESS 0xFFFF3CBA READ_WRITE /end MEASUREMENT
/begin MEASUREMENT fVTDGN4SE "0:診断不許可  1:診断許可" UBYTE COMP_0283 1 100 0 1 BIT_MASK 0x0010 ECU_ADDRESS 0xFFFF3CBA READ_WRITE /end MEASUREMENT
/begin MEASUREMENT fVTDGN7OKE "0:正常判定未  1:正常判定済" UBYTE COMP_0283 1 100 0 1 BIT_MASK 0x0008 ECU_ADDRESS 0xFFFF3CBA READ_WRITE /end MEASUREMENT
/begin MEASUREMENT fVTDGN7SE "0:不成立  1:成立" UBYTE COMP_0283 1 100 0 1 BIT_MASK 0x0004 ECU_ADDRESS 0xFFFF3CBA READ_WRITE /end MEASUREMENT
/begin MEASUREMENT fVTDTME "0:無駄時間処理停止中  1:無駄時間処理実行中" UBYTE COMP_0283 1 100 0 1 BIT_MASK 0x0002 ECU_ADDRESS 0xFFFF3CBA READ_WRITE /end MEASUREMENT
/begin MEASUREMENT fVTDTMI "0:無駄時間処理停止中  1:無駄時間処理実行中" UBYTE COMP_0283 1 100 0 1 BIT_MASK 0x0001 ECU_ADDRESS 0xFFFF3CBA READ_WRITE /end MEASUREMENT
/begin MEASUREMENT fVTEACTV1 "0:vVTEACTV1カウントアップ未経験  1:vVTEACTV1カウントアップ経験" UBYTE COMP_0283 1 100 0 1 BIT_MASK 0x0080 ECU_ADDRESS 0xFFFF3CBB READ_WRITE /end MEASUREMENT
/begin MEASUREMENT fVTEBCTV1 "0:vVTEBCTV1カウントアップ未経験  1:vVTEBCTV1カウントアップ経験" UBYTE COMP_0283 1 100 0 1 BIT_MASK 0x0040 ECU_ADDRESS 0xFFFF3CBB READ_WRITE /end MEASUREMENT
/begin MEASUREMENT fVTIACTV1 "0:vVTIACNT1カウントアップ未経験  1:vVTIACNT1カウントアップ経験" UBYTE COMP_0283 1 100 0 1 BIT_MASK 0x0020 ECU_ADDRESS 0xFFFF3CBB READ_WRITE /end MEASUREMENT
/begin MEASUREMENT fVTIBCTV1 "0:vVTIBCTV1カウントアップ未経験  1:vVTIBCTV1カウントアップ経験" UBYTE COMP_0283 1 100 0 1 BIT_MASK 0x0010 ECU_ADDRESS 0xFFFF3CBB READ_WRITE /end MEASUREMENT
/begin MEASUREMENT fVTLRNOK "0:学習不可能  1:学習可能" UBYTE COMP_0283 1 100 0 1 BIT_MASK 0x0008 ECU_ADDRESS 0xFFFF3CBB READ_WRITE /end MEASUREMENT
/begin MEASUREMENT fVTLRNOKE "0:学習不可能  1:学習可能" UBYTE COMP_0283 1 100 0 1 BIT_MASK 0x0004 ECU_ADDRESS 0xFFFF3CBB READ_WRITE /end MEASUREMENT
/begin MEASUREMENT fVTRPFLG "0:500.5.2_ﾄﾘｯﾌﾟｶｳﾝﾀ演算条件(v)条件  1:500.5.2_ﾄﾘｯﾌﾟｶｳﾝﾀ演算条件(v)条件" UBYTE COMP_0283 1 100 0 1 BIT_MASK 0x0002 ECU_ADDRESS 0xFFFF3CBB READ_WRITE /end MEASUREMENT
/begin MEASUREMENT fWDTFST "0:条件成立  1:条件不成立" UBYTE COMP_0283 1 100 0 1 BIT_MASK 0x0001 ECU_ADDRESS 0xFFFF3CBB READ_WRITE /end MEASUREMENT
/begin MEASUREMENT fWDTGO "0:条件成立  1:条件不成立" UBYTE COMP_0283 1 100 0 1 BIT_MASK 0x0080 ECU_ADDRESS 0xFFFF3CBC READ_WRITE /end MEASUREMENT
/begin MEASUREMENT fWDTGO1 "0:条件成立  1:条件不成立" UBYTE COMP_0283 1 100 0 1 BIT_MASK 0x0040 ECU_ADDRESS 0xFFFF3CBC READ_WRITE /end MEASUREMENT
/begin MEASUREMENT fWDTGO2 "0:条件成立  1:条件不成立" UBYTE COMP_0283 1 100 0 1 BIT_MASK 0x0020 ECU_ADDRESS 0xFFFF3CBC READ_WRITE /end MEASUREMENT
/begin MEASUREMENT fWGDUTYON "0:過給圧制御禁止  1:過給圧制御許可" UBYTE COMP_0283 1 100 0 1 BIT_MASK 0x0010 ECU_ADDRESS 0xFFFF3CBC READ_WRITE /end MEASUREMENT
/begin MEASUREMENT fWGFBIOFF "0:Iゲイン付加許可  1:禁止（Iゲイン_=_0）" UBYTE COMP_0283 1 100 0 1 BIT_MASK 0x0008 ECU_ADDRESS 0xFFFF3CBC READ_WRITE /end MEASUREMENT
/begin MEASUREMENT fWGFBPOFF "0:Pゲイン付加許可  1:禁止（Pゲイン_=_0）" UBYTE COMP_0283 1 100 0 1 BIT_MASK 0x0004 ECU_ADDRESS 0xFFFF3CBC READ_WRITE /end MEASUREMENT
/begin MEASUREMENT fWLNPOK "0:開始ﾃﾞｨﾚｲ経過前  1:開始ﾃﾞｨﾚｲ経過後" UBYTE COMP_0283 1 100 0 1 BIT_MASK 0x0002 ECU_ADDRESS 0xFFFF3CBC READ_WRITE /end MEASUREMENT
/begin MEASUREMENT fWTRPFLG "0:(w)条件不成立  1:(w)条件成立" UBYTE COMP_0283 1 100 0 1 BIT_MASK 0x0001 ECU_ADDRESS 0xFFFF3CBC READ_WRITE /end MEASUREMENT
/begin MEASUREMENT fXTRPFLG "0:(x)条件不成立  1:(x)条件成立" UBYTE COMP_0283 1 100 0 1 BIT_MASK 0x0080 ECU_ADDRESS 0xFFFF3CBD READ_WRITE /end MEASUREMENT
/begin MEASUREMENT fCRUMST_S "0:無効  1:有効" UBYTE COMP_0283 1 100 0 1 BIT_MASK 0x0040 ECU_ADDRESS 0xFFFF3CBD READ_WRITE /end MEASUREMENT
/begin MEASUREMENT fDCPUNG_S "0:CPUNGなし  1:CPUNGあり" UBYTE COMP_0283 1 100 0 1 BIT_MASK 0x0020 ECU_ADDRESS 0xFFFF3CBD READ_WRITE /end MEASUREMENT
/begin MEASUREMENT fPDLHDF_S "0:非作動中  1:作動中" UBYTE COMP_0283 1 100 0 1 BIT_MASK 0x0010 ECU_ADDRESS 0xFFFF3CBD READ_WRITE /end MEASUREMENT
/begin MEASUREMENT fPTSPFL_S "0:OFF  1:ON" UBYTE COMP_0283 1 100 0 1 BIT_MASK 0x0008 ECU_ADDRESS 0xFFFF3CBD READ_WRITE /end MEASUREMENT
/begin MEASUREMENT fPTSPUP_S "0:OFF  1:ON" UBYTE COMP_0283 1 100 0 1 BIT_MASK 0x0004 ECU_ADDRESS 0xFFFF3CBD READ_WRITE /end MEASUREMENT
/begin MEASUREMENT fSLMSTR_S "0:無効  1:有効" UBYTE COMP_0283 1 100 0 1 BIT_MASK 0x0002 ECU_ADDRESS 0xFFFF3CBD READ_WRITE /end MEASUREMENT
/begin MEASUREMENT fTHMOD_S "0:ベース特性開度  1:移行特性開度" UBYTE COMP_0283 1 100 0 1 BIT_MASK 0x0001 ECU_ADDRESS 0xFFFF3CBD READ_WRITE /end MEASUREMENT
/begin MEASUREMENT afACCFAIL "0:正常  1:ACCフェール" UBYTE COMP_0283 1 100 0 1 BIT_MASK 0x0080 ECU_ADDRESS 0xFFFF1C0D READ_WRITE /end MEASUREMENT
/begin MEASUREMENT afACCMDFAL "0:正常  1:ACCフェール" UBYTE COMP_0283 1 100 0 1 BIT_MASK 0x0040 ECU_ADDRESS 0xFFFF1C0D READ_WRITE /end MEASUREMENT
/begin MEASUREMENT afACOUTV "0:リレーOFF要求  1:リレーＯＮ要求" UBYTE COMP_0283 1 100 0 1 BIT_MASK 0x0020 ECU_ADDRESS 0xFFFF1C0D READ_WRITE /end MEASUREMENT
/begin MEASUREMENT afACPDCUT "0:エアコンカット信号OFF要求  1:エアコンカット信号ＯＮ要求" UBYTE COMP_0283 1 100 0 1 BIT_MASK 0x0010 ECU_ADDRESS 0xFFFF1C0D READ_WRITE /end MEASUREMENT
/begin MEASUREMENT afALTJG "0:不成立  1:高地判定パラメーター取得許可条件" UBYTE COMP_0283 1 100 0 1 BIT_MASK 0x0008 ECU_ADDRESS 0xFFFF1C0D READ_WRITE /end MEASUREMENT
/begin MEASUREMENT afAPS1SEL "0:正常  1:異常" UBYTE COMP_0283 1 100 0 1 BIT_MASK 0x0004 ECU_ADDRESS 0xFFFF1C0D READ_WRITE /end MEASUREMENT
/begin MEASUREMENT afAPS2SEL "0:正常  1:異常" UBYTE COMP_0283 1 100 0 1 BIT_MASK 0x0002 ECU_ADDRESS 0xFFFF1C0D READ_WRITE /end MEASUREMENT
/begin MEASUREMENT afAPSSNG "0:不成立  1:成立" UBYTE COMP_0283 1 100 0 1 BIT_MASK 0x0001 ECU_ADDRESS 0xFFFF1C0D READ_WRITE /end MEASUREMENT
/begin MEASUREMENT afCSBUST "0:不成立  1:成立" UBYTE COMP_0283 1 100 0 1 BIT_MASK 0x0080 ECU_ADDRESS 0xFFFF1C0E READ_WRITE /end MEASUREMENT
/begin MEASUREMENT afDSTLCUT "0:Dﾚﾝｼﾞｽﾄｰﾙ全気筒ﾘｶﾊﾞ  1:Dﾚﾝｼﾞｽﾄｰﾙ全気筒ｶｯﾄ" UBYTE COMP_0283 1 100 0 1 BIT_MASK 0x0040 ECU_ADDRESS 0xFFFF1C0E READ_WRITE /end MEASUREMENT
/begin MEASUREMENT afFABCSOL "0:SOL_OFF  1:SOL_ON" UBYTE COMP_0283 1 100 0 1 BIT_MASK 0x0020 ECU_ADDRESS 0xFFFF1C0E READ_WRITE /end MEASUREMENT
/begin MEASUREMENT afFANGIJT "0:不成立  1:成立" UBYTE COMP_0283 1 100 0 1 BIT_MASK 0x0010 ECU_ADDRESS 0xFFFF1C0E READ_WRITE /end MEASUREMENT
/begin MEASUREMENT afFCAT2INJ "0:条件不成立  1:条件成立" UBYTE COMP_0283 1 100 0 1 BIT_MASK 0x0008 ECU_ADDRESS 0xFFFF1C0E READ_WRITE /end MEASUREMENT
/begin MEASUREMENT afFCODOFF "0:ODOFF要求無し  1:ODOFF要求有り" UBYTE COMP_0283 1 100 0 1 BIT_MASK 0x0004 ECU_ADDRESS 0xFFFF1C0E READ_WRITE /end MEASUREMENT
/begin MEASUREMENT afFCON "0:ODOFF要求無し  1:ODOFF要求有り" UBYTE COMP_0283 1 100 0 1 BIT_MASK 0x0002 ECU_ADDRESS 0xFFFF1C0E READ_WRITE /end MEASUREMENT
/begin MEASUREMENT afFCRLUP "0:非ロックアップ中  1:ロックアップ中" UBYTE COMP_0283 1 100 0 1 BIT_MASK 0x0001 ECU_ADDRESS 0xFFFF1C0E READ_WRITE /end MEASUREMENT
/begin MEASUREMENT afFD3LU "0:要求有り  1:要求無し" UBYTE COMP_0283 1 100 0 1 BIT_MASK 0x0080 ECU_ADDRESS 0xFFFF1C0F READ_WRITE /end MEASUREMENT
/begin MEASUREMENT afFDTLIN "0:ロックアップ許可信号出力制御条件  1:ロックアップ許可信号出力制御条件" UBYTE COMP_0283 1 100 0 1 BIT_MASK 0x0040 ECU_ADDRESS 0xFFFF1C0F READ_WRITE /end MEASUREMENT
/begin MEASUREMENT afFDTLIN2 "0:ロックアップ許可信号出力制御条件  1:ロックアップ許可信号出力制御条件" UBYTE COMP_0283 1 100 0 1 BIT_MASK 0x0020 ECU_ADDRESS 0xFFFF1C0F READ_WRITE /end MEASUREMENT
/begin MEASUREMENT afFFCADV "0:右記以外  1:ADVLMT切り替え中" UBYTE COMP_0283 1 100 0 1 BIT_MASK 0x0010 ECU_ADDRESS 0xFFFF1C0F READ_WRITE /end MEASUREMENT
/begin MEASUREMENT afFFIR0 "0:FIR制御禁止  1:FIR制御許可" UBYTE COMP_0283 1 100 0 1 BIT_MASK 0x0008 ECU_ADDRESS 0xFFFF1C0F READ_WRITE /end MEASUREMENT
/begin MEASUREMENT afFLSWPT "0:vAPOST＜mAPOFULL(ﾋｽ-mDAPOFULL)  1:vAPOST≧mAPOFULL(ﾋｽ-mDAPOFULL)" UBYTE COMP_0283 1 100 0 1 BIT_MASK 0x0004 ECU_ADDRESS 0xFFFF1C0F READ_WRITE /end MEASUREMENT
/begin MEASUREMENT afFNEIJT "0:vTITM極低温始動時噴射ﾀｲﾐﾝｸﾞ未経  1:vTITM極低温始動時噴射ﾀｲﾐﾝｸﾞ経験" UBYTE COMP_0283 1 100 0 1 BIT_MASK 0x0002 ECU_ADDRESS 0xFFFF1C0F READ_WRITE /end MEASUREMENT
/begin MEASUREMENT afFODINH "0:OD許可  1:OD禁止" UBYTE COMP_0283 1 100 0 1 BIT_MASK 0x0001 ECU_ADDRESS 0xFFFF1C0F READ_WRITE /end MEASUREMENT
/begin MEASUREMENT afFPC "0:FPC端子Low出力  1:FPC端子High出力" UBYTE COMP_0283 1 100 0 1 BIT_MASK 0x0080 ECU_ADDRESS 0xFFFF1C10 READ_WRITE /end MEASUREMENT
/begin MEASUREMENT afFPRON "0:燃料ﾎﾟﾝﾌﾟOFF  1:燃料ﾎﾟﾝﾌﾟON" UBYTE COMP_0283 1 100 0 1 BIT_MASK 0x0040 ECU_ADDRESS 0xFFFF1C10 READ_WRITE /end MEASUREMENT
/begin MEASUREMENT afFSCCMP "0:均質噴射演算終了  1:成層噴射演算終了" UBYTE COMP_0283 1 100 0 1 BIT_MASK 0x0020 ECU_ADDRESS 0xFFFF1C10 READ_WRITE /end MEASUREMENT
/begin MEASUREMENT afFTWIJT "0:極低水温判定されていない  1:極低水温判定されている" UBYTE COMP_0283 1 100 0 1 BIT_MASK 0x0010 ECU_ADDRESS 0xFFFF1C10 READ_WRITE /end MEASUREMENT
/begin MEASUREMENT afFUKE "0:成立  1:不成立" UBYTE COMP_0283 1 100 0 1 BIT_MASK 0x0008 ECU_ADDRESS 0xFFFF1C10 READ_WRITE /end MEASUREMENT
/begin MEASUREMENT afGAKUON "0:REF間⊿N点火時期ﾌｨｰﾄﾞﾊﾞｯｸ制御終  1:REF間⊿N点火時期ﾌｨｰﾄﾞﾊﾞｯｸ制御開" UBYTE COMP_0283 1 100 0 1 BIT_MASK 0x0004 ECU_ADDRESS 0xFFFF1C10 READ_WRITE /end MEASUREMENT
/begin MEASUREMENT afGNDSLCT "0:始動後ﾘｰﾝ限界拡大制中N-Dｾﾚｸﾄ以外  1:始動後ﾘｰﾝ限界拡大制中N-Dｾﾚｸﾄ中" UBYTE COMP_0283 1 100 0 1 BIT_MASK 0x0002 ECU_ADDRESS 0xFFFF1C10 READ_WRITE /end MEASUREMENT
/begin MEASUREMENT afGOV "0:GOVIDL_未使用  1:GOVIDL_使用" UBYTE COMP_0283 1 100 0 1 BIT_MASK 0x0001 ECU_ADDRESS 0xFFFF1C10 READ_WRITE /end MEASUREMENT
/begin MEASUREMENT afINJ2ON "0:２段噴射不許可  1:2段噴射許可" UBYTE COMP_0283 1 100 0 1 BIT_MASK 0x0080 ECU_ADDRESS 0xFFFF1C11 READ_WRITE /end MEASUREMENT
/begin MEASUREMENT afISCADVH "0:なし  1:点火時期操作あり" UBYTE COMP_0283 1 100 0 1 BIT_MASK 0x0040 ECU_ADDRESS 0xFFFF1C11 READ_WRITE /end MEASUREMENT
/begin MEASUREMENT afISCADVL "0:なし  1:点火時期操作あり" UBYTE COMP_0283 1 100 0 1 BIT_MASK 0x0020 ECU_ADDRESS 0xFFFF1C11 READ_WRITE /end MEASUREMENT
/begin MEASUREMENT afKNSTDY "0:学習条件不成立  1:学習条件成立" UBYTE COMP_0283 1 100 0 1 BIT_MASK 0x0010 ECU_ADDRESS 0xFFFF1C11 READ_WRITE /end MEASUREMENT
/begin MEASUREMENT afNDSLCT "0:N-Dｾﾚｸﾄ以外  1:N-Dｾﾚｸﾄ中" UBYTE COMP_0283 1 100 0 1 BIT_MASK 0x0008 ECU_ADDRESS 0xFFFF1C11 READ_WRITE /end MEASUREMENT
/begin MEASUREMENT afOPNMOT "0:ﾓｰﾀ駆動回路ON  1:ﾓｰﾀ駆動回路OFF" UBYTE COMP_0283 1 100 0 1 BIT_MASK 0x0004 ECU_ADDRESS 0xFFFF1C11 READ_WRITE /end MEASUREMENT
/begin MEASUREMENT afPTDFAIL "0:正常  1:異常" UBYTE COMP_0283 1 100 0 1 BIT_MASK 0x0002 ECU_ADDRESS 0xFFFF1C11 READ_WRITE /end MEASUREMENT
/begin MEASUREMENT afPTDON "0:駆動力制御行わない  1:駆動力制御行う" UBYTE COMP_0283 1 100 0 1 BIT_MASK 0x0001 ECU_ADDRESS 0xFFFF1C11 READ_WRITE /end MEASUREMENT
/begin MEASUREMENT afRLYON "0:リレーOFF要求  1:リレーＯＮ要求" UBYTE COMP_0283 1 100 0 1 BIT_MASK 0x0080 ECU_ADDRESS 0xFFFF1C12 READ_WRITE /end MEASUREMENT
/begin MEASUREMENT afRQ_ENBR "0:補正非要求  1:補正要求" UBYTE COMP_0283 1 100 0 1 BIT_MASK 0x0040 ECU_ADDRESS 0xFFFF1C12 READ_WRITE /end MEASUREMENT
/begin MEASUREMENT afRTOHOLD "0:ﾚｼｵﾎｰﾙﾄﾞ制御終了  1:ﾚｼｵﾎｰﾙﾄﾞ制御開始" UBYTE COMP_0283 1 100 0 1 BIT_MASK 0x0020 ECU_ADDRESS 0xFFFF1C12 READ_WRITE /end MEASUREMENT
/begin MEASUREMENT afSFTREQEM "0:排気変速線要求無し  1:排気変速線要求有り" UBYTE COMP_0283 1 100 0 1 BIT_MASK 0x0010 ECU_ADDRESS 0xFFFF1C12 READ_WRITE /end MEASUREMENT
/begin MEASUREMENT afSNOWMODE "0:非_SNOW_MODE  1:SNOW_MODE" UBYTE COMP_0283 1 100 0 1 BIT_MASK 0x0008 ECU_ADDRESS 0xFFFF1C12 READ_WRITE /end MEASUREMENT
/begin MEASUREMENT afSTSW1 "0:スタータSW_OFF  1:スタータSW_ON" UBYTE COMP_0283 1 100 0 1 BIT_MASK 0x0004 ECU_ADDRESS 0xFFFF1C12 READ_WRITE /end MEASUREMENT
/begin MEASUREMENT afTMISTY "0:始動時ISC補正ﾃﾞｨﾚｲ経過前  1:始動時ISC補正ﾃﾞｨﾚｲ経過後" UBYTE COMP_0283 1 100 0 1 BIT_MASK 0x0002 ECU_ADDRESS 0xFFFF1C12 READ_WRITE /end MEASUREMENT
/begin MEASUREMENT afTPS1SEL "0:正常  1:異常" UBYTE COMP_0283 1 100 0 1 BIT_MASK 0x0001 ECU_ADDRESS 0xFFFF1C12 READ_WRITE /end MEASUREMENT
/begin MEASUREMENT afTPS2SEL "0:正常  1:異常" UBYTE COMP_0283 1 100 0 1 BIT_MASK 0x0080 ECU_ADDRESS 0xFFFF1C13 READ_WRITE /end MEASUREMENT
/begin MEASUREMENT afTPSSNG "0:不成立  1:成立" UBYTE COMP_0283 1 100 0 1 BIT_MASK 0x0040 ECU_ADDRESS 0xFFFF1C13 READ_WRITE /end MEASUREMENT
/begin MEASUREMENT afTRCCTRLN "0:Nレンジトルクｺﾝﾄﾛｰﾙ無し  1:Nレンジトルクｺﾝﾄﾛｰﾙ有り" UBYTE COMP_0283 1 100 0 1 BIT_MASK 0x0020 ECU_ADDRESS 0xFFFF1C13 READ_WRITE /end MEASUREMENT
/begin MEASUREMENT afVCLEAN "0:クリーニングモード制御不許可  1:クリーニングモード制御許可" UBYTE COMP_0283 1 100 0 1 BIT_MASK 0x0010 ECU_ADDRESS 0xFFFF1C13 READ_WRITE /end MEASUREMENT
/begin MEASUREMENT afVCLEANE "0:クリーニングモード制御不許可  1:クリーニングモード制御許可" UBYTE COMP_0283 1 100 0 1 BIT_MASK 0x0008 ECU_ADDRESS 0xFFFF1C13 READ_WRITE /end MEASUREMENT
/begin MEASUREMENT afVCSHOT "0:クリーニングモード要求不許可  1:クリーニングモード要求許可" UBYTE COMP_0283 1 100 0 1 BIT_MASK 0x0004 ECU_ADDRESS 0xFFFF1C13 READ_WRITE /end MEASUREMENT
/begin MEASUREMENT afVCSHOTE "0:クリーニングモード要求不許可  1:クリーニングモード要求許可" UBYTE COMP_0283 1 100 0 1 BIT_MASK 0x0002 ECU_ADDRESS 0xFFFF1C13 READ_WRITE /end MEASUREMENT
/begin MEASUREMENT afVPRFC "0:右記以外  1:成層始動用VEL待機燃料カット" UBYTE COMP_0283 1 100 0 1 BIT_MASK 0x0001 ECU_ADDRESS 0xFFFF1C13 READ_WRITE /end MEASUREMENT
/begin MEASUREMENT afWGCSOL "0:OFF  1:ON" UBYTE COMP_0283 1 100 0 1 BIT_MASK 0x0080 ECU_ADDRESS 0xFFFF1C14 READ_WRITE /end MEASUREMENT
/begin MEASUREMENT wfBOOST "0:－  1:－" UBYTE COMP_0283 1 100 0 1 BIT_MASK 0x0080 ECU_ADDRESS 0xFFFF3BE4 READ_WRITE /end MEASUREMENT
/begin MEASUREMENT wfBRKSW "0:OFF  1:ON" UBYTE COMP_0283 1 100 0 1 BIT_MASK 0x0040 ECU_ADDRESS 0xFFFF3BE4 READ_WRITE /end MEASUREMENT
/begin MEASUREMENT wfCLCHSW "0:CLUTCH_OFF  1:CLUTCH_ON" UBYTE COMP_0283 1 100 0 1 BIT_MASK 0x0020 ECU_ADDRESS 0xFFFF3BE4 READ_WRITE /end MEASUREMENT
/begin MEASUREMENT wfD2SUMCL "0:要求無し  1:要求有り" UBYTE COMP_0283 1 100 0 1 BIT_MASK 0x0010 ECU_ADDRESS 0xFFFF3BE4 READ_WRITE /end MEASUREMENT
/begin MEASUREMENT wfDI "0:調整モード識別SW_OFF  1:調整モード識別SW_ON" UBYTE COMP_0283 1 100 0 1 BIT_MASK 0x0008 ECU_ADDRESS 0xFFFF3BE4 READ_WRITE /end MEASUREMENT
/begin MEASUREMENT wfDSPDSINV "0:車速Invalid以外  1:車速Invalid" UBYTE COMP_0283 1 100 0 1 BIT_MASK 0x0004 ECU_ADDRESS 0xFFFF3BE4 READ_WRITE /end MEASUREMENT
/begin MEASUREMENT wfESPRQCDN "0:正常  1:異常" UBYTE COMP_0283 1 100 0 1 BIT_MASK 0x0002 ECU_ADDRESS 0xFFFF3BE4 READ_WRITE /end MEASUREMENT
/begin MEASUREMENT wfIDLEPR "0:ASCD処理前IDLE非判定中  1:ASCD処理前IDLE判定中" UBYTE COMP_0283 1 100 0 1 BIT_MASK 0x0001 ECU_ADDRESS 0xFFFF3BE4 READ_WRITE /end MEASUREMENT
/begin MEASUREMENT wfNIDLED "0:非Nｱｲﾄﾞﾙ制御中  1:Nｱｲﾄﾞﾙ制御中" UBYTE COMP_0283 1 100 0 1 BIT_MASK 0x0080 ECU_ADDRESS 0xFFFF3BE5 READ_WRITE /end MEASUREMENT
/begin MEASUREMENT wfPWST "0:P/S_SW_OFF  1:P/S_SW_ON" UBYTE COMP_0283 1 100 0 1 BIT_MASK 0x0040 ECU_ADDRESS 0xFFFF3BE5 READ_WRITE /end MEASUREMENT
/begin MEASUREMENT wfRSTREQ "0:ｽﾀｰﾀﾓｰﾀ駆動要求しない  1:ｽﾀｰﾀﾓｰﾀ駆動要求する" UBYTE COMP_0283 1 100 0 1 BIT_MASK 0x0020 ECU_ADDRESS 0xFFFF3BE5 READ_WRITE /end MEASUREMENT
/begin MEASUREMENT wfSSOFF "0:セルフシャットオフ判定未成立  1:セルフシャットオフ判定成立" UBYTE COMP_0283 1 100 0 1 BIT_MASK 0x0010 ECU_ADDRESS 0xFFFF3BE5 READ_WRITE /end MEASUREMENT
/begin MEASUREMENT wfSTPTN "0:不成立  1:成立" UBYTE COMP_0283 1 100 0 1 BIT_MASK 0x0008 ECU_ADDRESS 0xFFFF3BE5 READ_WRITE /end MEASUREMENT
/begin MEASUREMENT fBOOST "0:－  1:－" UBYTE COMP_0283 1 100 0 1 BIT_MASK 0x0080 ECU_ADDRESS 0xFFFF3BE6 READ_WRITE /end MEASUREMENT
/begin MEASUREMENT fBRKSW "0:OFF  1:ON" UBYTE COMP_0283 1 100 0 1 BIT_MASK 0x0040 ECU_ADDRESS 0xFFFF3BE6 READ_WRITE /end MEASUREMENT
/begin MEASUREMENT fCLCHSW "0:CLUTCH_OFF  1:CLUTCH_ON" UBYTE COMP_0283 1 100 0 1 BIT_MASK 0x0020 ECU_ADDRESS 0xFFFF3BE6 READ_WRITE /end MEASUREMENT
/begin MEASUREMENT fD2SUMCL "0:要求無し  1:要求有り" UBYTE COMP_0283 1 100 0 1 BIT_MASK 0x0010 ECU_ADDRESS 0xFFFF3BE6 READ_WRITE /end MEASUREMENT
/begin MEASUREMENT fDI "0:調整モード識別SW_OFF  1:調整モード識別SW_ON" UBYTE COMP_0283 1 100 0 1 BIT_MASK 0x0008 ECU_ADDRESS 0xFFFF3BE6 READ_WRITE /end MEASUREMENT
/begin MEASUREMENT fDSPDSINV "0:車速Invalid以外  1:車速Invalid" UBYTE COMP_0283 1 100 0 1 BIT_MASK 0x0004 ECU_ADDRESS 0xFFFF3BE6 READ_WRITE /end MEASUREMENT
/begin MEASUREMENT fESPRQCDN "0:正常  1:異常" UBYTE COMP_0283 1 100 0 1 BIT_MASK 0x0002 ECU_ADDRESS 0xFFFF3BE6 READ_WRITE /end MEASUREMENT
/begin MEASUREMENT fIDLEPR "0:ASCD処理前IDLE非判定中  1:ASCD処理前IDLE判定中" UBYTE COMP_0283 1 100 0 1 BIT_MASK 0x0001 ECU_ADDRESS 0xFFFF3BE6 READ_WRITE /end MEASUREMENT
/begin MEASUREMENT fNIDLED "0:非Nｱｲﾄﾞﾙ制御中  1:Nｱｲﾄﾞﾙ制御中" UBYTE COMP_0283 1 100 0 1 BIT_MASK 0x0080 ECU_ADDRESS 0xFFFF3BE7 READ_WRITE /end MEASUREMENT
/begin MEASUREMENT fPWST "0:－  1:－" UBYTE COMP_0283 1 100 0 1 BIT_MASK 0x0040 ECU_ADDRESS 0xFFFF3BE7 READ_WRITE /end MEASUREMENT
/begin MEASUREMENT fRSTREQ "0:ｽﾀｰﾀﾓｰﾀ駆動要求しない  1:ｽﾀｰﾀﾓｰﾀ駆動要求する" UBYTE COMP_0283 1 100 0 1 BIT_MASK 0x0020 ECU_ADDRESS 0xFFFF3BE7 READ_WRITE /end MEASUREMENT
/begin MEASUREMENT fSSOFF "0:セルフシャットオフ判定未成立  1:セルフシャットオフ判定成立" UBYTE COMP_0283 1 100 0 1 BIT_MASK 0x0010 ECU_ADDRESS 0xFFFF3BE7 READ_WRITE /end MEASUREMENT
/begin MEASUREMENT fSTPTN "0:不成立  1:成立" UBYTE COMP_0283 1 100 0 1 BIT_MASK 0x0008 ECU_ADDRESS 0xFFFF3BE7 READ_WRITE /end MEASUREMENT
/begin MEASUREMENT fBASPCV "0:基準圧BASPCVを更新していない  1:基準圧BASPCVを更新した" UBYTE COMP_0283 1 100 0 1 BIT_MASK 0x0080 ECU_ADDRESS 0xFFFF5620 READ_WRITE /end MEASUREMENT
/begin MEASUREMENT fBASPCVST "0:基準圧BASPCVを更新していない  1:基準圧BASPCVを更新した" UBYTE COMP_0283 1 100 0 1 BIT_MASK 0x0040 ECU_ADDRESS 0xFFFF5620 READ_WRITE /end MEASUREMENT
/begin MEASUREMENT fCVTCE "0:経験未  1:経験済" UBYTE COMP_0283 1 100 0 1 BIT_MASK 0x0020 ECU_ADDRESS 0xFFFF5620 READ_WRITE /end MEASUREMENT
/begin MEASUREMENT fCVTCE1 "0:未終了  1:終了" UBYTE COMP_0283 1 100 0 1 BIT_MASK 0x0010 ECU_ADDRESS 0xFFFF5620 READ_WRITE /end MEASUREMENT
/begin MEASUREMENT fCVTCE2 "0:未終了  1:終了" UBYTE COMP_0283 1 100 0 1 BIT_MASK 0x0008 ECU_ADDRESS 0xFFFF5620 READ_WRITE /end MEASUREMENT
/begin MEASUREMENT fCVTCI "0:経験未  1:経験済" UBYTE COMP_0283 1 100 0 1 BIT_MASK 0x0004 ECU_ADDRESS 0xFFFF5620 READ_WRITE /end MEASUREMENT
/begin MEASUREMENT fCVTCI1 "0:未終了  1:終了" UBYTE COMP_0283 1 100 0 1 BIT_MASK 0x0002 ECU_ADDRESS 0xFFFF5620 READ_WRITE /end MEASUREMENT
/begin MEASUREMENT fCVTCVE1 "0:未終了  1:終了" UBYTE COMP_0283 1 100 0 1 BIT_MASK 0x0001 ECU_ADDRESS 0xFFFF5620 READ_WRITE /end MEASUREMENT
/begin MEASUREMENT fCVTCVE2 "0:未終了  1:終了" UBYTE COMP_0283 1 100 0 1 BIT_MASK 0x0080 ECU_ADDRESS 0xFFFF5621 READ_WRITE /end MEASUREMENT
/begin MEASUREMENT fCVTCVI1 "0:未終了  1:終了" UBYTE COMP_0283 1 100 0 1 BIT_MASK 0x0040 ECU_ADDRESS 0xFFFF5621 READ_WRITE /end MEASUREMENT
/begin MEASUREMENT fCVTCVI2 "0:未終了  1:終了" UBYTE COMP_0283 1 100 0 1 BIT_MASK 0x0020 ECU_ADDRESS 0xFFFF5621 READ_WRITE /end MEASUREMENT
/begin MEASUREMENT fEEPWRITE "0:学習処理実行中でない  1:学習処理実行中" UBYTE COMP_0283 1 100 0 1 BIT_MASK 0x0010 ECU_ADDRESS 0xFFFF5621 READ_WRITE /end MEASUREMENT
/begin MEASUREMENT fEMPTY "0:右記以外  1:EMPTY" UBYTE COMP_0283 1 100 0 1 BIT_MASK 0x0008 ECU_ADDRESS 0xFFFF5621 READ_WRITE /end MEASUREMENT
/begin MEASUREMENT fENTMBUOK "0:条件不成立  1:条件成立" UBYTE COMP_0283 1 100 0 1 BIT_MASK 0x0004 ECU_ADDRESS 0xFFFF5621 READ_WRITE /end MEASUREMENT
/begin MEASUREMENT fEVGEMIL "0:初回  1:初回以降" UBYTE COMP_0283 1 100 0 1 BIT_MASK 0x0002 ECU_ADDRESS 0xFFFF5621 READ_WRITE /end MEASUREMENT
/begin MEASUREMENT fEVGENGBU "0:初回  1:初回以降" UBYTE COMP_0283 1 100 0 1 BIT_MASK 0x0001 ECU_ADDRESS 0xFFFF5621 READ_WRITE /end MEASUREMENT
/begin MEASUREMENT fEWTEND "0:右記以外  1:EEPROM書き込み終了" UBYTE COMP_0283 1 100 0 1 BIT_MASK 0x0080 ECU_ADDRESS 0xFFFF5622 READ_WRITE /end MEASUREMENT
/begin MEASUREMENT fFAAREA "0:記憶なし  1:記憶あり" UBYTE COMP_0283 1 100 0 1 BIT_MASK 0x0040 ECU_ADDRESS 0xFFFF5622 READ_WRITE /end MEASUREMENT
/begin MEASUREMENT fFACTAS "0:未経験  1:経験済み" UBYTE COMP_0283 1 100 0 1 BIT_MASK 0x0020 ECU_ADDRESS 0xFFFF5622 READ_WRITE /end MEASUREMENT
/begin MEASUREMENT fFBAREA "0:記憶なし  1:記憶あり" UBYTE COMP_0283 1 100 0 1 BIT_MASK 0x0010 ECU_ADDRESS 0xFFFF5622 READ_WRITE /end MEASUREMENT
/begin MEASUREMENT fFCAREA "0:記憶なし  1:記憶あり" UBYTE COMP_0283 1 100 0 1 BIT_MASK 0x0008 ECU_ADDRESS 0xFFFF5622 READ_WRITE /end MEASUREMENT
/begin MEASUREMENT fFEGRE "0:経験未  1:経験済" UBYTE COMP_0283 1 100 0 1 BIT_MASK 0x0004 ECU_ADDRESS 0xFFFF5622 READ_WRITE /end MEASUREMENT
/begin MEASUREMENT fFLGCHOI "0:チョイ掛けが発生した  1:チョイ掛けが発生していない" UBYTE COMP_0283 1 100 0 1 BIT_MASK 0x0002 ECU_ADDRESS 0xFFFF5622 READ_WRITE /end MEASUREMENT
/begin MEASUREMENT fFNGBUA "0:1st_TRIP_NG記憶なし  1:1st_TRIP_NG記憶あり" UBYTE COMP_0283 1 100 0 1 BIT_MASK 0x0001 ECU_ADDRESS 0xFFFF5622 READ_WRITE /end MEASUREMENT
/begin MEASUREMENT fFNGBUB "0:1st_TRIP_NG記憶なし  1:1st_TRIP_NG記憶あり" UBYTE COMP_0283 1 100 0 1 BIT_MASK 0x0080 ECU_ADDRESS 0xFFFF5623 READ_WRITE /end MEASUREMENT
/begin MEASUREMENT fFNGBUC "0:1st_TRIP_NG記憶なし  1:1st_TRIP_NG記憶あり" UBYTE COMP_0283 1 100 0 1 BIT_MASK 0x0040 ECU_ADDRESS 0xFFFF5623 READ_WRITE /end MEASUREMENT
/begin COMPU_METHOD COMP_0283 "1flag" RAT_FUNC "%8.2" "flag" COEFFS 0 1 0 0 0 1 /end COMPU_METHOD
/end MODULE
/end PROJECT
