/begin PROJECT X12C_KH3DT_DI_NAM_R/C ""
/begin HEADER "" /* key HEADER ++ "comment" に Par.scomment */ PROJECT_NO X12C_KH3DT_DI_NAM_R/C /* key PROJECT_NO ++ project number に car_eng_desti_lot */ VERSION "0KHDCFDZ7" /* key VERSION ++ version number に mProgver */ /end HEADER
/begin MODULE DIM ""
/begin MOD_COMMON "" ALIGNMENT_BYTE 1 ALIGNMENT_WORD 2 ALIGNMENT_LONG 4 ALIGNMENT_FLOAT32_IEEE 4 ALIGNMENT_FLOAT64_IEEE 4 DEPOSIT ABSOLUTE BYTE_ORDER MSB_FIRST /* ﾊﾞｲﾄｵｰﾀﾞｰがﾘﾌﾟﾚｰｽされる */ /end MOD_COMMON
/begin CHARACTERISTIC mfCVCUNG "0:Not DGN  1:DGN" VALUE 0x000162C9 REC_UBYTE_C 0 COMP_0283 0 1 BIT_MASK 0x0010 /end CHARACTERISTIC
/begin CHARACTERISTIC mfQHAPNG "0:Not DGN  1:DGN" VALUE 0x000162C9 REC_UBYTE_C 0 COMP_0283 0 1 BIT_MASK 0x0008 /end CHARACTERISTIC
/begin CHARACTERISTIC mfTEPDNG "0:Not DGN  1:DGN" VALUE 0x000162C9 REC_UBYTE_C 0 COMP_0283 0 1 BIT_MASK 0x0004 /end CHARACTERISTIC
/begin CHARACTERISTIC mfTATENG "0:Not DGN  1:DGN" VALUE 0x000162C9 REC_UBYTE_C 0 COMP_0283 0 1 BIT_MASK 0x0002 /end CHARACTERISTIC
/begin CHARACTERISTIC mfTTEPNG "0:Not DGN  1:DGN" VALUE 0x000162C9 REC_UBYTE_C 0 COMP_0283 0 1 BIT_MASK 0x0001 /end CHARACTERISTIC
/begin CHARACTERISTIC mDGNSW[34] "Flag mDGNSW[34]" VALUE 0x000162CA REC_UBYTE_C 0 COMP_0283 0 255 /end CHARACTERISTIC
/begin CHARACTERISTIC mfRLONNG "0:Not DGN  1:DGN" VALUE 0x000162CA REC_UBYTE_C 0 COMP_0283 0 1 BIT_MASK 0x0080 /end CHARACTERISTIC
/begin CHARACTERISTIC mfRLOFNG "0:Not DGN  1:DGN" VALUE 0x000162CA REC_UBYTE_C 0 COMP_0283 0 1 BIT_MASK 0x0040 /end CHARACTERISTIC
/begin CHARACTERISTIC mfDTSPNG "0:Not DGN  1:DGN" VALUE 0x000162CA REC_UBYTE_C 0 COMP_0283 0 1 BIT_MASK 0x0020 /end CHARACTERISTIC
/begin CHARACTERISTIC mfSFSGNG "0:Not DGN  1:DGN" VALUE 0x000162CA REC_UBYTE_C 0 COMP_0283 0 1 BIT_MASK 0x0010 /end CHARACTERISTIC
/begin CHARACTERISTIC mfCRNTNG "0:Not DGN  1:DGN" VALUE 0x000162CA REC_UBYTE_C 0 COMP_0283 0 1 BIT_MASK 0x0008 /end CHARACTERISTIC
/begin CHARACTERISTIC mfVSPRNG "0:Not DGN  1:DGN" VALUE 0x000162CA REC_UBYTE_C 0 COMP_0283 0 1 BIT_MASK 0x0004 /end CHARACTERISTIC
/begin CHARACTERISTIC mfIREVNG "0:Not DGN  1:DGN" VALUE 0x000162CA REC_UBYTE_C 0 COMP_0283 0 1 BIT_MASK 0x0002 /end CHARACTERISTIC
/begin CHARACTERISTIC mfPTDNNG "0:Not DGN  1:DGN" VALUE 0x000162CA REC_UBYTE_C 0 COMP_0283 0 1 BIT_MASK 0x0001 /end CHARACTERISTIC
/begin CHARACTERISTIC mDGNSW[35] "Flag mDGNSW[35]" VALUE 0x000162CB REC_UBYTE_C 0 COMP_0283 0 255 /end CHARACTERISTIC
/begin CHARACTERISTIC mfIDONNG "0:Not DGN  1:DGN" VALUE 0x000162CB REC_UBYTE_C 0 COMP_0283 0 1 BIT_MASK 0x0080 /end CHARACTERISTIC
/begin CHARACTERISTIC mfIDOFNG "0:Not DGN  1:DGN" VALUE 0x000162CB REC_UBYTE_C 0 COMP_0283 0 1 BIT_MASK 0x0040 /end CHARACTERISTIC
/begin CHARACTERISTIC mfBSOFNG "0:Not DGN  1:DGN" VALUE 0x000162CB REC_UBYTE_C 0 COMP_0283 0 1 BIT_MASK 0x0020 /end CHARACTERISTIC
/begin CHARACTERISTIC mfREVUNG "0:Not DGN  1:DGN" VALUE 0x000162CB REC_UBYTE_C 0 COMP_0283 0 1 BIT_MASK 0x0010 /end CHARACTERISTIC
/begin CHARACTERISTIC mfMAPSNG "0:Not DGN  1:DGN" VALUE 0x000162CB REC_UBYTE_C 0 COMP_0283 0 1 BIT_MASK 0x0008 /end CHARACTERISTIC
/begin CHARACTERISTIC mfMVPSNG "0:Not DGN  1:DGN" VALUE 0x000162CB REC_UBYTE_C 0 COMP_0283 0 1 BIT_MASK 0x0004 /end CHARACTERISTIC
/begin CHARACTERISTIC mfWLPNG1 "0:Not DGN  1:DGN" VALUE 0x000162CB REC_UBYTE_C 0 COMP_0283 0 1 BIT_MASK 0x0002 /end CHARACTERISTIC
/begin CHARACTERISTIC mfWLPNG2 "0:Not DGN  1:DGN" VALUE 0x000162CB REC_UBYTE_C 0 COMP_0283 0 1 BIT_MASK 0x0001 /end CHARACTERISTIC
/begin CHARACTERISTIC mDGNSW[36] "Flag mDGNSW[36]" VALUE 0x000162CC REC_UBYTE_C 0 COMP_0283 0 255 /end CHARACTERISTIC
/begin CHARACTERISTIC mfRTSPNG "0:Not DGN  1:DGN" VALUE 0x000162CC REC_UBYTE_C 0 COMP_0283 0 1 BIT_MASK 0x0080 /end CHARACTERISTIC
/begin CHARACTERISTIC mfDFLTNG "0:Not DGN  1:DGN" VALUE 0x000162CC REC_UBYTE_C 0 COMP_0283 0 1 BIT_MASK 0x0040 /end CHARACTERISTIC
/begin CHARACTERISTIC mfTHOPNG "0:Not DGN  1:DGN" VALUE 0x000162CC REC_UBYTE_C 0 COMP_0283 0 1 BIT_MASK 0x0020 /end CHARACTERISTIC
/begin CHARACTERISTIC mfBURNG "0:Not DGN  1:DGN" VALUE 0x000162CC REC_UBYTE_C 0 COMP_0283 0 1 BIT_MASK 0x0010 /end CHARACTERISTIC
/begin CHARACTERISTIC mfBURNGS "0:Not DGN  1:DGN" VALUE 0x000162CC REC_UBYTE_C 0 COMP_0283 0 1 BIT_MASK 0x0008 /end CHARACTERISTIC
/begin CHARACTERISTIC mfSSOFNG "0:Not DGN  1:DGN" VALUE 0x000162CC REC_UBYTE_C 0 COMP_0283 0 1 BIT_MASK 0x0004 /end CHARACTERISTIC
/begin CHARACTERISTIC mfTSKNGM "0:Not DGN  1:DGN" VALUE 0x000162CC REC_UBYTE_C 0 COMP_0283 0 1 BIT_MASK 0x0002 /end CHARACTERISTIC
/begin CHARACTERISTIC mfTSKNGS "0:Not DGN  1:DGN" VALUE 0x000162CC REC_UBYTE_C 0 COMP_0283 0 1 BIT_MASK 0x0001 /end CHARACTERISTIC
/begin CHARACTERISTIC mDGNSW[37] "Flag mDGNSW[37]" VALUE 0x000162CD REC_UBYTE_C 0 COMP_0283 0 255 /end CHARACTERISTIC
/begin CHARACTERISTIC mfROMNGM "0:Not DGN  1:DGN" VALUE 0x000162CD REC_UBYTE_C 0 COMP_0283 0 1 BIT_MASK 0x0080 /end CHARACTERISTIC
/begin CHARACTERISTIC mfRAMNGM "0:Not DGN  1:DGN" VALUE 0x000162CD REC_UBYTE_C 0 COMP_0283 0 1 BIT_MASK 0x0040 /end CHARACTERISTIC
/begin CHARACTERISTIC mfFPUNG "0:Not DGN  1:DGN" VALUE 0x000162CD REC_UBYTE_C 0 COMP_0283 0 1 BIT_MASK 0x0020 /end CHARACTERISTIC
/begin CHARACTERISTIC mfRANGS2 "0:Not DGN  1:DGN" VALUE 0x000162CD REC_UBYTE_C 0 COMP_0283 0 1 BIT_MASK 0x0010 /end CHARACTERISTIC
/begin CHARACTERISTIC mfWDTNGM "0:Not DGN  1:DGN" VALUE 0x000162CD REC_UBYTE_C 0 COMP_0283 0 1 BIT_MASK 0x0008 /end CHARACTERISTIC
/begin CHARACTERISTIC mfTIMNGM "0:Not DGN  1:DGN" VALUE 0x000162CD REC_UBYTE_C 0 COMP_0283 0 1 BIT_MASK 0x0004 /end CHARACTERISTIC
/begin CHARACTERISTIC mfEPWNGM "0:Not DGN  1:DGN" VALUE 0x000162CD REC_UBYTE_C 0 COMP_0283 0 1 BIT_MASK 0x0002 /end CHARACTERISTIC
/begin CHARACTERISTIC mfEPRNGM "0:Not DGN  1:DGN" VALUE 0x000162CD REC_UBYTE_C 0 COMP_0283 0 1 BIT_MASK 0x0001 /end CHARACTERISTIC
/begin CHARACTERISTIC mDGNSW[38] "Flag mDGNSW[38]" VALUE 0x000162CE REC_UBYTE_C 0 COMP_0283 0 255 /end CHARACTERISTIC
/begin CHARACTERISTIC mfROMNGS "0:Not DGN  1:DGN" VALUE 0x000162CE REC_UBYTE_C 0 COMP_0283 0 1 BIT_MASK 0x0080 /end CHARACTERISTIC
/begin CHARACTERISTIC mfRAMNGS "0:Not DGN  1:DGN" VALUE 0x000162CE REC_UBYTE_C 0 COMP_0283 0 1 BIT_MASK 0x0040 /end CHARACTERISTIC
/begin CHARACTERISTIC mfRANGM2 "0:Not DGN  1:DGN" VALUE 0x000162CE REC_UBYTE_C 0 COMP_0283 0 1 BIT_MASK 0x0010 /end CHARACTERISTIC
/begin CHARACTERISTIC mfWDTNGS "0:Not DGN  1:DGN" VALUE 0x000162CE REC_UBYTE_C 0 COMP_0283 0 1 BIT_MASK 0x0008 /end CHARACTERISTIC
/begin CHARACTERISTIC mfEPWNGS "0:Not DGN  1:DGN" VALUE 0x000162CE REC_UBYTE_C 0 COMP_0283 0 1 BIT_MASK 0x0002 /end CHARACTERISTIC
/begin CHARACTERISTIC mfEPRNGS "0:Not DGN  1:DGN" VALUE 0x000162CE REC_UBYTE_C 0 COMP_0283 0 1 BIT_MASK 0x0001 /end CHARACTERISTIC
/begin CHARACTERISTIC mDGNSW[39] "Flag mDGNSW[39]" VALUE 0x000162CF REC_UBYTE_C 0 COMP_0283 0 255 /end CHARACTERISTIC
/begin CHARACTERISTIC mfVTCSB1 "0:Not DGN  1:DGN" VALUE 0x000162CF REC_UBYTE_C 0 COMP_0283 0 1 BIT_MASK 0x0080 /end CHARACTERISTIC
/begin CHARACTERISTIC mfVTCSB2 "0:Not DGN  1:DGN" VALUE 0x000162CF REC_UBYTE_C 0 COMP_0283 0 1 BIT_MASK 0x0040 /end CHARACTERISTIC
/begin CHARACTERISTIC mfVTCSN1 "0:Not DGN  1:DGN" VALUE 0x000162CF REC_UBYTE_C 0 COMP_0283 0 1 BIT_MASK 0x0020 /end CHARACTERISTIC
/begin CHARACTERISTIC mfVTCSN2 "0:Not DGN  1:DGN" VALUE 0x000162CF REC_UBYTE_C 0 COMP_0283 0 1 BIT_MASK 0x0010 /end CHARACTERISTIC
/begin CHARACTERISTIC mfVTCOF1 "0:Not DGN  1:DGN" VALUE 0x000162CF REC_UBYTE_C 0 COMP_0283 0 1 BIT_MASK 0x0008 /end CHARACTERISTIC
/begin CHARACTERISTIC mfVTCOF2 "0:Not DGN  1:DGN" VALUE 0x000162CF REC_UBYTE_C 0 COMP_0283 0 1 BIT_MASK 0x0004 /end CHARACTERISTIC
/begin CHARACTERISTIC mfVTCDR1 "0:Not DGN  1:DGN" VALUE 0x000162CF REC_UBYTE_C 0 COMP_0283 0 1 BIT_MASK 0x0002 /end CHARACTERISTIC
/begin CHARACTERISTIC mfVTCDR2 "0:Not DGN  1:DGN" VALUE 0x000162CF REC_UBYTE_C 0 COMP_0283 0 1 BIT_MASK 0x0001 /end CHARACTERISTIC
/begin CHARACTERISTIC mDGNSW[40] "Flag mDGNSW[40]" VALUE 0x000162D0 REC_UBYTE_C 0 COMP_0283 0 255 /end CHARACTERISTIC
/begin CHARACTERISTIC mfASJBNG "0:Not DGN  1:DGN" VALUE 0x000162D0 REC_UBYTE_C 0 COMP_0283 0 1 BIT_MASK 0x0080 /end CHARACTERISTIC
/begin CHARACTERISTIC mfASFXNG "0:Not DGN  1:DGN" VALUE 0x000162D0 REC_UBYTE_C 0 COMP_0283 0 1 BIT_MASK 0x0040 /end CHARACTERISTIC
/begin CHARACTERISTIC mfASSWNG "0:Not DGN  1:DGN" VALUE 0x000162D0 REC_UBYTE_C 0 COMP_0283 0 1 BIT_MASK 0x0020 /end CHARACTERISTIC
/begin CHARACTERISTIC mfASBSNG "0:Not DGN  1:DGN" VALUE 0x000162D0 REC_UBYTE_C 0 COMP_0283 0 1 BIT_MASK 0x0010 /end CHARACTERISTIC
/begin CHARACTERISTIC mfASVSNG "0:Not DGN  1:DGN" VALUE 0x000162D0 REC_UBYTE_C 0 COMP_0283 0 1 BIT_MASK 0x0008 /end CHARACTERISTIC
/begin CHARACTERISTIC mfACCCNG "0:Not DGN  1:DGN" VALUE 0x000162D0 REC_UBYTE_C 0 COMP_0283 0 1 BIT_MASK 0x0004 /end CHARACTERISTIC
/begin CHARACTERISTIC mfBNCPNG "0:Not DGN  1:DGN" VALUE 0x000162D0 REC_UBYTE_C 0 COMP_0283 0 1 BIT_MASK 0x0002 /end CHARACTERISTIC
/begin CHARACTERISTIC mfACCNNG "0:Not DGN  1:DGN" VALUE 0x000162D0 REC_UBYTE_C 0 COMP_0283 0 1 BIT_MASK 0x0001 /end CHARACTERISTIC
/begin CHARACTERISTIC mDGNSW[41] "Flag mDGNSW[41]" VALUE 0x000162D1 REC_UBYTE_C 0 COMP_0283 0 255 /end CHARACTERISTIC
/begin CHARACTERISTIC mfVTSBE1 "0:Not DGN  1:DGN" VALUE 0x000162D1 REC_UBYTE_C 0 COMP_0283 0 1 BIT_MASK 0x0080 /end CHARACTERISTIC
/begin CHARACTERISTIC mfVTSBE2 "0:Not DGN  1:DGN" VALUE 0x000162D1 REC_UBYTE_C 0 COMP_0283 0 1 BIT_MASK 0x0040 /end CHARACTERISTIC
/begin CHARACTERISTIC mfVTSNE1 "0:Not DGN  1:DGN" VALUE 0x000162D1 REC_UBYTE_C 0 COMP_0283 0 1 BIT_MASK 0x0020 /end CHARACTERISTIC
/begin CHARACTERISTIC mfVTSNE2 "0:Not DGN  1:DGN" VALUE 0x000162D1 REC_UBYTE_C 0 COMP_0283 0 1 BIT_MASK 0x0010 /end CHARACTERISTIC
/begin CHARACTERISTIC mfVTOFE1 "0:Not DGN  1:DGN" VALUE 0x000162D1 REC_UBYTE_C 0 COMP_0283 0 1 BIT_MASK 0x0008 /end CHARACTERISTIC
/begin CHARACTERISTIC mfVTOFE2 "0:Not DGN  1:DGN" VALUE 0x000162D1 REC_UBYTE_C 0 COMP_0283 0 1 BIT_MASK 0x0004 /end CHARACTERISTIC
/begin CHARACTERISTIC mfVTDRE1 "0:Not DGN  1:DGN" VALUE 0x000162D1 REC_UBYTE_C 0 COMP_0283 0 1 BIT_MASK 0x0002 /end CHARACTERISTIC
/begin CHARACTERISTIC mfVTDRE2 "0:Not DGN  1:DGN" VALUE 0x000162D1 REC_UBYTE_C 0 COMP_0283 0 1 BIT_MASK 0x0001 /end CHARACTERISTIC
/begin CHARACTERISTIC mDGNSW[42] "Flag mDGNSW[42]" VALUE 0x000162D2 REC_UBYTE_C 0 COMP_0283 0 255 /end CHARACTERISTIC
/begin CHARACTERISTIC mfVTCPO1 "0:Not DGN  1:DGN" VALUE 0x000162D2 REC_UBYTE_C 0 COMP_0283 0 1 BIT_MASK 0x0080 /end CHARACTERISTIC
/begin CHARACTERISTIC mfVTCPO2 "0:Not DGN  1:DGN" VALUE 0x000162D2 REC_UBYTE_C 0 COMP_0283 0 1 BIT_MASK 0x0040 /end CHARACTERISTIC
/begin CHARACTERISTIC mfVTPOE1 "0:Not DGN  1:DGN" VALUE 0x000162D2 REC_UBYTE_C 0 COMP_0283 0 1 BIT_MASK 0x0020 /end CHARACTERISTIC
/begin CHARACTERISTIC mfVTPOE2 "0:Not DGN  1:DGN" VALUE 0x000162D2 REC_UBYTE_C 0 COMP_0283 0 1 BIT_MASK 0x0010 /end CHARACTERISTIC
/begin CHARACTERISTIC mfDC21NG "0:Not DGN  1:DGN" VALUE 0x000162D2 REC_UBYTE_C 0 COMP_0283 0 1 BIT_MASK 0x0004 /end CHARACTERISTIC
/begin CHARACTERISTIC mfDC22NG "0:Not DGN  1:DGN" VALUE 0x000162D2 REC_UBYTE_C 0 COMP_0283 0 1 BIT_MASK 0x0002 /end CHARACTERISTIC
/begin CHARACTERISTIC mfDC23NG "0:Not DGN  1:DGN" VALUE 0x000162D2 REC_UBYTE_C 0 COMP_0283 0 1 BIT_MASK 0x0001 /end CHARACTERISTIC
/begin CHARACTERISTIC mDGNSW[43] "Flag mDGNSW[43]" VALUE 0x000162D3 REC_UBYTE_C 0 COMP_0283 0 255 /end CHARACTERISTIC
/begin CHARACTERISTIC mfAFLNG1 "0:Not DGN  1:DGN" VALUE 0x000162D3 REC_UBYTE_C 0 COMP_0283 0 1 BIT_MASK 0x0080 /end CHARACTERISTIC
/begin CHARACTERISTIC mfAFLNG2 "0:Not DGN  1:DGN" VALUE 0x000162D3 REC_UBYTE_C 0 COMP_0283 0 1 BIT_MASK 0x0040 /end CHARACTERISTIC
/begin CHARACTERISTIC mfAFLLS "0:Not DGN  1:DGN" VALUE 0x000162D3 REC_UBYTE_C 0 COMP_0283 0 1 BIT_MASK 0x0020 /end CHARACTERISTIC
/begin CHARACTERISTIC mfAFLRS "0:Not DGN  1:DGN" VALUE 0x000162D3 REC_UBYTE_C 0 COMP_0283 0 1 BIT_MASK 0x0010 /end CHARACTERISTIC
/begin CHARACTERISTIC mfAFLHZ "0:Not DGN  1:DGN" VALUE 0x000162D3 REC_UBYTE_C 0 COMP_0283 0 1 BIT_MASK 0x0008 /end CHARACTERISTIC
/begin CHARACTERISTIC mfAFLAV "0:Not DGN  1:DGN" VALUE 0x000162D3 REC_UBYTE_C 0 COMP_0283 0 1 BIT_MASK 0x0004 /end CHARACTERISTIC
/begin CHARACTERISTIC mfAFHF1 "0:Not DGN  1:DGN" VALUE 0x000162D3 REC_UBYTE_C 0 COMP_0283 0 1 BIT_MASK 0x0002 /end CHARACTERISTIC
/begin CHARACTERISTIC mDGNSW[44] "Flag mDGNSW[44]" VALUE 0x000162D4 REC_UBYTE_C 0 COMP_0283 0 255 /end CHARACTERISTIC
/begin CHARACTERISTIC mfAFRNG1 "0:Not DGN  1:DGN" VALUE 0x000162D4 REC_UBYTE_C 0 COMP_0283 0 1 BIT_MASK 0x0080 /end CHARACTERISTIC
/begin CHARACTERISTIC mfAFRNG2 "0:Not DGN  1:DGN" VALUE 0x000162D4 REC_UBYTE_C 0 COMP_0283 0 1 BIT_MASK 0x0040 /end CHARACTERISTIC
/begin CHARACTERISTIC mfAFRLS "0:Not DGN  1:DGN" VALUE 0x000162D4 REC_UBYTE_C 0 COMP_0283 0 1 BIT_MASK 0x0020 /end CHARACTERISTIC
/begin CHARACTERISTIC mfAFRRS "0:Not DGN  1:DGN" VALUE 0x000162D4 REC_UBYTE_C 0 COMP_0283 0 1 BIT_MASK 0x0010 /end CHARACTERISTIC
/begin CHARACTERISTIC mfAFRHZ "0:Not DGN  1:DGN" VALUE 0x000162D4 REC_UBYTE_C 0 COMP_0283 0 1 BIT_MASK 0x0008 /end CHARACTERISTIC
/begin CHARACTERISTIC mfAFRAV "0:Not DGN  1:DGN" VALUE 0x000162D4 REC_UBYTE_C 0 COMP_0283 0 1 BIT_MASK 0x0004 /end CHARACTERISTIC
/begin CHARACTERISTIC mfAFHF2 "0:Not DGN  1:DGN" VALUE 0x000162D4 REC_UBYTE_C 0 COMP_0283 0 1 BIT_MASK 0x0002 /end CHARACTERISTIC
/begin CHARACTERISTIC mDGNSW[45] "Flag mDGNSW[45]" VALUE 0x000162D5 REC_UBYTE_C 0 COMP_0283 0 255 /end CHARACTERISTIC
/begin CHARACTERISTIC mfO2R3LO "0:Not DGN  1:DGN" VALUE 0x000162D5 REC_UBYTE_C 0 COMP_0283 0 1 BIT_MASK 0x0080 /end CHARACTERISTIC
/begin CHARACTERISTIC mfO2R3RO "0:Not DGN  1:DGN" VALUE 0x000162D5 REC_UBYTE_C 0 COMP_0283 0 1 BIT_MASK 0x0040 /end CHARACTERISTIC
/begin CHARACTERISTIC mfO2R3NG "0:Not DGN  1:DGN" VALUE 0x000162D5 REC_UBYTE_C 0 COMP_0283 0 1 BIT_MASK 0x0020 /end CHARACTERISTIC
/begin CHARACTERISTIC mfO2R3AV "0:Not DGN  1:DGN" VALUE 0x000162D5 REC_UBYTE_C 0 COMP_0283 0 1 BIT_MASK 0x0010 /end CHARACTERISTIC
/begin CHARACTERISTIC mfTO2HL1 "0:Not DGN  1:DGN" VALUE 0x000162D5 REC_UBYTE_C 0 COMP_0283 0 1 BIT_MASK 0x0004 /end CHARACTERISTIC
/begin CHARACTERISTIC mfTO2HH1 "0:Not DGN  1:DGN" VALUE 0x000162D5 REC_UBYTE_C 0 COMP_0283 0 1 BIT_MASK 0x0002 /end CHARACTERISTIC
/begin CHARACTERISTIC mDGNSW[46] "Flag mDGNSW[46]" VALUE 0x000162D6 REC_UBYTE_C 0 COMP_0283 0 255 /end CHARACTERISTIC
/begin CHARACTERISTIC mfTUBSNG "0:Not DGN  1:DGN" VALUE 0x000162D6 REC_UBYTE_C 0 COMP_0283 0 1 BIT_MASK 0x0080 /end CHARACTERISTIC
/begin CHARACTERISTIC mfINLCNG "0:Not DGN  1:DGN" VALUE 0x000162D6 REC_UBYTE_C 0 COMP_0283 0 1 BIT_MASK 0x0040 /end CHARACTERISTIC
/begin CHARACTERISTIC mfHLRFNG "0:Not DGN  1:DGN" VALUE 0x000162D6 REC_UBYTE_C 0 COMP_0283 0 1 BIT_MASK 0x0020 /end CHARACTERISTIC
/begin CHARACTERISTIC mfHLRSNG "0:Not DGN  1:DGN" VALUE 0x000162D6 REC_UBYTE_C 0 COMP_0283 0 1 BIT_MASK 0x0010 /end CHARACTERISTIC
/begin CHARACTERISTIC mfDCFNG "0:Not DGN  1:DGN" VALUE 0x000162D6 REC_UBYTE_C 0 COMP_0283 0 1 BIT_MASK 0x0008 /end CHARACTERISTIC
/begin CHARACTERISTIC mfDCSDN "0:Not DGN  1:DGN" VALUE 0x000162D6 REC_UBYTE_C 0 COMP_0283 0 1 BIT_MASK 0x0004 /end CHARACTERISTIC
/begin CHARACTERISTIC mfFRBFNG "0:Not DGN  1:DGN" VALUE 0x000162D6 REC_UBYTE_C 0 COMP_0283 0 1 BIT_MASK 0x0002 /end CHARACTERISTIC
/begin CHARACTERISTIC mfFRBSNG "0:Not DGN  1:DGN" VALUE 0x000162D6 REC_UBYTE_C 0 COMP_0283 0 1 BIT_MASK 0x0001 /end CHARACTERISTIC
/begin CHARACTERISTIC mDGNSW[47] "Flag mDGNSW[47]" VALUE 0x000162D7 REC_UBYTE_C 0 COMP_0283 0 255 /end CHARACTERISTIC
/begin CHARACTERISTIC mfICFNG "0:Not DGN  1:DGN" VALUE 0x000162D7 REC_UBYTE_C 0 COMP_0283 0 1 BIT_MASK 0x0080 /end CHARACTERISTIC
/begin CHARACTERISTIC mfICSNG "0:Not DGN  1:DGN" VALUE 0x000162D7 REC_UBYTE_C 0 COMP_0283 0 1 BIT_MASK 0x0040 /end CHARACTERISTIC
/begin CHARACTERISTIC mfLCBFNG "0:Not DGN  1:DGN" VALUE 0x000162D7 REC_UBYTE_C 0 COMP_0283 0 1 BIT_MASK 0x0020 /end CHARACTERISTIC
/begin CHARACTERISTIC mfLCBSNG "0:Not DGN  1:DGN" VALUE 0x000162D7 REC_UBYTE_C 0 COMP_0283 0 1 BIT_MASK 0x0010 /end CHARACTERISTIC
/begin CHARACTERISTIC mfTCNTNG "0:Not DGN  1:DGN" VALUE 0x000162D7 REC_UBYTE_C 0 COMP_0283 0 1 BIT_MASK 0x0008 /end CHARACTERISTIC
/begin CHARACTERISTIC mfMAFMAP "0:Not DGN  1:DGN" VALUE 0x000162D7 REC_UBYTE_C 0 COMP_0283 0 1 BIT_MASK 0x0004 /end CHARACTERISTIC
/begin CHARACTERISTIC mfMAPNGR "0:Not DGN  1:DGN" VALUE 0x000162D7 REC_UBYTE_C 0 COMP_0283 0 1 BIT_MASK 0x0002 /end CHARACTERISTIC
/begin CHARACTERISTIC mfTFBNG2 "0:Not DGN  1:DGN" VALUE 0x000162D7 REC_UBYTE_C 0 COMP_0283 0 1 BIT_MASK 0x0001 /end CHARACTERISTIC
/begin CHARACTERISTIC mDGNSW[48] "Flag mDGNSW[48]" VALUE 0x000162D8 REC_UBYTE_C 0 COMP_0283 0 255 /end CHARACTERISTIC
/begin CHARACTERISTIC mfO2F1O "0:Not DGN  1:DGN" VALUE 0x000162D8 REC_UBYTE_C 0 COMP_0283 0 1 BIT_MASK 0x0080 /end CHARACTERISTIC
/begin CHARACTERISTIC mfO2F2O "0:Not DGN  1:DGN" VALUE 0x000162D8 REC_UBYTE_C 0 COMP_0283 0 1 BIT_MASK 0x0040 /end CHARACTERISTIC
/begin CHARACTERISTIC mfO2F1L "0:Not DGN  1:DGN" VALUE 0x000162D8 REC_UBYTE_C 0 COMP_0283 0 1 BIT_MASK 0x0020 /end CHARACTERISTIC
/begin CHARACTERISTIC mfO2F2L "0:Not DGN  1:DGN" VALUE 0x000162D8 REC_UBYTE_C 0 COMP_0283 0 1 BIT_MASK 0x0010 /end CHARACTERISTIC
/begin CHARACTERISTIC mfO2F1R "0:Not DGN  1:DGN" VALUE 0x000162D8 REC_UBYTE_C 0 COMP_0283 0 1 BIT_MASK 0x0008 /end CHARACTERISTIC
/begin CHARACTERISTIC mfO2F2R "0:Not DGN  1:DGN" VALUE 0x000162D8 REC_UBYTE_C 0 COMP_0283 0 1 BIT_MASK 0x0004 /end CHARACTERISTIC
/begin CHARACTERISTIC mfO2F1D "0:Not DGN  1:DGN" VALUE 0x000162D8 REC_UBYTE_C 0 COMP_0283 0 1 BIT_MASK 0x0002 /end CHARACTERISTIC
/begin CHARACTERISTIC mfO2F2D "0:Not DGN  1:DGN" VALUE 0x000162D8 REC_UBYTE_C 0 COMP_0283 0 1 BIT_MASK 0x0001 /end CHARACTERISTIC
/begin CHARACTERISTIC mDGNSW[49] "Flag mDGNSW[49]" VALUE 0x000162D9 REC_UBYTE_C 0 COMP_0283 0 255 /end CHARACTERISTIC
/begin CHARACTERISTIC mfO2F1H "0:Not DGN  1:DGN" VALUE 0x000162D9 REC_UBYTE_C 0 COMP_0283 0 1 BIT_MASK 0x0080 /end CHARACTERISTIC
/begin CHARACTERISTIC mfO2F2H "0:Not DGN  1:DGN" VALUE 0x000162D9 REC_UBYTE_C 0 COMP_0283 0 1 BIT_MASK 0x0040 /end CHARACTERISTIC
/begin CHARACTERISTIC mfFO2HH1 "0:Not DGN  1:DGN" VALUE 0x000162D9 REC_UBYTE_C 0 COMP_0283 0 1 BIT_MASK 0x0020 /end CHARACTERISTIC
/begin CHARACTERISTIC mfFO2HH2 "0:Not DGN  1:DGN" VALUE 0x000162D9 REC_UBYTE_C 0 COMP_0283 0 1 BIT_MASK 0x0010 /end CHARACTERISTIC
/begin CHARACTERISTIC mfFO2HL1 "0:Not DGN  1:DGN" VALUE 0x000162D9 REC_UBYTE_C 0 COMP_0283 0 1 BIT_MASK 0x0008 /end CHARACTERISTIC
/begin CHARACTERISTIC mfFO2HL2 "0:Not DGN  1:DGN" VALUE 0x000162D9 REC_UBYTE_C 0 COMP_0283 0 1 BIT_MASK 0x0004 /end CHARACTERISTIC
/begin CHARACTERISTIC mfISCNGL "0:Not DGN  1:DGN" VALUE 0x000162D9 REC_UBYTE_C 0 COMP_0283 0 1 BIT_MASK 0x0002 /end CHARACTERISTIC
/begin CHARACTERISTIC mfISCNGH "0:Not DGN  1:DGN" VALUE 0x000162D9 REC_UBYTE_C 0 COMP_0283 0 1 BIT_MASK 0x0001 /end CHARACTERISTIC
/begin CHARACTERISTIC mDGNSW[50] "Flag mDGNSW[50]" VALUE 0x000162DA REC_UBYTE_C 0 COMP_0283 0 255 /end CHARACTERISTIC
/begin CHARACTERISTIC mfO2R1O "0:Not DGN  1:DGN" VALUE 0x000162DA REC_UBYTE_C 0 COMP_0283 0 1 BIT_MASK 0x0080 /end CHARACTERISTIC
/begin CHARACTERISTIC mfO2R2O "0:Not DGN  1:DGN" VALUE 0x000162DA REC_UBYTE_C 0 COMP_0283 0 1 BIT_MASK 0x0040 /end CHARACTERISTIC
/begin CHARACTERISTIC mfO2R1L "0:Not DGN  1:DGN" VALUE 0x000162DA REC_UBYTE_C 0 COMP_0283 0 1 BIT_MASK 0x0020 /end CHARACTERISTIC
/begin CHARACTERISTIC mfO2R2L "0:Not DGN  1:DGN" VALUE 0x000162DA REC_UBYTE_C 0 COMP_0283 0 1 BIT_MASK 0x0010 /end CHARACTERISTIC
/begin CHARACTERISTIC mfO2R1R "0:Not DGN  1:DGN" VALUE 0x000162DA REC_UBYTE_C 0 COMP_0283 0 1 BIT_MASK 0x0008 /end CHARACTERISTIC
/begin CHARACTERISTIC mfO2R2R "0:Not DGN  1:DGN" VALUE 0x000162DA REC_UBYTE_C 0 COMP_0283 0 1 BIT_MASK 0x0004 /end CHARACTERISTIC
/begin CHARACTERISTIC mfO2R1H "0:Not DGN  1:DGN" VALUE 0x000162DA REC_UBYTE_C 0 COMP_0283 0 1 BIT_MASK 0x0002 /end CHARACTERISTIC
/begin CHARACTERISTIC mfO2R2H "0:Not DGN  1:DGN" VALUE 0x000162DA REC_UBYTE_C 0 COMP_0283 0 1 BIT_MASK 0x0001 /end CHARACTERISTIC
/begin CHARACTERISTIC mDGNSW[51] "Flag mDGNSW[51]" VALUE 0x000162DB REC_UBYTE_C 0 COMP_0283 0 255 /end CHARACTERISTIC
/begin CHARACTERISTIC mfRO2HH1 "0:Not DGN  1:DGN" VALUE 0x000162DB REC_UBYTE_C 0 COMP_0283 0 1 BIT_MASK 0x0080 /end CHARACTERISTIC
/begin CHARACTERISTIC mfRO2HH2 "0:Not DGN  1:DGN" VALUE 0x000162DB REC_UBYTE_C 0 COMP_0283 0 1 BIT_MASK 0x0040 /end CHARACTERISTIC
/begin CHARACTERISTIC mfRO2HL1 "0:Not DGN  1:DGN" VALUE 0x000162DB REC_UBYTE_C 0 COMP_0283 0 1 BIT_MASK 0x0020 /end CHARACTERISTIC
/begin CHARACTERISTIC mfRO2HL2 "0:Not DGN  1:DGN" VALUE 0x000162DB REC_UBYTE_C 0 COMP_0283 0 1 BIT_MASK 0x0010 /end CHARACTERISTIC
/begin CHARACTERISTIC mfKN1NGL "0:Not DGN  1:DGN" VALUE 0x000162DB REC_UBYTE_C 0 COMP_0283 0 1 BIT_MASK 0x0008 /end CHARACTERISTIC
/begin CHARACTERISTIC mfKN1NGH "0:Not DGN  1:DGN" VALUE 0x000162DB REC_UBYTE_C 0 COMP_0283 0 1 BIT_MASK 0x0004 /end CHARACTERISTIC
/begin CHARACTERISTIC mfKN2NGL "0:Not DGN  1:DGN" VALUE 0x000162DB REC_UBYTE_C 0 COMP_0283 0 1 BIT_MASK 0x0002 /end CHARACTERISTIC
/begin CHARACTERISTIC mfKN2NGH "0:Not DGN  1:DGN" VALUE 0x000162DB REC_UBYTE_C 0 COMP_0283 0 1 BIT_MASK 0x0001 /end CHARACTERISTIC
/begin CHARACTERISTIC mDGNSW[52] "Flag mDGNSW[52]" VALUE 0x000162DC REC_UBYTE_C 0 COMP_0283 0 255 /end CHARACTERISTIC
/begin CHARACTERISTIC mfTHSNGR "0:Not DGN  1:DGN" VALUE 0x000162DC REC_UBYTE_C 0 COMP_0283 0 1 BIT_MASK 0x0080 /end CHARACTERISTIC
/begin CHARACTERISTIC mfTHSNGL "0:Not DGN  1:DGN" VALUE 0x000162DC REC_UBYTE_C 0 COMP_0283 0 1 BIT_MASK 0x0040 /end CHARACTERISTIC
/begin CHARACTERISTIC mfTHSNGH "0:Not DGN  1:DGN" VALUE 0x000162DC REC_UBYTE_C 0 COMP_0283 0 1 BIT_MASK 0x0020 /end CHARACTERISTIC
/begin CHARACTERISTIC mfAFMNGR "0:Not DGN  1:DGN" VALUE 0x000162DC REC_UBYTE_C 0 COMP_0283 0 1 BIT_MASK 0x0010 /end CHARACTERISTIC
/begin CHARACTERISTIC mfAFMNGL "0:Not DGN  1:DGN" VALUE 0x000162DC REC_UBYTE_C 0 COMP_0283 0 1 BIT_MASK 0x0008 /end CHARACTERISTIC
/begin CHARACTERISTIC mfAFMNGH "0:Not DGN  1:DGN" VALUE 0x000162DC REC_UBYTE_C 0 COMP_0283 0 1 BIT_MASK 0x0004 /end CHARACTERISTIC
/begin CHARACTERISTIC mfAFMNGM "0:Not DGN  1:DGN" VALUE 0x000162DC REC_UBYTE_C 0 COMP_0283 0 1 BIT_MASK 0x0002 /end CHARACTERISTIC
/begin CHARACTERISTIC mfIGNGR "0:Not DGN  1:DGN" VALUE 0x000162DC REC_UBYTE_C 0 COMP_0283 0 1 BIT_MASK 0x0001 /end CHARACTERISTIC
/begin CHARACTERISTIC mDGNSW[53] "Flag mDGNSW[53]" VALUE 0x000162DD REC_UBYTE_C 0 COMP_0283 0 255 /end CHARACTERISTIC
/begin CHARACTERISTIC mfTWNGL "0:Not DGN  1:DGN" VALUE 0x000162DD REC_UBYTE_C 0 COMP_0283 0 1 BIT_MASK 0x0080 /end CHARACTERISTIC
/begin CHARACTERISTIC mfTWNGH "0:Not DGN  1:DGN" VALUE 0x000162DD REC_UBYTE_C 0 COMP_0283 0 1 BIT_MASK 0x0040 /end CHARACTERISTIC
/begin CHARACTERISTIC mfEGSNGL "0:Not DGN  1:DGN" VALUE 0x000162DD REC_UBYTE_C 0 COMP_0283 0 1 BIT_MASK 0x0020 /end CHARACTERISTIC
/begin CHARACTERISTIC mfEGSNGH "0:Not DGN  1:DGN" VALUE 0x000162DD REC_UBYTE_C 0 COMP_0283 0 1 BIT_MASK 0x0010 /end CHARACTERISTIC
/begin CHARACTERISTIC mfTANGL "0:Not DGN  1:DGN" VALUE 0x000162DD REC_UBYTE_C 0 COMP_0283 0 1 BIT_MASK 0x0008 /end CHARACTERISTIC
/begin CHARACTERISTIC mfTANGH "0:Not DGN  1:DGN" VALUE 0x000162DD REC_UBYTE_C 0 COMP_0283 0 1 BIT_MASK 0x0004 /end CHARACTERISTIC
/begin CHARACTERISTIC mfTANGR "0:Not DGN  1:DGN" VALUE 0x000162DD REC_UBYTE_C 0 COMP_0283 0 1 BIT_MASK 0x0002 /end CHARACTERISTIC
/begin CHARACTERISTIC mfEVSNGR "0:Not DGN  1:DGN" VALUE 0x000162DD REC_UBYTE_C 0 COMP_0283 0 1 BIT_MASK 0x0001 /end CHARACTERISTIC
/begin CHARACTERISTIC mDGNSW[54] "Flag mDGNSW[54]" VALUE 0x000162DE REC_UBYTE_C 0 COMP_0283 0 255 /end CHARACTERISTIC
/begin CHARACTERISTIC mfTFNGR "0:Not DGN  1:DGN" VALUE 0x000162DE REC_UBYTE_C 0 COMP_0283 0 1 BIT_MASK 0x0080 /end CHARACTERISTIC
/begin CHARACTERISTIC mfTFNGL "0:Not DGN  1:DGN" VALUE 0x000162DE REC_UBYTE_C 0 COMP_0283 0 1 BIT_MASK 0x0040 /end CHARACTERISTIC
/begin CHARACTERISTIC mfTFNGH "0:Not DGN  1:DGN" VALUE 0x000162DE REC_UBYTE_C 0 COMP_0283 0 1 BIT_MASK 0x0020 /end CHARACTERISTIC
/begin CHARACTERISTIC mfFGPNGL "0:Not DGN  1:DGN" VALUE 0x000162DE REC_UBYTE_C 0 COMP_0283 0 1 BIT_MASK 0x0010 /end CHARACTERISTIC
/begin CHARACTERISTIC mfFGPNGH "0:Not DGN  1:DGN" VALUE 0x000162DE REC_UBYTE_C 0 COMP_0283 0 1 BIT_MASK 0x0008 /end CHARACTERISTIC
/begin CHARACTERISTIC mfEVCNGO "0:Not DGN  1:DGN" VALUE 0x000162DE REC_UBYTE_C 0 COMP_0283 0 1 BIT_MASK 0x0004 /end CHARACTERISTIC
/begin CHARACTERISTIC mfEVCNGS "0:Not DGN  1:DGN" VALUE 0x000162DE REC_UBYTE_C 0 COMP_0283 0 1 BIT_MASK 0x0002 /end CHARACTERISTIC
/begin CHARACTERISTIC mfTHMNGR "0:Not DGN  1:DGN" VALUE 0x000162DE REC_UBYTE_C 0 COMP_0283 0 1 BIT_MASK 0x0001 /end CHARACTERISTIC
/begin CHARACTERISTIC mDGNSW[55] "Flag mDGNSW[55]" VALUE 0x000162DF REC_UBYTE_C 0 COMP_0283 0 255 /end CHARACTERISTIC
/begin CHARACTERISTIC mfMRNR "0:Not DGN  1:DGN" VALUE 0x000162DF REC_UBYTE_C 0 COMP_0283 0 1 BIT_MASK 0x0080 /end CHARACTERISTIC
/begin CHARACTERISTIC mfMRNL "0:Not DGN  1:DGN" VALUE 0x000162DF REC_UBYTE_C 0 COMP_0283 0 1 BIT_MASK 0x0040 /end CHARACTERISTIC
/begin CHARACTERISTIC mfMRNR2 "0:Not DGN  1:DGN" VALUE 0x000162DF REC_UBYTE_C 0 COMP_0283 0 1 BIT_MASK 0x0020 /end CHARACTERISTIC
/begin CHARACTERISTIC mfMRNL2 "0:Not DGN  1:DGN" VALUE 0x000162DF REC_UBYTE_C 0 COMP_0283 0 1 BIT_MASK 0x0010 /end CHARACTERISTIC
/begin CHARACTERISTIC mfVTCI1R "0:Not DGN  1:DGN" VALUE 0x000162DF REC_UBYTE_C 0 COMP_0283 0 1 BIT_MASK 0x0008 /end CHARACTERISTIC
/begin CHARACTERISTIC mfVTCI2R "0:Not DGN  1:DGN" VALUE 0x000162DF REC_UBYTE_C 0 COMP_0283 0 1 BIT_MASK 0x0004 /end CHARACTERISTIC
/begin CHARACTERISTIC mfVTCE1R "0:Not DGN  1:DGN" VALUE 0x000162DF REC_UBYTE_C 0 COMP_0283 0 1 BIT_MASK 0x0002 /end CHARACTERISTIC
/begin CHARACTERISTIC mfVTCE2R "0:Not DGN  1:DGN" VALUE 0x000162DF REC_UBYTE_C 0 COMP_0283 0 1 BIT_MASK 0x0001 /end CHARACTERISTIC
/begin CHARACTERISTIC mDGNSW[56] "Flag mDGNSW[56]" VALUE 0x000162E0 REC_UBYTE_C 0 COMP_0283 0 255 /end CHARACTERISTIC
/begin CHARACTERISTIC mfPRSNGR "0:Not DGN  1:DGN" VALUE 0x000162E0 REC_UBYTE_C 0 COMP_0283 0 1 BIT_MASK 0x0080 /end CHARACTERISTIC
/begin CHARACTERISTIC mfPRSNGL "0:Not DGN  1:DGN" VALUE 0x000162E0 REC_UBYTE_C 0 COMP_0283 0 1 BIT_MASK 0x0040 /end CHARACTERISTIC
/begin CHARACTERISTIC mfPRSNGH "0:Not DGN  1:DGN" VALUE 0x000162E0 REC_UBYTE_C 0 COMP_0283 0 1 BIT_MASK 0x0020 /end CHARACTERISTIC
/begin CHARACTERISTIC mfABCNG2 "0:Not DGN  1:DGN" VALUE 0x000162E0 REC_UBYTE_C 0 COMP_0283 0 1 BIT_MASK 0x0010 /end CHARACTERISTIC
/begin CHARACTERISTIC mfEPSNGL "0:Not DGN  1:DGN" VALUE 0x000162E0 REC_UBYTE_C 0 COMP_0283 0 1 BIT_MASK 0x0008 /end CHARACTERISTIC
/begin CHARACTERISTIC mfEPSNGH "0:Not DGN  1:DGN" VALUE 0x000162E0 REC_UBYTE_C 0 COMP_0283 0 1 BIT_MASK 0x0004 /end CHARACTERISTIC
/begin CHARACTERISTIC mfEVPFLW "0:Not DGN  1:DGN" VALUE 0x000162E0 REC_UBYTE_C 0 COMP_0283 0 1 BIT_MASK 0x0002 /end CHARACTERISTIC
/begin CHARACTERISTIC mfCDCNGC "0:Not DGN  1:DGN" VALUE 0x000162E0 REC_UBYTE_C 0 COMP_0283 0 1 BIT_MASK 0x0001 /end CHARACTERISTIC
/begin CHARACTERISTIC mDGNSW[57] "Flag mDGNSW[57]" VALUE 0x000162E1 REC_UBYTE_C 0 COMP_0283 0 255 /end CHARACTERISTIC
/begin CHARACTERISTIC mfEVPVSL "0:Not DGN  1:DGN" VALUE 0x000162E1 REC_UBYTE_C 0 COMP_0283 0 1 BIT_MASK 0x0080 /end CHARACTERISTIC
/begin CHARACTERISTIC mfEVVSLP "0:Not DGN  1:DGN" VALUE 0x000162E1 REC_UBYTE_C 0 COMP_0283 0 1 BIT_MASK 0x0040 /end CHARACTERISTIC
/begin CHARACTERISTIC mfEVPSL "0:Not DGN  1:DGN" VALUE 0x000162E1 REC_UBYTE_C 0 COMP_0283 0 1 BIT_MASK 0x0020 /end CHARACTERISTIC
/begin CHARACTERISTIC mfEVPSLP "0:Not DGN  1:DGN" VALUE 0x000162E1 REC_UBYTE_C 0 COMP_0283 0 1 BIT_MASK 0x0010 /end CHARACTERISTIC
/begin CHARACTERISTIC mfISCDN2 "0:Not DGN  1:DGN" VALUE 0x000162E1 REC_UBYTE_C 0 COMP_0283 0 1 BIT_MASK 0x0008 /end CHARACTERISTIC
/begin CHARACTERISTIC mfABCNG3 "0:Not DGN  1:DGN" VALUE 0x000162E1 REC_UBYTE_C 0 COMP_0283 0 1 BIT_MASK 0x0004 /end CHARACTERISTIC
/begin CHARACTERISTIC mfTONGL "0:Not DGN  1:DGN" VALUE 0x000162E1 REC_UBYTE_C 0 COMP_0283 0 1 BIT_MASK 0x0002 /end CHARACTERISTIC
/begin CHARACTERISTIC mfTONGH "0:Not DGN  1:DGN" VALUE 0x000162E1 REC_UBYTE_C 0 COMP_0283 0 1 BIT_MASK 0x0001 /end CHARACTERISTIC
/begin CHARACTERISTIC mDGNSW[58] "Flag mDGNSW[58]" VALUE 0x000162E2 REC_UBYTE_C 0 COMP_0283 0 255 /end CHARACTERISTIC
/begin CHARACTERISTIC mfAP1NGH "0:Not DGN  1:DGN" VALUE 0x000162E2 REC_UBYTE_C 0 COMP_0283 0 1 BIT_MASK 0x0080 /end CHARACTERISTIC
/begin CHARACTERISTIC mfAP1NGL "0:Not DGN  1:DGN" VALUE 0x000162E2 REC_UBYTE_C 0 COMP_0283 0 1 BIT_MASK 0x0040 /end CHARACTERISTIC
/begin CHARACTERISTIC mfAP2NGH "0:Not DGN  1:DGN" VALUE 0x000162E2 REC_UBYTE_C 0 COMP_0283 0 1 BIT_MASK 0x0020 /end CHARACTERISTIC
/begin CHARACTERISTIC mfAP2NGL "0:Not DGN  1:DGN" VALUE 0x000162E2 REC_UBYTE_C 0 COMP_0283 0 1 BIT_MASK 0x0010 /end CHARACTERISTIC
/begin CHARACTERISTIC mfAP12NG "0:Not DGN  1:DGN" VALUE 0x000162E2 REC_UBYTE_C 0 COMP_0283 0 1 BIT_MASK 0x0008 /end CHARACTERISTIC
/begin CHARACTERISTIC mfTORPNG "0:Not DGN  1:DGN" VALUE 0x000162E2 REC_UBYTE_C 0 COMP_0283 0 1 BIT_MASK 0x0004 /end CHARACTERISTIC
/begin CHARACTERISTIC mfEONVNG "0:Not DGN  1:DGN" VALUE 0x000162E2 REC_UBYTE_C 0 COMP_0283 0 1 BIT_MASK 0x0002 /end CHARACTERISTIC
/begin CHARACTERISTIC mfAVCCSH "0:Not DGN  1:DGN" VALUE 0x000162E2 REC_UBYTE_C 0 COMP_0283 0 1 BIT_MASK 0x0001 /end CHARACTERISTIC
/begin CHARACTERISTIC mDGNSW[59] "Flag mDGNSW[59]" VALUE 0x000162E3 REC_UBYTE_C 0 COMP_0283 0 255 /end CHARACTERISTIC
/begin CHARACTERISTIC mfTP1NGH "0:Not DGN  1:DGN" VALUE 0x000162E3 REC_UBYTE_C 0 COMP_0283 0 1 BIT_MASK 0x0080 /end CHARACTERISTIC
/begin CHARACTERISTIC mfTP1NGL "0:Not DGN  1:DGN" VALUE 0x000162E3 REC_UBYTE_C 0 COMP_0283 0 1 BIT_MASK 0x0040 /end CHARACTERISTIC
/begin CHARACTERISTIC mfTP2NGH "0:Not DGN  1:DGN" VALUE 0x000162E3 REC_UBYTE_C 0 COMP_0283 0 1 BIT_MASK 0x0020 /end CHARACTERISTIC
/begin CHARACTERISTIC mfTP2NGL "0:Not DGN  1:DGN" VALUE 0x000162E3 REC_UBYTE_C 0 COMP_0283 0 1 BIT_MASK 0x0010 /end CHARACTERISTIC
/begin CHARACTERISTIC mfTP12NG "0:Not DGN  1:DGN" VALUE 0x000162E3 REC_UBYTE_C 0 COMP_0283 0 1 BIT_MASK 0x0008 /end CHARACTERISTIC
/begin CHARACTERISTIC mfTPLRLO "0:Not DGN  1:DGN" VALUE 0x000162E3 REC_UBYTE_C 0 COMP_0283 0 1 BIT_MASK 0x0002 /end CHARACTERISTIC
/begin CHARACTERISTIC mfTPLRNO "0:Not DGN  1:DGN" VALUE 0x000162E3 REC_UBYTE_C 0 COMP_0283 0 1 BIT_MASK 0x0001 /end CHARACTERISTIC
/begin CHARACTERISTIC mDGNSW[60] "Flag mDGNSW[60]" VALUE 0x000162E4 REC_UBYTE_C 0 COMP_0283 0 255 /end CHARACTERISTIC
/begin CHARACTERISTIC mfVMOOPN "0:Not DGN  1:DGN" VALUE 0x000162E4 REC_UBYTE_C 0 COMP_0283 0 1 BIT_MASK 0x0080 /end CHARACTERISTIC
/begin CHARACTERISTIC mfVMOSHT "0:Not DGN  1:DGN" VALUE 0x000162E4 REC_UBYTE_C 0 COMP_0283 0 1 BIT_MASK 0x0040 /end CHARACTERISTIC
/begin CHARACTERISTIC mfMOTOPN "0:Not DGN  1:DGN" VALUE 0x000162E4 REC_UBYTE_C 0 COMP_0283 0 1 BIT_MASK 0x0020 /end CHARACTERISTIC
/begin CHARACTERISTIC mfMOTSHT "0:Not DGN  1:DGN" VALUE 0x000162E4 REC_UBYTE_C 0 COMP_0283 0 1 BIT_MASK 0x0010 /end CHARACTERISTIC
/begin CHARACTERISTIC mfGMOOPN "0:Not DGN  1:DGN" VALUE 0x000162E4 REC_UBYTE_C 0 COMP_0283 0 1 BIT_MASK 0x0008 /end CHARACTERISTIC
/begin CHARACTERISTIC mfVMOPN2 "0:Not DGN  1:DGN" VALUE 0x000162E4 REC_UBYTE_C 0 COMP_0283 0 1 BIT_MASK 0x0004 /end CHARACTERISTIC
/begin CHARACTERISTIC mfVMSHT2 "0:Not DGN  1:DGN" VALUE 0x000162E4 REC_UBYTE_C 0 COMP_0283 0 1 BIT_MASK 0x0002 /end CHARACTERISTIC
/begin CHARACTERISTIC mfMOSHT2 "0:Not DGN  1:DGN" VALUE 0x000162E4 REC_UBYTE_C 0 COMP_0283 0 1 BIT_MASK 0x0001 /end CHARACTERISTIC
/begin CHARACTERISTIC mDGNSW[61] "Flag mDGNSW[61]" VALUE 0x000162E5 REC_UBYTE_C 0 COMP_0283 0 255 /end CHARACTERISTIC
/begin CHARACTERISTIC mfAFLHZR "0:Not DGN  1:DGN" VALUE 0x000162E5 REC_UBYTE_C 0 COMP_0283 0 1 BIT_MASK 0x0080 /end CHARACTERISTIC
/begin CHARACTERISTIC mfAFLHZL "0:Not DGN  1:DGN" VALUE 0x000162E5 REC_UBYTE_C 0 COMP_0283 0 1 BIT_MASK 0x0040 /end CHARACTERISTIC
/begin CHARACTERISTIC mfAFRHZR "0:Not DGN  1:DGN" VALUE 0x000162E5 REC_UBYTE_C 0 COMP_0283 0 1 BIT_MASK 0x0020 /end CHARACTERISTIC
/begin CHARACTERISTIC mfAFRHZL "0:Not DGN  1:DGN" VALUE 0x000162E5 REC_UBYTE_C 0 COMP_0283 0 1 BIT_MASK 0x0010 /end CHARACTERISTIC
/begin CHARACTERISTIC mfAFHF1L "0:Not DGN  1:DGN" VALUE 0x000162E5 REC_UBYTE_C 0 COMP_0283 0 1 BIT_MASK 0x0008 /end CHARACTERISTIC
/begin CHARACTERISTIC mfAFHF1H "0:Not DGN  1:DGN" VALUE 0x000162E5 REC_UBYTE_C 0 COMP_0283 0 1 BIT_MASK 0x0004 /end CHARACTERISTIC
/begin CHARACTERISTIC mfAFHF2L "0:Not DGN  1:DGN" VALUE 0x000162E5 REC_UBYTE_C 0 COMP_0283 0 1 BIT_MASK 0x0002 /end CHARACTERISTIC
/begin CHARACTERISTIC mfAFHF2H "0:Not DGN  1:DGN" VALUE 0x000162E5 REC_UBYTE_C 0 COMP_0283 0 1 BIT_MASK 0x0001 /end CHARACTERISTIC
/begin CHARACTERISTIC mDGNSW[62] "Flag mDGNSW[62]" VALUE 0x000162E6 REC_UBYTE_C 0 COMP_0283 0 255 /end CHARACTERISTIC
/begin CHARACTERISTIC mfAFRLD1 "0:Not DGN  1:DGN" VALUE 0x000162E6 REC_UBYTE_C 0 COMP_0283 0 1 BIT_MASK 0x0080 /end CHARACTERISTIC
/begin CHARACTERISTIC mfAFLRD1 "0:Not DGN  1:DGN" VALUE 0x000162E6 REC_UBYTE_C 0 COMP_0283 0 1 BIT_MASK 0x0040 /end CHARACTERISTIC
/begin CHARACTERISTIC mfAFRLD2 "0:Not DGN  1:DGN" VALUE 0x000162E6 REC_UBYTE_C 0 COMP_0283 0 1 BIT_MASK 0x0020 /end CHARACTERISTIC
/begin CHARACTERISTIC mfAFLRD2 "0:Not DGN  1:DGN" VALUE 0x000162E6 REC_UBYTE_C 0 COMP_0283 0 1 BIT_MASK 0x0010 /end CHARACTERISTIC
/begin CHARACTERISTIC mfTLRLO2 "0:Not DGN  1:DGN" VALUE 0x000162E6 REC_UBYTE_C 0 COMP_0283 0 1 BIT_MASK 0x0008 /end CHARACTERISTIC
/begin CHARACTERISTIC mfTLRNO2 "0:Not DGN  1:DGN" VALUE 0x000162E6 REC_UBYTE_C 0 COMP_0283 0 1 BIT_MASK 0x0004 /end CHARACTERISTIC
/begin CHARACTERISTIC mfDJUANG "0:Not DGN  1:DGN" VALUE 0x000162E6 REC_UBYTE_C 0 COMP_0283 0 1 BIT_MASK 0x0002 /end CHARACTERISTIC
/begin CHARACTERISTIC mfDJNG2 "0:Not DGN  1:DGN" VALUE 0x000162E6 REC_UBYTE_C 0 COMP_0283 0 1 BIT_MASK 0x0001 /end CHARACTERISTIC
/begin CHARACTERISTIC mDGNSW[63] "Flag mDGNSW[63]" VALUE 0x000162E7 REC_UBYTE_C 0 COMP_0283 0 255 /end CHARACTERISTIC
/begin CHARACTERISTIC mfSFTCNG "0:Not DGN  1:DGN" VALUE 0x000162E7 REC_UBYTE_C 0 COMP_0283 0 1 BIT_MASK 0x0080 /end CHARACTERISTIC
/begin CHARACTERISTIC mfSFTDNG "0:Not DGN  1:DGN" VALUE 0x000162E7 REC_UBYTE_C 0 COMP_0283 0 1 BIT_MASK 0x0040 /end CHARACTERISTIC
/begin CHARACTERISTIC mfSFTENG "0:Not DGN  1:DGN" VALUE 0x000162E7 REC_UBYTE_C 0 COMP_0283 0 1 BIT_MASK 0x0020 /end CHARACTERISTIC
/begin CHARACTERISTIC mfRSLSNG "0:Not DGN  1:DGN" VALUE 0x000162E7 REC_UBYTE_C 0 COMP_0283 0 1 BIT_MASK 0x0010 /end CHARACTERISTIC
/begin CHARACTERISTIC mfRSLUNG "0:Not DGN  1:DGN" VALUE 0x000162E7 REC_UBYTE_C 0 COMP_0283 0 1 BIT_MASK 0x0008 /end CHARACTERISTIC
/begin CHARACTERISTIC mfATVPNG "0:Not DGN  1:DGN" VALUE 0x000162E7 REC_UBYTE_C 0 COMP_0283 0 1 BIT_MASK 0x0004 /end CHARACTERISTIC
/begin CHARACTERISTIC mfTURBNG "0:Not DGN  1:DGN" VALUE 0x000162E7 REC_UBYTE_C 0 COMP_0283 0 1 BIT_MASK 0x0002 /end CHARACTERISTIC
/begin CHARACTERISTIC mfSOTMPF "0:Not DGN  1:DGN" VALUE 0x000162E7 REC_UBYTE_C 0 COMP_0283 0 1 BIT_MASK 0x0001 /end CHARACTERISTIC
/begin CHARACTERISTIC mDGNSW[64] "Flag mDGNSW[64]" VALUE 0x000162E8 REC_UBYTE_C 0 COMP_0283 0 255 /end CHARACTERISTIC
/begin CHARACTERISTIC mfATPWNG "0:Not DGN  1:DGN" VALUE 0x000162E8 REC_UBYTE_C 0 COMP_0283 0 1 BIT_MASK 0x0080 /end CHARACTERISTIC
/begin CHARACTERISTIC mfPLSFNG "0:Not DGN  1:DGN" VALUE 0x000162E8 REC_UBYTE_C 0 COMP_0283 0 1 BIT_MASK 0x0040 /end CHARACTERISTIC
/begin CHARACTERISTIC mfSP5NG "0:Not DGN  1:DGN" VALUE 0x000162E8 REC_UBYTE_C 0 COMP_0283 0 1 BIT_MASK 0x0020 /end CHARACTERISTIC
/begin CHARACTERISTIC mfSPRNG "0:Not DGN  1:DGN" VALUE 0x000162E8 REC_UBYTE_C 0 COMP_0283 0 1 BIT_MASK 0x0010 /end CHARACTERISTIC
/begin CHARACTERISTIC mfSOLCNG "0:Not DGN  1:DGN" VALUE 0x000162E8 REC_UBYTE_C 0 COMP_0283 0 1 BIT_MASK 0x0008 /end CHARACTERISTIC
/begin CHARACTERISTIC mfSPERR "0:Not DGN  1:DGN" VALUE 0x000162E8 REC_UBYTE_C 0 COMP_0283 0 1 BIT_MASK 0x0004 /end CHARACTERISTIC
/begin CHARACTERISTIC mfECANNG "0:Not DGN  1:DGN" VALUE 0x000162E8 REC_UBYTE_C 0 COMP_0283 0 1 BIT_MASK 0x0002 /end CHARACTERISTIC
/begin CHARACTERISTIC mfSP6NG "0:Not DGN  1:DGN" VALUE 0x000162E8 REC_UBYTE_C 0 COMP_0283 0 1 BIT_MASK 0x0001 /end CHARACTERISTIC
/begin CHARACTERISTIC mDGNSW[65] "Flag mDGNSW[65]" VALUE 0x000162E9 REC_UBYTE_C 0 COMP_0283 0 255 /end CHARACTERISTIC
/begin CHARACTERISTIC mfT1NGH2 "0:Not DGN  1:DGN" VALUE 0x000162E9 REC_UBYTE_C 0 COMP_0283 0 1 BIT_MASK 0x0080 /end CHARACTERISTIC
/begin CHARACTERISTIC mfT1NGL2 "0:Not DGN  1:DGN" VALUE 0x000162E9 REC_UBYTE_C 0 COMP_0283 0 1 BIT_MASK 0x0040 /end CHARACTERISTIC
/begin CHARACTERISTIC mfT2NGH2 "0:Not DGN  1:DGN" VALUE 0x000162E9 REC_UBYTE_C 0 COMP_0283 0 1 BIT_MASK 0x0020 /end CHARACTERISTIC
/begin CHARACTERISTIC mfT2NGL2 "0:Not DGN  1:DGN" VALUE 0x000162E9 REC_UBYTE_C 0 COMP_0283 0 1 BIT_MASK 0x0010 /end CHARACTERISTIC
/begin CHARACTERISTIC mfT12NG2 "0:Not DGN  1:DGN" VALUE 0x000162E9 REC_UBYTE_C 0 COMP_0283 0 1 BIT_MASK 0x0008 /end CHARACTERISTIC
/begin CHARACTERISTIC mfSECPNG "0:Not DGN  1:DGN" VALUE 0x000162E9 REC_UBYTE_C 0 COMP_0283 0 1 BIT_MASK 0x0004 /end CHARACTERISTIC
/begin CHARACTERISTIC mfPRIPNG "0:Not DGN  1:DGN" VALUE 0x000162E9 REC_UBYTE_C 0 COMP_0283 0 1 BIT_MASK 0x0002 /end CHARACTERISTIC
/begin CHARACTERISTIC mfPSRANG "0:Not DGN  1:DGN" VALUE 0x000162E9 REC_UBYTE_C 0 COMP_0283 0 1 BIT_MASK 0x0001 /end CHARACTERISTIC
/begin CHARACTERISTIC mDGNSW[66] "Flag mDGNSW[66]" VALUE 0x000162EA REC_UBYTE_C 0 COMP_0283 0 255 /end CHARACTERISTIC
/begin CHARACTERISTIC mfBTSNGH "0:Not DGN  1:DGN" VALUE 0x000162EA REC_UBYTE_C 0 COMP_0283 0 1 BIT_MASK 0x0080 /end CHARACTERISTIC
/begin CHARACTERISTIC mfBTSNGL "0:Not DGN  1:DGN" VALUE 0x000162EA REC_UBYTE_C 0 COMP_0283 0 1 BIT_MASK 0x0040 /end CHARACTERISTIC
/begin CHARACTERISTIC mfALTCNG "0:Not DGN  1:DGN" VALUE 0x000162EA REC_UBYTE_C 0 COMP_0283 0 1 BIT_MASK 0x0020 /end CHARACTERISTIC
/begin CHARACTERISTIC mfBCSNG2 "0:Not DGN  1:DGN" VALUE 0x000162EA REC_UBYTE_C 0 COMP_0283 0 1 BIT_MASK 0x0010 /end CHARACTERISTIC
/begin CHARACTERISTIC mfBCSNG1 "0:Not DGN  1:DGN" VALUE 0x000162EA REC_UBYTE_C 0 COMP_0283 0 1 BIT_MASK 0x0008 /end CHARACTERISTIC
/begin CHARACTERISTIC mfBCSNGH "0:Not DGN  1:DGN" VALUE 0x000162EA REC_UBYTE_C 0 COMP_0283 0 1 BIT_MASK 0x0004 /end CHARACTERISTIC
/begin CHARACTERISTIC mfBCSNGL "0:Not DGN  1:DGN" VALUE 0x000162EA REC_UBYTE_C 0 COMP_0283 0 1 BIT_MASK 0x0002 /end CHARACTERISTIC
/begin CHARACTERISTIC mfBCSNGC "0:Not DGN  1:DGN" VALUE 0x000162EA REC_UBYTE_C 0 COMP_0283 0 1 BIT_MASK 0x0001 /end CHARACTERISTIC
/begin CHARACTERISTIC mDGNSW[67] "Flag mDGNSW[67]" VALUE 0x000162EB REC_UBYTE_C 0 COMP_0283 0 255 /end CHARACTERISTIC
/begin CHARACTERISTIC mfSTNG "0:Not DGN  1:DGN" VALUE 0x000162EB REC_UBYTE_C 0 COMP_0283 0 1 BIT_MASK 0x0080 /end CHARACTERISTIC
/begin CHARACTERISTIC mfTQNG "0:Not DGN  1:DGN" VALUE 0x000162EB REC_UBYTE_C 0 COMP_0283 0 1 BIT_MASK 0x0040 /end CHARACTERISTIC
/begin CHARACTERISTIC mfSTNGNF "0:Not DGN  1:DGN" VALUE 0x000162EB REC_UBYTE_C 0 COMP_0283 0 1 BIT_MASK 0x0020 /end CHARACTERISTIC
/begin CHARACTERISTIC mfTQNGNF "0:Not DGN  1:DGN" VALUE 0x000162EB REC_UBYTE_C 0 COMP_0283 0 1 BIT_MASK 0x0010 /end CHARACTERISTIC
/begin CHARACTERISTIC mfHVSYS "0:Not DGN  1:DGN" VALUE 0x000162EB REC_UBYTE_C 0 COMP_0283 0 1 BIT_MASK 0x0008 /end CHARACTERISTIC
/begin CHARACTERISTIC mfEVSNGE "0:Not DGN  1:DGN" VALUE 0x000162EB REC_UBYTE_C 0 COMP_0283 0 1 BIT_MASK 0x0004 /end CHARACTERISTIC
/begin CHARACTERISTIC mfCNFNG2 "0:Not DGN  1:DGN" VALUE 0x000162EB REC_UBYTE_C 0 COMP_0283 0 1 BIT_MASK 0x0002 /end CHARACTERISTIC
/begin CHARACTERISTIC mfCANFNG "0:Not DGN  1:DGN" VALUE 0x000162EB REC_UBYTE_C 0 COMP_0283 0 1 BIT_MASK 0x0001 /end CHARACTERISTIC
/begin CHARACTERISTIC mDGNSW[68] "Flag mDGNSW[68]" VALUE 0x000162EC REC_UBYTE_C 0 COMP_0283 0 255 /end CHARACTERISTIC
/begin CHARACTERISTIC mfALTPWI "0:Not DGN  1:DGN" VALUE 0x000162EC REC_UBYTE_C 0 COMP_0283 0 1 BIT_MASK 0x0080 /end CHARACTERISTIC
/begin CHARACTERISTIC mfPDLHCF "0:Not DGN  1:DGN" VALUE 0x000162EC REC_UBYTE_C 0 COMP_0283 0 1 BIT_MASK 0x0040 /end CHARACTERISTIC
/begin CHARACTERISTIC mfCCSLMS "0:Not DGN  1:DGN" VALUE 0x000162EC REC_UBYTE_C 0 COMP_0283 0 1 BIT_MASK 0x0020 /end CHARACTERISTIC
/begin CHARACTERISTIC mfCCSLSS "0:Not DGN  1:DGN" VALUE 0x000162EC REC_UBYTE_C 0 COMP_0283 0 1 BIT_MASK 0x0010 /end CHARACTERISTIC
/begin CHARACTERISTIC mfCCSLVN "0:Not DGN  1:DGN" VALUE 0x000162EC REC_UBYTE_C 0 COMP_0283 0 1 BIT_MASK 0x0008 /end CHARACTERISTIC
/begin CHARACTERISTIC mfCCSLB1 "0:Not DGN  1:DGN" VALUE 0x000162EC REC_UBYTE_C 0 COMP_0283 0 1 BIT_MASK 0x0004 /end CHARACTERISTIC
/begin CHARACTERISTIC mfCCSLB2 "0:Not DGN  1:DGN" VALUE 0x000162EC REC_UBYTE_C 0 COMP_0283 0 1 BIT_MASK 0x0002 /end CHARACTERISTIC
/begin CHARACTERISTIC mfACPRSN "0:Not DGN  1:DGN" VALUE 0x000162EC REC_UBYTE_C 0 COMP_0283 0 1 BIT_MASK 0x0001 /end CHARACTERISTIC
/begin CHARACTERISTIC mDGNSW[69] "Flag mDGNSW[69]" VALUE 0x000162ED REC_UBYTE_C 0 COMP_0283 0 255 /end CHARACTERISTIC
/begin CHARACTERISTIC mfCLSW "0:Not DGN  1:DGN" VALUE 0x000162ED REC_UBYTE_C 0 COMP_0283 0 1 BIT_MASK 0x0080 /end CHARACTERISTIC
/begin CHARACTERISTIC mfSRVNG2 "0:Not DGN  1:DGN" VALUE 0x000162ED REC_UBYTE_C 0 COMP_0283 0 1 BIT_MASK 0x0040 /end CHARACTERISTIC
/begin CHARACTERISTIC mfTP4NG2 "0:Not DGN  1:DGN" VALUE 0x000162ED REC_UBYTE_C 0 COMP_0283 0 1 BIT_MASK 0x0020 /end CHARACTERISTIC
/begin CHARACTERISTIC mfRONNG2 "0:Not DGN  1:DGN" VALUE 0x000162ED REC_UBYTE_C 0 COMP_0283 0 1 BIT_MASK 0x0010 /end CHARACTERISTIC
/begin CHARACTERISTIC mfROFNG2 "0:Not DGN  1:DGN" VALUE 0x000162ED REC_UBYTE_C 0 COMP_0283 0 1 BIT_MASK 0x0008 /end CHARACTERISTIC
/begin CHARACTERISTIC mfEVCNGR "0:Not DGN  1:DGN" VALUE 0x000162ED REC_UBYTE_C 0 COMP_0283 0 1 BIT_MASK 0x0004 /end CHARACTERISTIC
/begin CHARACTERISTIC mfO2HFR1 "0:Not DGN  1:DGN" VALUE 0x000162ED REC_UBYTE_C 0 COMP_0283 0 1 BIT_MASK 0x0002 /end CHARACTERISTIC
/begin CHARACTERISTIC mfO2HRR1 "0:Not DGN  1:DGN" VALUE 0x000162ED REC_UBYTE_C 0 COMP_0283 0 1 BIT_MASK 0x0001 /end CHARACTERISTIC
/begin CHARACTERISTIC mDGNSW[70] "Flag mDGNSW[70]" VALUE 0x000162EE REC_UBYTE_C 0 COMP_0283 0 255 /end CHARACTERISTIC
/begin CHARACTERISTIC mfRSPNG2 "0:Not DGN  1:DGN" VALUE 0x000162EE REC_UBYTE_C 0 COMP_0283 0 1 BIT_MASK 0x0080 /end CHARACTERISTIC
/begin CHARACTERISTIC mfDFLNG2 "0:Not DGN  1:DGN" VALUE 0x000162EE REC_UBYTE_C 0 COMP_0283 0 1 BIT_MASK 0x0040 /end CHARACTERISTIC
/begin CHARACTERISTIC mfTOPNG2 "0:Not DGN  1:DGN" VALUE 0x000162EE REC_UBYTE_C 0 COMP_0283 0 1 BIT_MASK 0x0020 /end CHARACTERISTIC
/begin CHARACTERISTIC mfTGXNG2 "0:Not DGN  1:DGN" VALUE 0x000162EE REC_UBYTE_C 0 COMP_0283 0 1 BIT_MASK 0x0010 /end CHARACTERISTIC
/begin CHARACTERISTIC mfAFKLD2 "0:Not DGN  1:DGN" VALUE 0x000162EE REC_UBYTE_C 0 COMP_0283 0 1 BIT_MASK 0x0008 /end CHARACTERISTIC
/begin CHARACTERISTIC mfAFKLD1 "0:Not DGN  1:DGN" VALUE 0x000162EE REC_UBYTE_C 0 COMP_0283 0 1 BIT_MASK 0x0004 /end CHARACTERISTIC
/begin CHARACTERISTIC mfADVRNG "0:Not DGN  1:DGN" VALUE 0x000162EE REC_UBYTE_C 0 COMP_0283 0 1 BIT_MASK 0x0002 /end CHARACTERISTIC
/begin CHARACTERISTIC mfCSSMNG "0:Not DGN  1:DGN" VALUE 0x000162EE REC_UBYTE_C 0 COMP_0283 0 1 BIT_MASK 0x0001 /end CHARACTERISTIC
/begin CHARACTERISTIC mDGNSW[71] "Flag mDGNSW[71]" VALUE 0x000162EF REC_UBYTE_C 0 COMP_0283 0 255 /end CHARACTERISTIC
/begin CHARACTERISTIC mfINHNG4 "0:Not DGN  1:DGN" VALUE 0x000162EF REC_UBYTE_C 0 COMP_0283 0 1 BIT_MASK 0x0080 /end CHARACTERISTIC
/begin CHARACTERISTIC mfINHNG3 "0:Not DGN  1:DGN" VALUE 0x000162EF REC_UBYTE_C 0 COMP_0283 0 1 BIT_MASK 0x0040 /end CHARACTERISTIC
/begin CHARACTERISTIC mfINHNG2 "0:Not DGN  1:DGN" VALUE 0x000162EF REC_UBYTE_C 0 COMP_0283 0 1 BIT_MASK 0x0020 /end CHARACTERISTIC
/begin CHARACTERISTIC mfINHNG1 "0:Not DGN  1:DGN" VALUE 0x000162EF REC_UBYTE_C 0 COMP_0283 0 1 BIT_MASK 0x0010 /end CHARACTERISTIC
/begin CHARACTERISTIC mfINLNG4 "0:Not DGN  1:DGN" VALUE 0x000162EF REC_UBYTE_C 0 COMP_0283 0 1 BIT_MASK 0x0008 /end CHARACTERISTIC
/begin CHARACTERISTIC mfINLNG3 "0:Not DGN  1:DGN" VALUE 0x000162EF REC_UBYTE_C 0 COMP_0283 0 1 BIT_MASK 0x0004 /end CHARACTERISTIC
/begin CHARACTERISTIC mfINLNG2 "0:Not DGN  1:DGN" VALUE 0x000162EF REC_UBYTE_C 0 COMP_0283 0 1 BIT_MASK 0x0002 /end CHARACTERISTIC
/begin CHARACTERISTIC mfINLNG1 "0:Not DGN  1:DGN" VALUE 0x000162EF REC_UBYTE_C 0 COMP_0283 0 1 BIT_MASK 0x0001 /end CHARACTERISTIC
/begin CHARACTERISTIC mDGNSW[72] "Flag mDGNSW[72]" VALUE 0x000162F0 REC_UBYTE_C 0 COMP_0283 0 255 /end CHARACTERISTIC
/begin CHARACTERISTIC mfVELTIM "0:Not DGN  1:DGN" VALUE 0x000162F0 REC_UBYTE_C 0 COMP_0283 0 1 BIT_MASK 0x0080 /end CHARACTERISTIC
/begin CHARACTERISTIC mfVELRAM "0:Not DGN  1:DGN" VALUE 0x000162F0 REC_UBYTE_C 0 COMP_0283 0 1 BIT_MASK 0x0040 /end CHARACTERISTIC
/begin CHARACTERISTIC mfVELROM "0:Not DGN  1:DGN" VALUE 0x000162F0 REC_UBYTE_C 0 COMP_0283 0 1 BIT_MASK 0x0020 /end CHARACTERISTIC
/begin CHARACTERISTIC mfVELADP "0:Not DGN  1:DGN" VALUE 0x000162F0 REC_UBYTE_C 0 COMP_0283 0 1 BIT_MASK 0x0010 /end CHARACTERISTIC
/begin CHARACTERISTIC mfVELTSK "0:Not DGN  1:DGN" VALUE 0x000162F0 REC_UBYTE_C 0 COMP_0283 0 1 BIT_MASK 0x0008 /end CHARACTERISTIC
/begin CHARACTERISTIC mfVELANG "0:Not DGN  1:DGN" VALUE 0x000162F0 REC_UBYTE_C 0 COMP_0283 0 1 BIT_MASK 0x0004 /end CHARACTERISTIC
/begin CHARACTERISTIC mfVELFB2 "0:Not DGN  1:DGN" VALUE 0x000162F0 REC_UBYTE_C 0 COMP_0283 0 1 BIT_MASK 0x0002 /end CHARACTERISTIC
/begin CHARACTERISTIC mfVELFB1 "0:Not DGN  1:DGN" VALUE 0x000162F0 REC_UBYTE_C 0 COMP_0283 0 1 BIT_MASK 0x0001 /end CHARACTERISTIC
/begin CHARACTERISTIC mDGNSW[73] "Flag mDGNSW[73]" VALUE 0x000162F1 REC_UBYTE_C 0 COMP_0283 0 255 /end CHARACTERISTIC
/begin CHARACTERISTIC mfVS2NL2 "0:Not DGN  1:DGN" VALUE 0x000162F1 REC_UBYTE_C 0 COMP_0283 0 1 BIT_MASK 0x0080 /end CHARACTERISTIC
/begin CHARACTERISTIC mfVS2NL1 "0:Not DGN  1:DGN" VALUE 0x000162F1 REC_UBYTE_C 0 COMP_0283 0 1 BIT_MASK 0x0040 /end CHARACTERISTIC
/begin CHARACTERISTIC mfVS2NH2 "0:Not DGN  1:DGN" VALUE 0x000162F1 REC_UBYTE_C 0 COMP_0283 0 1 BIT_MASK 0x0020 /end CHARACTERISTIC
/begin CHARACTERISTIC mfVS2NH1 "0:Not DGN  1:DGN" VALUE 0x000162F1 REC_UBYTE_C 0 COMP_0283 0 1 BIT_MASK 0x0010 /end CHARACTERISTIC
/begin CHARACTERISTIC mfVS1NL2 "0:Not DGN  1:DGN" VALUE 0x000162F1 REC_UBYTE_C 0 COMP_0283 0 1 BIT_MASK 0x0008 /end CHARACTERISTIC
/begin CHARACTERISTIC mfVS1NL1 "0:Not DGN  1:DGN" VALUE 0x000162F1 REC_UBYTE_C 0 COMP_0283 0 1 BIT_MASK 0x0004 /end CHARACTERISTIC
/begin CHARACTERISTIC mfVS1NH2 "0:Not DGN  1:DGN" VALUE 0x000162F1 REC_UBYTE_C 0 COMP_0283 0 1 BIT_MASK 0x0002 /end CHARACTERISTIC
/begin CHARACTERISTIC mfVS1NH1 "0:Not DGN  1:DGN" VALUE 0x000162F1 REC_UBYTE_C 0 COMP_0283 0 1 BIT_MASK 0x0001 /end CHARACTERISTIC
/begin CHARACTERISTIC mDGNSW[74] "Flag mDGNSW[74]" VALUE 0x000162F2 REC_UBYTE_C 0 COMP_0283 0 255 /end CHARACTERISTIC
/begin CHARACTERISTIC mfVLCRN2 "0:Not DGN  1:DGN" VALUE 0x000162F2 REC_UBYTE_C 0 COMP_0283 0 1 BIT_MASK 0x0040 /end CHARACTERISTIC
/begin CHARACTERISTIC mfVLCRN1 "0:Not DGN  1:DGN" VALUE 0x000162F2 REC_UBYTE_C 0 COMP_0283 0 1 BIT_MASK 0x0020 /end CHARACTERISTIC
/begin CHARACTERISTIC mfVLSRE2 "0:Not DGN  1:DGN" VALUE 0x000162F2 REC_UBYTE_C 0 COMP_0283 0 1 BIT_MASK 0x0010 /end CHARACTERISTIC
/begin CHARACTERISTIC mfVLSRE1 "0:Not DGN  1:DGN" VALUE 0x000162F2 REC_UBYTE_C 0 COMP_0283 0 1 BIT_MASK 0x0008 /end CHARACTERISTIC
/begin CHARACTERISTIC mfVLACNG "0:Not DGN  1:DGN" VALUE 0x000162F2 REC_UBYTE_C 0 COMP_0283 0 1 BIT_MASK 0x0004 /end CHARACTERISTIC
/begin CHARACTERISTIC mfVS12N2 "0:Not DGN  1:DGN" VALUE 0x000162F2 REC_UBYTE_C 0 COMP_0283 0 1 BIT_MASK 0x0002 /end CHARACTERISTIC
/begin CHARACTERISTIC mfVS12N1 "0:Not DGN  1:DGN" VALUE 0x000162F2 REC_UBYTE_C 0 COMP_0283 0 1 BIT_MASK 0x0001 /end CHARACTERISTIC
/begin CHARACTERISTIC mDGNSW[75] "Flag mDGNSW[75]" VALUE 0x000162F3 REC_UBYTE_C 0 COMP_0283 0 255 /end CHARACTERISTIC
/begin CHARACTERISTIC mfVELCC2 "0:Not DGN  1:DGN" VALUE 0x000162F3 REC_UBYTE_C 0 COMP_0283 0 1 BIT_MASK 0x0080 /end CHARACTERISTIC
/begin CHARACTERISTIC mfVELCC1 "0:Not DGN  1:DGN" VALUE 0x000162F3 REC_UBYTE_C 0 COMP_0283 0 1 BIT_MASK 0x0040 /end CHARACTERISTIC
/begin CHARACTERISTIC mfVELCAN "0:Not DGN  1:DGN" VALUE 0x000162F3 REC_UBYTE_C 0 COMP_0283 0 1 BIT_MASK 0x0020 /end CHARACTERISTIC
/begin CHARACTERISTIC mfVELEEP "0:Not DGN  1:DGN" VALUE 0x000162F3 REC_UBYTE_C 0 COMP_0283 0 1 BIT_MASK 0x0010 /end CHARACTERISTIC
/begin CHARACTERISTIC mfAFSNG2 "0:Not DGN  1:DGN" VALUE 0x000162F3 REC_UBYTE_C 0 COMP_0283 0 1 BIT_MASK 0x0008 /end CHARACTERISTIC
/begin CHARACTERISTIC mfAFSNG1 "0:Not DGN  1:DGN" VALUE 0x000162F3 REC_UBYTE_C 0 COMP_0283 0 1 BIT_MASK 0x0004 /end CHARACTERISTIC
/begin CHARACTERISTIC mfVLROFN "0:Not DGN  1:DGN" VALUE 0x000162F3 REC_UBYTE_C 0 COMP_0283 0 1 BIT_MASK 0x0002 /end CHARACTERISTIC
/begin CHARACTERISTIC mfVLRONN "0:Not DGN  1:DGN" VALUE 0x000162F3 REC_UBYTE_C 0 COMP_0283 0 1 BIT_MASK 0x0001 /end CHARACTERISTIC
/begin CHARACTERISTIC mDGNSW[76] "Flag mDGNSW[76]" VALUE 0x000162F4 REC_UBYTE_C 0 COMP_0283 0 255 /end CHARACTERISTIC
/begin CHARACTERISTIC mfHVRING "0:Not DGN  1:DGN" VALUE 0x000162F4 REC_UBYTE_C 0 COMP_0283 0 1 BIT_MASK 0x0080 /end CHARACTERISTIC
/begin CHARACTERISTIC mfHVRINE "0:Not DGN  1:DGN" VALUE 0x000162F4 REC_UBYTE_C 0 COMP_0283 0 1 BIT_MASK 0x0040 /end CHARACTERISTIC
/begin CHARACTERISTIC mfEBRING "0:Not DGN  1:DGN" VALUE 0x000162F4 REC_UBYTE_C 0 COMP_0283 0 1 BIT_MASK 0x0020 /end CHARACTERISTIC
/begin CHARACTERISTIC mfEBRINE "0:Not DGN  1:DGN" VALUE 0x000162F4 REC_UBYTE_C 0 COMP_0283 0 1 BIT_MASK 0x0010 /end CHARACTERISTIC
/begin CHARACTERISTIC mfHVSMNE "0:Not DGN  1:DGN" VALUE 0x000162F4 REC_UBYTE_C 0 COMP_0283 0 1 BIT_MASK 0x0008 /end CHARACTERISTIC
/begin CHARACTERISTIC mfHVSMNG "0:Not DGN  1:DGN" VALUE 0x000162F4 REC_UBYTE_C 0 COMP_0283 0 1 BIT_MASK 0x0004 /end CHARACTERISTIC
/begin CHARACTERISTIC mfEBSMNE "0:Not DGN  1:DGN" VALUE 0x000162F4 REC_UBYTE_C 0 COMP_0283 0 1 BIT_MASK 0x0002 /end CHARACTERISTIC
/begin CHARACTERISTIC mfEBSMNG "0:Not DGN  1:DGN" VALUE 0x000162F4 REC_UBYTE_C 0 COMP_0283 0 1 BIT_MASK 0x0001 /end CHARACTERISTIC
/begin CHARACTERISTIC mDGNSW[77] "Flag mDGNSW[77]" VALUE 0x000162F5 REC_UBYTE_C 0 COMP_0283 0 255 /end CHARACTERISTIC
/begin CHARACTERISTIC mfO2R3L2 "0:Not DGN  1:DGN" VALUE 0x000162F5 REC_UBYTE_C 0 COMP_0283 0 1 BIT_MASK 0x0080 /end CHARACTERISTIC
/begin CHARACTERISTIC mfO2R3R2 "0:Not DGN  1:DGN" VALUE 0x000162F5 REC_UBYTE_C 0 COMP_0283 0 1 BIT_MASK 0x0040 /end CHARACTERISTIC
/begin CHARACTERISTIC mfO2R3N2 "0:Not DGN  1:DGN" VALUE 0x000162F5 REC_UBYTE_C 0 COMP_0283 0 1 BIT_MASK 0x0020 /end CHARACTERISTIC
/begin CHARACTERISTIC mfO2R3A2 "0:Not DGN  1:DGN" VALUE 0x000162F5 REC_UBYTE_C 0 COMP_0283 0 1 BIT_MASK 0x0010 /end CHARACTERISTIC
/begin CHARACTERISTIC mfTO2HL2 "0:Not DGN  1:DGN" VALUE 0x000162F5 REC_UBYTE_C 0 COMP_0283 0 1 BIT_MASK 0x0008 /end CHARACTERISTIC
/begin CHARACTERISTIC mfTO2HH2 "0:Not DGN  1:DGN" VALUE 0x000162F5 REC_UBYTE_C 0 COMP_0283 0 1 BIT_MASK 0x0004 /end CHARACTERISTIC
/begin CHARACTERISTIC mfHCTD2 "0:Not DGN  1:DGN" VALUE 0x000162F5 REC_UBYTE_C 0 COMP_0283 0 1 BIT_MASK 0x0002 /end CHARACTERISTIC
/begin CHARACTERISTIC mfHCTD1 "0:Not DGN  1:DGN" VALUE 0x000162F5 REC_UBYTE_C 0 COMP_0283 0 1 BIT_MASK 0x0001 /end CHARACTERISTIC
/begin CHARACTERISTIC mDGNSW[78] "Flag mDGNSW[78]" VALUE 0x000162F6 REC_UBYTE_C 0 COMP_0283 0 255 /end CHARACTERISTIC
/begin CHARACTERISTIC mfSTSYS "0:Not DGN  1:DGN" VALUE 0x000162F6 REC_UBYTE_C 0 COMP_0283 0 1 BIT_MASK 0x0080 /end CHARACTERISTIC
/begin CHARACTERISTIC mfCUTLN "0:Not DGN  1:DGN" VALUE 0x000162F6 REC_UBYTE_C 0 COMP_0283 0 1 BIT_MASK 0x0040 /end CHARACTERISTIC
/begin CHARACTERISTIC mfINHBOF "0:Not DGN  1:DGN" VALUE 0x000162F6 REC_UBYTE_C 0 COMP_0283 0 1 BIT_MASK 0x0020 /end CHARACTERISTIC
/begin CHARACTERISTIC mfSTRLON "0:Not DGN  1:DGN" VALUE 0x000162F6 REC_UBYTE_C 0 COMP_0283 0 1 BIT_MASK 0x0010 /end CHARACTERISTIC
/begin CHARACTERISTIC mfSTRLOF "0:Not DGN  1:DGN" VALUE 0x000162F6 REC_UBYTE_C 0 COMP_0283 0 1 BIT_MASK 0x0008 /end CHARACTERISTIC
/begin CHARACTERISTIC mfINHBON "0:Not DGN  1:DGN" VALUE 0x000162F6 REC_UBYTE_C 0 COMP_0283 0 1 BIT_MASK 0x0004 /end CHARACTERISTIC
/begin CHARACTERISTIC mfBPSRH "0:Not DGN  1:DGN" VALUE 0x000162F6 REC_UBYTE_C 0 COMP_0283 0 1 BIT_MASK 0x0002 /end CHARACTERISTIC
/begin CHARACTERISTIC mfSTROPN "0:Not DGN  1:DGN" VALUE 0x000162F6 REC_UBYTE_C 0 COMP_0283 0 1 BIT_MASK 0x0001 /end CHARACTERISTIC
/begin CHARACTERISTIC mDGNSW[79] "Flag mDGNSW[79]" VALUE 0x000162F7 REC_UBYTE_C 0 COMP_0283 0 255 /end CHARACTERISTIC
/begin CHARACTERISTIC mfINGNG8 "0:Not DGN  1:DGN" VALUE 0x000162F7 REC_UBYTE_C 0 COMP_0283 0 1 BIT_MASK 0x0080 /end CHARACTERISTIC
/begin CHARACTERISTIC mfINGNG7 "0:Not DGN  1:DGN" VALUE 0x000162F7 REC_UBYTE_C 0 COMP_0283 0 1 BIT_MASK 0x0040 /end CHARACTERISTIC
/begin CHARACTERISTIC mfINGNG6 "0:Not DGN  1:DGN" VALUE 0x000162F7 REC_UBYTE_C 0 COMP_0283 0 1 BIT_MASK 0x0020 /end CHARACTERISTIC
/begin CHARACTERISTIC mfINGNG5 "0:Not DGN  1:DGN" VALUE 0x000162F7 REC_UBYTE_C 0 COMP_0283 0 1 BIT_MASK 0x0010 /end CHARACTERISTIC
/begin CHARACTERISTIC mfINGNG4 "0:Not DGN  1:DGN" VALUE 0x000162F7 REC_UBYTE_C 0 COMP_0283 0 1 BIT_MASK 0x0008 /end CHARACTERISTIC
/begin CHARACTERISTIC mfINGNG3 "0:Not DGN  1:DGN" VALUE 0x000162F7 REC_UBYTE_C 0 COMP_0283 0 1 BIT_MASK 0x0004 /end CHARACTERISTIC
/begin CHARACTERISTIC mfINGNG2 "0:Not DGN  1:DGN" VALUE 0x000162F7 REC_UBYTE_C 0 COMP_0283 0 1 BIT_MASK 0x0002 /end CHARACTERISTIC
/begin CHARACTERISTIC mfINGNG1 "0:Not DGN  1:DGN" VALUE 0x000162F7 REC_UBYTE_C 0 COMP_0283 0 1 BIT_MASK 0x0001 /end CHARACTERISTIC
/begin CHARACTERISTIC mDGNSW[80] "Flag mDGNSW[80]" VALUE 0x000162F8 REC_UBYTE_C 0 COMP_0283 0 255 /end CHARACTERISTIC
/begin CHARACTERISTIC mfTAMNGL "0:Not DGN  1:DGN" VALUE 0x000162F8 REC_UBYTE_C 0 COMP_0283 0 1 BIT_MASK 0x0080 /end CHARACTERISTIC
/begin CHARACTERISTIC mfTAMNGH "0:Not DGN  1:DGN" VALUE 0x000162F8 REC_UBYTE_C 0 COMP_0283 0 1 BIT_MASK 0x0040 /end CHARACTERISTIC
/begin CHARACTERISTIC mfTAMNGR "0:Not DGN  1:DGN" VALUE 0x000162F8 REC_UBYTE_C 0 COMP_0283 0 1 BIT_MASK 0x0020 /end CHARACTERISTIC
/begin CHARACTERISTIC mfTHSNR2 "0:Not DGN  1:DGN" VALUE 0x000162F8 REC_UBYTE_C 0 COMP_0283 0 1 BIT_MASK 0x0010 /end CHARACTERISTIC
/begin CHARACTERISTIC mfTHSNL2 "0:Not DGN  1:DGN" VALUE 0x000162F8 REC_UBYTE_C 0 COMP_0283 0 1 BIT_MASK 0x0008 /end CHARACTERISTIC
/begin CHARACTERISTIC mfTHSNH2 "0:Not DGN  1:DGN" VALUE 0x000162F8 REC_UBYTE_C 0 COMP_0283 0 1 BIT_MASK 0x0004 /end CHARACTERISTIC
/begin CHARACTERISTIC mfBPSNG "0:Not DGN  1:DGN" VALUE 0x000162F8 REC_UBYTE_C 0 COMP_0283 0 1 BIT_MASK 0x0002 /end CHARACTERISTIC
/begin CHARACTERISTIC mfBPSNG2 "0:Not DGN  1:DGN" VALUE 0x000162F8 REC_UBYTE_C 0 COMP_0283 0 1 BIT_MASK 0x0001 /end CHARACTERISTIC
/begin CHARACTERISTIC mDGNSW[81] "Flag mDGNSW[81]" VALUE 0x000162F9 REC_UBYTE_C 0 COMP_0283 0 255 /end CHARACTERISTIC
/begin CHARACTERISTIC mfVPBNGL "0:Not DGN  1:DGN" VALUE 0x000162F9 REC_UBYTE_C 0 COMP_0283 0 1 BIT_MASK 0x0080 /end CHARACTERISTIC
/begin CHARACTERISTIC mfVPBNGH "0:Not DGN  1:DGN" VALUE 0x000162F9 REC_UBYTE_C 0 COMP_0283 0 1 BIT_MASK 0x0040 /end CHARACTERISTIC
/begin CHARACTERISTIC mfVPBNL2 "0:Not DGN  1:DGN" VALUE 0x000162F9 REC_UBYTE_C 0 COMP_0283 0 1 BIT_MASK 0x0020 /end CHARACTERISTIC
/begin CHARACTERISTIC mfVPBNH2 "0:Not DGN  1:DGN" VALUE 0x000162F9 REC_UBYTE_C 0 COMP_0283 0 1 BIT_MASK 0x0010 /end CHARACTERISTIC
/begin CHARACTERISTIC mfOVBST2 "0:Not DGN  1:DGN" VALUE 0x000162F9 REC_UBYTE_C 0 COMP_0283 0 1 BIT_MASK 0x0008 /end CHARACTERISTIC
/begin CHARACTERISTIC mfOVBST1 "0:Not DGN  1:DGN" VALUE 0x000162F9 REC_UBYTE_C 0 COMP_0283 0 1 BIT_MASK 0x0004 /end CHARACTERISTIC
/begin CHARACTERISTIC mfTUBNG2 "0:Not DGN  1:DGN" VALUE 0x000162F9 REC_UBYTE_C 0 COMP_0283 0 1 BIT_MASK 0x0002 /end CHARACTERISTIC
/begin CHARACTERISTIC mfTUBNG "0:Not DGN  1:DGN" VALUE 0x000162F9 REC_UBYTE_C 0 COMP_0283 0 1 BIT_MASK 0x0001 /end CHARACTERISTIC
/begin CHARACTERISTIC mDGNSW[82] "Flag mDGNSW[82]" VALUE 0x000162FA REC_UBYTE_C 0 COMP_0283 0 255 /end CHARACTERISTIC
/begin CHARACTERISTIC mfBCONG1 "0:Not DGN  1:DGN" VALUE 0x000162FA REC_UBYTE_C 0 COMP_0283 0 1 BIT_MASK 0x0080 /end CHARACTERISTIC
/begin CHARACTERISTIC mfBCGNG1 "0:Not DGN  1:DGN" VALUE 0x000162FA REC_UBYTE_C 0 COMP_0283 0 1 BIT_MASK 0x0040 /end CHARACTERISTIC
/begin CHARACTERISTIC mfTBSNG1 "0:Not DGN  1:DGN" VALUE 0x000162FA REC_UBYTE_C 0 COMP_0283 0 1 BIT_MASK 0x0020 /end CHARACTERISTIC
/begin CHARACTERISTIC mfBCONG2 "0:Not DGN  1:DGN" VALUE 0x000162FA REC_UBYTE_C 0 COMP_0283 0 1 BIT_MASK 0x0010 /end CHARACTERISTIC
/begin CHARACTERISTIC mfBCGNG2 "0:Not DGN  1:DGN" VALUE 0x000162FA REC_UBYTE_C 0 COMP_0283 0 1 BIT_MASK 0x0008 /end CHARACTERISTIC
/begin CHARACTERISTIC mfTBSNG2 "0:Not DGN  1:DGN" VALUE 0x000162FA REC_UBYTE_C 0 COMP_0283 0 1 BIT_MASK 0x0004 /end CHARACTERISTIC
/begin CHARACTERISTIC mfTATHL "0:Not DGN  1:DGN" VALUE 0x000162FA REC_UBYTE_C 0 COMP_0283 0 1 BIT_MASK 0x0002 /end CHARACTERISTIC
/begin CHARACTERISTIC mfTATHH "0:Not DGN  1:DGN" VALUE 0x000162FA REC_UBYTE_C 0 COMP_0283 0 1 BIT_MASK 0x0001 /end CHARACTERISTIC
/begin CHARACTERISTIC mDGNSW[83] "Flag mDGNSW[83]" VALUE 0x000162FB REC_UBYTE_C 0 COMP_0283 0 255 /end CHARACTERISTIC
/begin CHARACTERISTIC mfFPMNG "0:Not DGN  1:DGN" VALUE 0x000162FB REC_UBYTE_C 0 COMP_0283 0 1 BIT_MASK 0x0080 /end CHARACTERISTIC
/begin CHARACTERISTIC mfFPMCNG "0:Not DGN  1:DGN" VALUE 0x000162FB REC_UBYTE_C 0 COMP_0283 0 1 BIT_MASK 0x0040 /end CHARACTERISTIC
/begin CHARACTERISTIC mfFPMONG "0:Not DGN  1:DGN" VALUE 0x000162FB REC_UBYTE_C 0 COMP_0283 0 1 BIT_MASK 0x0020 /end CHARACTERISTIC
/begin CHARACTERISTIC mfEFNSNG "0:Not DGN  1:DGN" VALUE 0x000162FB REC_UBYTE_C 0 COMP_0283 0 1 BIT_MASK 0x0010 /end CHARACTERISTIC
/begin CHARACTERISTIC mfTWSTNG "0:Not DGN  1:DGN" VALUE 0x000162FB REC_UBYTE_C 0 COMP_0283 0 1 BIT_MASK 0x0008 /end CHARACTERISTIC
/begin CHARACTERISTIC mfCVONG "0:Not DGN  1:DGN" VALUE 0x000162FB REC_UBYTE_C 0 COMP_0283 0 1 BIT_MASK 0x0004 /end CHARACTERISTIC
/begin CHARACTERISTIC mfSAFMNH "0:Not DGN  1:DGN" VALUE 0x000162FB REC_UBYTE_C 0 COMP_0283 0 1 BIT_MASK 0x0002 /end CHARACTERISTIC
/begin CHARACTERISTIC mfSAFMNL "0:Not DGN  1:DGN" VALUE 0x000162FB REC_UBYTE_C 0 COMP_0283 0 1 BIT_MASK 0x0001 /end CHARACTERISTIC
/begin CHARACTERISTIC mDGNSW[84] "Flag mDGNSW[84]" VALUE 0x000162FC REC_UBYTE_C 0 COMP_0283 0 255 /end CHARACTERISTIC
/begin CHARACTERISTIC mfSEANG "0:Not DGN  1:DGN" VALUE 0x000162FC REC_UBYTE_C 0 COMP_0283 0 1 BIT_MASK 0x0080 /end CHARACTERISTIC
/begin CHARACTERISTIC mfSEANGL "0:Not DGN  1:DGN" VALUE 0x000162FC REC_UBYTE_C 0 COMP_0283 0 1 BIT_MASK 0x0040 /end CHARACTERISTIC
/begin CHARACTERISTIC mfSEANGR "0:Not DGN  1:DGN" VALUE 0x000162FC REC_UBYTE_C 0 COMP_0283 0 1 BIT_MASK 0x0020 /end CHARACTERISTIC
/begin CHARACTERISTIC mfCVONGL "0:Not DGN  1:DGN" VALUE 0x000162FC REC_UBYTE_C 0 COMP_0283 0 1 BIT_MASK 0x0010 /end CHARACTERISTIC
/begin CHARACTERISTIC mfCVONGR "0:Not DGN  1:DGN" VALUE 0x000162FC REC_UBYTE_C 0 COMP_0283 0 1 BIT_MASK 0x0008 /end CHARACTERISTIC
/begin CHARACTERISTIC mfAPONNG "0:Not DGN  1:DGN" VALUE 0x000162FC REC_UBYTE_C 0 COMP_0283 0 1 BIT_MASK 0x0004 /end CHARACTERISTIC
/begin CHARACTERISTIC mfAPOFNG "0:Not DGN  1:DGN" VALUE 0x000162FC REC_UBYTE_C 0 COMP_0283 0 1 BIT_MASK 0x0002 /end CHARACTERISTIC
/begin CHARACTERISTIC mfSEALNG "0:Not DGN  1:DGN" VALUE 0x000162FC REC_UBYTE_C 0 COMP_0283 0 1 BIT_MASK 0x0001 /end CHARACTERISTIC
/begin CHARACTERISTIC mDGNSW[85] "Flag mDGNSW[85]" VALUE 0x000162FD REC_UBYTE_C 0 COMP_0283 0 255 /end CHARACTERISTIC
/begin CHARACTERISTIC mfVTCOP1 "0:Not DGN  1:DGN" VALUE 0x000162FD REC_UBYTE_C 0 COMP_0283 0 1 BIT_MASK 0x0080 /end CHARACTERISTIC
/begin CHARACTERISTIC mfVTCOP2 "0:Not DGN  1:DGN" VALUE 0x000162FD REC_UBYTE_C 0 COMP_0283 0 1 BIT_MASK 0x0040 /end CHARACTERISTIC
/begin CHARACTERISTIC mfVTOPE1 "0:Not DGN  1:DGN" VALUE 0x000162FD REC_UBYTE_C 0 COMP_0283 0 1 BIT_MASK 0x0020 /end CHARACTERISTIC
/begin CHARACTERISTIC mfVTOPE2 "0:Not DGN  1:DGN" VALUE 0x000162FD REC_UBYTE_C 0 COMP_0283 0 1 BIT_MASK 0x0010 /end CHARACTERISTIC
/begin CHARACTERISTIC mfVLSLW2 "0:Not DGN  1:DGN" VALUE 0x000162FD REC_UBYTE_C 0 COMP_0283 0 1 BIT_MASK 0x0008 /end CHARACTERISTIC
/begin CHARACTERISTIC mfVLSLW1 "0:Not DGN  1:DGN" VALUE 0x000162FD REC_UBYTE_C 0 COMP_0283 0 1 BIT_MASK 0x0004 /end CHARACTERISTIC
/begin CHARACTERISTIC mfVLS4A2 "0:Not DGN  1:DGN" VALUE 0x000162FD REC_UBYTE_C 0 COMP_0283 0 1 BIT_MASK 0x0002 /end CHARACTERISTIC
/begin CHARACTERISTIC mfVLS4A1 "0:Not DGN  1:DGN" VALUE 0x000162FD REC_UBYTE_C 0 COMP_0283 0 1 BIT_MASK 0x0001 /end CHARACTERISTIC
/begin CHARACTERISTIC mDGNSW[86] "Flag mDGNSW[86]" VALUE 0x000162FE REC_UBYTE_C 0 COMP_0283 0 255 /end CHARACTERISTIC
/begin CHARACTERISTIC mfCSCHR "0:Not DGN  1:DGN" VALUE 0x000162FE REC_UBYTE_C 0 COMP_0283 0 1 BIT_MASK 0x0080 /end CHARACTERISTIC
/begin CHARACTERISTIC mfCSTOT "0:Not DGN  1:DGN" VALUE 0x000162FE REC_UBYTE_C 0 COMP_0283 0 1 BIT_MASK 0x0040 /end CHARACTERISTIC
/begin CHARACTERISTIC mfVSCMP "0:Not DGN  1:DGN" VALUE 0x000162FE REC_UBYTE_C 0 COMP_0283 0 1 BIT_MASK 0x0020 /end CHARACTERISTIC
/begin CHARACTERISTIC mfCSOOR "0:Not DGN  1:DGN" VALUE 0x000162FE REC_UBYTE_C 0 COMP_0283 0 1 BIT_MASK 0x0010 /end CHARACTERISTIC
/begin CHARACTERISTIC mfCSOCS "0:Not DGN  1:DGN" VALUE 0x000162FE REC_UBYTE_C 0 COMP_0283 0 1 BIT_MASK 0x0008 /end CHARACTERISTIC
/begin CHARACTERISTIC mfCSNOK "0:Not DGN  1:DGN" VALUE 0x000162FE REC_UBYTE_C 0 COMP_0283 0 1 BIT_MASK 0x0004 /end CHARACTERISTIC
/begin CHARACTERISTIC mfCLUCMP "0:Not DGN  1:DGN" VALUE 0x000162FE REC_UBYTE_C 0 COMP_0283 0 1 BIT_MASK 0x0002 /end CHARACTERISTIC
/begin CHARACTERISTIC mfBRKCMP "0:Not DGN  1:DGN" VALUE 0x000162FE REC_UBYTE_C 0 COMP_0283 0 1 BIT_MASK 0x0001 /end CHARACTERISTIC
/begin CHARACTERISTIC mDGNSW[87] "Flag mDGNSW[87]" VALUE 0x000162FF REC_UBYTE_C 0 COMP_0283 0 255 /end CHARACTERISTIC
/begin CHARACTERISTIC mfCRUCMP "0:Not DGN  1:DGN" VALUE 0x000162FF REC_UBYTE_C 0 COMP_0283 0 1 BIT_MASK 0x0080 /end CHARACTERISTIC
/begin CHARACTERISTIC mfACRING "0:Not DGN  1:DGN" VALUE 0x000162FF REC_UBYTE_C 0 COMP_0283 0 1 BIT_MASK 0x0040 /end CHARACTERISTIC
/begin CHARACTERISTIC mfBCRING "0:Not DGN  1:DGN" VALUE 0x000162FF REC_UBYTE_C 0 COMP_0283 0 1 BIT_MASK 0x0020 /end CHARACTERISTIC
/begin CHARACTERISTIC mfATRING "0:Not DGN  1:DGN" VALUE 0x000162FF REC_UBYTE_C 0 COMP_0283 0 1 BIT_MASK 0x0010 /end CHARACTERISTIC
/begin CHARACTERISTIC mfHMRING "0:Not DGN  1:DGN" VALUE 0x000162FF REC_UBYTE_C 0 COMP_0283 0 1 BIT_MASK 0x0008 /end CHARACTERISTIC
/begin CHARACTERISTIC mfATURNG "0:Not DGN  1:DGN" VALUE 0x000162FF REC_UBYTE_C 0 COMP_0283 0 1 BIT_MASK 0x0004 /end CHARACTERISTIC
/begin CHARACTERISTIC mfRODRD1 "0:Not DGN  1:DGN" VALUE 0x000162FF REC_UBYTE_C 0 COMP_0283 0 1 BIT_MASK 0x0002 /end CHARACTERISTIC
/begin CHARACTERISTIC mfRODRD2 "0:Not DGN  1:DGN" VALUE 0x000162FF REC_UBYTE_C 0 COMP_0283 0 1 BIT_MASK 0x0001 /end CHARACTERISTIC
/begin CHARACTERISTIC mDGNSW[88] "Flag mDGNSW[88]" VALUE 0x00016300 REC_UBYTE_C 0 COMP_0283 0 255 /end CHARACTERISTIC
/begin CHARACTERISTIC mfRQRVNG "0:Not DGN  1:DGN" VALUE 0x00016300 REC_UBYTE_C 0 COMP_0283 0 1 BIT_MASK 0x0080 /end CHARACTERISTIC
/begin CHARACTERISTIC mfTQSPNG "0:Not DGN  1:DGN" VALUE 0x00016300 REC_UBYTE_C 0 COMP_0283 0 1 BIT_MASK 0x0040 /end CHARACTERISTIC
/begin CHARACTERISTIC mfMTSFTV "0:Not DGN  1:DGN" VALUE 0x00016300 REC_UBYTE_C 0 COMP_0283 0 1 BIT_MASK 0x0020 /end CHARACTERISTIC
/begin CHARACTERISTIC mfMTSFTC "0:Not DGN  1:DGN" VALUE 0x00016300 REC_UBYTE_C 0 COMP_0283 0 1 BIT_MASK 0x0010 /end CHARACTERISTIC
/begin CHARACTERISTIC mfINMTNG "0:Not DGN  1:DGN" VALUE 0x00016300 REC_UBYTE_C 0 COMP_0283 0 1 BIT_MASK 0x0008 /end CHARACTERISTIC
/begin CHARACTERISTIC mfCCHXNG "0:Not DGN  1:DGN" VALUE 0x00016300 REC_UBYTE_C 0 COMP_0283 0 1 BIT_MASK 0x0004 /end CHARACTERISTIC
/begin CHARACTERISTIC mfCLCHNA "0:Not DGN  1:DGN" VALUE 0x00016300 REC_UBYTE_C 0 COMP_0283 0 1 BIT_MASK 0x0002 /end CHARACTERISTIC
/begin CHARACTERISTIC mfASCHAC "0:Not DGN  1:DGN" VALUE 0x00016300 REC_UBYTE_C 0 COMP_0283 0 1 BIT_MASK 0x0001 /end CHARACTERISTIC
/begin CHARACTERISTIC mDGNSW[89] "Flag mDGNSW[89]" VALUE 0x00016301 REC_UBYTE_C 0 COMP_0283 0 255 /end CHARACTERISTIC
/begin CHARACTERISTIC mfTMOTHG "0:Not DGN  1:DGN" VALUE 0x00016301 REC_UBYTE_C 0 COMP_0283 0 1 BIT_MASK 0x0080 /end CHARACTERISTIC
/begin CHARACTERISTIC mfDPSONG "0:Not DGN  1:DGN" VALUE 0x00016301 REC_UBYTE_C 0 COMP_0283 0 1 BIT_MASK 0x0040 /end CHARACTERISTIC
/begin CHARACTERISTIC mfDPCFNG "0:Not DGN  1:DGN" VALUE 0x00016301 REC_UBYTE_C 0 COMP_0283 0 1 BIT_MASK 0x0020 /end CHARACTERISTIC
/begin CHARACTERISTIC mfEPCSNG "0:Not DGN  1:DGN" VALUE 0x00016301 REC_UBYTE_C 0 COMP_0283 0 1 BIT_MASK 0x0010 /end CHARACTERISTIC
/begin CHARACTERISTIC mfFPCSNG "0:Not DGN  1:DGN" VALUE 0x00016301 REC_UBYTE_C 0 COMP_0283 0 1 BIT_MASK 0x0008 /end CHARACTERISTIC
/begin CHARACTERISTIC mfINAXCB "0:Not DGN  1:DGN" VALUE 0x00016301 REC_UBYTE_C 0 COMP_0283 0 1 BIT_MASK 0x0004 /end CHARACTERISTIC
/begin CHARACTERISTIC mfGPCSNG "0:Not DGN  1:DGN" VALUE 0x00016301 REC_UBYTE_C 0 COMP_0283 0 1 BIT_MASK 0x0002 /end CHARACTERISTIC
/begin CHARACTERISTIC mfGERANG "0:Not DGN  1:DGN" VALUE 0x00016301 REC_UBYTE_C 0 COMP_0283 0 1 BIT_MASK 0x0001 /end CHARACTERISTIC
/begin CHARACTERISTIC mDGNSW[90] "Flag mDGNSW[90]" VALUE 0x00016302 REC_UBYTE_C 0 COMP_0283 0 255 /end CHARACTERISTIC
/begin CHARACTERISTIC mfDUCMB2 "0:Not DGN  1:DGN" VALUE 0x00016302 REC_UBYTE_C 0 COMP_0283 0 1 BIT_MASK 0x0080 /end CHARACTERISTIC
/begin CHARACTERISTIC mfDUFLB2 "0:Not DGN  1:DGN" VALUE 0x00016302 REC_UBYTE_C 0 COMP_0283 0 1 BIT_MASK 0x0040 /end CHARACTERISTIC
/begin CHARACTERISTIC mfFPHNG "0:Not DGN  1:DGN" VALUE 0x00016302 REC_UBYTE_C 0 COMP_0283 0 1 BIT_MASK 0x0020 /end CHARACTERISTIC
/begin CHARACTERISTIC mfFPLNG "0:Not DGN  1:DGN" VALUE 0x00016302 REC_UBYTE_C 0 COMP_0283 0 1 BIT_MASK 0x0010 /end CHARACTERISTIC
/begin CHARACTERISTIC mfPSHNG "0:Not DGN  1:DGN" VALUE 0x00016302 REC_UBYTE_C 0 COMP_0283 0 1 BIT_MASK 0x0004 /end CHARACTERISTIC
/begin CHARACTERISTIC mfPSLNG "0:Not DGN  1:DGN" VALUE 0x00016302 REC_UBYTE_C 0 COMP_0283 0 1 BIT_MASK 0x0002 /end CHARACTERISTIC
/begin CHARACTERISTIC mfPSFNG "0:Not DGN  1:DGN" VALUE 0x00016302 REC_UBYTE_C 0 COMP_0283 0 1 BIT_MASK 0x0001 /end CHARACTERISTIC
/begin CHARACTERISTIC mDGNSW[91] "Flag mDGNSW[91]" VALUE 0x00016303 REC_UBYTE_C 0 COMP_0283 0 255 /end CHARACTERISTIC
/begin CHARACTERISTIC mfLPSMEO "0:Not DGN  1:DGN" VALUE 0x00016303 REC_UBYTE_C 0 COMP_0283 0 1 BIT_MASK 0x0080 /end CHARACTERISTIC
/begin CHARACTERISTIC mfTEPHNG "0:Not DGN  1:DGN" VALUE 0x00016303 REC_UBYTE_C 0 COMP_0283 0 1 BIT_MASK 0x0040 /end CHARACTERISTIC
/begin CHARACTERISTIC mfEFONNG "0:Not DGN  1:DGN" VALUE 0x00016303 REC_UBYTE_C 0 COMP_0283 0 1 BIT_MASK 0x0020 /end CHARACTERISTIC
/begin CHARACTERISTIC mfOPSNNG "0:Not DGN  1:DGN" VALUE 0x00016303 REC_UBYTE_C 0 COMP_0283 0 1 BIT_MASK 0x0010 /end CHARACTERISTIC
/begin CHARACTERISTIC mfFABRS "0:Not DGN  1:DGN" VALUE 0x00016303 REC_UBYTE_C 0 COMP_0283 0 1 BIT_MASK 0x0008 /end CHARACTERISTIC
/begin CHARACTERISTIC mfCSSADV "0:Not DGN  1:DGN" VALUE 0x00016303 REC_UBYTE_C 0 COMP_0283 0 1 BIT_MASK 0x0004 /end CHARACTERISTIC
/begin CHARACTERISTIC mfCSSRPM "0:Not DGN  1:DGN" VALUE 0x00016303 REC_UBYTE_C 0 COMP_0283 0 1 BIT_MASK 0x0002 /end CHARACTERISTIC
/begin CHARACTERISTIC mfCSSTNG "0:Not DGN  1:DGN" VALUE 0x00016303 REC_UBYTE_C 0 COMP_0283 0 1 BIT_MASK 0x0001 /end CHARACTERISTIC
/begin CHARACTERISTIC mDGNSW[92] "Flag mDGNSW[92]" VALUE 0x00016304 REC_UBYTE_C 0 COMP_0283 0 255 /end CHARACTERISTIC
/begin CHARACTERISTIC mfAFDLR2 "0:Not DGN  1:DGN" VALUE 0x00016304 REC_UBYTE_C 0 COMP_0283 0 1 BIT_MASK 0x0080 /end CHARACTERISTIC
/begin CHARACTERISTIC mfAFDLR1 "0:Not DGN  1:DGN" VALUE 0x00016304 REC_UBYTE_C 0 COMP_0283 0 1 BIT_MASK 0x0040 /end CHARACTERISTIC
/begin CHARACTERISTIC mfAFDRL2 "0:Not DGN  1:DGN" VALUE 0x00016304 REC_UBYTE_C 0 COMP_0283 0 1 BIT_MASK 0x0020 /end CHARACTERISTIC
/begin CHARACTERISTIC mfAFDRL1 "0:Not DGN  1:DGN" VALUE 0x00016304 REC_UBYTE_C 0 COMP_0283 0 1 BIT_MASK 0x0010 /end CHARACTERISTIC
/begin CHARACTERISTIC mfAFSLR2 "0:Not DGN  1:DGN" VALUE 0x00016304 REC_UBYTE_C 0 COMP_0283 0 1 BIT_MASK 0x0008 /end CHARACTERISTIC
/begin CHARACTERISTIC mfAFSLR1 "0:Not DGN  1:DGN" VALUE 0x00016304 REC_UBYTE_C 0 COMP_0283 0 1 BIT_MASK 0x0004 /end CHARACTERISTIC
/begin CHARACTERISTIC mfAFSRL2 "0:Not DGN  1:DGN" VALUE 0x00016304 REC_UBYTE_C 0 COMP_0283 0 1 BIT_MASK 0x0002 /end CHARACTERISTIC
/begin CHARACTERISTIC mfAFSRL1 "0:Not DGN  1:DGN" VALUE 0x00016304 REC_UBYTE_C 0 COMP_0283 0 1 BIT_MASK 0x0001 /end CHARACTERISTIC
/begin CHARACTERISTIC mDGNSW[93] "Flag mDGNSW[93]" VALUE 0x00016305 REC_UBYTE_C 0 COMP_0283 0 255 /end CHARACTERISTIC
/begin CHARACTERISTIC mfBTLNGp "0:Not DGN  1:DGN" VALUE 0x00016305 REC_UBYTE_C 0 COMP_0283 0 1 BIT_MASK 0x0080 /end CHARACTERISTIC
/begin CHARACTERISTIC mfBTHNGp "0:Not DGN  1:DGN" VALUE 0x00016305 REC_UBYTE_C 0 COMP_0283 0 1 BIT_MASK 0x0040 /end CHARACTERISTIC
/begin CHARACTERISTIC mfBPLNGp "0:Not DGN  1:DGN" VALUE 0x00016305 REC_UBYTE_C 0 COMP_0283 0 1 BIT_MASK 0x0020 /end CHARACTERISTIC
/begin CHARACTERISTIC mfBPHNGp "0:Not DGN  1:DGN" VALUE 0x00016305 REC_UBYTE_C 0 COMP_0283 0 1 BIT_MASK 0x0010 /end CHARACTERISTIC
/begin CHARACTERISTIC mfGTLNGp "0:Not DGN  1:DGN" VALUE 0x00016305 REC_UBYTE_C 0 COMP_0283 0 1 BIT_MASK 0x0008 /end CHARACTERISTIC
/begin CHARACTERISTIC mfGTHNGp "0:Not DGN  1:DGN" VALUE 0x00016305 REC_UBYTE_C 0 COMP_0283 0 1 BIT_MASK 0x0004 /end CHARACTERISTIC
/begin CHARACTERISTIC mfGPLNGp "0:Not DGN  1:DGN" VALUE 0x00016305 REC_UBYTE_C 0 COMP_0283 0 1 BIT_MASK 0x0002 /end CHARACTERISTIC
/begin CHARACTERISTIC mfGPHNGp "0:Not DGN  1:DGN" VALUE 0x00016305 REC_UBYTE_C 0 COMP_0283 0 1 BIT_MASK 0x0001 /end CHARACTERISTIC
/begin CHARACTERISTIC mDGNSW[94] "Flag mDGNSW[94]" VALUE 0x00016306 REC_UBYTE_C 0 COMP_0283 0 255 /end CHARACTERISTIC
/begin CHARACTERISTIC mfLFPNGp "0:Not DGN  1:DGN" VALUE 0x00016306 REC_UBYTE_C 0 COMP_0283 0 1 BIT_MASK 0x0080 /end CHARACTERISTIC
/begin CHARACTERISTIC mfHFPNGp "0:Not DGN  1:DGN" VALUE 0x00016306 REC_UBYTE_C 0 COMP_0283 0 1 BIT_MASK 0x0040 /end CHARACTERISTIC
/begin CHARACTERISTIC mfBOVNGp "0:Not DGN  1:DGN" VALUE 0x00016306 REC_UBYTE_C 0 COMP_0283 0 1 BIT_MASK 0x0008 /end CHARACTERISTIC
/begin CHARACTERISTIC mfDEVNGp "0:Not DGN  1:DGN" VALUE 0x00016306 REC_UBYTE_C 0 COMP_0283 0 1 BIT_MASK 0x0004 /end CHARACTERISTIC
/begin CHARACTERISTIC mfZAVNGp "0:Not DGN  1:DGN" VALUE 0x00016306 REC_UBYTE_C 0 COMP_0283 0 1 BIT_MASK 0x0002 /end CHARACTERISTIC
/begin CHARACTERISTIC mfISKNGp "0:Not DGN  1:DGN" VALUE 0x00016306 REC_UBYTE_C 0 COMP_0283 0 1 BIT_MASK 0x0001 /end CHARACTERISTIC
/begin CHARACTERISTIC mDGNSW[95] "Flag mDGNSW[95]" VALUE 0x00016307 REC_UBYTE_C 0 COMP_0283 0 255 /end CHARACTERISTIC
/begin CHARACTERISTIC mfLI1NGp "0:Not DGN  1:DGN" VALUE 0x00016307 REC_UBYTE_C 0 COMP_0283 0 1 BIT_MASK 0x0080 /end CHARACTERISTIC
/begin CHARACTERISTIC mfLI2NGp "0:Not DGN  1:DGN" VALUE 0x00016307 REC_UBYTE_C 0 COMP_0283 0 1 BIT_MASK 0x0040 /end CHARACTERISTIC
/begin CHARACTERISTIC mfLI3NGp "0:Not DGN  1:DGN" VALUE 0x00016307 REC_UBYTE_C 0 COMP_0283 0 1 BIT_MASK 0x0020 /end CHARACTERISTIC
/begin CHARACTERISTIC mfLI4NGp "0:Not DGN  1:DGN" VALUE 0x00016307 REC_UBYTE_C 0 COMP_0283 0 1 BIT_MASK 0x0010 /end CHARACTERISTIC
/begin CHARACTERISTIC mfFR2NGp "0:Not DGN  1:DGN" VALUE 0x00016307 REC_UBYTE_C 0 COMP_0283 0 1 BIT_MASK 0x0008 /end CHARACTERISTIC
/begin CHARACTERISTIC mfFR3NGp "0:Not DGN  1:DGN" VALUE 0x00016307 REC_UBYTE_C 0 COMP_0283 0 1 BIT_MASK 0x0004 /end CHARACTERISTIC
/begin CHARACTERISTIC mfTANTRH "0:Not DGN  1:DGN" VALUE 0x00016307 REC_UBYTE_C 0 COMP_0283 0 1 BIT_MASK 0x0002 /end CHARACTERISTIC
/begin CHARACTERISTIC mfTANTRL "0:Not DGN  1:DGN" VALUE 0x00016307 REC_UBYTE_C 0 COMP_0283 0 1 BIT_MASK 0x0001 /end CHARACTERISTIC
/begin CHARACTERISTIC mDGNSW[96] "Flag mDGNSW[96]" VALUE 0x00016308 REC_UBYTE_C 0 COMP_0283 0 255 /end CHARACTERISTIC
/begin CHARACTERISTIC mfOVHET2 "0:Not DGN  1:DGN" VALUE 0x00016308 REC_UBYTE_C 0 COMP_0283 0 1 BIT_MASK 0x0080 /end CHARACTERISTIC
/begin CHARACTERISTIC mfLFPHNG "0:Not DGN  1:DGN" VALUE 0x00016308 REC_UBYTE_C 0 COMP_0283 0 1 BIT_MASK 0x0040 /end CHARACTERISTIC
/begin CHARACTERISTIC mfLFPLNG "0:Not DGN  1:DGN" VALUE 0x00016308 REC_UBYTE_C 0 COMP_0283 0 1 BIT_MASK 0x0020 /end CHARACTERISTIC
/begin CHARACTERISTIC mfLFPFNG "0:Not DGN  1:DGN" VALUE 0x00016308 REC_UBYTE_C 0 COMP_0283 0 1 BIT_MASK 0x0010 /end CHARACTERISTIC
/begin CHARACTERISTIC mfLFPPNG "0:Not DGN  1:DGN" VALUE 0x00016308 REC_UBYTE_C 0 COMP_0283 0 1 BIT_MASK 0x0008 /end CHARACTERISTIC
/begin CHARACTERISTIC mfPSTNG3 "0:Not DGN  1:DGN" VALUE 0x00016308 REC_UBYTE_C 0 COMP_0283 0 1 BIT_MASK 0x0004 /end CHARACTERISTIC
/begin CHARACTERISTIC mfPSTNG2 "0:Not DGN  1:DGN" VALUE 0x00016308 REC_UBYTE_C 0 COMP_0283 0 1 BIT_MASK 0x0002 /end CHARACTERISTIC
/begin CHARACTERISTIC mfPSTNG1 "0:Not DGN  1:DGN" VALUE 0x00016308 REC_UBYTE_C 0 COMP_0283 0 1 BIT_MASK 0x0001 /end CHARACTERISTIC
/begin CHARACTERISTIC mDGNSW[97] "Flag mDGNSW[97]" VALUE 0x00016309 REC_UBYTE_C 0 COMP_0283 0 255 /end CHARACTERISTIC
/begin CHARACTERISTIC mfLFPONG "0:Not DGN  1:DGN" VALUE 0x00016309 REC_UBYTE_C 0 COMP_0283 0 1 BIT_MASK 0x0080 /end CHARACTERISTIC
/begin CHARACTERISTIC mfLFPRNG "0:Not DGN  1:DGN" VALUE 0x00016309 REC_UBYTE_C 0 COMP_0283 0 1 BIT_MASK 0x0040 /end CHARACTERISTIC
/begin CHARACTERISTIC mfCSSIT "0:Not DGN  1:DGN" VALUE 0x00016309 REC_UBYTE_C 0 COMP_0283 0 1 BIT_MASK 0x0020 /end CHARACTERISTIC
/begin CHARACTERISTIC mfCSSKRT "0:Not DGN  1:DGN" VALUE 0x00016309 REC_UBYTE_C 0 COMP_0283 0 1 BIT_MASK 0x0010 /end CHARACTERISTIC
/begin CHARACTERISTIC mfCSSDIG "0:Not DGN  1:DGN" VALUE 0x00016309 REC_UBYTE_C 0 COMP_0283 0 1 BIT_MASK 0x0008 /end CHARACTERISTIC
/begin CHARACTERISTIC mfTHCLNG "0:Not DGN  1:DGN" VALUE 0x00016309 REC_UBYTE_C 0 COMP_0283 0 1 BIT_MASK 0x0004 /end CHARACTERISTIC
/begin CHARACTERISTIC mfTHNGH "0:Not DGN  1:DGN" VALUE 0x00016309 REC_UBYTE_C 0 COMP_0283 0 1 BIT_MASK 0x0002 /end CHARACTERISTIC
/begin CHARACTERISTIC mfTHNGL "0:Not DGN  1:DGN" VALUE 0x00016309 REC_UBYTE_C 0 COMP_0283 0 1 BIT_MASK 0x0001 /end CHARACTERISTIC
/begin CHARACTERISTIC mDGNSW[98] "Flag mDGNSW[98]" VALUE 0x0001630A REC_UBYTE_C 0 COMP_0283 0 255 /end CHARACTERISTIC
/begin CHARACTERISTIC mfVSI1NG "0:Not DGN  1:DGN" VALUE 0x0001630A REC_UBYTE_C 0 COMP_0283 0 1 BIT_MASK 0x0080 /end CHARACTERISTIC
/begin CHARACTERISTIC mfVSI2NG "0:Not DGN  1:DGN" VALUE 0x0001630A REC_UBYTE_C 0 COMP_0283 0 1 BIT_MASK 0x0040 /end CHARACTERISTIC
/begin CHARACTERISTIC mfVSO1NG "0:Not DGN  1:DGN" VALUE 0x0001630A REC_UBYTE_C 0 COMP_0283 0 1 BIT_MASK 0x0020 /end CHARACTERISTIC
/begin CHARACTERISTIC mfVSO2NG "0:Not DGN  1:DGN" VALUE 0x0001630A REC_UBYTE_C 0 COMP_0283 0 1 BIT_MASK 0x0010 /end CHARACTERISTIC
/begin CHARACTERISTIC mfSTCTNG "0:Not DGN  1:DGN" VALUE 0x0001630A REC_UBYTE_C 0 COMP_0283 0 1 BIT_MASK 0x0008 /end CHARACTERISTIC
/begin CHARACTERISTIC mfVSUNG "0:Not DGN  1:DGN" VALUE 0x0001630A REC_UBYTE_C 0 COMP_0283 0 1 BIT_MASK 0x0004 /end CHARACTERISTIC
/begin CHARACTERISTIC mfVSSNG "0:Not DGN  1:DGN" VALUE 0x0001630A REC_UBYTE_C 0 COMP_0283 0 1 BIT_MASK 0x0002 /end CHARACTERISTIC
/begin CHARACTERISTIC mfISNSNG "0:Not DGN  1:DGN" VALUE 0x0001630A REC_UBYTE_C 0 COMP_0283 0 1 BIT_MASK 0x0001 /end CHARACTERISTIC
/begin CHARACTERISTIC mDGNSW[99] "Flag mDGNSW[99]" VALUE 0x0001630B REC_UBYTE_C 0 COMP_0283 0 255 /end CHARACTERISTIC
/begin CHARACTERISTIC mfBPS4NG "0:Not DGN  1:DGN" VALUE 0x0001630B REC_UBYTE_C 0 COMP_0283 0 1 BIT_MASK 0x0020 /end CHARACTERISTIC
/begin CHARACTERISTIC mfBP12NG "0:Not DGN  1:DGN" VALUE 0x0001630B REC_UBYTE_C 0 COMP_0283 0 1 BIT_MASK 0x0010 /end CHARACTERISTIC
/begin CHARACTERISTIC mfBP2NGH "0:Not DGN  1:DGN" VALUE 0x0001630B REC_UBYTE_C 0 COMP_0283 0 1 BIT_MASK 0x0008 /end CHARACTERISTIC
/begin CHARACTERISTIC mfBP2NGL "0:Not DGN  1:DGN" VALUE 0x0001630B REC_UBYTE_C 0 COMP_0283 0 1 BIT_MASK 0x0004 /end CHARACTERISTIC
/begin CHARACTERISTIC mfBP1NGH "0:Not DGN  1:DGN" VALUE 0x0001630B REC_UBYTE_C 0 COMP_0283 0 1 BIT_MASK 0x0002 /end CHARACTERISTIC
/begin CHARACTERISTIC mfBP1NGL "0:Not DGN  1:DGN" VALUE 0x0001630B REC_UBYTE_C 0 COMP_0283 0 1 BIT_MASK 0x0001 /end CHARACTERISTIC
/begin CHARACTERISTIC mDGNSW[100 "Flag mDGNSW[100" VALUE 0x0001630C REC_UBYTE_C 0 COMP_0283 0 255 /end CHARACTERISTIC
/begin CHARACTERISTIC mfECMTMH "0:Not DGN  1:DGN" VALUE 0x0001630C REC_UBYTE_C 0 COMP_0283 0 1 BIT_MASK 0x0080 /end CHARACTERISTIC
/begin CHARACTERISTIC mfAFMRM1 "0:Not DGN  1:DGN" VALUE 0x0001630C REC_UBYTE_C 0 COMP_0283 0 1 BIT_MASK 0x0040 /end CHARACTERISTIC
/begin CHARACTERISTIC mfAFMRM2 "0:Not DGN  1:DGN" VALUE 0x0001630C REC_UBYTE_C 0 COMP_0283 0 1 BIT_MASK 0x0020 /end CHARACTERISTIC
/begin CHARACTERISTIC mfAFMFS1 "0:Not DGN  1:DGN" VALUE 0x0001630C REC_UBYTE_C 0 COMP_0283 0 1 BIT_MASK 0x0010 /end CHARACTERISTIC
/begin CHARACTERISTIC mfAFMFS2 "0:Not DGN  1:DGN" VALUE 0x0001630C REC_UBYTE_C 0 COMP_0283 0 1 BIT_MASK 0x0008 /end CHARACTERISTIC
/begin CHARACTERISTIC mfLFGSNG "0:Not DGN  1:DGN" VALUE 0x0001630C REC_UBYTE_C 0 COMP_0283 0 1 BIT_MASK 0x0004 /end CHARACTERISTIC
/begin CHARACTERISTIC mfPLGSNG "0:Not DGN  1:DGN" VALUE 0x0001630C REC_UBYTE_C 0 COMP_0283 0 1 BIT_MASK 0x0002 /end CHARACTERISTIC
/begin CHARACTERISTIC mfPRGSNG "0:Not DGN  1:DGN" VALUE 0x0001630C REC_UBYTE_C 0 COMP_0283 0 1 BIT_MASK 0x0001 /end CHARACTERISTIC
/begin CHARACTERISTIC mDGNSW[101 "Flag mDGNSW[101" VALUE 0x0001630D REC_UBYTE_C 0 COMP_0283 0 255 /end CHARACTERISTIC
/begin CHARACTERISTIC mfRCS2NG "0:Not DGN  1:DGN" VALUE 0x0001630D REC_UBYTE_C 0 COMP_0283 0 1 BIT_MASK 0x0040 /end CHARACTERISTIC
/begin CHARACTERISTIC mfRCS1NG "0:Not DGN  1:DGN" VALUE 0x0001630D REC_UBYTE_C 0 COMP_0283 0 1 BIT_MASK 0x0020 /end CHARACTERISTIC
/begin CHARACTERISTIC mfSSGROT "0:Not DGN  1:DGN" VALUE 0x0001630D REC_UBYTE_C 0 COMP_0283 0 1 BIT_MASK 0x0010 /end CHARACTERISTIC
/begin CHARACTERISTIC mfSSGNG1 "0:Not DGN  1:DGN" VALUE 0x0001630D REC_UBYTE_C 0 COMP_0283 0 1 BIT_MASK 0x0008 /end CHARACTERISTIC
/begin CHARACTERISTIC mfSSGNG2 "0:Not DGN  1:DGN" VALUE 0x0001630D REC_UBYTE_C 0 COMP_0283 0 1 BIT_MASK 0x0004 /end CHARACTERISTIC
/begin CHARACTERISTIC mfSSGINH "0:Not DGN  1:DGN" VALUE 0x0001630D REC_UBYTE_C 0 COMP_0283 0 1 BIT_MASK 0x0002 /end CHARACTERISTIC
/begin CHARACTERISTIC mfSSGCRK "0:Not DGN  1:DGN" VALUE 0x0001630D REC_UBYTE_C 0 COMP_0283 0 1 BIT_MASK 0x0001 /end CHARACTERISTIC
/begin CHARACTERISTIC mDGNSW[102 "Flag mDGNSW[102" VALUE 0x0001630E REC_UBYTE_C 0 COMP_0283 0 255 /end CHARACTERISTIC
/begin CHARACTERISTIC mfMCTHNG "0:Not DGN  1:DGN" VALUE 0x0001630E REC_UBYTE_C 0 COMP_0283 0 1 BIT_MASK 0x0080 /end CHARACTERISTIC
/begin CHARACTERISTIC mfLINBOF "0:Not DGN  1:DGN" VALUE 0x0001630E REC_UBYTE_C 0 COMP_0283 0 1 BIT_MASK 0x0040 /end CHARACTERISTIC
/begin CHARACTERISTIC mfVSCS "0:Not DGN  1:DGN" VALUE 0x0001630E REC_UBYTE_C 0 COMP_0283 0 1 BIT_MASK 0x0020 /end CHARACTERISTIC
/begin CHARACTERISTIC mfVSRES "0:Not DGN  1:DGN" VALUE 0x0001630E REC_UBYTE_C 0 COMP_0283 0 1 BIT_MASK 0x0010 /end CHARACTERISTIC
/begin CHARACTERISTIC mfSSGCS "0:Not DGN  1:DGN" VALUE 0x0001630E REC_UBYTE_C 0 COMP_0283 0 1 BIT_MASK 0x0008 /end CHARACTERISTIC
/begin CHARACTERISTIC mfSSGRES "0:Not DGN  1:DGN" VALUE 0x0001630E REC_UBYTE_C 0 COMP_0283 0 1 BIT_MASK 0x0004 /end CHARACTERISTIC
/begin CHARACTERISTIC mfECMSND "0:Not DGN  1:DGN" VALUE 0x0001630E REC_UBYTE_C 0 COMP_0283 0 1 BIT_MASK 0x0002 /end CHARACTERISTIC
/begin CHARACTERISTIC mfDCMTDG "0:Not DGN  1:DGN" VALUE 0x0001630E REC_UBYTE_C 0 COMP_0283 0 1 BIT_MASK 0x0001 /end CHARACTERISTIC
/begin CHARACTERISTIC mDGNSW[103 "Flag mDGNSW[103" VALUE 0x0001630F REC_UBYTE_C 0 COMP_0283 0 255 /end CHARACTERISTIC
/begin CHARACTERISTIC mfBRKPNG "0:Not DGN  1:DGN" VALUE 0x0001630F REC_UBYTE_C 0 COMP_0283 0 1 BIT_MASK 0x0080 /end CHARACTERISTIC
/begin CHARACTERISTIC mfBNCON "0:Not DGN  1:DGN" VALUE 0x0001630F REC_UBYTE_C 0 COMP_0283 0 1 BIT_MASK 0x0040 /end CHARACTERISTIC
/begin CHARACTERISTIC mfBNCOF "0:Not DGN  1:DGN" VALUE 0x0001630F REC_UBYTE_C 0 COMP_0283 0 1 BIT_MASK 0x0020 /end CHARACTERISTIC
/begin CHARACTERISTIC mfBSONNG "0:Not DGN  1:DGN" VALUE 0x0001630F REC_UBYTE_C 0 COMP_0283 0 1 BIT_MASK 0x0010 /end CHARACTERISTIC
/begin CHARACTERISTIC mfISSTOP "0:Not DGN  1:DGN" VALUE 0x0001630F REC_UBYTE_C 0 COMP_0283 0 1 BIT_MASK 0x0008 /end CHARACTERISTIC
/begin CHARACTERISTIC mfISINON "0:Not DGN  1:DGN" VALUE 0x0001630F REC_UBYTE_C 0 COMP_0283 0 1 BIT_MASK 0x0004 /end CHARACTERISTIC
/begin CHARACTERISTIC mfISSTON "0:Not DGN  1:DGN" VALUE 0x0001630F REC_UBYTE_C 0 COMP_0283 0 1 BIT_MASK 0x0002 /end CHARACTERISTIC
/begin CHARACTERISTIC mfISSTOF "0:Not DGN  1:DGN" VALUE 0x0001630F REC_UBYTE_C 0 COMP_0283 0 1 BIT_MASK 0x0001 /end CHARACTERISTIC
/begin CHARACTERISTIC mDGNSW[104 "Flag mDGNSW[104" VALUE 0x00016310 REC_UBYTE_C 0 COMP_0283 0 255 /end CHARACTERISTIC
/begin CHARACTERISTIC mfMCTONG "0:Not DGN  1:DGN" VALUE 0x00016310 REC_UBYTE_C 0 COMP_0283 0 1 BIT_MASK 0x0080 /end CHARACTERISTIC
/begin CHARACTERISTIC mfMCTFNG "0:Not DGN  1:DGN" VALUE 0x00016310 REC_UBYTE_C 0 COMP_0283 0 1 BIT_MASK 0x0040 /end CHARACTERISTIC
/begin CHARACTERISTIC mfMCTANG "0:Not DGN  1:DGN" VALUE 0x00016310 REC_UBYTE_C 0 COMP_0283 0 1 BIT_MASK 0x0020 /end CHARACTERISTIC
/begin CHARACTERISTIC mfMCTWNG "0:Not DGN  1:DGN" VALUE 0x00016310 REC_UBYTE_C 0 COMP_0283 0 1 BIT_MASK 0x0010 /end CHARACTERISTIC
/begin CHARACTERISTIC mfCRPNG2 "0:Not DGN  1:DGN" VALUE 0x00016310 REC_UBYTE_C 0 COMP_0283 0 1 BIT_MASK 0x0008 /end CHARACTERISTIC
/begin CHARACTERISTIC mfCNGST2 "0:Not DGN  1:DGN" VALUE 0x00016310 REC_UBYTE_C 0 COMP_0283 0 1 BIT_MASK 0x0004 /end CHARACTERISTIC
/begin CHARACTERISTIC mfLBRNG2 "0:Not DGN  1:DGN" VALUE 0x00016310 REC_UBYTE_C 0 COMP_0283 0 1 BIT_MASK 0x0002 /end CHARACTERISTIC
/begin CHARACTERISTIC mfLBTNG2 "0:Not DGN  1:DGN" VALUE 0x00016310 REC_UBYTE_C 0 COMP_0283 0 1 BIT_MASK 0x0001 /end CHARACTERISTIC
/begin CHARACTERISTIC mDGNSW[105 "Flag mDGNSW[105" VALUE 0x00016311 REC_UBYTE_C 0 COMP_0283 0 255 /end CHARACTERISTIC
/begin CHARACTERISTIC mfVDRING "0:Not DGN  1:DGN" VALUE 0x00016311 REC_UBYTE_C 0 COMP_0283 0 1 BIT_MASK 0x0080 /end CHARACTERISTIC
/begin CHARACTERISTIC mfVSPLRA "0:Not DGN  1:DGN" VALUE 0x00016311 REC_UBYTE_C 0 COMP_0283 0 1 BIT_MASK 0x0040 /end CHARACTERISTIC
/begin CHARACTERISTIC mfVSPLDR "0:Not DGN  1:DGN" VALUE 0x00016311 REC_UBYTE_C 0 COMP_0283 0 1 BIT_MASK 0x0020 /end CHARACTERISTIC
/begin CHARACTERISTIC mfVSPLDL "0:Not DGN  1:DGN" VALUE 0x00016311 REC_UBYTE_C 0 COMP_0283 0 1 BIT_MASK 0x0010 /end CHARACTERISTIC
/begin CHARACTERISTIC mfGCALNG "0:Not DGN  1:DGN" VALUE 0x00016311 REC_UBYTE_C 0 COMP_0283 0 1 BIT_MASK 0x0008 /end CHARACTERISTIC
/begin CHARACTERISTIC mfGRVRAT "0:Not DGN  1:DGN" VALUE 0x00016311 REC_UBYTE_C 0 COMP_0283 0 1 BIT_MASK 0x0004 /end CHARACTERISTIC
/begin CHARACTERISTIC mfGRVOOR "0:Not DGN  1:DGN" VALUE 0x00016311 REC_UBYTE_C 0 COMP_0283 0 1 BIT_MASK 0x0002 /end CHARACTERISTIC
/begin CHARACTERISTIC mfEPBPCR "0:Not DGN  1:DGN" VALUE 0x00016311 REC_UBYTE_C 0 COMP_0283 0 1 BIT_MASK 0x0001 /end CHARACTERISTIC
/begin CHARACTERISTIC mDGNSW[106 "Flag mDGNSW[106" VALUE 0x00016312 REC_UBYTE_C 0 COMP_0283 0 255 /end CHARACTERISTIC
/begin CHARACTERISTIC mfGRVNGL "0:Not DGN  1:DGN" VALUE 0x00016312 REC_UBYTE_C 0 COMP_0283 0 1 BIT_MASK 0x0004 /end CHARACTERISTIC
/begin CHARACTERISTIC mfGRVNGH "0:Not DGN  1:DGN" VALUE 0x00016312 REC_UBYTE_C 0 COMP_0283 0 1 BIT_MASK 0x0002 /end CHARACTERISTIC
/begin CHARACTERISTIC mfEGVRNG "0:Not DGN  1:DGN" VALUE 0x00016312 REC_UBYTE_C 0 COMP_0283 0 1 BIT_MASK 0x0001 /end CHARACTERISTIC
/begin CHARACTERISTIC isumchk "ROM Const isumchk" VALUE 0x00020404 REC_ULONG_C 0 COMP_0068 0 4294967295 /end CHARACTERISTIC
/begin CHARACTERISTIC iptychk "ROM Const iptychk" VALUE 0x00020408 REC_ULONG_C 0 COMP_0068 0 4294967295 /end CHARACTERISTIC
/begin CHARACTERISTIC mBLNKECNO "Table mBLNKECNO" CURVE 0x00006F00 REC_UBYTE_C 0 COMP_0662_S 0 255
 /begin AXIS_DESCR FIX_AXIS NO_INPUT_QUANTITY COMP_0000_S 5 0 4 FIX_AXIS_PAR_DIST 0 1 5 /end AXIS_DESCR
/end CHARACTERISTIC
/* MEASUREMENT --------------------------------------------------------- */
/begin MEASUREMENT fABFADJ "0:λ点補正値算出処理未了  1:λ点補正値算出処理終了" UBYTE COMP_0283 1 100 0 1 BIT_MASK 0x0002 ECU_ADDRESS 0xFFFF338C READ_WRITE /end MEASUREMENT
/begin MEASUREMENT fABFCMP "0:目標A/F固定制御不成立  1:目標A/F固定制御中" UBYTE COMP_0283 1 100 0 1 BIT_MASK 0x0002 ECU_ADDRESS 0xFFFF09FC READ_WRITE /end MEASUREMENT
/begin MEASUREMENT fAFAV "0:燃料リカバー時診断領域条件を判定  1:燃料リカバー時診断領域条件を判定" UBYTE COMP_0283 1 100 0 1 BIT_MASK 0x0002 ECU_ADDRESS 0xFFFF0A1F READ_WRITE /end MEASUREMENT
/begin MEASUREMENT fAFAVCAL "0:前A/Fｾﾝｻ中間電位故障診断を行わな  1:前A/Fｾﾝｻ中間電位故障診断を行う" UBYTE COMP_0283 1 100 0 1 BIT_MASK 0x0002 ECU_ADDRESS 0xFFFF0A1E READ_WRITE /end MEASUREMENT
/begin MEASUREMENT fAFBINT "0:初期化済みでは無い  1:初期化済み" UBYTE COMP_0283 1 100 0 1 BIT_MASK 0x0002 ECU_ADDRESS 0xFFFF0A20 READ_WRITE /end MEASUREMENT
/begin MEASUREMENT fAFDALP "0:不成立  1:成立" UBYTE COMP_0283 1 100 0 1 BIT_MASK 0x0002 ECU_ADDRESS 0xFFFF2266 READ_WRITE /end MEASUREMENT
/begin MEASUREMENT fAFDTGT "0:不成立  1:成立" UBYTE COMP_0283 1 100 0 1 BIT_MASK 0x0002 ECU_ADDRESS 0xFFFF226F READ_WRITE /end MEASUREMENT
/begin MEASUREMENT fAFHCONT "0:不成立  1:ﾋｰﾀ-制御許可条件成立" UBYTE COMP_0283 1 100 0 1 BIT_MASK 0x0002 ECU_ADDRESS 0xFFFF33D5 READ_WRITE /end MEASUREMENT
/begin MEASUREMENT fAFHMOD1A "0:移行未  1:移行済" UBYTE COMP_0283 1 100 0 1 BIT_MASK 0x0002 ECU_ADDRESS 0xFFFF33D6 READ_WRITE /end MEASUREMENT
/begin MEASUREMENT fAFHMODE "0:非制御  1:ﾋｰﾀ-制御中" UBYTE COMP_0283 1 100 0 1 BIT_MASK 0x0002 ECU_ADDRESS 0xFFFF1FB2 READ_WRITE /end MEASUREMENT
/begin MEASUREMENT fAFHON "0:A/FｾﾝｻﾋｰﾀOFF  1:A/FｾﾝｻﾋｰﾀON" UBYTE COMP_0283 1 100 0 1 BIT_MASK 0x0002 ECU_ADDRESS 0xFFFF1FB3 READ_WRITE /end MEASUREMENT
/begin MEASUREMENT wfAFHON "0:A/FｾﾝｻﾋｰﾀOFF  1:A/FｾﾝｻﾋｰﾀON" UBYTE COMP_0283 1 100 0 1 BIT_MASK 0x0002 ECU_ADDRESS 0xFFFF1E7F READ_WRITE /end MEASUREMENT
/begin MEASUREMENT fAFHZ "0:燃料リカバー時診断領域条件を判定  1:燃料リカバー時診断領域条件を判定" UBYTE COMP_0283 1 100 0 1 BIT_MASK 0x0002 ECU_ADDRESS 0xFFFF0A22 READ_WRITE /end MEASUREMENT
/begin MEASUREMENT fAFHZCAL "0:前A/Fｾﾝｻﾘｯﾁ→ﾘｰﾝ応答診断を行わな  1:前A/Fｾﾝｻﾘｯﾁ→ﾘｰﾝ応答診断を行う" UBYTE COMP_0283 1 100 0 1 BIT_MASK 0x0002 ECU_ADDRESS 0xFFFF0A21 READ_WRITE /end MEASUREMENT
/begin MEASUREMENT fAFHZGO "0:診断領域条件不成立  1:診断領域条件成立" UBYTE COMP_0283 1 100 0 1 BIT_MASK 0x0002 ECU_ADDRESS 0xFFFF2270 READ_WRITE /end MEASUREMENT
/begin MEASUREMENT fAFHZLROK "0:リッチ→リーン応答劣化診断OK判定  1:リッチ→リーン応答劣化診断OK判定" UBYTE COMP_0283 1 100 0 1 BIT_MASK 0x0002 ECU_ADDRESS 0xFFFF2271 READ_WRITE /end MEASUREMENT
/begin MEASUREMENT fAFHZRCV "0:リーン→リッチ応答劣化診断領域条  1:リーン→リッチ応答劣化診断領域条" UBYTE COMP_0283 1 100 0 1 BIT_MASK 0x0002 ECU_ADDRESS 0xFFFF0A23 READ_WRITE /end MEASUREMENT
/begin MEASUREMENT fAFHZRLOK "0:リーン→リッチ応答劣化診断OK判定  1:リーン→リッチ応答劣化診断OK判定" UBYTE COMP_0283 1 100 0 1 BIT_MASK 0x0002 ECU_ADDRESS 0xFFFF2272 READ_WRITE /end MEASUREMENT
/begin MEASUREMENT fAFKDST "0:非診断中  1:診断中" UBYTE COMP_0283 1 100 0 1 BIT_MASK 0x0002 ECU_ADDRESS 0xFFFF2274 READ_WRITE /end MEASUREMENT
/begin MEASUREMENT fAFLREND "0:前A/Fｾﾝｻ応答劣化診断未終了(ﾘｯﾁ→  1:前A/Fｾﾝｻ応答劣化診断終了(ﾘｯﾁ→ﾘｰ" UBYTE COMP_0283 1 100 0 1 BIT_MASK 0x0002 ECU_ADDRESS 0xFFFF2276 READ_WRITE /end MEASUREMENT
/begin MEASUREMENT fAFLSTRP "0:A/Fｾﾝｻｼﾌﾄ診断ﾘｰﾝｼﾌﾄ診断TRIP未判  1:A/Fｾﾝｻｼﾌﾄ診断ﾘｰﾝｼﾌﾄ診断TRIP判定" UBYTE COMP_0283 1 100 0 1 BIT_MASK 0x0002 ECU_ADDRESS 0xFFFF2277 READ_WRITE /end MEASUREMENT
/begin MEASUREMENT fAFMODE1C "0:WETTIME経過による移行  1:ﾄﾞﾗｲ判定による移行" UBYTE COMP_0283 1 100 0 1 BIT_MASK 0x0002 ECU_ADDRESS 0xFFFF33D9 READ_WRITE /end MEASUREMENT
/begin MEASUREMENT fAFOFLG "0:A/Fｾﾝｻ断線診断GST出力ﾃﾞｰﾀ更新可  1:A/Fｾﾝｻ断線診断GST出力ﾃﾞｰﾀ更新不" UBYTE COMP_0283 1 100 0 1 BIT_MASK 0x0002 ECU_ADDRESS 0xFFFF2281 READ_WRITE /end MEASUREMENT
/begin MEASUREMENT fAFOHONO "0:後O2ｾﾝｻのﾋｰﾀが最初からＯＮでない  1:後O2ｾﾝｻのﾋｰﾀが最初にＯＮになった" UBYTE COMP_0283 1 100 0 1 BIT_MASK 0x0002 ECU_ADDRESS 0xFFFF2282 READ_WRITE /end MEASUREMENT
/begin MEASUREMENT fAFOK "0:A/Fｾﾝｻ断線診断正常時GST出力ﾃﾞｰﾀ  1:A/Fｾﾝｻ断線診断正常時GST出力ﾃﾞｰﾀ" UBYTE COMP_0283 1 100 0 1 BIT_MASK 0x0002 ECU_ADDRESS 0xFFFF2283 READ_WRITE /end MEASUREMENT
/begin MEASUREMENT fAFRLEND "0:前A/Fｾﾝｻ応答劣化診断未終了(ﾘｰﾝ→  1:前A/Fｾﾝｻ応答劣化診断終了(ﾘｰﾝ→ﾘｯ" UBYTE COMP_0283 1 100 0 1 BIT_MASK 0x0002 ECU_ADDRESS 0xFFFF2285 READ_WRITE /end MEASUREMENT
/begin MEASUREMENT fAFRSTRP "0:A/Fｾﾝｻｼﾌﾄ診断ﾘｯﾁｼﾌﾄ診断TRIP未判  1:A/Fｾﾝｻｼﾌﾄ診断ﾘｯﾁｼﾌﾄ診断TRIP判定" UBYTE COMP_0283 1 100 0 1 BIT_MASK 0x0002 ECU_ADDRESS 0xFFFF2286 READ_WRITE /end MEASUREMENT
/begin MEASUREMENT fAFSACTM "0:A/Fｾﾝｻ活性判定なし  1:A/Fｾﾝｻ活性判定あり" UBYTE COMP_0283 1 100 0 1 BIT_MASK 0x0002 ECU_ADDRESS 0xFFFF2287 READ_WRITE /end MEASUREMENT
/begin MEASUREMENT fAFSAVEND "0:前A/Fｾﾝｻ中間電位診断未終了  1:前A/Fｾﾝｻ中間電位診断終了" UBYTE COMP_0283 1 100 0 1 BIT_MASK 0x0002 ECU_ADDRESS 0xFFFF228C READ_WRITE /end MEASUREMENT
/begin MEASUREMENT fAFSCLP "0:不成立  1:成立" UBYTE COMP_0283 1 100 0 1 BIT_MASK 0x0002 ECU_ADDRESS 0xFFFF0A25 READ_WRITE /end MEASUREMENT
/begin MEASUREMENT fAFSTAR "0:ﾓﾆﾀ領域外  1:ﾓﾆﾀ領域" UBYTE COMP_0283 1 100 0 1 BIT_MASK 0x0002 ECU_ADDRESS 0xFFFF22AC READ_WRITE /end MEASUREMENT
/begin MEASUREMENT fAFSTKJG "0:診断許可条件不成立  1:診断許可条件成立" UBYTE COMP_0283 1 100 0 1 BIT_MASK 0x0002 ECU_ADDRESS 0xFFFF20FA READ_WRITE /end MEASUREMENT
/begin MEASUREMENT fAFSTKNGE "0:右記以外  1:NG判定済み" UBYTE COMP_0283 1 100 0 1 BIT_MASK 0x0002 ECU_ADDRESS 0xFFFF22AD READ_WRITE /end MEASUREMENT
/begin MEASUREMENT fAHOSINBL "0:AFSHOS更新不許可  1:AFSHOS更新許可" UBYTE COMP_0283 1 100 0 1 BIT_MASK 0x0002 ECU_ADDRESS 0xFFFF22BB READ_WRITE /end MEASUREMENT
/begin MEASUREMENT fALNEND "0:全域反映制御未実行  1:全域反映制御済" UBYTE COMP_0283 1 100 0 1 BIT_MASK 0x0002 ECU_ADDRESS 0xFFFF22CC READ_WRITE /end MEASUREMENT
/begin MEASUREMENT fALNJDG "0:許可条件不成立  1:許可条件成立" UBYTE COMP_0283 1 100 0 1 BIT_MASK 0x0002 ECU_ADDRESS 0xFFFF0A40 READ_WRITE /end MEASUREMENT
/begin MEASUREMENT fALPJDGE "0:未経過  1:経過" UBYTE COMP_0283 1 100 0 1 BIT_MASK 0x0002 ECU_ADDRESS 0xFFFF0A5E READ_WRITE /end MEASUREMENT
/begin MEASUREMENT fALRNOKL "0:全域反映制御ﾘｰﾝ条件不成立  1:全域反映制御ﾘｰﾝ条件成立" UBYTE COMP_0283 1 100 0 1 BIT_MASK 0x0002 ECU_ADDRESS 0xFFFF0A5F READ_WRITE /end MEASUREMENT
/begin MEASUREMENT fALRNOKR "0:全域反映制御ﾘｯﾁ条件不成立  1:全域反映制御ﾘｯﾁ条件成立" UBYTE COMP_0283 1 100 0 1 BIT_MASK 0x0002 ECU_ADDRESS 0xFFFF0A60 READ_WRITE /end MEASUREMENT
/begin MEASUREMENT fARAJBF "0:不成立  1:成立" UBYTE COMP_0283 1 100 0 1 BIT_MASK 0x0002 ECU_ADDRESS 0xFFFF2358 READ_WRITE /end MEASUREMENT
/begin MEASUREMENT fARAJUG "0:不成立  1:成立" UBYTE COMP_0283 1 100 0 1 BIT_MASK 0x0002 ECU_ADDRESS 0xFFFF2359 READ_WRITE /end MEASUREMENT
/begin MEASUREMENT fASHLGO "0:A/Fｾﾝｻ学習不許可  1:A/Fｾﾝｻ学習許可" UBYTE COMP_0283 1 100 0 1 BIT_MASK 0x0002 ECU_ADDRESS 0xFFFF2369 READ_WRITE /end MEASUREMENT
/begin MEASUREMENT fASHLRCV "0:A/Fｾﾝｻｼﾌﾄ学習条件不成立  1:A/Fｾﾝｻｼﾌﾄ学習条件成立" UBYTE COMP_0283 1 100 0 1 BIT_MASK 0x0002 ECU_ADDRESS 0xFFFF236A READ_WRITE /end MEASUREMENT
/begin MEASUREMENT fASHTEND "0:右記以外  1:A/Fｾﾝｻｼﾌﾄ診断終了" UBYTE COMP_0283 1 100 0 1 BIT_MASK 0x0002 ECU_ADDRESS 0xFFFF236B READ_WRITE /end MEASUREMENT
/begin MEASUREMENT fAVGAFH1 "0:設定前  1:初期値設定後" UBYTE COMP_0283 1 100 0 1 BIT_MASK 0x0002 ECU_ADDRESS 0xFFFF344E READ_WRITE /end MEASUREMENT
/begin MEASUREMENT fBASLRNK "0:右記以外  1:更新タイミング" UBYTE COMP_0283 1 100 0 1 BIT_MASK 0x0002 ECU_ADDRESS 0xFFFF0A97 READ_WRITE /end MEASUREMENT
/begin MEASUREMENT fBASLRNKE "0:右記以外  1:更新タイミング" UBYTE COMP_0283 1 100 0 1 BIT_MASK 0x0002 ECU_ADDRESS 0xFFFF0A96 READ_WRITE /end MEASUREMENT
/begin MEASUREMENT fBPRAM1 "0:ｽﾃｰｼﾞ1診断ﾊﾟﾗﾒｰﾀﾊﾞｯｸｱｯﾌﾟ未完  1:ｽﾃｰｼﾞ1診断ﾊﾟﾗﾒｰﾀﾊﾞｯｸｱｯﾌﾟ完了" UBYTE COMP_0283 1 100 0 1 BIT_MASK 0x0002 ECU_ADDRESS 0xFFFF3453 READ_WRITE /end MEASUREMENT
/begin MEASUREMENT fCALPSET "0:未終了  1:終了" UBYTE COMP_0283 1 100 0 1 BIT_MASK 0x0002 ECU_ADDRESS 0xFFFF23FC READ_WRITE /end MEASUREMENT
/begin MEASUREMENT fCATAR2 "0:不成立  1:成立" UBYTE COMP_0283 1 100 0 1 BIT_MASK 0x0002 ECU_ADDRESS 0xFFFF2400 READ_WRITE /end MEASUREMENT
/begin MEASUREMENT fCATARA "0:触媒診断条件未経験  1:触媒診断条件経験" UBYTE COMP_0283 1 100 0 1 BIT_MASK 0x0002 ECU_ADDRESS 0xFFFF2402 READ_WRITE /end MEASUREMENT
/begin MEASUREMENT fCATCNG "0:不成立  1:成立" UBYTE COMP_0283 1 100 0 1 BIT_MASK 0x0002 ECU_ADDRESS 0xFFFF2403 READ_WRITE /end MEASUREMENT
/begin MEASUREMENT fCATDGNST "0:不成立  1:成立" UBYTE COMP_0283 1 100 0 1 BIT_MASK 0x0002 ECU_ADDRESS 0xFFFF2404 READ_WRITE /end MEASUREMENT
/begin MEASUREMENT fCATEND "0:診断未終了  1:診断終了" UBYTE COMP_0283 1 100 0 1 BIT_MASK 0x0002 ECU_ADDRESS 0xFFFF2405 READ_WRITE /end MEASUREMENT
/begin MEASUREMENT fCATENDV "0:診断未終了  1:診断終了" UBYTE COMP_0283 1 100 0 1 BIT_MASK 0x0002 ECU_ADDRESS 0xFFFF2406 READ_WRITE /end MEASUREMENT
/begin MEASUREMENT fCATEVP "0:不成立  1:成立" UBYTE COMP_0283 1 100 0 1 BIT_MASK 0x0002 ECU_ADDRESS 0xFFFF2407 READ_WRITE /end MEASUREMENT
/begin MEASUREMENT fCATJUG "0:不成立  1:成立" UBYTE COMP_0283 1 100 0 1 BIT_MASK 0x0002 ECU_ADDRESS 0xFFFF2408 READ_WRITE /end MEASUREMENT
/begin MEASUREMENT fCATST2 "0:右記以外  1:ステージ2診断へ移行" UBYTE COMP_0283 1 100 0 1 BIT_MASK 0x0002 ECU_ADDRESS 0xFFFF240E READ_WRITE /end MEASUREMENT
/begin MEASUREMENT fCLMP "0:右記以外  1:徐々ｸﾗﾝﾌﾟ中" UBYTE COMP_0283 1 100 0 1 BIT_MASK 0x0002 ECU_ADDRESS 0xFFFF243A READ_WRITE /end MEASUREMENT
/begin MEASUREMENT fCLMPT0 "0:右記以外  1:徐々ｸﾗﾝﾌﾟ中" UBYTE COMP_0283 1 100 0 1 BIT_MASK 0x0002 ECU_ADDRESS 0xFFFF243B READ_WRITE /end MEASUREMENT
/begin MEASUREMENT fCNTSTL "0:ﾊﾞｯｸｱｯﾌﾟ取得不許可  1:ﾊﾞｯｸｱｯﾌﾟ取得許可" UBYTE COMP_0283 1 100 0 1 BIT_MASK 0x0002 ECU_ADDRESS 0xFFFF2101 READ_WRITE /end MEASUREMENT
/begin MEASUREMENT fCNTSTR "0:ﾊﾞｯｸｱｯﾌﾟ取得不許可  1:ﾊﾞｯｸｱｯﾌﾟ取得許可" UBYTE COMP_0283 1 100 0 1 BIT_MASK 0x0002 ECU_ADDRESS 0xFFFF2102 READ_WRITE /end MEASUREMENT
/begin MEASUREMENT fCPCJUG "0:CPC不許可  1:CPC許可" UBYTE COMP_0283 1 100 0 1 BIT_MASK 0x0002 ECU_ADDRESS 0xFFFF3600 READ_WRITE /end MEASUREMENT
/begin MEASUREMENT fCST1OK "0:ステージ１OK未判定  1:ステージ１OK判定" UBYTE COMP_0283 1 100 0 1 BIT_MASK 0x0002 ECU_ADDRESS 0xFFFF2488 READ_WRITE /end MEASUREMENT
/begin MEASUREMENT fCST2NG "0:ステージ2NG未判定  1:ステージ2NG判定" UBYTE COMP_0283 1 100 0 1 BIT_MASK 0x0002 ECU_ADDRESS 0xFFFF2489 READ_WRITE /end MEASUREMENT
/begin MEASUREMENT fCST2OK "0:ステージ2OK未判定  1:ステージ2OK判定" UBYTE COMP_0283 1 100 0 1 BIT_MASK 0x0002 ECU_ADDRESS 0xFFFF248A READ_WRITE /end MEASUREMENT
/begin MEASUREMENT fCVTCCHK "0:CVTC　LO  1:CVTC　HI" UBYTE COMP_0283 1 100 0 1 BIT_MASK 0x0002 ECU_ADDRESS 0xFFFF2020 READ_WRITE /end MEASUREMENT
/begin MEASUREMENT wfCVTCCHK "0:CVTC　LO  1:CVTC　HI" UBYTE COMP_0283 1 100 0 1 BIT_MASK 0x0002 ECU_ADDRESS 0xFFFF1EEC READ_WRITE /end MEASUREMENT
/begin MEASUREMENT fCVTCECHK "0:LOW  1:HIGH" UBYTE COMP_0283 1 100 0 1 BIT_MASK 0x0002 ECU_ADDRESS 0xFFFF2021 READ_WRITE /end MEASUREMENT
/begin MEASUREMENT fDABFHIS "0:全気筒F/C中にDABF≦DABFHIS#を計  1:全気筒F/C中にDABF≦DABFHIS#を計" UBYTE COMP_0283 1 100 0 1 BIT_MASK 0x0002 ECU_ADDRESS 0xFFFF0B02 READ_WRITE /end MEASUREMENT
/begin MEASUREMENT fDCTCNTOK "0:DCTCNT(ﾊﾞﾝｸ対応)ｶｳﾝﾄしない  1:DCTCNT(ﾊﾞﾝｸ対応)ｶｳﾝﾄする" UBYTE COMP_0283 1 100 0 1 BIT_MASK 0x0002 ECU_ADDRESS 0xFFFF2511 READ_WRITE /end MEASUREMENT
/begin MEASUREMENT fDGNGRD "0:不成立  1:成立" UBYTE COMP_0283 1 100 0 1 BIT_MASK 0x0002 ECU_ADDRESS 0xFFFF253E READ_WRITE /end MEASUREMENT
/begin MEASUREMENT fDGNIMD "0:不成立  1:成立" UBYTE COMP_0283 1 100 0 1 BIT_MASK 0x0002 ECU_ADDRESS 0xFFFF253F READ_WRITE /end MEASUREMENT
/begin MEASUREMENT fDLREND "0:未終了  1:終了" UBYTE COMP_0283 1 100 0 1 BIT_MASK 0x0002 ECU_ADDRESS 0xFFFF2570 READ_WRITE /end MEASUREMENT
/begin MEASUREMENT fDLTVRO2 "0:後O2/S診断パラメータ取得禁止  1:後O2/S診断パラメータ取得許可" UBYTE COMP_0283 1 100 0 1 BIT_MASK 0x0002 ECU_ADDRESS 0xFFFF2585 READ_WRITE /end MEASUREMENT
/begin MEASUREMENT fDRLEND "0:未終了  1:終了" UBYTE COMP_0283 1 100 0 1 BIT_MASK 0x0002 ECU_ADDRESS 0xFFFF25A4 READ_WRITE /end MEASUREMENT
/begin MEASUREMENT fDRVJUG "0:運転性対策領域以外  1:運転性対策領域" UBYTE COMP_0283 1 100 0 1 BIT_MASK 0x0002 ECU_ADDRESS 0xFFFF25B6 READ_WRITE /end MEASUREMENT
/begin MEASUREMENT fELNREV "0:ｴﾝｼﾞﾝ16回転していない  1:ｴﾝｼﾞﾝ16回転している" UBYTE COMP_0283 1 100 0 1 BIT_MASK 0x0002 ECU_ADDRESS 0xFFFF0B8A READ_WRITE /end MEASUREMENT
/begin MEASUREMENT fELRNOK "0:領域別学習条件不成立  1:領域別学習条件成立" UBYTE COMP_0283 1 100 0 1 BIT_MASK 0x0002 ECU_ADDRESS 0xFFFF0B8B READ_WRITE /end MEASUREMENT
/begin MEASUREMENT fERRJOK "0:未判定  1:正常判定" UBYTE COMP_0283 1 100 0 1 BIT_MASK 0x0002 ECU_ADDRESS 0xFFFF268F READ_WRITE /end MEASUREMENT
/begin MEASUREMENT fERRJOKE "0:未判定  1:正常判定" UBYTE COMP_0283 1 100 0 1 BIT_MASK 0x0002 ECU_ADDRESS 0xFFFF268E READ_WRITE /end MEASUREMENT
/begin MEASUREMENT fERROR "0:正常  1:異常" UBYTE COMP_0283 1 100 0 1 BIT_MASK 0x0002 ECU_ADDRESS 0xFFFF0B95 READ_WRITE /end MEASUREMENT
/begin MEASUREMENT fERRORE "0:正常  1:異常" UBYTE COMP_0283 1 100 0 1 BIT_MASK 0x0002 ECU_ADDRESS 0xFFFF0B94 READ_WRITE /end MEASUREMENT
/begin MEASUREMENT fFAFAVNG1 "0:前A./Fｾﾝｻ中間電位故障NG1回目判定  1:前A./Fｾﾝｻ中間電位故障NG1回目判定" UBYTE COMP_0283 1 100 0 1 BIT_MASK 0x0002 ECU_ADDRESS 0xFFFF4698 READ_WRITE /end MEASUREMENT
/begin MEASUREMENT fFAFAVNG2 "0:前A./Fｾﾝｻ中間電位故障NG2回目判定  1:前A./Fｾﾝｻ中間電位故障NG2回目判定" UBYTE COMP_0283 1 100 0 1 BIT_MASK 0x0002 ECU_ADDRESS 0xFFFF4699 READ_WRITE /end MEASUREMENT
/begin MEASUREMENT fFAFAVOK "0:前A./Fｾﾝｻ中間電位故障OK判定未識  1:前A./Fｾﾝｻ中間電位故障OK判定識別" UBYTE COMP_0283 1 100 0 1 BIT_MASK 0x0002 ECU_ADDRESS 0xFFFF469A READ_WRITE /end MEASUREMENT
/begin MEASUREMENT fFAFHCN "0:A/Fﾋｰﾀ診断判定ﾄﾘｯﾌﾟ未判定  1:A/Fﾋｰﾀ診断判定ﾄﾘｯﾌﾟ既判定" UBYTE COMP_0283 1 100 0 1 BIT_MASK 0x0002 ECU_ADDRESS 0xFFFF26E9 READ_WRITE /end MEASUREMENT
/begin MEASUREMENT fFAFHFAL "0:右記以外  1:ﾌｪｰﾙﾓｰﾄﾞ" UBYTE COMP_0283 1 100 0 1 BIT_MASK 0x0002 ECU_ADDRESS 0xFFFF1629 READ_WRITE /end MEASUREMENT
/begin MEASUREMENT fFAFHMAX "0:A/Fｾﾝｻﾋｰﾀﾊﾟﾗﾒｰﾀﾊﾞｯｸｱｯﾌﾟ条件非成  1:A/Fｾﾝｻﾋｰﾀﾊﾟﾗﾒｰﾀﾊﾞｯｸｱｯﾌﾟ条件成立" UBYTE COMP_0283 1 100 0 1 BIT_MASK 0x0002 ECU_ADDRESS 0xFFFF26EA READ_WRITE /end MEASUREMENT
/begin MEASUREMENT fFAFHMIN "0:A/Fｾﾝｻﾋｰﾀﾊﾟﾗﾒｰﾀﾊﾞｯｸｱｯﾌﾟ条件非成  1:A/Fｾﾝｻﾋｰﾀﾊﾟﾗﾒｰﾀﾊﾞｯｸｱｯﾌﾟ条件成立" UBYTE COMP_0283 1 100 0 1 BIT_MASK 0x0002 ECU_ADDRESS 0xFFFF26EB READ_WRITE /end MEASUREMENT
/begin MEASUREMENT fFAFHMLOK "0:A/Fﾋｰﾀ診断正常終了未終了  1:A/Fﾋｰﾀ診断正常終了終了" UBYTE COMP_0283 1 100 0 1 BIT_MASK 0x0002 ECU_ADDRESS 0xFFFF26EC READ_WRITE /end MEASUREMENT
/begin MEASUREMENT fFAFHNG1 "0:ﾋｰﾀ診断1stﾄﾘｯﾌﾟNG未検出  1:ﾋｰﾀ診断1stﾄﾘｯﾌﾟNG検出" UBYTE COMP_0283 1 100 0 1 BIT_MASK 0x0002 ECU_ADDRESS 0xFFFF469B READ_WRITE /end MEASUREMENT
/begin MEASUREMENT fFAFHNG2 "0:ﾋｰﾀ診断2ndﾄﾘｯﾌﾟNG未検出  1:ﾋｰﾀ診断2ndﾄﾘｯﾌﾟNG検出" UBYTE COMP_0283 1 100 0 1 BIT_MASK 0x0002 ECU_ADDRESS 0xFFFF469C READ_WRITE /end MEASUREMENT
/begin MEASUREMENT fFAFHOK2 "0:ﾋｰﾀ診断OK未検出  1:ﾋｰﾀ診断OK検出" UBYTE COMP_0283 1 100 0 1 BIT_MASK 0x0002 ECU_ADDRESS 0xFFFF469D READ_WRITE /end MEASUREMENT
/begin MEASUREMENT fFAFHZNG1 "0:前A./Fｾﾝｻ応答劣化診断NG1回目判定  1:前A./Fｾﾝｻ応答劣化診断NG1回目判定" UBYTE COMP_0283 1 100 0 1 BIT_MASK 0x0002 ECU_ADDRESS 0xFFFF469E READ_WRITE /end MEASUREMENT
/begin MEASUREMENT fFAFHZNG2 "0:前A./Fｾﾝｻ応答劣化診断NG2回目判定  1:前A./Fｾﾝｻ応答劣化診断NG2回目判定" UBYTE COMP_0283 1 100 0 1 BIT_MASK 0x0002 ECU_ADDRESS 0xFFFF469F READ_WRITE /end MEASUREMENT
/begin MEASUREMENT fFAFHZOK "0:前A./Fｾﾝｻ応答劣化診断OK判定未識  1:前A./Fｾﾝｻ応答劣化診断OK判定識別" UBYTE COMP_0283 1 100 0 1 BIT_MASK 0x0002 ECU_ADDRESS 0xFFFF46A0 READ_WRITE /end MEASUREMENT
/begin MEASUREMENT fFAFLMT "0:不成立  1:成立" UBYTE COMP_0283 1 100 0 1 BIT_MASK 0x0002 ECU_ADDRESS 0xFFFF26ED READ_WRITE /end MEASUREMENT
/begin MEASUREMENT fFAFLNG1 "0:A./Fｾﾝｻｼﾌﾄ診断ﾘｰﾝｼﾌﾄNG1回目判定  1:A./Fｾﾝｻｼﾌﾄ診断ﾘｰﾝｼﾌﾄNG1回目判定" UBYTE COMP_0283 1 100 0 1 BIT_MASK 0x0002 ECU_ADDRESS 0xFFFF46A1 READ_WRITE /end MEASUREMENT
/begin MEASUREMENT fFAFLNG2 "0:A./Fｾﾝｻｼﾌﾄ診断ﾘｰﾝｼﾌﾄNG2回目判定  1:A./Fｾﾝｻｼﾌﾄ診断ﾘｰﾝｼﾌﾄNG2回目判定" UBYTE COMP_0283 1 100 0 1 BIT_MASK 0x0002 ECU_ADDRESS 0xFFFF46A2 READ_WRITE /end MEASUREMENT
/begin MEASUREMENT fFAFLROK "0:リッチ→リーン応答劣化診断OK判定  1:リッチ→リーン応答劣化診断OK判定" UBYTE COMP_0283 1 100 0 1 BIT_MASK 0x0002 ECU_ADDRESS 0xFFFF46A3 READ_WRITE /end MEASUREMENT
/begin MEASUREMENT fFAFMLOK "0:A/Fｾﾝｻ診断OK未終了  1:A/Fｾﾝｻ診断OK終了" UBYTE COMP_0283 1 100 0 1 BIT_MASK 0x0002 ECU_ADDRESS 0xFFFF26EE READ_WRITE /end MEASUREMENT
/begin MEASUREMENT fFAFOK2 "0:A/Fｾﾝｻ診断未終了  1:A/Fｾﾝｻ診断終了" UBYTE COMP_0283 1 100 0 1 BIT_MASK 0x0002 ECU_ADDRESS 0xFFFF46A4 READ_WRITE /end MEASUREMENT
/begin MEASUREMENT fFAFONG1 "0:A/Fｾﾝｻ断線診断１ｓｔﾄﾘｯﾌﾟNG検出  1:E/Fｾﾝｻ断線診断１ｓｔﾄﾘｯﾌﾟNG検出" UBYTE COMP_0283 1 100 0 1 BIT_MASK 0x0002 ECU_ADDRESS 0xFFFF46A5 READ_WRITE /end MEASUREMENT
/begin MEASUREMENT fFAFONG2 "0:A/Fｾﾝｻ断線診断２ｓｔﾄﾘｯﾌﾟNG検出  1:E/Fｾﾝｻ断線診断２ｓｔﾄﾘｯﾌﾟNG検出" UBYTE COMP_0283 1 100 0 1 BIT_MASK 0x0002 ECU_ADDRESS 0xFFFF46A6 READ_WRITE /end MEASUREMENT
/begin MEASUREMENT fFAFRLOK "0:リーン→リッチ応答劣化診断OK判定  1:リーン→リッチ応答劣化診断OK判定" UBYTE COMP_0283 1 100 0 1 BIT_MASK 0x0002 ECU_ADDRESS 0xFFFF46A7 READ_WRITE /end MEASUREMENT
/begin MEASUREMENT fFAFRNG1 "0:A./Fｾﾝｻｼﾌﾄ診断ﾘｯﾁｼﾌﾄNG1回目判定  1:A./Fｾﾝｻｼﾌﾄ診断ﾘｯﾁｼﾌﾄNG1回目判定" UBYTE COMP_0283 1 100 0 1 BIT_MASK 0x0002 ECU_ADDRESS 0xFFFF46A8 READ_WRITE /end MEASUREMENT
/begin MEASUREMENT fFAFRNG2 "0:A./Fｾﾝｻｼﾌﾄ診断ﾘｯﾁｼﾌﾄNG2回目判定  1:A./Fｾﾝｻｼﾌﾄ診断ﾘｯﾁｼﾌﾄNG2回目判定" UBYTE COMP_0283 1 100 0 1 BIT_MASK 0x0002 ECU_ADDRESS 0xFFFF46A9 READ_WRITE /end MEASUREMENT
/begin MEASUREMENT fFAFRVNG1 "0:ﾘｰﾝ→ﾘｯﾁ応答劣化診断 1st TRIP NG  1:ﾘｰﾝ→ﾘｯﾁ応答劣化診断 1st TRIP NG" UBYTE COMP_0283 1 100 0 1 BIT_MASK 0x0002 ECU_ADDRESS 0xFFFF46AA READ_WRITE /end MEASUREMENT
/begin MEASUREMENT fFAFRVNG2 "0:ﾘｰﾝ→ﾘｯﾁ応答劣化診断 2nd TRIP NG  1:ﾘｰﾝ→ﾘｯﾁ応答劣化診断 2nd TRIP NG" UBYTE COMP_0283 1 100 0 1 BIT_MASK 0x0002 ECU_ADDRESS 0xFFFF46AB READ_WRITE /end MEASUREMENT
/begin MEASUREMENT fFAFSACT "0:取り消し  1:A/Fｾﾝｻ活性判定成立" UBYTE COMP_0283 1 100 0 1 BIT_MASK 0x0002 ECU_ADDRESS 0xFFFF2045 READ_WRITE /end MEASUREMENT
/begin MEASUREMENT wfFAFSACT "0:取り消し  1:A/Fｾﾝｻ活性判定成立" UBYTE COMP_0283 1 100 0 1 BIT_MASK 0x0002 ECU_ADDRESS 0xFFFF1F11 READ_WRITE /end MEASUREMENT
/begin MEASUREMENT fFCAFHZ "0:前A/Fｾﾝｻ応答劣化/中間電位診断用F  1:前A/Fｾﾝｻ応答劣化/中間電位診断用F" UBYTE COMP_0283 1 100 0 1 BIT_MASK 0x0002 ECU_ADDRESS 0xFFFF0BAE READ_WRITE /end MEASUREMENT
/begin MEASUREMENT fFCAFHZF "0:前A/Fｾﾝｻ応答劣化/中間電位診断用F  1:前A/Fｾﾝｻ応答劣化/中間電位診断用F" UBYTE COMP_0283 1 100 0 1 BIT_MASK 0x0002 ECU_ADDRESS 0xFFFF0BAF READ_WRITE /end MEASUREMENT
/begin MEASUREMENT fFCATD "0:ステージ2診断NG  1:ステージ2診断へ移行" UBYTE COMP_0283 1 100 0 1 BIT_MASK 0x0002 ECU_ADDRESS 0xFFFF2706 READ_WRITE /end MEASUREMENT
/begin MEASUREMENT fFCCUPD "0:後O2/S F/C条件未判定  1:後O2/S F/C条件判定" UBYTE COMP_0283 1 100 0 1 BIT_MASK 0x0002 ECU_ADDRESS 0xFFFF2708 READ_WRITE /end MEASUREMENT
/begin MEASUREMENT fFCRCLP "0:右記以外  1:燃料ｶｯﾄﾘｶﾊﾞ中" UBYTE COMP_0283 1 100 0 1 BIT_MASK 0x0002 ECU_ADDRESS 0xFFFF0BB3 READ_WRITE /end MEASUREMENT
/begin MEASUREMENT fFCUTRCV "0:-  1:AFSHOS更新許可フラグ" UBYTE COMP_0283 1 100 0 1 BIT_MASK 0x0002 ECU_ADDRESS 0xFFFF3B5C READ_WRITE /end MEASUREMENT
/begin MEASUREMENT fFDITHER "0:禁止  1:許可" UBYTE COMP_0283 1 100 0 1 BIT_MASK 0x0002 ECU_ADDRESS 0xFFFF0BB8 READ_WRITE /end MEASUREMENT
/begin MEASUREMENT fFDITHERE "0:禁止  1:許可" UBYTE COMP_0283 1 100 0 1 BIT_MASK 0x0002 ECU_ADDRESS 0xFFFF0BB7 READ_WRITE /end MEASUREMENT
/begin MEASUREMENT fFIMRDYBF "0:診断未終了  1:診断終了" UBYTE COMP_0283 1 100 0 1 BIT_MASK 0x0002 ECU_ADDRESS 0xFFFF273C READ_WRITE /end MEASUREMENT
/begin MEASUREMENT fFMRCPC1 "0:無し  1:有り" UBYTE COMP_0283 1 100 0 1 BIT_MASK 0x0002 ECU_ADDRESS 0xFFFF204E READ_WRITE /end MEASUREMENT
/begin MEASUREMENT wfFMRCPC1 "0:無し  1:有り" UBYTE COMP_0283 1 100 0 1 BIT_MASK 0x0002 ECU_ADDRESS 0xFFFF1F1A READ_WRITE /end MEASUREMENT
/begin MEASUREMENT fFMRCPC2 "0:無し  1:有り" UBYTE COMP_0283 1 100 0 1 BIT_MASK 0x0002 ECU_ADDRESS 0xFFFF204F READ_WRITE /end MEASUREMENT
/begin MEASUREMENT wfFMRCPC2 "0:無し  1:有り" UBYTE COMP_0283 1 100 0 1 BIT_MASK 0x0002 ECU_ADDRESS 0xFFFF1F1B READ_WRITE /end MEASUREMENT
/begin MEASUREMENT fFMRJG1 "0:燃料ｼｽﾃﾑ診断条件不成立  1:燃料ｼｽﾃﾑ診断条件成立" UBYTE COMP_0283 1 100 0 1 BIT_MASK 0x0002 ECU_ADDRESS 0xFFFF3722 READ_WRITE /end MEASUREMENT
/begin MEASUREMENT fFMRJG2 "0:燃料ｼｽﾃﾑ診断条件不成立  1:燃料ｼｽﾃﾑ診断条件成立" UBYTE COMP_0283 1 100 0 1 BIT_MASK 0x0002 ECU_ADDRESS 0xFFFF3723 READ_WRITE /end MEASUREMENT
/begin MEASUREMENT fFNVOLIMP "0:不成立  1:成立" UBYTE COMP_0283 1 100 0 1 BIT_MASK 0x0002 ECU_ADDRESS 0xFFFF372E READ_WRITE /end MEASUREMENT
/begin MEASUREMENT fFO2HDON "0:O2ヒータデューティOFF  1:O2ヒータデューティON" UBYTE COMP_0283 1 100 0 1 BIT_MASK 0x0002 ECU_ADDRESS 0xFFFF0BCE READ_WRITE /end MEASUREMENT
/begin MEASUREMENT fFO2HNG "0:OK  1:NG" UBYTE COMP_0283 1 100 0 1 BIT_MASK 0x0002 ECU_ADDRESS 0xFFFF372F READ_WRITE /end MEASUREMENT
/begin MEASUREMENT afFO2HON "0:OFF  1:ON" UBYTE COMP_0283 1 100 0 1 BIT_MASK 0x0002 ECU_ADDRESS 0xFFFF1AAC READ_WRITE /end MEASUREMENT
/begin MEASUREMENT fFO2HON "0:OFF  1:ON" UBYTE COMP_0283 1 100 0 1 BIT_MASK 0x0002 ECU_ADDRESS 0xFFFF1B2C READ_WRITE /end MEASUREMENT
/begin MEASUREMENT fFO2HTU "0:禁止  1:許可" UBYTE COMP_0283 1 100 0 1 BIT_MASK 0x0002 ECU_ADDRESS 0xFFFF3730 READ_WRITE /end MEASUREMENT
/begin MEASUREMENT fFRO2FC "0:右記以外  1:燃料ｶｯﾄﾘｶﾊﾞｰ後" UBYTE COMP_0283 1 100 0 1 BIT_MASK 0x0002 ECU_ADDRESS 0xFFFF2759 READ_WRITE /end MEASUREMENT
/begin MEASUREMENT fFROHCMN "0:後O2/Sﾊﾟﾗﾒｰﾀﾊﾞｯｸｱｯﾌﾟ条件非成立  1:後O2/Sﾊﾟﾗﾒｰﾀﾊﾞｯｸｱｯﾌﾟ条件成立" UBYTE COMP_0283 1 100 0 1 BIT_MASK 0x0002 ECU_ADDRESS 0xFFFF275A READ_WRITE /end MEASUREMENT
/begin MEASUREMENT fFROHCMX "0:後O2/Sﾊﾟﾗﾒｰﾀﾊﾞｯｸｱｯﾌﾟ条件非成立  1:後O2/Sﾊﾟﾗﾒｰﾀﾊﾞｯｸｱｯﾌﾟ条件成立" UBYTE COMP_0283 1 100 0 1 BIT_MASK 0x0002 ECU_ADDRESS 0xFFFF275B READ_WRITE /end MEASUREMENT
/begin MEASUREMENT fFSO2NG "0:O2/S 正常  1:O2/S 2V以上NGが１度でも発生した" UBYTE COMP_0283 1 100 0 1 BIT_MASK 0x0002 ECU_ADDRESS 0xFFFF1763 READ_WRITE /end MEASUREMENT
/begin MEASUREMENT fFSO2S "0:O2/S 正常  1:O2/S OPEN/SHORT" UBYTE COMP_0283 1 100 0 1 BIT_MASK 0x0002 ECU_ADDRESS 0xFFFF0954 READ_WRITE /end MEASUREMENT
/begin MEASUREMENT wfFSO2S "0:O2/S 正常  1:O2/S OPEN/SHORT" UBYTE COMP_0283 1 100 0 1 BIT_MASK 0x0002 ECU_ADDRESS 0xFFFF0924 READ_WRITE /end MEASUREMENT
/begin MEASUREMENT fFVTLNCIB "0:収束していない  1:収束している" UBYTE COMP_0283 1 100 0 1 BIT_MASK 0x0002 ECU_ADDRESS 0xFFFF2765 READ_WRITE /end MEASUREMENT
/begin MEASUREMENT fFWKSTG "0:右記以外  1:WKSTRGクリア要求あり" UBYTE COMP_0283 1 100 0 1 BIT_MASK 0x0002 ECU_ADDRESS 0xFFFF2766 READ_WRITE /end MEASUREMENT
/begin MEASUREMENT fGAVGAFH "0:GSTﾊﾟﾗﾒｰﾀ更新歴無し  1:GSTﾊﾟﾗﾒｰﾀ更新歴あり" UBYTE COMP_0283 1 100 0 1 BIT_MASK 0x0002 ECU_ADDRESS 0xFFFF2767 READ_WRITE /end MEASUREMENT
/begin MEASUREMENT fGCATNG "0:GSTCAN診断終了条件NG判定不成立  1:GSTCAN診断終了条件NG判定成立" UBYTE COMP_0283 1 100 0 1 BIT_MASK 0x0002 ECU_ADDRESS 0xFFFF2768 READ_WRITE /end MEASUREMENT
/begin MEASUREMENT fGCATOK "0:GSTCAN診断終了条件OK判定不成立  1:GSTCAN診断終了条件終了OK判定成立" UBYTE COMP_0283 1 100 0 1 BIT_MASK 0x0002 ECU_ADDRESS 0xFFFF2769 READ_WRITE /end MEASUREMENT
/begin MEASUREMENT fGMRAB "0:NG判定してない  1:NG判定した" UBYTE COMP_0283 1 100 0 1 BIT_MASK 0x0002 ECU_ADDRESS 0xFFFF3746 READ_WRITE /end MEASUREMENT
/begin MEASUREMENT fGMRC "0:NG判定してない  1:NG判定した" UBYTE COMP_0283 1 100 0 1 BIT_MASK 0x0002 ECU_ADDRESS 0xFFFF3747 READ_WRITE /end MEASUREMENT
/begin MEASUREMENT fGMRD "0:NG判定してない  1:NG判定した" UBYTE COMP_0283 1 100 0 1 BIT_MASK 0x0002 ECU_ADDRESS 0xFFFF3748 READ_WRITE /end MEASUREMENT
/begin MEASUREMENT fGMRE "0:NG判定してない  1:NG判定した" UBYTE COMP_0283 1 100 0 1 BIT_MASK 0x0002 ECU_ADDRESS 0xFFFF3749 READ_WRITE /end MEASUREMENT
/begin MEASUREMENT fGMRF "0:NG判定してない  1:NG判定した" UBYTE COMP_0283 1 100 0 1 BIT_MASK 0x0002 ECU_ADDRESS 0xFFFF374A READ_WRITE /end MEASUREMENT
/begin MEASUREMENT fGRO2H "0:GSTﾊﾟﾗﾒｰﾀ更新歴無し  1:GSTﾊﾟﾗﾒｰﾀ更新歴あり" UBYTE COMP_0283 1 100 0 1 BIT_MASK 0x0002 ECU_ADDRESS 0xFFFF2784 READ_WRITE /end MEASUREMENT
/begin MEASUREMENT fHOSCINBL "0:HOSCMAX更新不許可  1:HOSCMAX更新許可" UBYTE COMP_0283 1 100 0 1 BIT_MASK 0x0002 ECU_ADDRESS 0xFFFF27A0 READ_WRITE /end MEASUREMENT
/begin MEASUREMENT fHOSLGO "0:HOSCMAX学習不許可  1:HOSCMAX学習許可" UBYTE COMP_0283 1 100 0 1 BIT_MASK 0x0002 ECU_ADDRESS 0xFFFF27A1 READ_WRITE /end MEASUREMENT
/begin MEASUREMENT fIDLNEND "0:-  1:-" UBYTE COMP_0283 1 100 0 1 BIT_MASK 0x0002 ECU_ADDRESS 0xFFFF0C2E READ_WRITE /end MEASUREMENT
/begin MEASUREMENT fINTGSTP "0:不成立  1:成立" UBYTE COMP_0283 1 100 0 1 BIT_MASK 0x0002 ECU_ADDRESS 0xFFFF280F READ_WRITE /end MEASUREMENT
/begin MEASUREMENT fISTPRCV "0:切替制御なし  1:切替制御中" UBYTE COMP_0283 1 100 0 1 BIT_MASK 0x0002 ECU_ADDRESS 0xFFFF281E READ_WRITE /end MEASUREMENT
/begin MEASUREMENT fJUGCNT "0:処理無し  1:演算" UBYTE COMP_0283 1 100 0 1 BIT_MASK 0x0002 ECU_ADDRESS 0xFFFF2846 READ_WRITE /end MEASUREMENT
/begin MEASUREMENT fKINSI "0:許可  1:禁止" UBYTE COMP_0283 1 100 0 1 BIT_MASK 0x0002 ECU_ADDRESS 0xFFFF285B READ_WRITE /end MEASUREMENT
/begin MEASUREMENT fLAON "0:λ点補正モード解除  1:λ点補正モード中" UBYTE COMP_0283 1 100 0 1 BIT_MASK 0x0002 ECU_ADDRESS 0xFFFF37A7 READ_WRITE /end MEASUREMENT
/begin MEASUREMENT fLIMEX "0:-  1:LSOSQ放出中" UBYTE COMP_0283 1 100 0 1 BIT_MASK 0x0002 ECU_ADDRESS 0xFFFF2891 READ_WRITE /end MEASUREMENT
/begin MEASUREMENT fLIMEX2 "0:-  1:ﾘｯﾁ化制御中" UBYTE COMP_0283 1 100 0 1 BIT_MASK 0x0002 ECU_ADDRESS 0xFFFF2890 READ_WRITE /end MEASUREMENT
/begin MEASUREMENT fLJUDGE "0:-  1:AFSHOS更新許可フラグ" UBYTE COMP_0283 1 100 0 1 BIT_MASK 0x0002 ECU_ADDRESS 0xFFFF2896 READ_WRITE /end MEASUREMENT
/begin MEASUREMENT fLJUONE "0:A/Fｾﾝｻ学習更新不許可（ﾘｰﾝ）  1:A/Fｾﾝｻ学習更新1度許可（ﾘｰﾝ）" UBYTE COMP_0283 1 100 0 1 BIT_MASK 0x0002 ECU_ADDRESS 0xFFFF2897 READ_WRITE /end MEASUREMENT
/begin MEASUREMENT fLJUONH "0:HOSCMAX学習更新不許可（ﾘｰﾝ）  1:HOSCMAX学習更新1度許可（ﾘｰﾝ）" UBYTE COMP_0283 1 100 0 1 BIT_MASK 0x0002 ECU_ADDRESS 0xFFFF2898 READ_WRITE /end MEASUREMENT
/begin MEASUREMENT bfLMCLST "0:ｸﾛｰｽﾞ開始前  1:ｸﾛｰｽﾞ開始後" UBYTE COMP_0283 1 100 0 1 BIT_MASK 0x0002 ECU_ADDRESS 0xFFFF1A54 READ_WRITE /end MEASUREMENT
/begin MEASUREMENT fLMDCLP "0:OPEN  1:CLOSE" UBYTE COMP_0283 1 100 0 1 BIT_MASK 0x0002 ECU_ADDRESS 0xFFFF097C READ_WRITE /end MEASUREMENT
/begin MEASUREMENT bfLMDCLS "0:OPEN  1:CLOSE" UBYTE COMP_0283 1 100 0 1 BIT_MASK 0x0002 ECU_ADDRESS 0xFFFF1A30 READ_WRITE /end MEASUREMENT
/begin MEASUREMENT fLMDCPM "0:不成立  1:成立" UBYTE COMP_0283 1 100 0 1 BIT_MASK 0x0002 ECU_ADDRESS 0xFFFF0CEE READ_WRITE /end MEASUREMENT
/begin MEASUREMENT bfLMDRCH "0:ﾘｰﾝ  1:ﾘｯﾁ" UBYTE COMP_0283 1 100 0 1 BIT_MASK 0x0002 ECU_ADDRESS 0xFFFF1A31 READ_WRITE /end MEASUREMENT
/begin MEASUREMENT fLNCNDOK "0:-  1:-" UBYTE COMP_0283 1 100 0 1 BIT_MASK 0x0002 ECU_ADDRESS 0xFFFF0CEF READ_WRITE /end MEASUREMENT
/begin MEASUREMENT fLNRSET "0:ﾘｾｯﾄ中でない  1:ﾘｾｯﾄ中" UBYTE COMP_0283 1 100 0 1 BIT_MASK 0x0002 ECU_ADDRESS 0xFFFF28A6 READ_WRITE /end MEASUREMENT
/begin MEASUREMENT fLNRSETz "0:ﾘｾｯﾄ中でない(前回値)  1:ﾘｾｯﾄ中(前回値)" UBYTE COMP_0283 1 100 0 1 BIT_MASK 0x0002 ECU_ADDRESS 0xFFFF28A7 READ_WRITE /end MEASUREMENT
/begin MEASUREMENT fLRDNGZ "0:NG未判定  1:NG検出" UBYTE COMP_0283 1 100 0 1 BIT_MASK 0x0002 ECU_ADDRESS 0xFFFF28B4 READ_WRITE /end MEASUREMENT
/begin MEASUREMENT fLRDOKZ "0:OK未判定  1:OK検出" UBYTE COMP_0283 1 100 0 1 BIT_MASK 0x0002 ECU_ADDRESS 0xFFFF28B5 READ_WRITE /end MEASUREMENT
/begin MEASUREMENT fLRFO2 "0:右記以外  1:リッチからリーンに切り替わった" UBYTE COMP_0283 1 100 0 1 BIT_MASK 0x0002 ECU_ADDRESS 0xFFFF28C0 READ_WRITE /end MEASUREMENT
/begin MEASUREMENT fMCLPEKB "0:非ﾓﾆﾀｸﾗﾝﾌﾟ->ﾓﾆﾀｸﾗﾝﾌﾟ不成立  1:非ﾓﾆﾀｸﾗﾝﾌﾟ->ﾓﾆﾀｸﾗﾝﾌﾟ成立" UBYTE COMP_0283 1 100 0 1 BIT_MASK 0x0002 ECU_ADDRESS 0xFFFF28EF READ_WRITE /end MEASUREMENT
/begin MEASUREMENT fMNTCNTA "0:右記以外  1:a)条件によるｶｳﾝﾄｱｯﾌﾟ" UBYTE COMP_0283 1 100 0 1 BIT_MASK 0x0002 ECU_ADDRESS 0xFFFF29A3 READ_WRITE /end MEASUREMENT
/begin MEASUREMENT fMONTCLP "0:ﾓﾆﾀｸﾗﾝﾌﾟ未経験  1:ﾓﾆﾀｸﾗﾝﾌﾟ経験" UBYTE COMP_0283 1 100 0 1 BIT_MASK 0x0002 ECU_ADDRESS 0xFFFF29B4 READ_WRITE /end MEASUREMENT
/begin MEASUREMENT bfMOPEN "0:未発生  1:発生" UBYTE COMP_0283 1 100 0 1 BIT_MASK 0x0002 ECU_ADDRESS 0xFFFF1A32 READ_WRITE /end MEASUREMENT
/begin MEASUREMENT fMRGKJK "0:燃料学習用O2/S OK  1:燃料学習用O2/S NG" UBYTE COMP_0283 1 100 0 1 BIT_MASK 0x0002 ECU_ADDRESS 0xFFFF37BC READ_WRITE /end MEASUREMENT
/begin MEASUREMENT fNGOK "0:OK  1:NG" UBYTE COMP_0283 1 100 0 1 BIT_MASK 0x0002 ECU_ADDRESS 0xFFFF29CE READ_WRITE /end MEASUREMENT
/begin MEASUREMENT fNTPCAN "0:ｷｬﾝｾﾙ条件不成立  1:ｷｬﾝｾﾙ条件成立" UBYTE COMP_0283 1 100 0 1 BIT_MASK 0x0002 ECU_ADDRESS 0xFFFF29EC READ_WRITE /end MEASUREMENT
/begin MEASUREMENT fNTPST "0:未算出  1:算出済み" UBYTE COMP_0283 1 100 0 1 BIT_MASK 0x0002 ECU_ADDRESS 0xFFFF29F6 READ_WRITE /end MEASUREMENT
/begin MEASUREMENT fO2HCHK "0:未  1:ｾｯﾄ済み" UBYTE COMP_0283 1 100 0 1 BIT_MASK 0x0002 ECU_ADDRESS 0xFFFF37D0 READ_WRITE /end MEASUREMENT
/begin MEASUREMENT fO2HIRL "0:後O2ﾋｰﾀON条件不成立  1:後O2ﾋｰﾀON条件成立" UBYTE COMP_0283 1 100 0 1 BIT_MASK 0x0002 ECU_ADDRESS 0xFFFF29FE READ_WRITE /end MEASUREMENT
/begin MEASUREMENT fOOFPT "0:未完了  1:完了" UBYTE COMP_0283 1 100 0 1 BIT_MASK 0x0002 ECU_ADDRESS 0xFFFF2A06 READ_WRITE /end MEASUREMENT
/begin MEASUREMENT fOSCON "0:-  1:AFSHOS更新許可フラグ" UBYTE COMP_0283 1 100 0 1 BIT_MASK 0x0002 ECU_ADDRESS 0xFFFF2A17 READ_WRITE /end MEASUREMENT
/begin MEASUREMENT fPHOS1OK "0:PHOS1演算禁止  1:PHOS1演算許可" UBYTE COMP_0283 1 100 0 1 BIT_MASK 0x0002 ECU_ADDRESS 0xFFFF0DA4 READ_WRITE /end MEASUREMENT
/begin MEASUREMENT fPHOSAOK "0:PHOSA演算条件不成立  1:PHOSA演算条件成立" UBYTE COMP_0283 1 100 0 1 BIT_MASK 0x0002 ECU_ADDRESS 0xFFFF0DA5 READ_WRITE /end MEASUREMENT
/begin MEASUREMENT fPUSDGN "0:不成立  1:成立" UBYTE COMP_0283 1 100 0 1 BIT_MASK 0x0002 ECU_ADDRESS 0xFFFF2A75 READ_WRITE /end MEASUREMENT
/begin MEASUREMENT fPUSDGN2 "0:不成立  1:成立" UBYTE COMP_0283 1 100 0 1 BIT_MASK 0x0002 ECU_ADDRESS 0xFFFF2A74 READ_WRITE /end MEASUREMENT
/begin MEASUREMENT fRCRSET "0:ﾘｾｯﾄ中でない  1:ﾘｾｯﾄ中" UBYTE COMP_0283 1 100 0 1 BIT_MASK 0x0002 ECU_ADDRESS 0xFFFF2ACE READ_WRITE /end MEASUREMENT
/begin MEASUREMENT fRCRSETz "0:ﾘｾｯﾄ中でない(前回値)  1:ﾘｾｯﾄ中(前回値)" UBYTE COMP_0283 1 100 0 1 BIT_MASK 0x0002 ECU_ADDRESS 0xFFFF2ACF READ_WRITE /end MEASUREMENT
/begin MEASUREMENT fRDTYOUT "0:ﾘｱO2ﾋｰﾀDUTYｾｯﾄ未  1:ﾘｱO2ﾋｰﾀDUTYｾｯﾄ済" UBYTE COMP_0283 1 100 0 1 BIT_MASK 0x0002 ECU_ADDRESS 0xFFFF3228 READ_WRITE /end MEASUREMENT
/begin MEASUREMENT fRFBST "0:初回  1:2回目以降" UBYTE COMP_0283 1 100 0 1 BIT_MASK 0x0002 ECU_ADDRESS 0xFFFF2AEC READ_WRITE /end MEASUREMENT
/begin MEASUREMENT fRFOEVP "0:後O2ｾﾝｻ診断によるキャニスタパー  1:後O2ｾﾝｻ診断によるキャニスタパー" UBYTE COMP_0283 1 100 0 1 BIT_MASK 0x0002 ECU_ADDRESS 0xFFFF2AF5 READ_WRITE /end MEASUREMENT
/begin MEASUREMENT fRJUDGE "0:-  1:AFSHOS更新許可フラグ" UBYTE COMP_0283 1 100 0 1 BIT_MASK 0x0002 ECU_ADDRESS 0xFFFF2AFE READ_WRITE /end MEASUREMENT
/begin MEASUREMENT fRJUONE "0:A/Fｾﾝｻ学習更新不許可（ﾘｯﾁ）  1:A/Fｾﾝｻ学習更新1度許可（ﾘｯﾁ）" UBYTE COMP_0283 1 100 0 1 BIT_MASK 0x0002 ECU_ADDRESS 0xFFFF2AFF READ_WRITE /end MEASUREMENT
/begin MEASUREMENT fRJUONH "0:HOSCMAX学習更新不許可（ﾘｯﾁ）  1:HOSCMAX学習更新1度許可（ﾘｯﾁ）" UBYTE COMP_0283 1 100 0 1 BIT_MASK 0x0002 ECU_ADDRESS 0xFFFF2B00 READ_WRITE /end MEASUREMENT
/begin MEASUREMENT fRLDNGZ "0:NG未判定  1:NG検出" UBYTE COMP_0283 1 100 0 1 BIT_MASK 0x0002 ECU_ADDRESS 0xFFFF2B06 READ_WRITE /end MEASUREMENT
/begin MEASUREMENT fRLDOKZ "0:OK未判定  1:OK検出" UBYTE COMP_0283 1 100 0 1 BIT_MASK 0x0002 ECU_ADDRESS 0xFFFF2B07 READ_WRITE /end MEASUREMENT
/begin MEASUREMENT fRLFO2 "0:右記以外  1:リーンからリッチに切り替わった" UBYTE COMP_0283 1 100 0 1 BIT_MASK 0x0002 ECU_ADDRESS 0xFFFF2B10 READ_WRITE /end MEASUREMENT
/begin MEASUREMENT fRLNOK "0:異常電圧診断(最小値)OK未終了  1:異常電圧診断(最小値)OK終了" UBYTE COMP_0283 1 100 0 1 BIT_MASK 0x0002 ECU_ADDRESS 0xFFFF2B11 READ_WRITE /end MEASUREMENT
/begin MEASUREMENT fRLTGT "0:αﾘｯﾁ側  1:αﾘｰﾝ側" UBYTE COMP_0283 1 100 0 1 BIT_MASK 0x0002 ECU_ADDRESS 0xFFFF2B18 READ_WRITE /end MEASUREMENT
/begin MEASUREMENT fRO2DLY "0:非要求  1:要求" UBYTE COMP_0283 1 100 0 1 BIT_MASK 0x0002 ECU_ADDRESS 0xFFFF2B1B READ_WRITE /end MEASUREMENT
/begin MEASUREMENT fRO2DTCL "0:後O2/S ﾊﾟﾗﾒｰﾀｸﾘｱ非要求  1:後O2/S ﾊﾟﾗﾒｰﾀｸﾘｱ要求" UBYTE COMP_0283 1 100 0 1 BIT_MASK 0x0002 ECU_ADDRESS 0xFFFF2B1C READ_WRITE /end MEASUREMENT
/begin MEASUREMENT fRO2DTYCH "0:切換え条件非成立  1:切換え条件成立" UBYTE COMP_0283 1 100 0 1 BIT_MASK 0x0002 ECU_ADDRESS 0xFFFF2B1D READ_WRITE /end MEASUREMENT
/begin MEASUREMENT fRO2DYMX2 "0:上限値2非出力  1:上限値2出力" UBYTE COMP_0283 1 100 0 1 BIT_MASK 0x0002 ECU_ADDRESS 0xFFFF2B1E READ_WRITE /end MEASUREMENT
/begin MEASUREMENT fRO2FB "0:右記以外  1:F/B中" UBYTE COMP_0283 1 100 0 1 BIT_MASK 0x0002 ECU_ADDRESS 0xFFFF2B22 READ_WRITE /end MEASUREMENT
/begin MEASUREMENT fRO2FBALP "0:触媒診断未終了  1:触媒診断終了" UBYTE COMP_0283 1 100 0 1 BIT_MASK 0x0002 ECU_ADDRESS 0xFFFF2B1F READ_WRITE /end MEASUREMENT
/begin MEASUREMENT fRO2FBALZ "0:触媒診断未終了（前回値)  1:触媒診断終了（前回値)" UBYTE COMP_0283 1 100 0 1 BIT_MASK 0x0002 ECU_ADDRESS 0xFFFF2B20 READ_WRITE /end MEASUREMENT
/begin MEASUREMENT fRO2FBCLP "0:右記以外  1:F/B中" UBYTE COMP_0283 1 100 0 1 BIT_MASK 0x0002 ECU_ADDRESS 0xFFFF2B21 READ_WRITE /end MEASUREMENT
/begin MEASUREMENT fRO2FBR "0:右記以外  1:RrO2/S診断RrO2/S F/B制御要求" UBYTE COMP_0283 1 100 0 1 BIT_MASK 0x0002 ECU_ADDRESS 0xFFFF2B25 READ_WRITE /end MEASUREMENT
/begin MEASUREMENT fRO2HDON "0:リアO2ヒータデューティOFF  1:リアO2ヒータデューティON" UBYTE COMP_0283 1 100 0 1 BIT_MASK 0x0002 ECU_ADDRESS 0xFFFF2B27 READ_WRITE /end MEASUREMENT
/begin MEASUREMENT afRO2HON "0:OFF  1:ON" UBYTE COMP_0283 1 100 0 1 BIT_MASK 0x0002 ECU_ADDRESS 0xFFFF3ADA READ_WRITE /end MEASUREMENT
/begin MEASUREMENT fRO2HON "0:OFF  1:ON" UBYTE COMP_0283 1 100 0 1 BIT_MASK 0x0002 ECU_ADDRESS 0xFFFF3B82 READ_WRITE /end MEASUREMENT
/begin MEASUREMENT fRO2HON1 "0:OFF  1:ON" UBYTE COMP_0283 1 100 0 1 BIT_MASK 0x0002 ECU_ADDRESS 0xFFFF387D READ_WRITE /end MEASUREMENT
/begin MEASUREMENT fRO2INT "0:ｲﾆｼｬﾗｲｽﾞ未了  1:ｲﾆｼｬﾗｲｽﾞ完了" UBYTE COMP_0283 1 100 0 1 BIT_MASK 0x0002 ECU_ADDRESS 0xFFFF2B2A READ_WRITE /end MEASUREMENT
/begin MEASUREMENT fRO2MLOK "0:後O2/S診断OK未終了  1:後O2/S診断OK終了" UBYTE COMP_0283 1 100 0 1 BIT_MASK 0x0002 ECU_ADDRESS 0xFFFF2B2B READ_WRITE /end MEASUREMENT
/begin MEASUREMENT fRO2OK2 "0:後O2/S診断OK未終了  1:後O2/S診断OK終了" UBYTE COMP_0283 1 100 0 1 BIT_MASK 0x0002 ECU_ADDRESS 0xFFFF4D4E READ_WRITE /end MEASUREMENT
/begin MEASUREMENT fRO2PHSD "0:RO2/S診断ﾃﾞｨﾚｰ付きPHOS条件不成立  1:RO2/S診断ﾃﾞｨﾚｰ付きPHOS条件成立" UBYTE COMP_0283 1 100 0 1 BIT_MASK 0x0002 ECU_ADDRESS 0xFFFF2B2C READ_WRITE /end MEASUREMENT
/begin MEASUREMENT fRO2PJUG "0:RO2/S診断ステージ２領域条件不成  1:RO2/S診断ステージ２領域条件成立" UBYTE COMP_0283 1 100 0 1 BIT_MASK 0x0002 ECU_ADDRESS 0xFFFF2B2D READ_WRITE /end MEASUREMENT
/begin MEASUREMENT fRO2RL "0:リーン  1:リッチ" UBYTE COMP_0283 1 100 0 1 BIT_MASK 0x0002 ECU_ADDRESS 0xFFFF211D READ_WRITE /end MEASUREMENT
/begin MEASUREMENT fRO2STG2 "0:RO2/S診断ステージ２移行条件不成  1:RO2/S診断ステージ２移行条件成立" UBYTE COMP_0283 1 100 0 1 BIT_MASK 0x0002 ECU_ADDRESS 0xFFFF2B2F READ_WRITE /end MEASUREMENT
/begin MEASUREMENT fRO2STG2E "0:RO2/S診断ステージ２未判定  1:RO2/S診断ステージ２終了" UBYTE COMP_0283 1 100 0 1 BIT_MASK 0x0002 ECU_ADDRESS 0xFFFF2B2E READ_WRITE /end MEASUREMENT
/begin MEASUREMENT fRO2STG2J "0:右記以外  1:RO2/S診断ステージ２NG処理要求" UBYTE COMP_0283 1 100 0 1 BIT_MASK 0x0002 ECU_ADDRESS 0xFFFF2B30 READ_WRITE /end MEASUREMENT
/begin MEASUREMENT fRO2STG2V "0:RO2/S診断仮想ステージ２移行条件  1:RO2/S診断仮想ステージ２移行条件" UBYTE COMP_0283 1 100 0 1 BIT_MASK 0x0002 ECU_ADDRESS 0xFFFF2B31 READ_WRITE /end MEASUREMENT
/begin MEASUREMENT fROAVCN "0:異常電圧2診断TRIP未終了  1:異常電圧2診断TRIP終了" UBYTE COMP_0283 1 100 0 1 BIT_MASK 0x0002 ECU_ADDRESS 0xFFFF2B34 READ_WRITE /end MEASUREMENT
/begin MEASUREMENT fROAVNG1 "0:異常電圧2診断NG 1TRIP未終了  1:異常電圧2診断NG 1TRIP終了" UBYTE COMP_0283 1 100 0 1 BIT_MASK 0x0002 ECU_ADDRESS 0xFFFF4D4F READ_WRITE /end MEASUREMENT
/begin MEASUREMENT fROAVNG2 "0:異常電圧2診断NG 2TRIP未終了  1:異常電圧2診断NG 2TRIP終了" UBYTE COMP_0283 1 100 0 1 BIT_MASK 0x0002 ECU_ADDRESS 0xFFFF4D50 READ_WRITE /end MEASUREMENT
/begin MEASUREMENT fROHCAN "0:後O2/H診断異常判定未終了  1:後O2/H診断異常判定終了" UBYTE COMP_0283 1 100 0 1 BIT_MASK 0x0002 ECU_ADDRESS 0xFFFF2B37 READ_WRITE /end MEASUREMENT
/begin MEASUREMENT fROHMLOK "0:後O2/H診断正常終了未終了  1:後O2/H診断正常終了終了" UBYTE COMP_0283 1 100 0 1 BIT_MASK 0x0002 ECU_ADDRESS 0xFFFF2B38 READ_WRITE /end MEASUREMENT
/begin MEASUREMENT fROHNG1 "0:後O2/H診断異常終了1TRIP未終了  1:後O2/H診断異常終了1TRIP終了" UBYTE COMP_0283 1 100 0 1 BIT_MASK 0x0002 ECU_ADDRESS 0xFFFF4D51 READ_WRITE /end MEASUREMENT
/begin MEASUREMENT fROHNG2 "0:後O2/H診断異常終了2TRIP未終了  1:後O2/H診断異常終了2TRIP終了" UBYTE COMP_0283 1 100 0 1 BIT_MASK 0x0002 ECU_ADDRESS 0xFFFF4D52 READ_WRITE /end MEASUREMENT
/begin MEASUREMENT fROHOK2 "0:後O2/H診断正常終了未終了  1:後O2/H診断正常終了終了" UBYTE COMP_0283 1 100 0 1 BIT_MASK 0x0002 ECU_ADDRESS 0xFFFF4D53 READ_WRITE /end MEASUREMENT
/begin MEASUREMENT fROHONT "0:不成立  1:成立" UBYTE COMP_0283 1 100 0 1 BIT_MASK 0x0002 ECU_ADDRESS 0xFFFF2B39 READ_WRITE /end MEASUREMENT
/begin MEASUREMENT fROJFCT "0:燃料カット時間経過未  1:燃料カット時間経過済" UBYTE COMP_0283 1 100 0 1 BIT_MASK 0x0002 ECU_ADDRESS 0xFFFF2B3B READ_WRITE /end MEASUREMENT
/begin MEASUREMENT fROMNCN "0:異常電圧(最小値)診断TRIP未終了  1:異常電圧(最小値)診断TRIP終了" UBYTE COMP_0283 1 100 0 1 BIT_MASK 0x0002 ECU_ADDRESS 0xFFFF2B3C READ_WRITE /end MEASUREMENT
/begin MEASUREMENT fROMNNG1 "0:異常電圧(最小値)診断NG 1TRIP未終  1:異常電圧(最小値)診断NG 1TRIP終了" UBYTE COMP_0283 1 100 0 1 BIT_MASK 0x0002 ECU_ADDRESS 0xFFFF4D54 READ_WRITE /end MEASUREMENT
/begin MEASUREMENT fROMNNG2 "0:異常電圧(最小値)診断NG 2TRIP未終  1:異常電圧(最小値)診断NG 2TRIP終了" UBYTE COMP_0283 1 100 0 1 BIT_MASK 0x0002 ECU_ADDRESS 0xFFFF4D55 READ_WRITE /end MEASUREMENT
/begin MEASUREMENT fROMXCN "0:異常電圧(最大値)診断TRIP未終了  1:異常電圧(最大値)診断TRIP終了" UBYTE COMP_0283 1 100 0 1 BIT_MASK 0x0002 ECU_ADDRESS 0xFFFF2B3D READ_WRITE /end MEASUREMENT
/begin MEASUREMENT fROMXNG1 "0:異常電圧(最大値)診断NG 1TRIP未終  1:異常電圧(最大値)診断NG 1TRIP終了" UBYTE COMP_0283 1 100 0 1 BIT_MASK 0x0002 ECU_ADDRESS 0xFFFF4D56 READ_WRITE /end MEASUREMENT
/begin MEASUREMENT fROMXNG2 "0:異常電圧(最大値)診断NG 2TRIP未終  1:異常電圧(最大値)診断NG 2TRIP終了" UBYTE COMP_0283 1 100 0 1 BIT_MASK 0x0002 ECU_ADDRESS 0xFFFF4D57 READ_WRITE /end MEASUREMENT
/begin MEASUREMENT fRORSCN "0:応答時間診断TRIP未終了  1:応答時間診断TRIP終了" UBYTE COMP_0283 1 100 0 1 BIT_MASK 0x0002 ECU_ADDRESS 0xFFFF2B4A READ_WRITE /end MEASUREMENT
/begin MEASUREMENT fRORSNG1 "0:応答時間診断NG 1TRIP未終了  1:応答時間診断NG 1TRIP終了" UBYTE COMP_0283 1 100 0 1 BIT_MASK 0x0002 ECU_ADDRESS 0xFFFF4D59 READ_WRITE /end MEASUREMENT
/begin MEASUREMENT fRORSNG2 "0:応答時間診断NG 2TRIP未終了  1:応答時間診断NG 2TRIP終了" UBYTE COMP_0283 1 100 0 1 BIT_MASK 0x0002 ECU_ADDRESS 0xFFFF4D5A READ_WRITE /end MEASUREMENT
/begin MEASUREMENT fRRCOK "0:異常電圧診断(最大値)OK未終了  1:異常電圧診断(最大値)OK終了" UBYTE COMP_0283 1 100 0 1 BIT_MASK 0x0002 ECU_ADDRESS 0xFFFF2B50 READ_WRITE /end MEASUREMENT
/begin MEASUREMENT fRRFOEVP "0:後O2ｾﾝｻ診断によるキャニスタパー  1:後O2ｾﾝｻ診断によるキャニスタパー" UBYTE COMP_0283 1 100 0 1 BIT_MASK 0x0002 ECU_ADDRESS 0xFFFF2B51 READ_WRITE /end MEASUREMENT
/begin MEASUREMENT fRRPSOK "0:応答時間診断OK未終了  1:応答時間診断OK終了" UBYTE COMP_0283 1 100 0 1 BIT_MASK 0x0002 ECU_ADDRESS 0xFFFF2B58 READ_WRITE /end MEASUREMENT
/begin MEASUREMENT fRST2ARA "0:ステージ2領域条件不成立  1:ステージ2領域条件成立" UBYTE COMP_0283 1 100 0 1 BIT_MASK 0x0002 ECU_ADDRESS 0xFFFF2B5F READ_WRITE /end MEASUREMENT
/begin MEASUREMENT fRST2ARAV "0:条件不成立  1:条件成立" UBYTE COMP_0283 1 100 0 1 BIT_MASK 0x0002 ECU_ADDRESS 0xFFFF2B60 READ_WRITE /end MEASUREMENT
/begin MEASUREMENT fRST2GO "0:右記以外  1:RrO2/S診断RrO2/S F/B制御要求許可" UBYTE COMP_0283 1 100 0 1 BIT_MASK 0x0002 ECU_ADDRESS 0xFFFF2B61 READ_WRITE /end MEASUREMENT
/begin MEASUREMENT fSLLEAN "0:切替わり前  1:切替わり後" UBYTE COMP_0283 1 100 0 1 BIT_MASK 0x0002 ECU_ADDRESS 0xFFFF2B86 READ_WRITE /end MEASUREMENT
/begin MEASUREMENT fSLRICH "0:切替わり前  1:切替わり後" UBYTE COMP_0283 1 100 0 1 BIT_MASK 0x0002 ECU_ADDRESS 0xFFFF2BAC READ_WRITE /end MEASUREMENT
/begin MEASUREMENT fSLRNOK "0:学習条件不成立  1:学習条件成立" UBYTE COMP_0283 1 100 0 1 BIT_MASK 0x0002 ECU_ADDRESS 0xFFFF0EB4 READ_WRITE /end MEASUREMENT
/begin MEASUREMENT fSOLDGN "0:不成立  1:成立" UBYTE COMP_0283 1 100 0 1 BIT_MASK 0x0002 ECU_ADDRESS 0xFFFF2BE8 READ_WRITE /end MEASUREMENT
/begin MEASUREMENT fST2ARA "0:不成立  1:成立" UBYTE COMP_0283 1 100 0 1 BIT_MASK 0x0002 ECU_ADDRESS 0xFFFF2BF8 READ_WRITE /end MEASUREMENT
/begin MEASUREMENT fST2ARAV "0:仮想ｽﾃｰｼﾞ2領域条件不成立  1:仮想ｽﾃｰｼﾞ2領域条件成立" UBYTE COMP_0283 1 100 0 1 BIT_MASK 0x0002 ECU_ADDRESS 0xFFFF2BF9 READ_WRITE /end MEASUREMENT
/begin MEASUREMENT fST2GO "0:不成立  1:成立" UBYTE COMP_0283 1 100 0 1 BIT_MASK 0x0002 ECU_ADDRESS 0xFFFF2BFA READ_WRITE /end MEASUREMENT
/begin MEASUREMENT fST2GOV "0:不成立  1:成立" UBYTE COMP_0283 1 100 0 1 BIT_MASK 0x0002 ECU_ADDRESS 0xFFFF2BFB READ_WRITE /end MEASUREMENT
/begin MEASUREMENT fST2GOW "0:移行禁止  1:移行許可" UBYTE COMP_0283 1 100 0 1 BIT_MASK 0x0002 ECU_ADDRESS 0xFFFF2BFC READ_WRITE /end MEASUREMENT
/begin MEASUREMENT fST2JDG "0:不成立  1:成立" UBYTE COMP_0283 1 100 0 1 BIT_MASK 0x0002 ECU_ADDRESS 0xFFFF2BFD READ_WRITE /end MEASUREMENT
/begin MEASUREMENT fST2JDGOK "0:不成立  1:成立" UBYTE COMP_0283 1 100 0 1 BIT_MASK 0x0002 ECU_ADDRESS 0xFFFF2BFE READ_WRITE /end MEASUREMENT
/begin MEASUREMENT fSTPFLG2 "0:右記以外  1:I分停止" UBYTE COMP_0283 1 100 0 1 BIT_MASK 0x0002 ECU_ADDRESS 0xFFFF2C0F READ_WRITE /end MEASUREMENT
/begin MEASUREMENT fSUMOSL "0:右記以外  1:リーン側O2ストレージ能力演算" UBYTE COMP_0283 1 100 0 1 BIT_MASK 0x0002 ECU_ADDRESS 0xFFFF2C44 READ_WRITE /end MEASUREMENT
/begin MEASUREMENT fSUMOSR "0:右記以外  1:リッチ側O2ストレージ能力演算" UBYTE COMP_0283 1 100 0 1 BIT_MASK 0x0002 ECU_ADDRESS 0xFFFF2C45 READ_WRITE /end MEASUREMENT
/begin MEASUREMENT fTABFCPL "0:目標A/F未固定  1:目標A/F固定" UBYTE COMP_0283 1 100 0 1 BIT_MASK 0x0002 ECU_ADDRESS 0xFFFF2C66 READ_WRITE /end MEASUREMENT
/begin MEASUREMENT fTABFCPR "0:目標A/F未固定  1:目標A/F固定" UBYTE COMP_0283 1 100 0 1 BIT_MASK 0x0002 ECU_ADDRESS 0xFFFF2C67 READ_WRITE /end MEASUREMENT
/begin MEASUREMENT fTDRYTIME "0:未設定  1:設定済" UBYTE COMP_0283 1 100 0 1 BIT_MASK 0x0002 ECU_ADDRESS 0xFFFF38BB READ_WRITE /end MEASUREMENT
/begin MEASUREMENT fTECLP "0:右記以外  1:即ｸﾗﾝﾌﾟ中" UBYTE COMP_0283 1 100 0 1 BIT_MASK 0x0002 ECU_ADDRESS 0xFFFF2CC5 READ_WRITE /end MEASUREMENT
/begin MEASUREMENT fTGAFCMP "0:不成立  1:成立" UBYTE COMP_0283 1 100 0 1 BIT_MASK 0x0002 ECU_ADDRESS 0xFFFF2CF6 READ_WRITE /end MEASUREMENT
/begin MEASUREMENT fTMADJM1 "0:不成立  1:成立" UBYTE COMP_0283 1 100 0 1 BIT_MASK 0x0002 ECU_ADDRESS 0xFFFF38D4 READ_WRITE /end MEASUREMENT
/begin MEASUREMENT fTROFMT "0:右記以外  1:成立" UBYTE COMP_0283 1 100 0 1 BIT_MASK 0x0002 ECU_ADDRESS 0xFFFF2E4F READ_WRITE /end MEASUREMENT
/begin MEASUREMENT fTWETTIME "0:未設定  1:設定済" UBYTE COMP_0283 1 100 0 1 BIT_MASK 0x0002 ECU_ADDRESS 0xFFFF391F READ_WRITE /end MEASUREMENT
/begin MEASUREMENT fUBNCNTOK "0:UBNCNT(ﾊﾞﾝｸ対応)ｶｳﾝﾄしない  1:UBNCNT(ﾊﾞﾝｸ対応)ｶｳﾝトする" UBYTE COMP_0283 1 100 0 1 BIT_MASK 0x0002 ECU_ADDRESS 0xFFFF2EF7 READ_WRITE /end MEASUREMENT
/begin MEASUREMENT fUDRESET1 "0:ﾘｾｯﾄ条件不成立  1:ﾘｾｯﾄ条件成立" UBYTE COMP_0283 1 100 0 1 BIT_MASK 0x0002 ECU_ADDRESS 0xFFFF2EF8 READ_WRITE /end MEASUREMENT
/begin MEASUREMENT fUDRESET2 "0:ﾘｾｯﾄ条件不成立  1:ﾘｾｯﾄ条件成立" UBYTE COMP_0283 1 100 0 1 BIT_MASK 0x0002 ECU_ADDRESS 0xFFFF2EF9 READ_WRITE /end MEASUREMENT
/begin MEASUREMENT fVAERRE "0:負  1:正" UBYTE COMP_0283 1 100 0 1 BIT_MASK 0x0002 ECU_ADDRESS 0xFFFF2EFC READ_WRITE /end MEASUREMENT
/begin MEASUREMENT fVAERRI "0:負  1:正" UBYTE COMP_0283 1 100 0 1 BIT_MASK 0x0002 ECU_ADDRESS 0xFFFF2EFD READ_WRITE /end MEASUREMENT
/begin MEASUREMENT fVCFBIFRZ "0:F/B実行  1:F/B休止" UBYTE COMP_0283 1 100 0 1 BIT_MASK 0x0002 ECU_ADDRESS 0xFFFF2F14 READ_WRITE /end MEASUREMENT
/begin MEASUREMENT fVCFBIFZE "0:F/B実行  1:F/B休止" UBYTE COMP_0283 1 100 0 1 BIT_MASK 0x0002 ECU_ADDRESS 0xFFFF2F15 READ_WRITE /end MEASUREMENT
/begin MEASUREMENT fVCFBIHDE "0:許可  1:禁止" UBYTE COMP_0283 1 100 0 1 BIT_MASK 0x0002 ECU_ADDRESS 0xFFFF2F16 READ_WRITE /end MEASUREMENT
/begin MEASUREMENT fVCFBIHDI "0:許可  1:禁止" UBYTE COMP_0283 1 100 0 1 BIT_MASK 0x0002 ECU_ADDRESS 0xFFFF2F17 READ_WRITE /end MEASUREMENT
/begin MEASUREMENT fVRO2I "0:右記以外  1:VRO2履歴ｾｯﾄ" UBYTE COMP_0283 1 100 0 1 BIT_MASK 0x0002 ECU_ADDRESS 0xFFFF3983 READ_WRITE /end MEASUREMENT
/begin MEASUREMENT fVSCFBIFE "0:許可  1:上限以上" UBYTE COMP_0283 1 100 0 1 BIT_MASK 0x0002 ECU_ADDRESS 0xFFFF32C7 READ_WRITE /end MEASUREMENT
/begin MEASUREMENT fVSCFBIFI "0:許可  1:上限以上" UBYTE COMP_0283 1 100 0 1 BIT_MASK 0x0002 ECU_ADDRESS 0xFFFF32C8 READ_WRITE /end MEASUREMENT
/begin MEASUREMENT fVSCMAXE "0:上限未満  1:上限以上" UBYTE COMP_0283 1 100 0 1 BIT_MASK 0x0002 ECU_ADDRESS 0xFFFF32C9 READ_WRITE /end MEASUREMENT
/begin MEASUREMENT fVSCMAXI "0:上限未満  1:上限以上" UBYTE COMP_0283 1 100 0 1 BIT_MASK 0x0002 ECU_ADDRESS 0xFFFF32CA READ_WRITE /end MEASUREMENT
/begin MEASUREMENT fVSCMINE "0:下限値より大きい  1:下限値以下" UBYTE COMP_0283 1 100 0 1 BIT_MASK 0x0002 ECU_ADDRESS 0xFFFF32CB READ_WRITE /end MEASUREMENT
/begin MEASUREMENT fVSCMINI "0:下限値より大きい  1:下限値以下" UBYTE COMP_0283 1 100 0 1 BIT_MASK 0x0002 ECU_ADDRESS 0xFFFF32CC READ_WRITE /end MEASUREMENT
/begin MEASUREMENT fVSDLIME "0:上下限以内  1:上下限の外" UBYTE COMP_0283 1 100 0 1 BIT_MASK 0x0002 ECU_ADDRESS 0xFFFF32CD READ_WRITE /end MEASUREMENT
/begin MEASUREMENT fVSDLIMI "0:上下限以内  1:上下限の外" UBYTE COMP_0283 1 100 0 1 BIT_MASK 0x0002 ECU_ADDRESS 0xFFFF32CE READ_WRITE /end MEASUREMENT
/begin MEASUREMENT fVTCDG1_S "0:不成立  1:成立" UBYTE COMP_0283 1 100 0 1 BIT_MASK 0x0002 ECU_ADDRESS 0xFFFF3070 READ_WRITE /end MEASUREMENT
/begin MEASUREMENT fVTCDG2_S "0:不成立  1:成立" UBYTE COMP_0283 1 100 0 1 BIT_MASK 0x0002 ECU_ADDRESS 0xFFFF3071 READ_WRITE /end MEASUREMENT
/begin MEASUREMENT fVTCDG3_S "0:不成立  1:成立" UBYTE COMP_0283 1 100 0 1 BIT_MASK 0x0002 ECU_ADDRESS 0xFFFF3072 READ_WRITE /end MEASUREMENT
/begin MEASUREMENT fVTCDG4_S "0:不成立  1:成立" UBYTE COMP_0283 1 100 0 1 BIT_MASK 0x0002 ECU_ADDRESS 0xFFFF3073 READ_WRITE /end MEASUREMENT
/begin MEASUREMENT fVTCDG5_S "0:不成立  1:成立" UBYTE COMP_0283 1 100 0 1 BIT_MASK 0x0002 ECU_ADDRESS 0xFFFF3074 READ_WRITE /end MEASUREMENT
/begin MEASUREMENT fVTCDGE1 "0:不成立  1:成立" UBYTE COMP_0283 1 100 0 1 BIT_MASK 0x0002 ECU_ADDRESS 0xFFFF2F8A READ_WRITE /end MEASUREMENT
/begin MEASUREMENT fVTCDGE2 "0:不成立  1:成立" UBYTE COMP_0283 1 100 0 1 BIT_MASK 0x0002 ECU_ADDRESS 0xFFFF2F8B READ_WRITE /end MEASUREMENT
/begin MEASUREMENT fVTCDGE3 "0:不成立  1:成立" UBYTE COMP_0283 1 100 0 1 BIT_MASK 0x0002 ECU_ADDRESS 0xFFFF2F8C READ_WRITE /end MEASUREMENT
/begin MEASUREMENT fVTCDGE4 "0:不成立  1:成立" UBYTE COMP_0283 1 100 0 1 BIT_MASK 0x0002 ECU_ADDRESS 0xFFFF2F8D READ_WRITE /end MEASUREMENT
/begin MEASUREMENT fVTCDGE5 "0:不成立  1:成立" UBYTE COMP_0283 1 100 0 1 BIT_MASK 0x0002 ECU_ADDRESS 0xFFFF2F8E READ_WRITE /end MEASUREMENT
/begin MEASUREMENT fVTCDGN "0:不成立  1:成立" UBYTE COMP_0283 1 100 0 1 BIT_MASK 0x0002 ECU_ADDRESS 0xFFFF2F93 READ_WRITE /end MEASUREMENT
/begin MEASUREMENT fVTCDGN1S "0:不成立  1:成立" UBYTE COMP_0283 1 100 0 1 BIT_MASK 0x0002 ECU_ADDRESS 0xFFFF2F8F READ_WRITE /end MEASUREMENT
/begin MEASUREMENT fVTCDGN2 "0:不成立  1:成立" UBYTE COMP_0283 1 100 0 1 BIT_MASK 0x0002 ECU_ADDRESS 0xFFFF2F90 READ_WRITE /end MEASUREMENT
/begin MEASUREMENT fVTCDGN2S "0:不成立  1:成立" UBYTE COMP_0283 1 100 0 1 BIT_MASK 0x0002 ECU_ADDRESS 0xFFFF2F91 READ_WRITE /end MEASUREMENT
/begin MEASUREMENT fVTCDGN3S "0:診断不許可  1:診断許可" UBYTE COMP_0283 1 100 0 1 BIT_MASK 0x0002 ECU_ADDRESS 0xFFFF3BD5 READ_WRITE /end MEASUREMENT
/begin MEASUREMENT fVTDGN3SE "0:診断不許可  1:診断許可" UBYTE COMP_0283 1 100 0 1 BIT_MASK 0x0002 ECU_ADDRESS 0xFFFF3BD8 READ_WRITE /end MEASUREMENT
/begin MEASUREMENT fVTCDGN4S "0:診断不許可  1:診断許可" UBYTE COMP_0283 1 100 0 1 BIT_MASK 0x0002 ECU_ADDRESS 0xFFFF2F92 READ_WRITE /end MEASUREMENT
/begin MEASUREMENT fVTCDGN5 "0:不成立  1:成立" UBYTE COMP_0283 1 100 0 1 BIT_MASK 0x0002 ECU_ADDRESS 0xFFFF212B READ_WRITE /end MEASUREMENT
/begin MEASUREMENT fVTCDGN5E "0:不成立  1:成立" UBYTE COMP_0283 1 100 0 1 BIT_MASK 0x0002 ECU_ADDRESS 0xFFFF212A READ_WRITE /end MEASUREMENT
/begin MEASUREMENT fVTCDGN6 "0:不成立  1:成立" UBYTE COMP_0283 1 100 0 1 BIT_MASK 0x0002 ECU_ADDRESS 0xFFFF212C READ_WRITE /end MEASUREMENT
/begin MEASUREMENT fVTCFS3_S "0:正常判定  1:フェールセーフNG判定" UBYTE COMP_0283 1 100 0 1 BIT_MASK 0x0002 ECU_ADDRESS 0xFFFF3075 READ_WRITE /end MEASUREMENT
/begin MEASUREMENT fVTCFS4_S "0:正常判定  1:フェールセーフNG判定" UBYTE COMP_0283 1 100 0 1 BIT_MASK 0x0002 ECU_ADDRESS 0xFFFF3076 READ_WRITE /end MEASUREMENT
/begin MEASUREMENT fVTCFS5_S "0:不成立  1:成立" UBYTE COMP_0283 1 100 0 1 BIT_MASK 0x0002 ECU_ADDRESS 0xFFFF3077 READ_WRITE /end MEASUREMENT
/begin MEASUREMENT fVTCFSE3 "0:不成立  1:成立" UBYTE COMP_0283 1 100 0 1 BIT_MASK 0x0002 ECU_ADDRESS 0xFFFF2F94 READ_WRITE /end MEASUREMENT
/begin MEASUREMENT fVTCFSE4 "0:不成立  1:成立" UBYTE COMP_0283 1 100 0 1 BIT_MASK 0x0002 ECU_ADDRESS 0xFFFF2F95 READ_WRITE /end MEASUREMENT
/begin MEASUREMENT fVTCFSE5 "0:不成立  1:成立" UBYTE COMP_0283 1 100 0 1 BIT_MASK 0x0002 ECU_ADDRESS 0xFFFF2F96 READ_WRITE /end MEASUREMENT
/begin MEASUREMENT afVTCICLR "0:I分クリアしない  1:I分クリア" UBYTE COMP_0283 1 100 0 1 BIT_MASK 0x0002 ECU_ADDRESS 0xFFFF3B2F READ_WRITE /end MEASUREMENT
/begin MEASUREMENT fVTCICLR "0:I分クリアしない  1:I分クリア" UBYTE COMP_0283 1 100 0 1 BIT_MASK 0x0002 ECU_ADDRESS 0xFFFF3BD7 READ_WRITE /end MEASUREMENT
/begin MEASUREMENT fVTCICLRA "0:I分クリアしない  1:I分クリア" UBYTE COMP_0283 1 100 0 1 BIT_MASK 0x0002 ECU_ADDRESS 0xFFFF2F97 READ_WRITE /end MEASUREMENT
/begin MEASUREMENT fVTCICLRE "0:I分クリアしない  1:I分クリア" UBYTE COMP_0283 1 100 0 1 BIT_MASK 0x0002 ECU_ADDRESS 0xFFFF3BD6 READ_WRITE /end MEASUREMENT
/begin MEASUREMENT fVTCPAUSE "0:VTC F/B制御非休止  1:VTC F/B制御休止" UBYTE COMP_0283 1 100 0 1 BIT_MASK 0x0002 ECU_ADDRESS 0xFFFF2FB6 READ_WRITE /end MEASUREMENT
/begin MEASUREMENT fVTDGN4OK "0:正常判定未  1:正常判定済" UBYTE COMP_0283 1 100 0 1 BIT_MASK 0x0002 ECU_ADDRESS 0xFFFF2FBB READ_WRITE /end MEASUREMENT
/begin MEASUREMENT fVTICLRAE "0:I分クリアしない  1:I分クリア" UBYTE COMP_0283 1 100 0 1 BIT_MASK 0x0002 ECU_ADDRESS 0xFFFF2FC0 READ_WRITE /end MEASUREMENT
/begin MEASUREMENT fVTPAUSEE "0:VTC F/B制御非休止  1:VTC F/B制御休止" UBYTE COMP_0283 1 100 0 1 BIT_MASK 0x0002 ECU_ADDRESS 0xFFFF2FCA READ_WRITE /end MEASUREMENT
/begin MEASUREMENT fWETDRYJG "0:判定未終了  1:判定終了" UBYTE COMP_0283 1 100 0 1 BIT_MASK 0x0002 ECU_ADDRESS 0xFFFF16CE READ_WRITE /end MEASUREMENT
/begin MEASUREMENT fYKLOK "0:不成立  1:成立" UBYTE COMP_0283 1 100 0 1 BIT_MASK 0x0002 ECU_ADDRESS 0xFFFF302E READ_WRITE /end MEASUREMENT
/begin MEASUREMENT wfAFHMODE "0:非制御  1:ﾋｰﾀ-制御中" UBYTE COMP_0283 1 100 0 1 BIT_MASK 0x0002 ECU_ADDRESS 0xFFFF1E7E READ_WRITE /end MEASUREMENT
/begin MEASUREMENT afFCUTRCV "0:-  1:AFSHOS更新許可フラグ" UBYTE COMP_0283 1 100 0 1 BIT_MASK 0x0002 ECU_ADDRESS 0xFFFF3AB4 READ_WRITE /end MEASUREMENT
/begin MEASUREMENT fINRNREQ "0:非成立  1:成立" UBYTE COMP_0283 1 100 0 1 BIT_MASK 0x0002 ECU_ADDRESS 0xFFFF280E READ_WRITE /end MEASUREMENT
/begin MEASUREMENT fLGLNIEND "0:非成立  1:成立" UBYTE COMP_0283 1 100 0 1 BIT_MASK 0x0002 ECU_ADDRESS 0xFFFF2886 READ_WRITE /end MEASUREMENT
/begin MEASUREMENT fAFKDEND "0:未終了  1:終了" UBYTE COMP_0283 1 100 0 1 BIT_MASK 0x0002 ECU_ADDRESS 0xFFFF2273 READ_WRITE /end MEASUREMENT
/begin MEASUREMENT fALLGJDGI "0:非成立  1:成立" UBYTE COMP_0283 1 100 0 1 BIT_MASK 0x0002 ECU_ADDRESS 0xFFFF22CA READ_WRITE /end MEASUREMENT
/begin MEASUREMENT fALLGJDGP "0:非成立  1:成立" UBYTE COMP_0283 1 100 0 1 BIT_MASK 0x0002 ECU_ADDRESS 0xFFFF22CB READ_WRITE /end MEASUREMENT
/begin MEASUREMENT fELLGREV "0:非成立  1:成立" UBYTE COMP_0283 1 100 0 1 BIT_MASK 0x0002 ECU_ADDRESS 0xFFFF2667 READ_WRITE /end MEASUREMENT
/begin MEASUREMENT fELRLIOK "0:非成立  1:成立" UBYTE COMP_0283 1 100 0 1 BIT_MASK 0x0002 ECU_ADDRESS 0xFFFF2668 READ_WRITE /end MEASUREMENT
/begin MEASUREMENT fELRLPOK "0:非成立  1:成立" UBYTE COMP_0283 1 100 0 1 BIT_MASK 0x0002 ECU_ADDRESS 0xFFFF2669 READ_WRITE /end MEASUREMENT
/begin MEASUREMENT fLGLNPEND "0:非成立  1:成立" UBYTE COMP_0283 1 100 0 1 BIT_MASK 0x0002 ECU_ADDRESS 0xFFFF2887 READ_WRITE /end MEASUREMENT
/begin MEASUREMENT fLNCNLGI "0:非成立  1:成立" UBYTE COMP_0283 1 100 0 1 BIT_MASK 0x0002 ECU_ADDRESS 0xFFFF28A4 READ_WRITE /end MEASUREMENT
/begin MEASUREMENT fLNCNLGP "0:非成立  1:成立" UBYTE COMP_0283 1 100 0 1 BIT_MASK 0x0002 ECU_ADDRESS 0xFFFF28A5 READ_WRITE /end MEASUREMENT
/begin MEASUREMENT fRESLGCT "0:非成立  1:成立" UBYTE COMP_0283 1 100 0 1 BIT_MASK 0x0002 ECU_ADDRESS 0xFFFF2ADF READ_WRITE /end MEASUREMENT
/begin MEASUREMENT fTRTPI "0:不成立(ﾊﾟｰｼｬﾙ)  1:成立(ｱｲﾄﾞﾙ)" UBYTE COMP_0283 1 100 0 1 BIT_MASK 0x0002 ECU_ADDRESS 0xFFFF2E9C READ_WRITE /end MEASUREMENT
/begin MEASUREMENT fMCLPEKBU "0:学習値更新無し  1:学習値更新有り" UBYTE COMP_0283 1 100 0 1 BIT_MASK 0x0002 ECU_ADDRESS 0xFFFF28F0 READ_WRITE /end MEASUREMENT
/begin MEASUREMENT fAFMDGBK "0:AFM機能診断故障未確定  1:AFM機能診断故障確定" UBYTE COMP_0283 1 100 0 1 BIT_MASK 0x0002 ECU_ADDRESS 0xFFFF227C READ_WRITE /end MEASUREMENT
/begin MEASUREMENT fAFMDTVCB "0:不成立  1:成立" UBYTE COMP_0283 1 100 0 1 BIT_MASK 0x0002 ECU_ADDRESS 0xFFFF227D READ_WRITE /end MEASUREMENT
/begin MEASUREMENT fAFMTVLB "0:不成立  1:成立" UBYTE COMP_0283 1 100 0 1 BIT_MASK 0x0002 ECU_ADDRESS 0xFFFF2280 READ_WRITE /end MEASUREMENT
/begin MEASUREMENT fAFDRG "0:不成立  1:成立" UBYTE COMP_0283 1 100 0 1 BIT_MASK 0x0002 ECU_ADDRESS 0xFFFF226E READ_WRITE /end MEASUREMENT
/begin MEASUREMENT fAFVDRG "0:不成立  1:成立" UBYTE COMP_0283 1 100 0 1 BIT_MASK 0x0002 ECU_ADDRESS 0xFFFF22AF READ_WRITE /end MEASUREMENT
/begin MEASUREMENT fRATEFLG "0:不成立  1:成立" UBYTE COMP_0283 1 100 0 1 BIT_MASK 0x0002 ECU_ADDRESS 0xFFFF2AC4 READ_WRITE /end MEASUREMENT
/begin MEASUREMENT fRESCNTL2 "0:ｶｳﾝﾄ条件不成立  1:ｶｳﾝﾄ条件成立" UBYTE COMP_0283 1 100 0 1 BIT_MASK 0x0002 ECU_ADDRESS 0xFFFF2AD9 READ_WRITE /end MEASUREMENT
/begin MEASUREMENT fRESCNTR2 "0:ｶｳﾝﾄ条件不成立  1:ｶｳﾝﾄ条件成立" UBYTE COMP_0283 1 100 0 1 BIT_MASK 0x0002 ECU_ADDRESS 0xFFFF2ADC READ_WRITE /end MEASUREMENT
/begin MEASUREMENT fTBCDG3_S "0:不成立  1:成立" UBYTE COMP_0283 1 100 0 1 BIT_MASK 0x0002 ECU_ADDRESS 0xFFFF3058 READ_WRITE /end MEASUREMENT
/begin MEASUREMENT fTBCDGN3 "0:不成立  1:成立" UBYTE COMP_0283 1 100 0 1 BIT_MASK 0x0002 ECU_ADDRESS 0xFFFF2128 READ_WRITE /end MEASUREMENT
/begin MEASUREMENT fTBCDG2_S "0:不成立  1:成立" UBYTE COMP_0283 1 100 0 1 BIT_MASK 0x0002 ECU_ADDRESS 0xFFFF3057 READ_WRITE /end MEASUREMENT
/begin MEASUREMENT fTBCDGN2 "0:不成立  1:成立" UBYTE COMP_0283 1 100 0 1 BIT_MASK 0x0002 ECU_ADDRESS 0xFFFF2127 READ_WRITE /end MEASUREMENT
/begin MEASUREMENT fTBCDG1_S "0:不成立  1:成立" UBYTE COMP_0283 1 100 0 1 BIT_MASK 0x0002 ECU_ADDRESS 0xFFFF3056 READ_WRITE /end MEASUREMENT
/begin MEASUREMENT fTBCDGN1 "0:不成立  1:成立" UBYTE COMP_0283 1 100 0 1 BIT_MASK 0x0002 ECU_ADDRESS 0xFFFF2126 READ_WRITE /end MEASUREMENT
/begin MEASUREMENT fAFTMONCL "0:-  1:-" UBYTE COMP_0283 1 100 0 1 BIT_MASK 0x0002 ECU_ADDRESS 0xFFFF22AE READ_WRITE /end MEASUREMENT
/begin MEASUREMENT fHFCRCLP "0:-  1:-" UBYTE COMP_0283 1 100 0 1 BIT_MASK 0x0002 ECU_ADDRESS 0xFFFF2796 READ_WRITE /end MEASUREMENT
/begin MEASUREMENT fIBDGNCON "0:不許可  1:許可" UBYTE COMP_0283 1 100 0 1 BIT_MASK 0x0002 ECU_ADDRESS 0xFFFF27C5 READ_WRITE /end MEASUREMENT
/begin MEASUREMENT fBRAMNG "0:NG無し  1:NG有り" UBYTE COMP_0283 1 100 0 1 BIT_MASK 0x0080 ECU_ADDRESS 0xFFFF562D READ_WRITE /end MEASUREMENT
/begin MEASUREMENT fCNXUCE7 "0:not  1:Network_supervision_is_active(A." UBYTE COMP_0283 1 100 0 1 BIT_MASK 0x0040 ECU_ADDRESS 0xFFFF562D READ_WRITE /end MEASUREMENT
/begin MEASUREMENT fCNXUCE8 "0:not  1:Network_supervision_is_active(Cl" UBYTE COMP_0283 1 100 0 1 BIT_MASK 0x0020 ECU_ADDRESS 0xFFFF562D READ_WRITE /end MEASUREMENT
/begin MEASUREMENT fCOMPEONV "0:未完了  1:完了" UBYTE COMP_0283 1 100 0 1 BIT_MASK 0x0010 ECU_ADDRESS 0xFFFF562D READ_WRITE /end MEASUREMENT
/begin MEASUREMENT fEONVCNT "0:非予約  1:予約" UBYTE COMP_0283 1 100 0 1 BIT_MASK 0x0008 ECU_ADDRESS 0xFFFF562D READ_WRITE /end MEASUREMENT
/begin MEASUREMENT fFPRESNG "0:絶対圧センサNG不成立  1:絶対圧センサNG成立" UBYTE COMP_0283 1 100 0 1 BIT_MASK 0x0004 ECU_ADDRESS 0xFFFF562D READ_WRITE /end MEASUREMENT
/begin MEASUREMENT fFSTMIL "0:MIL消灯  1:MIL点灯" UBYTE COMP_0283 1 100 0 1 BIT_MASK 0x0002 ECU_ADDRESS 0xFFFF562D READ_WRITE /end MEASUREMENT
/begin MEASUREMENT fFSTMILZ "0:MIL消灯  1:MIL点灯" UBYTE COMP_0283 1 100 0 1 BIT_MASK 0x0001 ECU_ADDRESS 0xFFFF562D READ_WRITE /end MEASUREMENT
/begin MEASUREMENT fGSBU1ST "0:未経験  1:経験済み" UBYTE COMP_0283 1 100 0 1 BIT_MASK 0x0080 ECU_ADDRESS 0xFFFF562E READ_WRITE /end MEASUREMENT
/begin MEASUREMENT fIDONCHCK "0:ｿﾌﾄｱｲﾄﾞﾙｽｲｯﾁON  1:ｿﾌﾄｱｲﾄﾞﾙｽｲｯﾁOFF" UBYTE COMP_0283 1 100 0 1 BIT_MASK 0x0040 ECU_ADDRESS 0xFFFF562E READ_WRITE /end MEASUREMENT
/begin MEASUREMENT fMCLPNGJL "0:ﾓﾆﾀｸﾗﾝﾌﾟによるLEAN側NG未検出  1:ﾓﾆﾀｸﾗﾝﾌﾟによるLEAN側NG検出" UBYTE COMP_0283 1 100 0 1 BIT_MASK 0x0020 ECU_ADDRESS 0xFFFF562E READ_WRITE /end MEASUREMENT
/begin MEASUREMENT fMCLPNGJR "0:ﾓﾆﾀｸﾗﾝﾌﾟによるRICH側NG未検出  1:ﾓﾆﾀｸﾗﾝﾌﾟによるRICH側NG検出" UBYTE COMP_0283 1 100 0 1 BIT_MASK 0x0010 ECU_ADDRESS 0xFFFF562E READ_WRITE /end MEASUREMENT
/begin MEASUREMENT fO2HEND "0:O2/H診断未終了  1:後O2/H診断終了" UBYTE COMP_0283 1 100 0 1 BIT_MASK 0x0008 ECU_ADDRESS 0xFFFF562E READ_WRITE /end MEASUREMENT
/begin MEASUREMENT fWDTNG_M "0:正常  1:NG" UBYTE COMP_0283 1 100 0 1 BIT_MASK 0x0004 ECU_ADDRESS 0xFFFF562E READ_WRITE /end MEASUREMENT
/begin MEASUREMENT wfBLFAN "0:ﾌﾞﾛｱﾌｧﾝSW_OFF  1:ﾌﾞﾛｱﾌｧﾝSW_ON" UBYTE COMP_0283 1 100 0 1 BIT_MASK 0x0080 ECU_ADDRESS 0xFFFF1B91 READ_WRITE /end MEASUREMENT
/begin MEASUREMENT wfENGRUN "0:エンジン非回転中  1:エンジン回転中" UBYTE COMP_0283 1 100 0 1 BIT_MASK 0x0040 ECU_ADDRESS 0xFFFF1B91 READ_WRITE /end MEASUREMENT
/begin MEASUREMENT wfFRFOG "0:ﾌﾛﾝﾄﾌｫｸﾞSW_OFF  1:ﾌﾛﾝﾄﾌｫｸﾞSW_ON" UBYTE COMP_0283 1 100 0 1 BIT_MASK 0x0020 ECU_ADDRESS 0xFFFF1B91 READ_WRITE /end MEASUREMENT
/begin MEASUREMENT wfLDHLH "0:ﾍｯﾄﾞﾗｲﾄ(High)SW_OFF  1:ﾍｯﾄﾞﾗｲﾄ(High)SW_ON" UBYTE COMP_0283 1 100 0 1 BIT_MASK 0x0010 ECU_ADDRESS 0xFFFF1B91 READ_WRITE /end MEASUREMENT
/begin MEASUREMENT wfLDHLL "0:ﾍｯﾄﾞﾗｲﾄ(Low)SW_OFF  1:ﾍｯﾄﾞﾗｲﾄ(Low)SW_ON" UBYTE COMP_0283 1 100 0 1 BIT_MASK 0x0008 ECU_ADDRESS 0xFFFF1B91 READ_WRITE /end MEASUREMENT
/begin MEASUREMENT wfNEUT "0:NEUTSW_OFF  1:NEUTSW_ON" UBYTE COMP_0283 1 100 0 1 BIT_MASK 0x0004 ECU_ADDRESS 0xFFFF1B91 READ_WRITE /end MEASUREMENT
/begin MEASUREMENT wfPOSLP "0:ﾎﾟｼﾞｼｮﾝﾗｲﾄSW_OFF  1:ﾎﾟｼﾞｼｮﾝﾗｲﾄSW_ON" UBYTE COMP_0283 1 100 0 1 BIT_MASK 0x0002 ECU_ADDRESS 0xFFFF1B91 READ_WRITE /end MEASUREMENT
/begin MEASUREMENT wfREDEF "0:ﾘｱﾃﾞﾌｫｯｶﾞSW_OFF  1:ﾘｱﾃﾞﾌｫｯｶﾞSW_ON" UBYTE COMP_0283 1 100 0 1 BIT_MASK 0x0001 ECU_ADDRESS 0xFFFF1B91 READ_WRITE /end MEASUREMENT
/begin MEASUREMENT fBLFAN "0:ﾌﾞﾛｱﾌｧﾝSW_OFF  1:ﾌﾞﾛｱﾌｧﾝSW_ON" UBYTE COMP_0283 1 100 0 1 BIT_MASK 0x0080 ECU_ADDRESS 0xFFFF1B92 READ_WRITE /end MEASUREMENT
/begin MEASUREMENT fENGRUN "0:エンジン非回転中  1:エンジン回転中" UBYTE COMP_0283 1 100 0 1 BIT_MASK 0x0040 ECU_ADDRESS 0xFFFF1B92 READ_WRITE /end MEASUREMENT
/begin MEASUREMENT fFRFOG "0:ﾌﾛﾝﾄﾌｫｸﾞSW_OFF  1:ﾌﾛﾝﾄﾌｫｸﾞSW_ON" UBYTE COMP_0283 1 100 0 1 BIT_MASK 0x0020 ECU_ADDRESS 0xFFFF1B92 READ_WRITE /end MEASUREMENT
/begin MEASUREMENT fLDHLH "0:ﾍｯﾄﾞﾗｲﾄ(High)SW_OFF  1:ﾍｯﾄﾞﾗｲﾄ(High)SW_ON" UBYTE COMP_0283 1 100 0 1 BIT_MASK 0x0010 ECU_ADDRESS 0xFFFF1B92 READ_WRITE /end MEASUREMENT
/begin MEASUREMENT fLDHLL "0:ﾍｯﾄﾞﾗｲﾄ(Low)SW_OFF  1:ﾍｯﾄﾞﾗｲﾄ(Low)SW_ON" UBYTE COMP_0283 1 100 0 1 BIT_MASK 0x0008 ECU_ADDRESS 0xFFFF1B92 READ_WRITE /end MEASUREMENT
/begin MEASUREMENT fNEUT "0:NEUTSW_OFF  1:NEUTSW_ON" UBYTE COMP_0283 1 100 0 1 BIT_MASK 0x0004 ECU_ADDRESS 0xFFFF1B92 READ_WRITE /end MEASUREMENT
/begin MEASUREMENT fPOSLP "0:ﾎﾟｼﾞｼｮﾝﾗｲﾄSW_OFF  1:ﾎﾟｼﾞｼｮﾝﾗｲﾄSW_ON" UBYTE COMP_0283 1 100 0 1 BIT_MASK 0x0002 ECU_ADDRESS 0xFFFF1B92 READ_WRITE /end MEASUREMENT
/begin MEASUREMENT fREDEF "0:ﾘｱﾃﾞﾌｫｯｶﾞSW_OFF  1:ﾘｱﾃﾞﾌｫｯｶﾞSW_ON" UBYTE COMP_0283 1 100 0 1 BIT_MASK 0x0001 ECU_ADDRESS 0xFFFF1B92 READ_WRITE /end MEASUREMENT
/begin MEASUREMENT fATOP "0:TOP以外  1:TOP" UBYTE COMP_0283 1 100 0 1 BIT_MASK 0x0080 ECU_ADDRESS 0xFFFF1B9A READ_WRITE /end MEASUREMENT
/begin MEASUREMENT fATRNG1 "0:ATｼﾌﾄﾚﾝｼﾞ信号1速以外  1:ATｼﾌﾄﾚﾝｼﾞ信号1速" UBYTE COMP_0283 1 100 0 1 BIT_MASK 0x0040 ECU_ADDRESS 0xFFFF1B9A READ_WRITE /end MEASUREMENT
/begin MEASUREMENT fCVTFAIL "0:正常  1:異常" UBYTE COMP_0283 1 100 0 1 BIT_MASK 0x0020 ECU_ADDRESS 0xFFFF1B9A READ_WRITE /end MEASUREMENT
/begin MEASUREMENT fDTVOM "0:減速中ではない  1:減速中" UBYTE COMP_0283 1 100 0 1 BIT_MASK 0x0010 ECU_ADDRESS 0xFFFF1B9A READ_WRITE /end MEASUREMENT
/begin MEASUREMENT fDTVOP "0:加速中ではない  1:加速中" UBYTE COMP_0283 1 100 0 1 BIT_MASK 0x0008 ECU_ADDRESS 0xFFFF1B9A READ_WRITE /end MEASUREMENT
/begin MEASUREMENT fECHOK "0:条件不成立  1:条件成立" UBYTE COMP_0283 1 100 0 1 BIT_MASK 0x0004 ECU_ADDRESS 0xFFFF1B9A READ_WRITE /end MEASUREMENT
/begin MEASUREMENT fEXCALCHK "0:異常  1:正常" UBYTE COMP_0283 1 100 0 1 BIT_MASK 0x0002 ECU_ADDRESS 0xFFFF1B9A READ_WRITE /end MEASUREMENT
/begin MEASUREMENT fFMAPSEL "0:Dﾚﾝｼﾞ選択  1:Dsﾚﾝｼﾞ選択" UBYTE COMP_0283 1 100 0 1 BIT_MASK 0x0001 ECU_ADDRESS 0xFFFF1B9A READ_WRITE /end MEASUREMENT
/begin MEASUREMENT fFOILSWON "0:右記以外  1:油圧低下" UBYTE COMP_0283 1 100 0 1 BIT_MASK 0x0080 ECU_ADDRESS 0xFFFF1B9B READ_WRITE /end MEASUREMENT
/begin MEASUREMENT fFSCKATIH "0:許可  1:禁止" UBYTE COMP_0283 1 100 0 1 BIT_MASK 0x0040 ECU_ADDRESS 0xFFFF1B9B READ_WRITE /end MEASUREMENT
/begin MEASUREMENT fFSTVO "0:TH/S_正常  1:TH/S_OPEN/SHORT" UBYTE COMP_0283 1 100 0 1 BIT_MASK 0x0020 ECU_ADDRESS 0xFFFF1B9B READ_WRITE /end MEASUREMENT
/begin MEASUREMENT fFSTWN "0:TW/S_正常  1:TW/S_OPEN/SHORT" UBYTE COMP_0283 1 100 0 1 BIT_MASK 0x0010 ECU_ADDRESS 0xFFFF1B9B READ_WRITE /end MEASUREMENT
/begin MEASUREMENT fHRATIO "0:変速比状態が厳しい  1:変速比状態が厳しくない" UBYTE COMP_0283 1 100 0 1 BIT_MASK 0x0008 ECU_ADDRESS 0xFFFF1B9B READ_WRITE /end MEASUREMENT
/begin MEASUREMENT fIDLEUP "0:要求無し  1:要求有り" UBYTE COMP_0283 1 100 0 1 BIT_MASK 0x0004 ECU_ADDRESS 0xFFFF1B9B READ_WRITE /end MEASUREMENT
/begin MEASUREMENT fIDLSOFIS "0:IDLE時SOFIS制御許可  1:IDLE時SOFIS制御禁止" UBYTE COMP_0283 1 100 0 1 BIT_MASK 0x0002 ECU_ADDRESS 0xFFFF1B9B READ_WRITE /end MEASUREMENT
/begin MEASUREMENT fISCFBHI "0:ISC_F/B_早期化不許可  1:ISC_F/B_早期化許可" UBYTE COMP_0283 1 100 0 1 BIT_MASK 0x0001 ECU_ADDRESS 0xFFFF1B9B READ_WRITE /end MEASUREMENT
/begin MEASUREMENT fKENST "0:簡易エンスト状態以外  1:簡易エンスト状態" UBYTE COMP_0283 1 100 0 1 BIT_MASK 0x0080 ECU_ADDRESS 0xFFFF1B9C READ_WRITE /end MEASUREMENT
/begin MEASUREMENT fKTOP "0:TOP以外  1:TOP" UBYTE COMP_0283 1 100 0 1 BIT_MASK 0x0040 ECU_ADDRESS 0xFFFF1B9C READ_WRITE /end MEASUREMENT
/begin MEASUREMENT fLOAD "0:OFF  1:ON" UBYTE COMP_0283 1 100 0 1 BIT_MASK 0x0020 ECU_ADDRESS 0xFFFF1B9C READ_WRITE /end MEASUREMENT
/begin MEASUREMENT fM4WDSW "0:M4WD_sw_OFF  1:M4WD_sw_ON" UBYTE COMP_0283 1 100 0 1 BIT_MASK 0x0010 ECU_ADDRESS 0xFFFF1B9C READ_WRITE /end MEASUREMENT
/begin MEASUREMENT fMIDLE "0:メカアイドル_SW_OFF  1:メカアイドル_SW_ON" UBYTE COMP_0283 1 100 0 1 BIT_MASK 0x0008 ECU_ADDRESS 0xFFFF1B9C READ_WRITE /end MEASUREMENT
/begin MEASUREMENT fMSFT "0:Mﾓｰﾄﾞ以外  1:Mﾓｰﾄﾞ時" UBYTE COMP_0283 1 100 0 1 BIT_MASK 0x0004 ECU_ADDRESS 0xFFFF1B9C READ_WRITE /end MEASUREMENT
/begin MEASUREMENT fNIDLELRN "0:Clutch_learning_not_demand  1:Clutch_learning_demand" UBYTE COMP_0283 1 100 0 1 BIT_MASK 0x0002 ECU_ADDRESS 0xFFFF1B9C READ_WRITE /end MEASUREMENT
/begin MEASUREMENT fNIDLESTB "0:N_Idle_Standby_NG  1:N_Idle_Standby_OK" UBYTE COMP_0283 1 100 0 1 BIT_MASK 0x0001 ECU_ADDRESS 0xFFFF1B9C READ_WRITE /end MEASUREMENT
/begin MEASUREMENT fNIEMREQ "0:非許可  1:許可" UBYTE COMP_0283 1 100 0 1 BIT_MASK 0x0080 ECU_ADDRESS 0xFFFF1B9D READ_WRITE /end MEASUREMENT
/begin MEASUREMENT fOILPNG "0:アイドルUP要求無し  1:アイドルUP要求有り" UBYTE COMP_0283 1 100 0 1 BIT_MASK 0x0040 ECU_ADDRESS 0xFFFF1B9D READ_WRITE /end MEASUREMENT
/begin MEASUREMENT fONSHIFT "0:変速中でない  1:変速中" UBYTE COMP_0283 1 100 0 1 BIT_MASK 0x0020 ECU_ADDRESS 0xFFFF1B9D READ_WRITE /end MEASUREMENT
/begin MEASUREMENT fPDSW "0:－  1:－" UBYTE COMP_0283 1 100 0 1 BIT_MASK 0x0010 ECU_ADDRESS 0xFFFF1B9D READ_WRITE /end MEASUREMENT
/begin MEASUREMENT fSLFCHK "0:異常  1:正常" UBYTE COMP_0283 1 100 0 1 BIT_MASK 0x0008 ECU_ADDRESS 0xFFFF1B9D READ_WRITE /end MEASUREMENT
/begin MEASUREMENT fSYNCCHK "0:異常  1:正常" UBYTE COMP_0283 1 100 0 1 BIT_MASK 0x0004 ECU_ADDRESS 0xFFFF1B9D READ_WRITE /end MEASUREMENT
/begin MEASUREMENT fTAINT "0:右記以外  1:TAINT_イニシャライズ終了" UBYTE COMP_0283 1 100 0 1 BIT_MASK 0x0002 ECU_ADDRESS 0xFFFF1B9D READ_WRITE /end MEASUREMENT
/begin MEASUREMENT fTIPDOF "0:条件不成立  1:条件成立" UBYTE COMP_0283 1 100 0 1 BIT_MASK 0x0001 ECU_ADDRESS 0xFFFF1B9D READ_WRITE /end MEASUREMENT
/begin MEASUREMENT fTPSTEND "0:TP始動時制御終了前  1:TP始動時制御終了" UBYTE COMP_0283 1 100 0 1 BIT_MASK 0x0080 ECU_ADDRESS 0xFFFF1B9E READ_WRITE /end MEASUREMENT
/begin MEASUREMENT fTRANS "0:定常  1:過渡" UBYTE COMP_0283 1 100 0 1 BIT_MASK 0x0040 ECU_ADDRESS 0xFFFF1B9E READ_WRITE /end MEASUREMENT
/begin MEASUREMENT fTVST "0:1以外  1:OFF後初回" UBYTE COMP_0283 1 100 0 1 BIT_MASK 0x0020 ECU_ADDRESS 0xFFFF1B9E READ_WRITE /end MEASUREMENT
/begin MEASUREMENT fIDLEPR_S "0:OFF  1:ON" UBYTE COMP_0283 1 100 0 1 BIT_MASK 0x0010 ECU_ADDRESS 0xFFFF1B9E READ_WRITE /end MEASUREMENT
/begin MEASUREMENT wfACSW "0:OFF  1:ON" UBYTE COMP_0283 1 100 0 1 BIT_MASK 0x0080 ECU_ADDRESS 0xFFFF3BED READ_WRITE /end MEASUREMENT
/begin MEASUREMENT wfENGSTP "0:エンスト判定未成立  1:エンスト判定成立" UBYTE COMP_0283 1 100 0 1 BIT_MASK 0x0040 ECU_ADDRESS 0xFFFF3BED READ_WRITE /end MEASUREMENT
/begin MEASUREMENT wfIDLE "0:ソフトアイドルスイッチON  1:ソフトアイドルスイッチOFF" UBYTE COMP_0283 1 100 0 1 BIT_MASK 0x0020 ECU_ADDRESS 0xFFFF3BED READ_WRITE /end MEASUREMENT
/begin MEASUREMENT wfIDSTJDG "0:アイドルストップ禁止  1:アイドルストップ許可" UBYTE COMP_0283 1 100 0 1 BIT_MASK 0x0010 ECU_ADDRESS 0xFFFF3BED READ_WRITE /end MEASUREMENT
/begin MEASUREMENT wfIGNSW "0:IGSW_OFF  1:IGSW_ON" UBYTE COMP_0283 1 100 0 1 BIT_MASK 0x0008 ECU_ADDRESS 0xFFFF3BED READ_WRITE /end MEASUREMENT
/begin MEASUREMENT wfNEWSTJDG "0:再始動制御禁止  1:再始動制御許可" UBYTE COMP_0283 1 100 0 1 BIT_MASK 0x0004 ECU_ADDRESS 0xFFFF3BED READ_WRITE /end MEASUREMENT
/begin MEASUREMENT wfNIDLE "0:非Nｱｲﾄﾞﾙ制御中  1:Nｱｲﾄﾞﾙ制御中" UBYTE COMP_0283 1 100 0 1 BIT_MASK 0x0002 ECU_ADDRESS 0xFFFF3BED READ_WRITE /end MEASUREMENT
/begin MEASUREMENT wfSTSW "0:STSW_OFF  1:STSW_ON" UBYTE COMP_0283 1 100 0 1 BIT_MASK 0x0001 ECU_ADDRESS 0xFFFF3BED READ_WRITE /end MEASUREMENT
/begin MEASUREMENT fACSW "0:OFF  1:ON" UBYTE COMP_0283 1 100 0 1 BIT_MASK 0x0080 ECU_ADDRESS 0xFFFF3BEE READ_WRITE /end MEASUREMENT
/begin MEASUREMENT fENGSTP "0:エンスト判定未成立  1:エンスト判定成立" UBYTE COMP_0283 1 100 0 1 BIT_MASK 0x0040 ECU_ADDRESS 0xFFFF3BEE READ_WRITE /end MEASUREMENT
/begin MEASUREMENT fIDLE "0:ソフトアイドルスイッチON  1:ソフトアイドルスイッチOFF" UBYTE COMP_0283 1 100 0 1 BIT_MASK 0x0020 ECU_ADDRESS 0xFFFF3BEE READ_WRITE /end MEASUREMENT
/begin MEASUREMENT fIDSTJDG "0:アイドルストップ禁止  1:アイドルストップ許可" UBYTE COMP_0283 1 100 0 1 BIT_MASK 0x0010 ECU_ADDRESS 0xFFFF3BEE READ_WRITE /end MEASUREMENT
/begin MEASUREMENT fIGNSW "0:IGSW_OFF  1:IGSW_ON" UBYTE COMP_0283 1 100 0 1 BIT_MASK 0x0008 ECU_ADDRESS 0xFFFF3BEE READ_WRITE /end MEASUREMENT
/begin MEASUREMENT fNEWSTJDG "0:再始動制御禁止  1:再始動制御許可" UBYTE COMP_0283 1 100 0 1 BIT_MASK 0x0004 ECU_ADDRESS 0xFFFF3BEE READ_WRITE /end MEASUREMENT
/begin MEASUREMENT fNIDLE "0:非Nｱｲﾄﾞﾙ制御中  1:Nｱｲﾄﾞﾙ制御中" UBYTE COMP_0283 1 100 0 1 BIT_MASK 0x0002 ECU_ADDRESS 0xFFFF3BEE READ_WRITE /end MEASUREMENT
/begin MEASUREMENT fSTSW "0:STSW_OFF  1:STSW_ON" UBYTE COMP_0283 1 100 0 1 BIT_MASK 0x0001 ECU_ADDRESS 0xFFFF3BEE READ_WRITE /end MEASUREMENT
/begin MEASUREMENT wfACCCUFAL "0:ACC正常  1:ACC異常(機能停止）" UBYTE COMP_0283 1 100 0 1 BIT_MASK 0x0080 ECU_ADDRESS 0xFFFF3BF1 READ_WRITE /end MEASUREMENT
/begin MEASUREMENT wfACCMSGCA "0:不成立  1:成立" UBYTE COMP_0283 1 100 0 1 BIT_MASK 0x0040 ECU_ADDRESS 0xFFFF3BF1 READ_WRITE /end MEASUREMENT
/begin MEASUREMENT wfACSW0 "0:OFF  1:ON" UBYTE COMP_0283 1 100 0 1 BIT_MASK 0x0020 ECU_ADDRESS 0xFFFF3BF1 READ_WRITE /end MEASUREMENT
/begin MEASUREMENT wfACSWLU "0:OFF  1:ON" UBYTE COMP_0283 1 100 0 1 BIT_MASK 0x0010 ECU_ADDRESS 0xFFFF3BF1 READ_WRITE /end MEASUREMENT
/begin MEASUREMENT wfACTDDL1 "0:DDL1アクティブテスト非実行中  1:DDL1アクティブテスト実行中" UBYTE COMP_0283 1 100 0 1 BIT_MASK 0x0008 ECU_ADDRESS 0xFFFF3BF1 READ_WRITE /end MEASUREMENT
/begin MEASUREMENT wfACTDDL2 "0:DDL2アクティブテスト非実行中  1:DDL2アクティブテスト実行中" UBYTE COMP_0283 1 100 0 1 BIT_MASK 0x0004 ECU_ADDRESS 0xFFFF3BF1 READ_WRITE /end MEASUREMENT
/begin MEASUREMENT wfAGBINVLD "0:有効トルク要求  1:無効トルク要求" UBYTE COMP_0283 1 100 0 1 BIT_MASK 0x0002 ECU_ADDRESS 0xFFFF3BF1 READ_WRITE /end MEASUREMENT
/begin MEASUREMENT wfAGBSIPNG "0:OK  1:NG" UBYTE COMP_0283 1 100 0 1 BIT_MASK 0x0001 ECU_ADDRESS 0xFFFF3BF1 READ_WRITE /end MEASUREMENT
/begin MEASUREMENT wfANTTMOUT "0:No_event  1:Anticipation_time_out_detected" UBYTE COMP_0283 1 100 0 1 BIT_MASK 0x0080 ECU_ADDRESS 0xFFFF3BF2 READ_WRITE /end MEASUREMENT
/begin MEASUREMENT wfAPSKD "0:右記以外  1:ｷｯｸﾀﾞｳﾝ判定中" UBYTE COMP_0283 1 100 0 1 BIT_MASK 0x0040 ECU_ADDRESS 0xFFFF3BF2 READ_WRITE /end MEASUREMENT
/begin MEASUREMENT wfASCDCLSW "0:スイッチ入力無し  1:スイッチ入力有り" UBYTE COMP_0283 1 100 0 1 BIT_MASK 0x0020 ECU_ADDRESS 0xFFFF3BF2 READ_WRITE /end MEASUREMENT
/begin MEASUREMENT wfASRMALFN "0:ASR正常  1:ASR異常" UBYTE COMP_0283 1 100 0 1 BIT_MASK 0x0010 ECU_ADDRESS 0xFFFF3BF2 READ_WRITE /end MEASUREMENT
/begin MEASUREMENT wfASRRQCDN "0:正常  1:異常" UBYTE COMP_0283 1 100 0 1 BIT_MASK 0x0008 ECU_ADDRESS 0xFFFF3BF2 READ_WRITE /end MEASUREMENT
/begin MEASUREMENT wfATNEUT "0:NEUT_SW_OFF  1:NEUT_SW_ON" UBYTE COMP_0283 1 100 0 1 BIT_MASK 0x0004 ECU_ADDRESS 0xFFFF3BF2 READ_WRITE /end MEASUREMENT
/begin MEASUREMENT wfBCMNG "0:正常  1:異常" UBYTE COMP_0283 1 100 0 1 BIT_MASK 0x0002 ECU_ADDRESS 0xFFFF3BF2 READ_WRITE /end MEASUREMENT
/begin MEASUREMENT wfBRKSWBCM "0:Brake_not_activated  1:Brake_activated" UBYTE COMP_0283 1 100 0 1 BIT_MASK 0x0001 ECU_ADDRESS 0xFFFF3BF2 READ_WRITE /end MEASUREMENT
/begin MEASUREMENT wfCANICNG "0:正常  1:NG" UBYTE COMP_0283 1 100 0 1 BIT_MASK 0x0080 ECU_ADDRESS 0xFFFF3BF3 READ_WRITE /end MEASUREMENT
/begin MEASUREMENT wfCANINIT "0:CANイニシャル未了  1:CANイニシャル終了" UBYTE COMP_0283 1 100 0 1 BIT_MASK 0x0040 ECU_ADDRESS 0xFFFF3BF3 READ_WRITE /end MEASUREMENT
/begin MEASUREMENT wfCANMASK "0:送受信ｶｳﾝﾀｰをｸﾘｱしない  1:送受信ｶｳﾝﾀｰをｸﾘｱする" UBYTE COMP_0283 1 100 0 1 BIT_MASK 0x0020 ECU_ADDRESS 0xFFFF3BF3 READ_WRITE /end MEASUREMENT
/begin MEASUREMENT wfCAPWCLR "0:F/C警告灯点灯クリア要求なし  1:F/C警告灯点灯クリア要求あり" UBYTE COMP_0283 1 100 0 1 BIT_MASK 0x0010 ECU_ADDRESS 0xFFFF3BF3 READ_WRITE /end MEASUREMENT
/begin MEASUREMENT wfCRENGSTP "0:Crankingエンスト判定未成立  1:Crankingエンスト判定成立" UBYTE COMP_0283 1 100 0 1 BIT_MASK 0x0008 ECU_ADDRESS 0xFFFF3BF3 READ_WRITE /end MEASUREMENT
/begin MEASUREMENT wfCRUISE2 "0:ASCD許可後クルーズ中でない  1:ASCD許可後クルーズ中" UBYTE COMP_0283 1 100 0 1 BIT_MASK 0x0004 ECU_ADDRESS 0xFFFF3BF3 READ_WRITE /end MEASUREMENT
/begin MEASUREMENT wfDERATING "0:No_fault  1:System_in_derating" UBYTE COMP_0283 1 100 0 1 BIT_MASK 0x0002 ECU_ADDRESS 0xFFFF3BF3 READ_WRITE /end MEASUREMENT
/begin MEASUREMENT wfDISPMPH "0:km/h表示  1:MPH表示" UBYTE COMP_0283 1 100 0 1 BIT_MASK 0x0001 ECU_ADDRESS 0xFFFF3BF3 READ_WRITE /end MEASUREMENT
/begin MEASUREMENT wfDOWNVSP "0:急減速以外  1:急減速" UBYTE COMP_0283 1 100 0 1 BIT_MASK 0x0080 ECU_ADDRESS 0xFFFF3BF4 READ_WRITE /end MEASUREMENT
/begin MEASUREMENT wfECMACCON "0:非作動中  1:作動中" UBYTE COMP_0283 1 100 0 1 BIT_MASK 0x0040 ECU_ADDRESS 0xFFFF3BF4 READ_WRITE /end MEASUREMENT
/begin MEASUREMENT wfEGST "0:OFF  1:ON" UBYTE COMP_0283 1 100 0 1 BIT_MASK 0x0020 ECU_ADDRESS 0xFFFF3BF4 READ_WRITE /end MEASUREMENT
/begin MEASUREMENT wfEONVNBC "0:前回トリップでの履歴無し  1:前回トリップでの履歴有り" UBYTE COMP_0283 1 100 0 1 BIT_MASK 0x0010 ECU_ADDRESS 0xFFFF3BF4 READ_WRITE /end MEASUREMENT
/begin MEASUREMENT wfEPSNG "0:正常  1:異常" UBYTE COMP_0283 1 100 0 1 BIT_MASK 0x0008 ECU_ADDRESS 0xFFFF3BF4 READ_WRITE /end MEASUREMENT
/begin MEASUREMENT wfESPMALFN "0:ESP正常  1:ESP異常" UBYTE COMP_0283 1 100 0 1 BIT_MASK 0x0004 ECU_ADDRESS 0xFFFF3BF4 READ_WRITE /end MEASUREMENT
/begin MEASUREMENT wfETCENA "0:異常  1:正常" UBYTE COMP_0283 1 100 0 1 BIT_MASK 0x0002 ECU_ADDRESS 0xFFFF3BF4 READ_WRITE /end MEASUREMENT
/begin MEASUREMENT wfETQDNETS "0:電制4WD駆動保護エンジントルク低  1:電制4WD駆動保護エンジントルク低" UBYTE COMP_0283 1 100 0 1 BIT_MASK 0x0001 ECU_ADDRESS 0xFFFF3BF4 READ_WRITE /end MEASUREMENT
/begin MEASUREMENT wfETQDNR "0:低減要求なし  1:低減要求あり" UBYTE COMP_0283 1 100 0 1 BIT_MASK 0x0080 ECU_ADDRESS 0xFFFF3BF5 READ_WRITE /end MEASUREMENT
/begin MEASUREMENT wfETSCLKNG "0:OK  1:NG" UBYTE COMP_0283 1 100 0 1 BIT_MASK 0x0040 ECU_ADDRESS 0xFFFF3BF5 READ_WRITE /end MEASUREMENT
/begin MEASUREMENT wfETSIVDCA "0:OK  1:NG" UBYTE COMP_0283 1 100 0 1 BIT_MASK 0x0020 ECU_ADDRESS 0xFFFF3BF5 READ_WRITE /end MEASUREMENT
/begin MEASUREMENT wfFAFDOK "0:故障中  1:正常" UBYTE COMP_0283 1 100 0 1 BIT_MASK 0x0010 ECU_ADDRESS 0xFFFF3BF5 READ_WRITE /end MEASUREMENT
/begin MEASUREMENT wfFCLVSP "0:条件不成立  1:条件成立" UBYTE COMP_0283 1 100 0 1 BIT_MASK 0x0008 ECU_ADDRESS 0xFFFF3BF5 READ_WRITE /end MEASUREMENT
/begin MEASUREMENT wfFDGNCLR2 "0:診断データクリア非要求  1:診断データクリア要求" UBYTE COMP_0283 1 100 0 1 BIT_MASK 0x0004 ECU_ADDRESS 0xFFFF3BF5 READ_WRITE /end MEASUREMENT
/begin MEASUREMENT wfFICTMPH "0:ECM発熱抑制制御実施要求なし  1:ECM発熱抑制制御実施要求あり" UBYTE COMP_0283 1 100 0 1 BIT_MASK 0x0002 ECU_ADDRESS 0xFFFF3BF5 READ_WRITE /end MEASUREMENT
/begin MEASUREMENT wfFICTMPHL "0:ECM高温時リミッタ制御実施要求な  1:ECM高温時リミッタ制御実施要求あ" UBYTE COMP_0283 1 100 0 1 BIT_MASK 0x0001 ECU_ADDRESS 0xFFFF3BF5 READ_WRITE /end MEASUREMENT
/begin MEASUREMENT wfFSRT "0:右記以外  1:SRTモード中" UBYTE COMP_0283 1 100 0 1 BIT_MASK 0x0080 ECU_ADDRESS 0xFFFF3BF6 READ_WRITE /end MEASUREMENT
/begin MEASUREMENT wfFTANOK "0:未演算  1:演算" UBYTE COMP_0283 1 100 0 1 BIT_MASK 0x0040 ECU_ADDRESS 0xFFFF3BF6 READ_WRITE /end MEASUREMENT
/begin MEASUREMENT wfGASCDNG "0:NGでない  1:NG" UBYTE COMP_0283 1 100 0 1 BIT_MASK 0x0020 ECU_ADDRESS 0xFFFF3BF6 READ_WRITE /end MEASUREMENT
/begin MEASUREMENT wfGKTVOLRN "0:GKTVOF学習未経験  1:GKTVOF学習経験" UBYTE COMP_0283 1 100 0 1 BIT_MASK 0x0010 ECU_ADDRESS 0xFFFF3BF6 READ_WRITE /end MEASUREMENT
/begin MEASUREMENT wfIDLENI "0:Nアイドル非要求  1:Nアイドル要求" UBYTE COMP_0283 1 100 0 1 BIT_MASK 0x0008 ECU_ADDRESS 0xFFFF3BF6 READ_WRITE /end MEASUREMENT
/begin MEASUREMENT wfIHRST "0:USMからの受信ﾃﾞｰﾀ=0  1:USMからの受信ﾃﾞｰﾀ=1" UBYTE COMP_0283 1 100 0 1 BIT_MASK 0x0004 ECU_ADDRESS 0xFFFF3BF6 READ_WRITE /end MEASUREMENT
/begin MEASUREMENT wfIMMCOMNG "0:正常  1:故障" UBYTE COMP_0283 1 100 0 1 BIT_MASK 0x0002 ECU_ADDRESS 0xFFFF3BF6 READ_WRITE /end MEASUREMENT
/begin MEASUREMENT wfIMMFCUT "0:要求無し  1:要求有り" UBYTE COMP_0283 1 100 0 1 BIT_MASK 0x0001 ECU_ADDRESS 0xFFFF3BF6 READ_WRITE /end MEASUREMENT
/begin MEASUREMENT wfIMMIMLCK "0:正常  1:故障" UBYTE COMP_0283 1 100 0 1 BIT_MASK 0x0080 ECU_ADDRESS 0xFFFF3BF7 READ_WRITE /end MEASUREMENT
/begin MEASUREMENT wfIMMKEYER "0:正常  1:故障" UBYTE COMP_0283 1 100 0 1 BIT_MASK 0x0040 ECU_ADDRESS 0xFFFF3BF7 READ_WRITE /end MEASUREMENT
/begin MEASUREMENT wfIMMKEYNG "0:正常  1:故障" UBYTE COMP_0283 1 100 0 1 BIT_MASK 0x0020 ECU_ADDRESS 0xFFFF3BF7 READ_WRITE /end MEASUREMENT
/begin MEASUREMENT wfIMMLCMNG "0:正常  1:故障" UBYTE COMP_0283 1 100 0 1 BIT_MASK 0x0010 ECU_ADDRESS 0xFFFF3BF7 READ_WRITE /end MEASUREMENT
/begin MEASUREMENT wfIMMVIDNG "0:正常  1:故障" UBYTE COMP_0283 1 100 0 1 BIT_MASK 0x0008 ECU_ADDRESS 0xFFFF3BF7 READ_WRITE /end MEASUREMENT
/begin MEASUREMENT wfINCHACT "0:不許可  1:許可" UBYTE COMP_0283 1 100 0 1 BIT_MASK 0x0004 ECU_ADDRESS 0xFFFF3BF7 READ_WRITE /end MEASUREMENT
/begin MEASUREMENT wfINDDRNG "0:Dﾚﾝｼﾞ以外  1:Dﾚﾝｼﾞ" UBYTE COMP_0283 1 100 0 1 BIT_MASK 0x0002 ECU_ADDRESS 0xFFFF3BF7 READ_WRITE /end MEASUREMENT
/begin MEASUREMENT wfINHCUT "0:USMからの受信ﾃﾞｰﾀ=0  1:USMからの受信ﾃﾞｰﾀ=1" UBYTE COMP_0283 1 100 0 1 BIT_MASK 0x0001 ECU_ADDRESS 0xFFFF3BF7 READ_WRITE /end MEASUREMENT
/begin MEASUREMENT wfINHTOFF "0:ｲﾝﾋﾋﾞﾀｶｯﾄｵﾌ指令がOFF  1:ｲﾝﾋﾋﾞﾀｶｯﾄｵﾌ指令がON" UBYTE COMP_0283 1 100 0 1 BIT_MASK 0x0080 ECU_ADDRESS 0xFFFF3BF8 READ_WRITE /end MEASUREMENT
/begin MEASUREMENT wfISACT "0:IS中判定していない  1:IS中判定している" UBYTE COMP_0283 1 100 0 1 BIT_MASK 0x0040 ECU_ADDRESS 0xFFFF3BF8 READ_WRITE /end MEASUREMENT
/begin MEASUREMENT wfISRSRICH "0:不許可  1:許可" UBYTE COMP_0283 1 100 0 1 BIT_MASK 0x0020 ECU_ADDRESS 0xFFFF3BF8 READ_WRITE /end MEASUREMENT
/begin MEASUREMENT wfISSTREQ "0:不要  1:要求" UBYTE COMP_0283 1 100 0 1 BIT_MASK 0x0010 ECU_ADDRESS 0xFFFF3BF8 READ_WRITE /end MEASUREMENT
/begin MEASUREMENT wfJKSRCOFF "0:右記以外  1:回転数制御禁止中" UBYTE COMP_0283 1 100 0 1 BIT_MASK 0x0008 ECU_ADDRESS 0xFFFF3BF8 READ_WRITE /end MEASUREMENT
/begin MEASUREMENT wfLRNEND "0:未終了  1:終了" UBYTE COMP_0283 1 100 0 1 BIT_MASK 0x0004 ECU_ADDRESS 0xFFFF3BF8 READ_WRITE /end MEASUREMENT
/begin MEASUREMENT wfMETNG "0:正常  1:異常" UBYTE COMP_0283 1 100 0 1 BIT_MASK 0x0002 ECU_ADDRESS 0xFFFF3BF8 READ_WRITE /end MEASUREMENT
/begin MEASUREMENT wfMGISCFB "0:Moter_ISC_F/B  1:Not_Moter_ISC_F/B" UBYTE COMP_0283 1 100 0 1 BIT_MASK 0x0001 ECU_ADDRESS 0xFFFF3BF8 READ_WRITE /end MEASUREMENT
/begin MEASUREMENT wfMISFFAL "0:OK  1:NG" UBYTE COMP_0283 1 100 0 1 BIT_MASK 0x0080 ECU_ADDRESS 0xFFFF3BF9 READ_WRITE /end MEASUREMENT
/begin MEASUREMENT wfMSRRQCDN "0:正常  1:異常" UBYTE COMP_0283 1 100 0 1 BIT_MASK 0x0040 ECU_ADDRESS 0xFFFF3BF9 READ_WRITE /end MEASUREMENT
/begin MEASUREMENT wfMUPSFTTD "0:要求なし  1:要求あり" UBYTE COMP_0283 1 100 0 1 BIT_MASK 0x0020 ECU_ADDRESS 0xFFFF3BF9 READ_WRITE /end MEASUREMENT
/begin MEASUREMENT wfODCANACC "0:要求無し  1:要求有り" UBYTE COMP_0283 1 100 0 1 BIT_MASK 0x0010 ECU_ADDRESS 0xFFFF3BF9 READ_WRITE /end MEASUREMENT
/begin MEASUREMENT wfOUTREVF "0:正常  1:CVT出力回転数フェール" UBYTE COMP_0283 1 100 0 1 BIT_MASK 0x0008 ECU_ADDRESS 0xFFFF3BF9 READ_WRITE /end MEASUREMENT
/begin MEASUREMENT wfPPAMBRNP "0:パージカット要求なし  1:パージカット要求あり" UBYTE COMP_0283 1 100 0 1 BIT_MASK 0x0004 ECU_ADDRESS 0xFFFF3BF9 READ_WRITE /end MEASUREMENT
/begin MEASUREMENT wfPTDCANNG "0:正常  1:異常" UBYTE COMP_0283 1 100 0 1 BIT_MASK 0x0002 ECU_ADDRESS 0xFFFF3BF9 READ_WRITE /end MEASUREMENT
/begin MEASUREMENT wfREVOUNI "0:レボユニモニタ信号LO  1:レボユニモニタ信号HI" UBYTE COMP_0283 1 100 0 1 BIT_MASK 0x0001 ECU_ADDRESS 0xFFFF3BF9 READ_WRITE /end MEASUREMENT
/begin MEASUREMENT wfREVSW "0:－  1:－" UBYTE COMP_0283 1 100 0 1 BIT_MASK 0x0080 ECU_ADDRESS 0xFFFF3BFA READ_WRITE /end MEASUREMENT
/begin MEASUREMENT wfRSTRQACT "0:非実行中  1:実行中" UBYTE COMP_0283 1 100 0 1 BIT_MASK 0x0040 ECU_ADDRESS 0xFFFF3BFA READ_WRITE /end MEASUREMENT
/begin MEASUREMENT wfSBDP "0:不成立  1:成立" UBYTE COMP_0283 1 100 0 1 BIT_MASK 0x0020 ECU_ADDRESS 0xFFFF3BFA READ_WRITE /end MEASUREMENT
/begin MEASUREMENT wfSENNG "0:許可  1:不許可" UBYTE COMP_0283 1 100 0 1 BIT_MASK 0x0010 ECU_ADDRESS 0xFFFF3BFA READ_WRITE /end MEASUREMENT
/begin MEASUREMENT wfSIPFULL "0:不成立  1:成立" UBYTE COMP_0283 1 100 0 1 BIT_MASK 0x0008 ECU_ADDRESS 0xFFFF3BFA READ_WRITE /end MEASUREMENT
/begin MEASUREMENT wfSIPMAX "0:不成立  1:成立" UBYTE COMP_0283 1 100 0 1 BIT_MASK 0x0004 ECU_ADDRESS 0xFFFF3BFA READ_WRITE /end MEASUREMENT
/begin MEASUREMENT wfSIPMIN "0:不成立  1:成立" UBYTE COMP_0283 1 100 0 1 BIT_MASK 0x0002 ECU_ADDRESS 0xFFFF3BFA READ_WRITE /end MEASUREMENT
/begin MEASUREMENT wfSIPREV "0:回転数制御要求無し  1:回転数制御要求有り" UBYTE COMP_0283 1 100 0 1 BIT_MASK 0x0001 ECU_ADDRESS 0xFFFF3BFA READ_WRITE /end MEASUREMENT
/begin MEASUREMENT wfSIPROG "0:AGBトルク要求無し  1:AGBトルク要求有り" UBYTE COMP_0283 1 100 0 1 BIT_MASK 0x0080 ECU_ADDRESS 0xFFFF3BFB READ_WRITE /end MEASUREMENT
/begin MEASUREMENT wfSNOWSW "0:SNOW_SW_OFF  1:SNOW_SW_ON" UBYTE COMP_0283 1 100 0 1 BIT_MASK 0x0040 ECU_ADDRESS 0xFFFF3BFB READ_WRITE /end MEASUREMENT
/begin MEASUREMENT wfSPCINST "0:SPCINT算出前  1:SPCINT算出終了" UBYTE COMP_0283 1 100 0 1 BIT_MASK 0x0020 ECU_ADDRESS 0xFFFF3BFB READ_WRITE /end MEASUREMENT
/begin MEASUREMENT wfSSGBDUMP "0:No_failure  1:Detected__failure_/_Battery_disc" UBYTE COMP_0283 1 100 0 1 BIT_MASK 0x0010 ECU_ADDRESS 0xFFFF3BFB READ_WRITE /end MEASUREMENT
/begin MEASUREMENT wfSSGHEAT "0:No_failure  1:Detected_failure_/_Electronic_ov" UBYTE COMP_0283 1 100 0 1 BIT_MASK 0x0008 ECU_ADDRESS 0xFFFF3BFB READ_WRITE /end MEASUREMENT
/begin MEASUREMENT wfSSGTHERM "0:No_event  1:Stop-start_inhibitation_demand" UBYTE COMP_0283 1 100 0 1 BIT_MASK 0x0004 ECU_ADDRESS 0xFFFF3BFB READ_WRITE /end MEASUREMENT
/begin MEASUREMENT wfSSGVHIGH "0:No_failure  1:Detected_failure_/_Network_volta" UBYTE COMP_0283 1 100 0 1 BIT_MASK 0x0002 ECU_ADDRESS 0xFFFF3BFB READ_WRITE /end MEASUREMENT
/begin MEASUREMENT wfSSOKENST "0:リレーオフ禁止  1:リレーオフ許可" UBYTE COMP_0283 1 100 0 1 BIT_MASK 0x0001 ECU_ADDRESS 0xFFFF3BFB READ_WRITE /end MEASUREMENT
/begin MEASUREMENT wfSTCUT "0:USMからの受信ﾃﾞｰﾀ=0  1:USMからの受信ﾃﾞｰﾀ=1" UBYTE COMP_0283 1 100 0 1 BIT_MASK 0x0080 ECU_ADDRESS 0xFFFF3BFC READ_WRITE /end MEASUREMENT
/begin MEASUREMENT wfSTMST "0:USMからの受信ﾃﾞｰﾀ=0  1:USMからの受信ﾃﾞｰﾀ=1" UBYTE COMP_0283 1 100 0 1 BIT_MASK 0x0040 ECU_ADDRESS 0xFFFF3BFC READ_WRITE /end MEASUREMENT
/begin MEASUREMENT wfSYSTMNG "0:許可  1:不許可" UBYTE COMP_0283 1 100 0 1 BIT_MASK 0x0020 ECU_ADDRESS 0xFFFF3BFC READ_WRITE /end MEASUREMENT
/begin MEASUREMENT wfTANSET "0:未経験  1:経験済" UBYTE COMP_0283 1 100 0 1 BIT_MASK 0x0010 ECU_ADDRESS 0xFFFF3BFC READ_WRITE /end MEASUREMENT
/begin MEASUREMENT wfTCSACT "0:TCS非動作時  1:TCS動作時" UBYTE COMP_0283 1 100 0 1 BIT_MASK 0x0008 ECU_ADDRESS 0xFFFF3BFC READ_WRITE /end MEASUREMENT
/begin MEASUREMENT wfTCVTRG10 "0:実行中でない  1:実行中" UBYTE COMP_0283 1 100 0 1 BIT_MASK 0x0004 ECU_ADDRESS 0xFFFF3BFC READ_WRITE /end MEASUREMENT
/begin MEASUREMENT wfTFINTD "0:未算出  1:算出済" UBYTE COMP_0283 1 100 0 1 BIT_MASK 0x0002 ECU_ADDRESS 0xFFFF3BFC READ_WRITE /end MEASUREMENT
/begin MEASUREMENT wfUSMNG "0:正常  1:異常" UBYTE COMP_0283 1 100 0 1 BIT_MASK 0x0001 ECU_ADDRESS 0xFFFF3BFC READ_WRITE /end MEASUREMENT
/begin MEASUREMENT wfUSMNG2 "0:異常未検出  1:異常検出" UBYTE COMP_0283 1 100 0 1 BIT_MASK 0x0080 ECU_ADDRESS 0xFFFF3BFD READ_WRITE /end MEASUREMENT
/begin MEASUREMENT wfVASCDNG "0:NGでない  1:NG" UBYTE COMP_0283 1 100 0 1 BIT_MASK 0x0040 ECU_ADDRESS 0xFFFF3BFD READ_WRITE /end MEASUREMENT
/begin MEASUREMENT wfVDCACT "0:VDC非動作時  1:VDC動作時" UBYTE COMP_0283 1 100 0 1 BIT_MASK 0x0020 ECU_ADDRESS 0xFFFF3BFD READ_WRITE /end MEASUREMENT
/begin MEASUREMENT wfVPRNGH "0:-  1:-" UBYTE COMP_0283 1 100 0 1 BIT_MASK 0x0010 ECU_ADDRESS 0xFFFF3BFD READ_WRITE /end MEASUREMENT
/begin MEASUREMENT wfVPRNGL "0:-  1:-" UBYTE COMP_0283 1 100 0 1 BIT_MASK 0x0008 ECU_ADDRESS 0xFFFF3BFD READ_WRITE /end MEASUREMENT
/begin MEASUREMENT wfVSINPNG1 "0:No_failure  1:Detected_failure/Input_circuit_f" UBYTE COMP_0283 1 100 0 1 BIT_MASK 0x0004 ECU_ADDRESS 0xFFFF3BFD READ_WRITE /end MEASUREMENT
/begin MEASUREMENT wfVSINPNG2 "0:No_failure  1:Detected_failure/Input_circuit_f" UBYTE COMP_0283 1 100 0 1 BIT_MASK 0x0002 ECU_ADDRESS 0xFFFF3BFD READ_WRITE /end MEASUREMENT
/begin MEASUREMENT wfVSOUTNG1 "0:No_failure  1:Detected_failure/Output_circuit_" UBYTE COMP_0283 1 100 0 1 BIT_MASK 0x0001 ECU_ADDRESS 0xFFFF3BFD READ_WRITE /end MEASUREMENT
/begin MEASUREMENT wfVSOUTNG2 "0:No_failure  1:Detected_failure/Output_circuit_" UBYTE COMP_0283 1 100 0 1 BIT_MASK 0x0080 ECU_ADDRESS 0xFFFF3BFE READ_WRITE /end MEASUREMENT
/begin MEASUREMENT wfVSTWARN1 "0:No_warning  1:Detected_warning/Temperature_war" UBYTE COMP_0283 1 100 0 1 BIT_MASK 0x0040 ECU_ADDRESS 0xFFFF3BFE READ_WRITE /end MEASUREMENT
/begin MEASUREMENT wfVSTWARN2 "0:No_warning  1:Detected_warning/Temperature_war" UBYTE COMP_0283 1 100 0 1 BIT_MASK 0x0020 ECU_ADDRESS 0xFFFF3BFE READ_WRITE /end MEASUREMENT
/begin MEASUREMENT wfVSUNING1 "0:No_failure  1:Detected_failure/Unit_internal_f" UBYTE COMP_0283 1 100 0 1 BIT_MASK 0x0010 ECU_ADDRESS 0xFFFF3BFE READ_WRITE /end MEASUREMENT
/begin MEASUREMENT wfVSUNING2 "0:No_failure  1:Detected_failure/Unit_internal_f" UBYTE COMP_0283 1 100 0 1 BIT_MASK 0x0008 ECU_ADDRESS 0xFFFF3BFE READ_WRITE /end MEASUREMENT
/begin MEASUREMENT wfIDLE_S "0:IDLE_OFF  1:IDLE_ON" UBYTE COMP_0283 1 100 0 1 BIT_MASK 0x0004 ECU_ADDRESS 0xFFFF3BFE READ_WRITE /end MEASUREMENT
/begin MEASUREMENT fACCCUFAL "0:ACC正常  1:ACC異常(機能停止）" UBYTE COMP_0283 1 100 0 1 BIT_MASK 0x0080 ECU_ADDRESS 0xFFFF3BFF READ_WRITE /end MEASUREMENT
/begin MEASUREMENT fACCMSGCA "0:不成立  1:成立" UBYTE COMP_0283 1 100 0 1 BIT_MASK 0x0040 ECU_ADDRESS 0xFFFF3BFF READ_WRITE /end MEASUREMENT
/begin MEASUREMENT fACSW0 "0:OFF  1:ON" UBYTE COMP_0283 1 100 0 1 BIT_MASK 0x0020 ECU_ADDRESS 0xFFFF3BFF READ_WRITE /end MEASUREMENT
/begin MEASUREMENT fACSWLU "0:OFF  1:ON" UBYTE COMP_0283 1 100 0 1 BIT_MASK 0x0010 ECU_ADDRESS 0xFFFF3BFF READ_WRITE /end MEASUREMENT
/begin MEASUREMENT fACTDDL1 "0:DDL1アクティブテスト非実行中  1:DDL1アクティブテスト実行中" UBYTE COMP_0283 1 100 0 1 BIT_MASK 0x0008 ECU_ADDRESS 0xFFFF3BFF READ_WRITE /end MEASUREMENT
/begin MEASUREMENT fACTDDL2 "0:DDL2アクティブテスト非実行中  1:DDL2アクティブテスト実行中" UBYTE COMP_0283 1 100 0 1 BIT_MASK 0x0004 ECU_ADDRESS 0xFFFF3BFF READ_WRITE /end MEASUREMENT
/begin MEASUREMENT fAGBINVLD "0:有効トルク要求  1:無効トルク要求" UBYTE COMP_0283 1 100 0 1 BIT_MASK 0x0002 ECU_ADDRESS 0xFFFF3BFF READ_WRITE /end MEASUREMENT
/begin MEASUREMENT fAGBSIPNG "0:OK  1:NG" UBYTE COMP_0283 1 100 0 1 BIT_MASK 0x0001 ECU_ADDRESS 0xFFFF3BFF READ_WRITE /end MEASUREMENT
/begin MEASUREMENT fANTTMOUT "0:No_event  1:Anticipation_time_out_detected" UBYTE COMP_0283 1 100 0 1 BIT_MASK 0x0080 ECU_ADDRESS 0xFFFF3C00 READ_WRITE /end MEASUREMENT
/begin MEASUREMENT fAPSKD "0:右記以外  1:ｷｯｸﾀﾞｳﾝ判定中" UBYTE COMP_0283 1 100 0 1 BIT_MASK 0x0040 ECU_ADDRESS 0xFFFF3C00 READ_WRITE /end MEASUREMENT
/begin MEASUREMENT fASCDCLSW "0:スイッチ入力無し  1:スイッチ入力有り" UBYTE COMP_0283 1 100 0 1 BIT_MASK 0x0020 ECU_ADDRESS 0xFFFF3C00 READ_WRITE /end MEASUREMENT
/begin MEASUREMENT fASRMALFN "0:ASR正常  1:ASR異常" UBYTE COMP_0283 1 100 0 1 BIT_MASK 0x0010 ECU_ADDRESS 0xFFFF3C00 READ_WRITE /end MEASUREMENT
/begin MEASUREMENT fASRRQCDN "0:正常  1:異常" UBYTE COMP_0283 1 100 0 1 BIT_MASK 0x0008 ECU_ADDRESS 0xFFFF3C00 READ_WRITE /end MEASUREMENT
/begin MEASUREMENT fATNEUT "0:NEUT_SW_OFF  1:NEUT_SW_ON" UBYTE COMP_0283 1 100 0 1 BIT_MASK 0x0004 ECU_ADDRESS 0xFFFF3C00 READ_WRITE /end MEASUREMENT
/begin MEASUREMENT fBCMNG "0:正常  1:異常" UBYTE COMP_0283 1 100 0 1 BIT_MASK 0x0002 ECU_ADDRESS 0xFFFF3C00 READ_WRITE /end MEASUREMENT
/begin MEASUREMENT fBRKSWBCM "0:Brake_not_activated  1:Brake_activated" UBYTE COMP_0283 1 100 0 1 BIT_MASK 0x0001 ECU_ADDRESS 0xFFFF3C00 READ_WRITE /end MEASUREMENT
/begin MEASUREMENT fCANICNG "0:正常  1:NG" UBYTE COMP_0283 1 100 0 1 BIT_MASK 0x0080 ECU_ADDRESS 0xFFFF3C01 READ_WRITE /end MEASUREMENT
/begin MEASUREMENT fCANINIT "0:CANイニシャル未了  1:CANイニシャル終了" UBYTE COMP_0283 1 100 0 1 BIT_MASK 0x0040 ECU_ADDRESS 0xFFFF3C01 READ_WRITE /end MEASUREMENT
/begin MEASUREMENT fCANMASK "0:送受信ｶｳﾝﾀｰをｸﾘｱしない  1:送受信ｶｳﾝﾀｰをｸﾘｱする" UBYTE COMP_0283 1 100 0 1 BIT_MASK 0x0020 ECU_ADDRESS 0xFFFF3C01 READ_WRITE /end MEASUREMENT
/begin MEASUREMENT fCAPWCLR "0:F/C警告灯点灯クリア要求なし  1:F/C警告灯点灯クリア要求あり" UBYTE COMP_0283 1 100 0 1 BIT_MASK 0x0010 ECU_ADDRESS 0xFFFF3C01 READ_WRITE /end MEASUREMENT
/begin MEASUREMENT fCRENGSTP "0:Crankingエンスト判定未成立  1:Crankingエンスト判定成立" UBYTE COMP_0283 1 100 0 1 BIT_MASK 0x0008 ECU_ADDRESS 0xFFFF3C01 READ_WRITE /end MEASUREMENT
/begin MEASUREMENT fCRUISE2 "0:ASCD許可後クルーズ中でない  1:ASCD許可後クルーズ中" UBYTE COMP_0283 1 100 0 1 BIT_MASK 0x0004 ECU_ADDRESS 0xFFFF3C01 READ_WRITE /end MEASUREMENT
/begin MEASUREMENT fDERATING "0:No_fault  1:System_in_derating" UBYTE COMP_0283 1 100 0 1 BIT_MASK 0x0002 ECU_ADDRESS 0xFFFF3C01 READ_WRITE /end MEASUREMENT
/begin MEASUREMENT fDISPMPH "0:km/h表示  1:MPH表示" UBYTE COMP_0283 1 100 0 1 BIT_MASK 0x0001 ECU_ADDRESS 0xFFFF3C01 READ_WRITE /end MEASUREMENT
/begin MEASUREMENT fDOWNVSP "0:急減速以外  1:急減速" UBYTE COMP_0283 1 100 0 1 BIT_MASK 0x0080 ECU_ADDRESS 0xFFFF3C02 READ_WRITE /end MEASUREMENT
/begin MEASUREMENT fECMACCON "0:非作動中  1:作動中" UBYTE COMP_0283 1 100 0 1 BIT_MASK 0x0040 ECU_ADDRESS 0xFFFF3C02 READ_WRITE /end MEASUREMENT
/begin MEASUREMENT fEGST "0:OFF  1:ON" UBYTE COMP_0283 1 100 0 1 BIT_MASK 0x0020 ECU_ADDRESS 0xFFFF3C02 READ_WRITE /end MEASUREMENT
/begin MEASUREMENT fEONVNBC "0:前回トリップでの履歴無し  1:前回トリップでの履歴有り" UBYTE COMP_0283 1 100 0 1 BIT_MASK 0x0010 ECU_ADDRESS 0xFFFF3C02 READ_WRITE /end MEASUREMENT
/begin MEASUREMENT fEPSNG "0:正常  1:異常" UBYTE COMP_0283 1 100 0 1 BIT_MASK 0x0008 ECU_ADDRESS 0xFFFF3C02 READ_WRITE /end MEASUREMENT
/begin MEASUREMENT fESPMALFN "0:ESP正常  1:ESP異常" UBYTE COMP_0283 1 100 0 1 BIT_MASK 0x0004 ECU_ADDRESS 0xFFFF3C02 READ_WRITE /end MEASUREMENT
/begin MEASUREMENT fETCENA "0:異常  1:正常" UBYTE COMP_0283 1 100 0 1 BIT_MASK 0x0002 ECU_ADDRESS 0xFFFF3C02 READ_WRITE /end MEASUREMENT
/begin MEASUREMENT fETQDNETS "0:電制4WD駆動保護エンジントルク低  1:電制4WD駆動保護エンジントルク低" UBYTE COMP_0283 1 100 0 1 BIT_MASK 0x0001 ECU_ADDRESS 0xFFFF3C02 READ_WRITE /end MEASUREMENT
/begin MEASUREMENT fETQDNR "0:低減要求なし  1:低減要求あり" UBYTE COMP_0283 1 100 0 1 BIT_MASK 0x0080 ECU_ADDRESS 0xFFFF3C03 READ_WRITE /end MEASUREMENT
/begin MEASUREMENT fETSCLKNG "0:OK  1:NG" UBYTE COMP_0283 1 100 0 1 BIT_MASK 0x0040 ECU_ADDRESS 0xFFFF3C03 READ_WRITE /end MEASUREMENT
/begin MEASUREMENT fETSIVDCA "0:OK  1:NG" UBYTE COMP_0283 1 100 0 1 BIT_MASK 0x0020 ECU_ADDRESS 0xFFFF3C03 READ_WRITE /end MEASUREMENT
/begin MEASUREMENT fFAFDOK "0:故障中  1:正常" UBYTE COMP_0283 1 100 0 1 BIT_MASK 0x0010 ECU_ADDRESS 0xFFFF3C03 READ_WRITE /end MEASUREMENT
/begin MEASUREMENT fFCLVSP "0:条件不成立  1:条件成立" UBYTE COMP_0283 1 100 0 1 BIT_MASK 0x0008 ECU_ADDRESS 0xFFFF3C03 READ_WRITE /end MEASUREMENT
/begin MEASUREMENT fFDGNCLR2 "0:診断データクリア非要求  1:診断データクリア要求" UBYTE COMP_0283 1 100 0 1 BIT_MASK 0x0004 ECU_ADDRESS 0xFFFF3C03 READ_WRITE /end MEASUREMENT
/begin MEASUREMENT fFICTMPH "0:ECM発熱抑制制御実施要求なし  1:ECM発熱抑制制御実施要求あり" UBYTE COMP_0283 1 100 0 1 BIT_MASK 0x0002 ECU_ADDRESS 0xFFFF3C03 READ_WRITE /end MEASUREMENT
/begin MEASUREMENT fFICTMPHL "0:ECM高温時リミッタ制御実施要求な  1:ECM高温時リミッタ制御実施要求あ" UBYTE COMP_0283 1 100 0 1 BIT_MASK 0x0001 ECU_ADDRESS 0xFFFF3C03 READ_WRITE /end MEASUREMENT
/begin MEASUREMENT fFSRT "0:右記以外  1:SRTモード中" UBYTE COMP_0283 1 100 0 1 BIT_MASK 0x0080 ECU_ADDRESS 0xFFFF3C04 READ_WRITE /end MEASUREMENT
/begin MEASUREMENT fFTANOK "0:未演算  1:演算" UBYTE COMP_0283 1 100 0 1 BIT_MASK 0x0040 ECU_ADDRESS 0xFFFF3C04 READ_WRITE /end MEASUREMENT
/begin MEASUREMENT fGASCDNG "0:NGでない  1:NG" UBYTE COMP_0283 1 100 0 1 BIT_MASK 0x0020 ECU_ADDRESS 0xFFFF3C04 READ_WRITE /end MEASUREMENT
/begin MEASUREMENT fGKTVOLRN "0:GKTVOF学習未経験  1:GKTVOF学習経験" UBYTE COMP_0283 1 100 0 1 BIT_MASK 0x0010 ECU_ADDRESS 0xFFFF3C04 READ_WRITE /end MEASUREMENT
/begin MEASUREMENT fIDLENI "0:Nアイドル非要求  1:Nアイドル要求" UBYTE COMP_0283 1 100 0 1 BIT_MASK 0x0008 ECU_ADDRESS 0xFFFF3C04 READ_WRITE /end MEASUREMENT
/begin MEASUREMENT fIHRST "0:USMからの受信ﾃﾞｰﾀ=0  1:USMからの受信ﾃﾞｰﾀ=1" UBYTE COMP_0283 1 100 0 1 BIT_MASK 0x0004 ECU_ADDRESS 0xFFFF3C04 READ_WRITE /end MEASUREMENT
/begin MEASUREMENT fIMMCOMNG "0:正常  1:故障" UBYTE COMP_0283 1 100 0 1 BIT_MASK 0x0002 ECU_ADDRESS 0xFFFF3C04 READ_WRITE /end MEASUREMENT
/begin MEASUREMENT fIMMFCUT "0:要求無し  1:要求有り" UBYTE COMP_0283 1 100 0 1 BIT_MASK 0x0001 ECU_ADDRESS 0xFFFF3C04 READ_WRITE /end MEASUREMENT
/begin MEASUREMENT fIMMIMLCK "0:正常  1:故障" UBYTE COMP_0283 1 100 0 1 BIT_MASK 0x0080 ECU_ADDRESS 0xFFFF3C05 READ_WRITE /end MEASUREMENT
/begin MEASUREMENT fIMMKEYER "0:正常  1:故障" UBYTE COMP_0283 1 100 0 1 BIT_MASK 0x0040 ECU_ADDRESS 0xFFFF3C05 READ_WRITE /end MEASUREMENT
/begin MEASUREMENT fIMMKEYNG "0:正常  1:故障" UBYTE COMP_0283 1 100 0 1 BIT_MASK 0x0020 ECU_ADDRESS 0xFFFF3C05 READ_WRITE /end MEASUREMENT
/begin MEASUREMENT fIMMLCMNG "0:正常  1:故障" UBYTE COMP_0283 1 100 0 1 BIT_MASK 0x0010 ECU_ADDRESS 0xFFFF3C05 READ_WRITE /end MEASUREMENT
/begin MEASUREMENT fIMMVIDNG "0:正常  1:故障" UBYTE COMP_0283 1 100 0 1 BIT_MASK 0x0008 ECU_ADDRESS 0xFFFF3C05 READ_WRITE /end MEASUREMENT
/begin MEASUREMENT fINCHACT "0:不許可  1:許可" UBYTE COMP_0283 1 100 0 1 BIT_MASK 0x0004 ECU_ADDRESS 0xFFFF3C05 READ_WRITE /end MEASUREMENT
/begin MEASUREMENT fINDDRNG "0:Dﾚﾝｼﾞ以外  1:Dﾚﾝｼﾞ" UBYTE COMP_0283 1 100 0 1 BIT_MASK 0x0002 ECU_ADDRESS 0xFFFF3C05 READ_WRITE /end MEASUREMENT
/begin MEASUREMENT fINHCUT "0:USMからの受信ﾃﾞｰﾀ=0  1:USMからの受信ﾃﾞｰﾀ=1" UBYTE COMP_0283 1 100 0 1 BIT_MASK 0x0001 ECU_ADDRESS 0xFFFF3C05 READ_WRITE /end MEASUREMENT
/begin MEASUREMENT fINHTOFF "0:ｲﾝﾋﾋﾞﾀｶｯﾄｵﾌ指令がOFF  1:ｲﾝﾋﾋﾞﾀｶｯﾄｵﾌ指令がON" UBYTE COMP_0283 1 100 0 1 BIT_MASK 0x0080 ECU_ADDRESS 0xFFFF3C06 READ_WRITE /end MEASUREMENT
/begin MEASUREMENT fISACT "0:IS中判定していない  1:IS中判定している" UBYTE COMP_0283 1 100 0 1 BIT_MASK 0x0040 ECU_ADDRESS 0xFFFF3C06 READ_WRITE /end MEASUREMENT
/begin MEASUREMENT fISRSRICH "0:不許可  1:許可" UBYTE COMP_0283 1 100 0 1 BIT_MASK 0x0020 ECU_ADDRESS 0xFFFF3C06 READ_WRITE /end MEASUREMENT
/begin MEASUREMENT fISSTREQ "0:不要  1:要求" UBYTE COMP_0283 1 100 0 1 BIT_MASK 0x0010 ECU_ADDRESS 0xFFFF3C06 READ_WRITE /end MEASUREMENT
/begin MEASUREMENT fJKSRCOFF "0:右記以外  1:回転数制御禁止中" UBYTE COMP_0283 1 100 0 1 BIT_MASK 0x0008 ECU_ADDRESS 0xFFFF3C06 READ_WRITE /end MEASUREMENT
/begin MEASUREMENT fLRNEND "0:未終了  1:終了" UBYTE COMP_0283 1 100 0 1 BIT_MASK 0x0004 ECU_ADDRESS 0xFFFF3C06 READ_WRITE /end MEASUREMENT
/begin MEASUREMENT fMETNG "0:正常  1:異常" UBYTE COMP_0283 1 100 0 1 BIT_MASK 0x0002 ECU_ADDRESS 0xFFFF3C06 READ_WRITE /end MEASUREMENT
/begin MEASUREMENT fMGISCFB "0:Moter_ISC_F/B  1:Not_Moter_ISC_F/B" UBYTE COMP_0283 1 100 0 1 BIT_MASK 0x0001 ECU_ADDRESS 0xFFFF3C06 READ_WRITE /end MEASUREMENT
/begin MEASUREMENT fMISFFAL "0:OK  1:NG" UBYTE COMP_0283 1 100 0 1 BIT_MASK 0x0080 ECU_ADDRESS 0xFFFF3C07 READ_WRITE /end MEASUREMENT
/begin MEASUREMENT fMSRRQCDN "0:正常  1:異常" UBYTE COMP_0283 1 100 0 1 BIT_MASK 0x0040 ECU_ADDRESS 0xFFFF3C07 READ_WRITE /end MEASUREMENT
/begin MEASUREMENT fMUPSFTTD "0:要求なし  1:要求あり" UBYTE COMP_0283 1 100 0 1 BIT_MASK 0x0020 ECU_ADDRESS 0xFFFF3C07 READ_WRITE /end MEASUREMENT
/begin MEASUREMENT fODCANACC "0:要求無し  1:要求有り" UBYTE COMP_0283 1 100 0 1 BIT_MASK 0x0010 ECU_ADDRESS 0xFFFF3C07 READ_WRITE /end MEASUREMENT
/begin MEASUREMENT fOUTREVF "0:正常  1:CVT出力回転数フェール" UBYTE COMP_0283 1 100 0 1 BIT_MASK 0x0008 ECU_ADDRESS 0xFFFF3C07 READ_WRITE /end MEASUREMENT
/begin MEASUREMENT fPPAMBRNP "0:禁止解除  1:禁止" UBYTE COMP_0283 1 100 0 1 BIT_MASK 0x0004 ECU_ADDRESS 0xFFFF3C07 READ_WRITE /end MEASUREMENT
/begin MEASUREMENT fPTDCANNG "0:正常  1:異常" UBYTE COMP_0283 1 100 0 1 BIT_MASK 0x0002 ECU_ADDRESS 0xFFFF3C07 READ_WRITE /end MEASUREMENT
/begin MEASUREMENT fREVOUNI "0:レボユニモニタ信号LO  1:レボユニモニタ信号HI" UBYTE COMP_0283 1 100 0 1 BIT_MASK 0x0001 ECU_ADDRESS 0xFFFF3C07 READ_WRITE /end MEASUREMENT
/begin MEASUREMENT fREVSW "0:－  1:－" UBYTE COMP_0283 1 100 0 1 BIT_MASK 0x0080 ECU_ADDRESS 0xFFFF3C08 READ_WRITE /end MEASUREMENT
/begin MEASUREMENT fRSTRQACT "0:非実行中  1:実行中" UBYTE COMP_0283 1 100 0 1 BIT_MASK 0x0040 ECU_ADDRESS 0xFFFF3C08 READ_WRITE /end MEASUREMENT
/begin MEASUREMENT fSBDP "0:不成立  1:成立" UBYTE COMP_0283 1 100 0 1 BIT_MASK 0x0020 ECU_ADDRESS 0xFFFF3C08 READ_WRITE /end MEASUREMENT
/begin MEASUREMENT fSENNG "0:許可  1:不許可" UBYTE COMP_0283 1 100 0 1 BIT_MASK 0x0010 ECU_ADDRESS 0xFFFF3C08 READ_WRITE /end MEASUREMENT
/begin MEASUREMENT fSIPFULL "0:不成立  1:成立" UBYTE COMP_0283 1 100 0 1 BIT_MASK 0x0008 ECU_ADDRESS 0xFFFF3C08 READ_WRITE /end MEASUREMENT
/begin MEASUREMENT fSIPMAX "0:不成立  1:成立" UBYTE COMP_0283 1 100 0 1 BIT_MASK 0x0004 ECU_ADDRESS 0xFFFF3C08 READ_WRITE /end MEASUREMENT
/begin MEASUREMENT fSIPMIN "0:不成立  1:成立" UBYTE COMP_0283 1 100 0 1 BIT_MASK 0x0002 ECU_ADDRESS 0xFFFF3C08 READ_WRITE /end MEASUREMENT
/begin MEASUREMENT fSIPREV "0:回転数制御要求無し  1:回転数制御要求有り" UBYTE COMP_0283 1 100 0 1 BIT_MASK 0x0001 ECU_ADDRESS 0xFFFF3C08 READ_WRITE /end MEASUREMENT
/begin MEASUREMENT fSIPROG "0:AGBトルク要求無し  1:AGBトルク要求有り" UBYTE COMP_0283 1 100 0 1 BIT_MASK 0x0080 ECU_ADDRESS 0xFFFF3C09 READ_WRITE /end MEASUREMENT
/begin MEASUREMENT fSNOWSW "0:SNOW_SW_OFF  1:SNOW_SW_ON" UBYTE COMP_0283 1 100 0 1 BIT_MASK 0x0040 ECU_ADDRESS 0xFFFF3C09 READ_WRITE /end MEASUREMENT
/begin MEASUREMENT fSPCINST "0:SPCINT算出前  1:SPCINT算出終了" UBYTE COMP_0283 1 100 0 1 BIT_MASK 0x0020 ECU_ADDRESS 0xFFFF3C09 READ_WRITE /end MEASUREMENT
/begin MEASUREMENT fSSGBDUMP "0:No_failure  1:Detected__failure_/_Battery_disc" UBYTE COMP_0283 1 100 0 1 BIT_MASK 0x0010 ECU_ADDRESS 0xFFFF3C09 READ_WRITE /end MEASUREMENT
/begin MEASUREMENT fSSGHEAT "0:No_failure  1:Detected_failure_/_Electronic_ov" UBYTE COMP_0283 1 100 0 1 BIT_MASK 0x0008 ECU_ADDRESS 0xFFFF3C09 READ_WRITE /end MEASUREMENT
/begin MEASUREMENT fSSGTHERM "0:No_event  1:Stop-start_inhibitation_demand" UBYTE COMP_0283 1 100 0 1 BIT_MASK 0x0004 ECU_ADDRESS 0xFFFF3C09 READ_WRITE /end MEASUREMENT
/begin MEASUREMENT fSSGVHIGH "0:No_failure  1:Detected_failure_/_Network_volta" UBYTE COMP_0283 1 100 0 1 BIT_MASK 0x0002 ECU_ADDRESS 0xFFFF3C09 READ_WRITE /end MEASUREMENT
/begin MEASUREMENT fSSOKENST "0:リレーオフ禁止  1:リレーオフ許可" UBYTE COMP_0283 1 100 0 1 BIT_MASK 0x0001 ECU_ADDRESS 0xFFFF3C09 READ_WRITE /end MEASUREMENT
/begin MEASUREMENT fSTCUT "0:USMからの受信ﾃﾞｰﾀ=0  1:USMからの受信ﾃﾞｰﾀ=1" UBYTE COMP_0283 1 100 0 1 BIT_MASK 0x0080 ECU_ADDRESS 0xFFFF3C0A READ_WRITE /end MEASUREMENT
/begin MEASUREMENT fSTMST "0:USMからの受信ﾃﾞｰﾀ=0  1:USMからの受信ﾃﾞｰﾀ=1" UBYTE COMP_0283 1 100 0 1 BIT_MASK 0x0040 ECU_ADDRESS 0xFFFF3C0A READ_WRITE /end MEASUREMENT
/begin MEASUREMENT fSYSTMNG "0:許可  1:不許可" UBYTE COMP_0283 1 100 0 1 BIT_MASK 0x0020 ECU_ADDRESS 0xFFFF3C0A READ_WRITE /end MEASUREMENT
/begin MEASUREMENT fTANSET "0:未経験  1:経験済" UBYTE COMP_0283 1 100 0 1 BIT_MASK 0x0010 ECU_ADDRESS 0xFFFF3C0A READ_WRITE /end MEASUREMENT
/begin MEASUREMENT fTCSACT "0:TCS非動作時  1:TCS動作時" UBYTE COMP_0283 1 100 0 1 BIT_MASK 0x0008 ECU_ADDRESS 0xFFFF3C0A READ_WRITE /end MEASUREMENT
/begin MEASUREMENT fTCVTRG10 "0:実行中でない  1:実行中" UBYTE COMP_0283 1 100 0 1 BIT_MASK 0x0004 ECU_ADDRESS 0xFFFF3C0A READ_WRITE /end MEASUREMENT
/begin MEASUREMENT fTFINTD "0:未算出  1:算出済" UBYTE COMP_0283 1 100 0 1 BIT_MASK 0x0002 ECU_ADDRESS 0xFFFF3C0A READ_WRITE /end MEASUREMENT
/begin MEASUREMENT fUSMNG "0:正常  1:異常" UBYTE COMP_0283 1 100 0 1 BIT_MASK 0x0001 ECU_ADDRESS 0xFFFF3C0A READ_WRITE /end MEASUREMENT
/begin MEASUREMENT fUSMNG2 "0:異常未検出  1:異常検出" UBYTE COMP_0283 1 100 0 1 BIT_MASK 0x0080 ECU_ADDRESS 0xFFFF3C0B READ_WRITE /end MEASUREMENT
/begin MEASUREMENT fVASCDNG "0:NGでない  1:NG" UBYTE COMP_0283 1 100 0 1 BIT_MASK 0x0040 ECU_ADDRESS 0xFFFF3C0B READ_WRITE /end MEASUREMENT
/begin MEASUREMENT fVDCACT "0:VDC非動作時  1:VDC動作時" UBYTE COMP_0283 1 100 0 1 BIT_MASK 0x0020 ECU_ADDRESS 0xFFFF3C0B READ_WRITE /end MEASUREMENT
/begin MEASUREMENT fVPRNGH "0:-  1:-" UBYTE COMP_0283 1 100 0 1 BIT_MASK 0x0010 ECU_ADDRESS 0xFFFF3C0B READ_WRITE /end MEASUREMENT
/begin MEASUREMENT fVPRNGL "0:-  1:-" UBYTE COMP_0283 1 100 0 1 BIT_MASK 0x0008 ECU_ADDRESS 0xFFFF3C0B READ_WRITE /end MEASUREMENT
/begin MEASUREMENT fVSINPNG1 "0:No_failure  1:Detected_failure/Input_circuit_f" UBYTE COMP_0283 1 100 0 1 BIT_MASK 0x0004 ECU_ADDRESS 0xFFFF3C0B READ_WRITE /end MEASUREMENT
/begin MEASUREMENT fVSINPNG2 "0:No_failure  1:Detected_failure/Input_circuit_f" UBYTE COMP_0283 1 100 0 1 BIT_MASK 0x0002 ECU_ADDRESS 0xFFFF3C0B READ_WRITE /end MEASUREMENT
/begin MEASUREMENT fVSOUTNG1 "0:No_failure  1:Detected_failure/Output_circuit_" UBYTE COMP_0283 1 100 0 1 BIT_MASK 0x0001 ECU_ADDRESS 0xFFFF3C0B READ_WRITE /end MEASUREMENT
/begin MEASUREMENT fVSOUTNG2 "0:No_failure  1:Detected_failure/Output_circuit_" UBYTE COMP_0283 1 100 0 1 BIT_MASK 0x0080 ECU_ADDRESS 0xFFFF3C0C READ_WRITE /end MEASUREMENT
/begin MEASUREMENT fVSTWARN1 "0:No_warning  1:Detected_warning/Temperature_war" UBYTE COMP_0283 1 100 0 1 BIT_MASK 0x0040 ECU_ADDRESS 0xFFFF3C0C READ_WRITE /end MEASUREMENT
/begin MEASUREMENT fVSTWARN2 "0:No_warning  1:Detected_warning/Temperature_war" UBYTE COMP_0283 1 100 0 1 BIT_MASK 0x0020 ECU_ADDRESS 0xFFFF3C0C READ_WRITE /end MEASUREMENT
/begin MEASUREMENT fVSUNING1 "0:No_failure  1:Detected_failure/Unit_internal_f" UBYTE COMP_0283 1 100 0 1 BIT_MASK 0x0010 ECU_ADDRESS 0xFFFF3C0C READ_WRITE /end MEASUREMENT
/begin MEASUREMENT fVSUNING2 "0:No_failure  1:Detected_failure/Unit_internal_f" UBYTE COMP_0283 1 100 0 1 BIT_MASK 0x0008 ECU_ADDRESS 0xFFFF3C0C READ_WRITE /end MEASUREMENT
/begin MEASUREMENT fIDLE_S "0:IDLE_OFF  1:IDLE_ON" UBYTE COMP_0283 1 100 0 1 BIT_MASK 0x0004 ECU_ADDRESS 0xFFFF3C0C READ_WRITE /end MEASUREMENT
/begin MEASUREMENT fACCMOD "0:非加速ﾓｰﾄﾞ  1:加速ﾓｰﾄﾞ" UBYTE COMP_0283 1 100 0 1 BIT_MASK 0x0080 ECU_ADDRESS 0xFFFF3C1C READ_WRITE /end MEASUREMENT
/begin MEASUREMENT fACCUT14 "0:ｺｰｽﾄA/Cｶｯﾄ非作動  1:ｺｰｽﾄA/Cｶｯﾄ作動" UBYTE COMP_0283 1 100 0 1 BIT_MASK 0x0020 ECU_ADDRESS 0xFFFF3C1C READ_WRITE /end MEASUREMENT
/begin MEASUREMENT fACPDPRS1 "0:右記以外  1:PDPREN≧ACPDPRS1#" UBYTE COMP_0283 1 100 0 1 BIT_MASK 0x0010 ECU_ADDRESS 0xFFFF3C1C READ_WRITE /end MEASUREMENT
/begin MEASUREMENT fACPDPRS2 "0:右記以外  1:PDPREN≧ACPDPRS2#" UBYTE COMP_0283 1 100 0 1 BIT_MASK 0x0008 ECU_ADDRESS 0xFFFF3C1C READ_WRITE /end MEASUREMENT
/begin MEASUREMENT fACPDPRS3 "0:右記以外  1:PDPREN≧ACPDPRS3#" UBYTE COMP_0283 1 100 0 1 BIT_MASK 0x0004 ECU_ADDRESS 0xFFFF3C1C READ_WRITE /end MEASUREMENT
/begin MEASUREMENT fACSTEX "0:始動時ｴｱｺﾝﾘﾚｰ出力経験なし  1:始動時ｴｱｺﾝﾘﾚｰ出力経験あり" UBYTE COMP_0283 1 100 0 1 BIT_MASK 0x0002 ECU_ADDRESS 0xFFFF3C1C READ_WRITE /end MEASUREMENT
/begin MEASUREMENT fACSTOK "0:右記以外  1:始動時許可条件(1)～(4)が全て成立" UBYTE COMP_0283 1 100 0 1 BIT_MASK 0x0001 ECU_ADDRESS 0xFFFF3C1C READ_WRITE /end MEASUREMENT
/begin MEASUREMENT fACSTON "0:OFF  1:ON" UBYTE COMP_0283 1 100 0 1 BIT_MASK 0x0080 ECU_ADDRESS 0xFFFF3C1D READ_WRITE /end MEASUREMENT
/begin MEASUREMENT fACTCRIB "0:不成立  1:成立" UBYTE COMP_0283 1 100 0 1 BIT_MASK 0x0040 ECU_ADDRESS 0xFFFF3C1D READ_WRITE /end MEASUREMENT
/begin MEASUREMENT fACVSP1 "0:右記以外  1:VSP≧ACVSP1#" UBYTE COMP_0283 1 100 0 1 BIT_MASK 0x0020 ECU_ADDRESS 0xFFFF3C1D READ_WRITE /end MEASUREMENT
/begin MEASUREMENT fACVSP2 "0:右記以外  1:VSP≧ACVSP2#" UBYTE COMP_0283 1 100 0 1 BIT_MASK 0x0010 ECU_ADDRESS 0xFFFF3C1D READ_WRITE /end MEASUREMENT
/begin MEASUREMENT fACVSP3 "0:右記以外  1:VSP≧ACVSP3#" UBYTE COMP_0283 1 100 0 1 BIT_MASK 0x0008 ECU_ADDRESS 0xFFFF3C1D READ_WRITE /end MEASUREMENT
/begin MEASUREMENT fADALPNG "0:不成立  1:成立" UBYTE COMP_0283 1 100 0 1 BIT_MASK 0x0004 ECU_ADDRESS 0xFFFF3C1D READ_WRITE /end MEASUREMENT
/begin MEASUREMENT fADCGA "0:不成立  1:成立" UBYTE COMP_0283 1 100 0 1 BIT_MASK 0x0002 ECU_ADDRESS 0xFFFF3C1D READ_WRITE /end MEASUREMENT
/begin MEASUREMENT fADCGBNG "0:不成立  1:成立" UBYTE COMP_0283 1 100 0 1 BIT_MASK 0x0001 ECU_ADDRESS 0xFFFF3C1D READ_WRITE /end MEASUREMENT
/begin MEASUREMENT fADCGBOK "0:不成立  1:成立" UBYTE COMP_0283 1 100 0 1 BIT_MASK 0x0080 ECU_ADDRESS 0xFFFF3C1E READ_WRITE /end MEASUREMENT
/begin MEASUREMENT fADCGC "0:不成立  1:成立" UBYTE COMP_0283 1 100 0 1 BIT_MASK 0x0040 ECU_ADDRESS 0xFFFF3C1E READ_WRITE /end MEASUREMENT
/begin MEASUREMENT fADCGD "0:不成立  1:成立" UBYTE COMP_0283 1 100 0 1 BIT_MASK 0x0020 ECU_ADDRESS 0xFFFF3C1E READ_WRITE /end MEASUREMENT
/begin MEASUREMENT fADDCURHS4 "0:ADDCUR2<-CCHGADMR(ヒスCHGHYS#)  1:ADDCUR2_≧_-CCHGADMR(ヒスCHGHYS#" UBYTE COMP_0283 1 100 0 1 BIT_MASK 0x0010 ECU_ADDRESS 0xFFFF3C1E READ_WRITE /end MEASUREMENT
/begin MEASUREMENT fADJSTP "0:制御値許可条件判定を実行  1:制御値許可条件判定を実行しない" UBYTE COMP_0283 1 100 0 1 BIT_MASK 0x0008 ECU_ADDRESS 0xFFFF3C1E READ_WRITE /end MEASUREMENT
/begin MEASUREMENT fADRETJEK "0:無駄時間処理不許可  1:無駄時間処理許可" UBYTE COMP_0283 1 100 0 1 BIT_MASK 0x0004 ECU_ADDRESS 0xFFFF3C1E READ_WRITE /end MEASUREMENT
/begin MEASUREMENT fADRETJIK "0:無駄時間処理不許可  1:無駄時間処理許可" UBYTE COMP_0283 1 100 0 1 BIT_MASK 0x0002 ECU_ADDRESS 0xFFFF3C1E READ_WRITE /end MEASUREMENT
/begin MEASUREMENT fADTRPFLG "0:(AD)条件不成立  1:(AD)条件成立" UBYTE COMP_0283 1 100 0 1 BIT_MASK 0x0001 ECU_ADDRESS 0xFFFF3C1E READ_WRITE /end MEASUREMENT
/begin MEASUREMENT fADV55 "0:EEPROM点火時期調整値書き込み処理  1:EEPROM点火時期調整値書き込み処理" UBYTE COMP_0283 1 100 0 1 BIT_MASK 0x0080 ECU_ADDRESS 0xFFFF3C1F READ_WRITE /end MEASUREMENT
/begin MEASUREMENT fADV55OLD "0:EEPROM点火時期調整値書き込み要求  1:EEPROM点火時期調整値書き込み要求" UBYTE COMP_0283 1 100 0 1 BIT_MASK 0x0040 ECU_ADDRESS 0xFFFF3C1F READ_WRITE /end MEASUREMENT
/begin MEASUREMENT fADVADJ "0:点火時期調整でない  1:点火時期調整である" UBYTE COMP_0283 1 100 0 1 BIT_MASK 0x0020 ECU_ADDRESS 0xFFFF3C1F READ_WRITE /end MEASUREMENT
/begin MEASUREMENT fADVADJWT "0:右記以外  1:ADVEPN値EEPROM書込み要求" UBYTE COMP_0283 1 100 0 1 BIT_MASK 0x0010 ECU_ADDRESS 0xFFFF3C1F READ_WRITE /end MEASUREMENT
/begin MEASUREMENT fADVRETJE "0:無駄時間処理不許可  1:無駄時間処理許可" UBYTE COMP_0283 1 100 0 1 BIT_MASK 0x0008 ECU_ADDRESS 0xFFFF3C1F READ_WRITE /end MEASUREMENT
/begin MEASUREMENT fADVRETJI "0:無駄時間処理不許可  1:無駄時間処理許可" UBYTE COMP_0283 1 100 0 1 BIT_MASK 0x0004 ECU_ADDRESS 0xFFFF3C1F READ_WRITE /end MEASUREMENT
/begin MEASUREMENT fADVRTDP "0:禁止  1:許可" UBYTE COMP_0283 1 100 0 1 BIT_MASK 0x0002 ECU_ADDRESS 0xFFFF3C1F READ_WRITE /end MEASUREMENT
/begin MEASUREMENT fAETRPFLG "0:(AE)条件不成立  1:(AE)条件成立" UBYTE COMP_0283 1 100 0 1 BIT_MASK 0x0001 ECU_ADDRESS 0xFFFF3C1F READ_WRITE /end MEASUREMENT
/begin MEASUREMENT fAFCLOK "0:ﾘｰﾝ化不許可  1:ﾘｰﾝ化許可" UBYTE COMP_0283 1 100 0 1 BIT_MASK 0x0080 ECU_ADDRESS 0xFFFF3C20 READ_WRITE /end MEASUREMENT
/begin MEASUREMENT fAFKDRG "0:非成立  1:成立" UBYTE COMP_0283 1 100 0 1 BIT_MASK 0x0040 ECU_ADDRESS 0xFFFF3C20 READ_WRITE /end MEASUREMENT
/begin MEASUREMENT fAFMAPCN "0:非成立  1:成立" UBYTE COMP_0283 1 100 0 1 BIT_MASK 0x0020 ECU_ADDRESS 0xFFFF3C20 READ_WRITE /end MEASUREMENT
/begin MEASUREMENT fAFMDTVOC "0:不成立  1:成立" UBYTE COMP_0283 1 100 0 1 BIT_MASK 0x0010 ECU_ADDRESS 0xFFFF3C20 READ_WRITE /end MEASUREMENT
/begin MEASUREMENT fAFMHWCN "0:非成立  1:成立" UBYTE COMP_0283 1 100 0 1 BIT_MASK 0x0008 ECU_ADDRESS 0xFFFF3C20 READ_WRITE /end MEASUREMENT
/begin MEASUREMENT fAFMICND "0:条件非成立  1:条件成立" UBYTE COMP_0283 1 100 0 1 BIT_MASK 0x0004 ECU_ADDRESS 0xFFFF3C20 READ_WRITE /end MEASUREMENT
/begin MEASUREMENT fAFMNFSH "0:不成立  1:成立" UBYTE COMP_0283 1 100 0 1 BIT_MASK 0x0002 ECU_ADDRESS 0xFFFF3C20 READ_WRITE /end MEASUREMENT
/begin MEASUREMENT fAFMNFSL "0:不成立  1:成立" UBYTE COMP_0283 1 100 0 1 BIT_MASK 0x0001 ECU_ADDRESS 0xFFFF3C20 READ_WRITE /end MEASUREMENT
/begin MEASUREMENT fAFMNGRCN "0:不成立  1:成立" UBYTE COMP_0283 1 100 0 1 BIT_MASK 0x0080 ECU_ADDRESS 0xFFFF3C21 READ_WRITE /end MEASUREMENT
/begin MEASUREMENT fAFMNGRH "0:不成立  1:成立" UBYTE COMP_0283 1 100 0 1 BIT_MASK 0x0040 ECU_ADDRESS 0xFFFF3C21 READ_WRITE /end MEASUREMENT
/begin MEASUREMENT fAFMNGRL "0:不成立  1:成立" UBYTE COMP_0283 1 100 0 1 BIT_MASK 0x0020 ECU_ADDRESS 0xFFFF3C21 READ_WRITE /end MEASUREMENT
/begin MEASUREMENT fAFMRMOK "0:不成立  1:成立" UBYTE COMP_0283 1 100 0 1 BIT_MASK 0x0010 ECU_ADDRESS 0xFFFF3C21 READ_WRITE /end MEASUREMENT
/begin MEASUREMENT fAFMTANCN "0:AFM診断吸気温度条件非成立  1:AFM診断吸気温度条件成立" UBYTE COMP_0283 1 100 0 1 BIT_MASK 0x0008 ECU_ADDRESS 0xFFFF3C21 READ_WRITE /end MEASUREMENT
/begin MEASUREMENT fAFMTVOL "0:不成立  1:成立" UBYTE COMP_0283 1 100 0 1 BIT_MASK 0x0004 ECU_ADDRESS 0xFFFF3C21 READ_WRITE /end MEASUREMENT
/begin MEASUREMENT fAFOPCND "0:条件非成立  1:条件成立" UBYTE COMP_0283 1 100 0 1 BIT_MASK 0x0002 ECU_ADDRESS 0xFFFF3C21 READ_WRITE /end MEASUREMENT
/begin MEASUREMENT fAFRSCVDP "0:診断不許可  1:診断許可" UBYTE COMP_0283 1 100 0 1 BIT_MASK 0x0001 ECU_ADDRESS 0xFFFF3C21 READ_WRITE /end MEASUREMENT
/begin MEASUREMENT fAFSHCND "0:条件非成立  1:条件成立" UBYTE COMP_0283 1 100 0 1 BIT_MASK 0x0080 ECU_ADDRESS 0xFFFF3C22 READ_WRITE /end MEASUREMENT
/begin MEASUREMENT fAFTRPFLG "0:(AF)条件不成立  1:(AF)条件成立" UBYTE COMP_0283 1 100 0 1 BIT_MASK 0x0040 ECU_ADDRESS 0xFFFF3C22 READ_WRITE /end MEASUREMENT
/begin MEASUREMENT fAGBCLKCA "0:OK  1:NG" UBYTE COMP_0283 1 100 0 1 BIT_MASK 0x0020 ECU_ADDRESS 0xFFFF3C22 READ_WRITE /end MEASUREMENT
/begin MEASUREMENT fAGBCLKNG "0:OK  1:NG" UBYTE COMP_0283 1 100 0 1 BIT_MASK 0x0010 ECU_ADDRESS 0xFFFF3C22 READ_WRITE /end MEASUREMENT
/begin MEASUREMENT fAGBCMDFT "0:許可  1:禁止" UBYTE COMP_0283 1 100 0 1 BIT_MASK 0x0008 ECU_ADDRESS 0xFFFF3C22 READ_WRITE /end MEASUREMENT
/begin MEASUREMENT fAGBDLYNG "0:OK  1:NG" UBYTE COMP_0283 1 100 0 1 BIT_MASK 0x0004 ECU_ADDRESS 0xFFFF3C22 READ_WRITE /end MEASUREMENT
/begin MEASUREMENT fAGBFNCNG "0:OK  1:NG" UBYTE COMP_0283 1 100 0 1 BIT_MASK 0x0002 ECU_ADDRESS 0xFFFF3C22 READ_WRITE /end MEASUREMENT
/begin MEASUREMENT fAGBLNKCA "0:OK  1:NG" UBYTE COMP_0283 1 100 0 1 BIT_MASK 0x0001 ECU_ADDRESS 0xFFFF3C22 READ_WRITE /end MEASUREMENT
/begin MEASUREMENT fAGBLNKCM "0:OK  1:NG" UBYTE COMP_0283 1 100 0 1 BIT_MASK 0x0080 ECU_ADDRESS 0xFFFF3C23 READ_WRITE /end MEASUREMENT
/begin MEASUREMENT fAGBRTDNG "0:OK  1:NG" UBYTE COMP_0283 1 100 0 1 BIT_MASK 0x0040 ECU_ADDRESS 0xFFFF3C23 READ_WRITE /end MEASUREMENT
/begin MEASUREMENT fAGBTQDFT "0:非制限中  1:制限中" UBYTE COMP_0283 1 100 0 1 BIT_MASK 0x0020 ECU_ADDRESS 0xFFFF3C23 READ_WRITE /end MEASUREMENT
/begin MEASUREMENT fAGBTUPNG "0:OK  1:NG" UBYTE COMP_0283 1 100 0 1 BIT_MASK 0x0010 ECU_ADDRESS 0xFFFF3C23 READ_WRITE /end MEASUREMENT
/begin MEASUREMENT fAGTRPFLG "0:(AG)条件不成立  1:(AG)条件成立" UBYTE COMP_0283 1 100 0 1 BIT_MASK 0x0008 ECU_ADDRESS 0xFFFF3C23 READ_WRITE /end MEASUREMENT
/begin MEASUREMENT fAHTRPFLG "0:(AH)条件不成立  1:(AH)条件成立" UBYTE COMP_0283 1 100 0 1 BIT_MASK 0x0004 ECU_ADDRESS 0xFFFF3C23 READ_WRITE /end MEASUREMENT
/begin MEASUREMENT fAITRPFLG "0:(AI)条件不成立  1:(AI)条件成立" UBYTE COMP_0283 1 100 0 1 BIT_MASK 0x0002 ECU_ADDRESS 0xFFFF3C23 READ_WRITE /end MEASUREMENT
/begin COMPU_METHOD COMP_0000_S "fixed axis Long" RAT_FUNC "%8.2" "Long" COEFFS 0 1 0 0 0 1 /end COMPU_METHOD
/begin COMPU_METHOD COMP_0068 "1-" RAT_FUNC "%8.2" "-" COEFFS 0 1 0 0 0 1 /end COMPU_METHOD
/begin COMPU_METHOD COMP_0283 "1flag" RAT_FUNC "%8.2" "flag" COEFFS 0 1 0 0 0 1 /end COMPU_METHOD
/begin COMPU_METHOD COMP_0662_S "1-      1" RAT_FUNC "%8.2" "-      1" COEFFS 0 1 0 0 0 1 /end COMPU_METHOD
/* RECORD_LAYOUT ------------------------------------------------------ */
/begin RECORD_LAYOUT REC_UBYTE_C FNC_VALUES 1 UBYTE COLUMN_DIR DIRECT /end RECORD_LAYOUT
/begin RECORD_LAYOUT REC_ULONG_C FNC_VALUES 1 ULONG COLUMN_DIR DIRECT /end RECORD_LAYOUT
/end MODULE
/end PROJECT
