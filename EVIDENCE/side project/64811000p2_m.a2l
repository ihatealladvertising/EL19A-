ASAP2_VERSION 1 3_BETA
/begin PROJECT TK_X91_EUR_VC ""
/begin HEADER "" /* key HEADER ++ "comment" Ç… Par.scomment */ PROJECT_NO TK_X91_EUR_VC /* key PROJECT_NO ++ project number Ç… car_eng_desti_lot */ VERSION "7V4YHZEB2" /* key VERSION ++ version number Ç… mProgver */ /end HEADER
/begin MODULE DIM ""
/begin MOD_COMMON "" DEPOSIT ABSOLUTE BYTE_ORDER MSB_FIRST /* ﬁ≤ƒµ∞¿ﬁ∞Ç™ÿÃﬂ⁄∞ΩÇ≥ÇÍÇÈ */ /end MOD_COMMON
/begin FUNCTION KF7-320A.15[4] "Calculation of ADV phase control value at acceleration" /end FUNCTION
/begin FUNCTION KF7-320A.17[N] "Expansion control of lambda control area" /end FUNCTION
/begin FUNCTION KF7-320A.18[4] "Calculation of ADV under normal operation" /end FUNCTION
/begin FUNCTION KF7-320A.19[7] "Calculation of ADV at Engine Start" /end FUNCTION
/begin FUNCTION KF7-320A.20[2] "Calculation of basic ignition timing" /end FUNCTION
/begin FUNCTION KF7-320A.21[N] "Calculation of dwell" /end FUNCTION
/begin FUNCTION KF7-320A.22[5] "Ignition timing correction for VTC" /end FUNCTION
/begin FUNCTION KF7-320A.23[N] "Ignition timing control for splashing noise correction" /end FUNCTION
/begin FUNCTION KF7-330.1M[3] "ISC required opening area (main calculation section)" /end FUNCTION
/begin FUNCTION KF7-330.1P[3] "ISC required opening area (sub calculation section)" /end FUNCTION
/begin FUNCTION KF7-330.3[6] "Judgment for the execution of idle stabilization feedback control [#ISCFB] " /end FUNCTION
/begin FUNCTION KF7-330.4A[53] "Idle speed target value calculation (for MPI)" /end FUNCTION
/begin FUNCTION KF7-330.5[53] "Air flow rate command value QAACV" /end FUNCTION
/begin FUNCTION KF7-330.7A[1] "Appropriate air flow rate during deceleration <With non-CVT vehicles>" /end FUNCTION
/begin FUNCTION KF7-330.8[1] "ISC air flow rate correction value at engine start [ISCST]" /end FUNCTION
/begin FUNCTION KF7-330.9[8] "Air flow rate corrected for torque converter load reduction during deceleration" /end FUNCTION
/begin FUNCTION KF7-340.1M[8] "PTD-ETD (torque control D2 block) [main calculation section]" /end FUNCTION
/begin FUNCTION KF7-340.1P[7] "PTD-ETD Interface [sub calculation section]" /end FUNCTION
/begin FUNCTION KF7-340.2M[2] "APO Torque calculation (torque control D1 block) [main calculation section]" /end FUNCTION
/begin FUNCTION KF7-340.2P[1] "APO Torque calculation [sub calculation section]" /end FUNCTION
/begin FUNCTION KF7-340.3M[1] "Target driving force calculation [main calculation section]" /end FUNCTION
/begin FUNCTION KF7-340.3P[2] "Target diving force calculation [sub calculation section]" /end FUNCTION
/begin FUNCTION KF7-340.4[1] "Processing on PTD target driving force initial delay" /end FUNCTION
/begin FUNCTION KF7-340.5[4] "Conversion of target driving force for AT/ CVT communication" /end FUNCTION
/begin FUNCTION KF7-340.5P[2] "Conversion of target driving force for AT/ CVT communication [sub calculation]" /end FUNCTION
/begin FUNCTION KF7-340.6M[2] "Target driving force ON/OFF switching [main calculation section]" /end FUNCTION
/begin FUNCTION KF7-340.6P[2] "Target driving force ON/OFF switching [sub calculation section]" /end FUNCTION
/begin FUNCTION KF7-340.7[4] "Driving force demand control ON/OFF judgment" /end FUNCTION
/begin FUNCTION KF7-340.8M[8] "Calculation of target engine torque [main calculation section]" /end FUNCTION
/begin FUNCTION KF7-340.8P[8] "Calculation of target engine torque [sub calculation section]" /end FUNCTION
/begin FUNCTION KF7-340.9M[3] "Calculation of actual change gear ratio [main calculation section]" /end FUNCTION
/begin FUNCTION KF7-340.9P[3] "Calculation of actual change gear ratio [sub calculation section]" /end FUNCTION
/begin FUNCTION KF7-340.10M[1] "Torque converter torque ratio calculation [main calculation section]" /end FUNCTION
/begin FUNCTION KF7-340.10P[N] "Torque converter torque ratio calculation [sub calculation section]" /end FUNCTION
/begin FUNCTION KF7-340.11[4] "Correction for inertia torque" /end FUNCTION
/begin FUNCTION KF7-340.13[4] "PTD fail flag process " /end FUNCTION
/begin CHARACTERISTIC mMTFDFK "First-ordered filter weight" MAP 0x0000E21A REC_UWORD_C 0 COMP_0290 0 0.999985458
 /begin AXIS_DESCR FIX_AXIS NO_INPUT_QUANTITY COMP_0205_S 3 0 2 FIX_AXIS_PAR_DIST 0 1 3 /end AXIS_DESCR
 /begin AXIS_DESCR FIX_AXIS NO_INPUT_QUANTITY COMP_0205_S 3 0 2 FIX_AXIS_PAR_DIST 0 1 3 /end AXIS_DESCR
 /begin FUNCTION_LIST KF7-340.4[1] /end FUNCTION_LIST
/end CHARACTERISTIC
/begin CHARACTERISTIC mACDYFF "A/C start compensation time" VALUE 0x000081CC REC_UBYTE_C 0 COMP_0008 0 25500 /begin FUNCTION_LIST KF7-330.5[53] /end FUNCTION_LIST /end CHARACTERISTIC
/begin CHARACTERISTIC mACOFHS "At the time of the A/C start, at the time of the -drive, the amount of compensation difference air" VALUE 0x000081D3 REC_UBYTE_C 0 COMP_0009 0 199.21875 /begin FUNCTION_LIST KF7-330.5[53] /end FUNCTION_LIST /end CHARACTERISTIC
/begin CHARACTERISTIC mACONDY "At the time of air-conditioning on, delay" VALUE 0x000081D5 REC_UBYTE_C 0 COMP_0008 0 25500 /begin FUNCTION_LIST KF7-330.5[53] KF7-376.2[21] KF7-376.3[2] /end FUNCTION_LIST /end CHARACTERISTIC
/begin CHARACTERISTIC mADDFDATW "Addition drive power AT reflection rate" VALUE 0x000081F1 REC_UBYTE_C 0 COMP_0009 0 199.21875 /begin FUNCTION_LIST KF7-340.8M[8] KF7-340.8P[8] /end FUNCTION_LIST /end CHARACTERISTIC
/begin CHARACTERISTIC mADDFDLIM "Drive power upper limit limiter (control for the running resistance)" VALUE 0x00008FA2 REC_UWORD_C 0 COMP_0014_S 0 65535 /begin FUNCTION_LIST KF7-340.8M[8] KF7-340.15[3] /end FUNCTION_LIST /end CHARACTERISTIC
/begin CHARACTERISTIC mADFDLM_S "Drive power upper limit limiter (control for the running resistance)" VALUE 0x0000F6CA REC_UWORD_C 0 COMP_0014_S 0 65535 /begin FUNCTION_LIST KF7-340.8P[8] /end FUNCTION_LIST /end CHARACTERISTIC
/begin CHARACTERISTIC mADVDN "Rotation rise value upper limit" VALUE 0x000081F7 REC_UBYTE_C 0 COMP_0000 0 6375 /begin FUNCTION_LIST KF7-320A.15[4] R301.23.ADV_calculation_1_1_2 /end FUNCTION_LIST /end CHARACTERISTIC
/begin CHARACTERISTIC mALMT "ADV compensation advance limiter" VALUE 0x00008266 REC_UBYTE_C 0 COMP_0017 0 255 /begin FUNCTION_LIST KF7-320A.15[4] R301.23.ADV_calculation_1_1_2 /end FUNCTION_LIST /end CHARACTERISTIC
/begin CHARACTERISTIC mALPLMT "Acceleration judgement acceleration lower limit" VALUE 0x0000826A REC_UBYTE_C 0 COMP_0053_S 0 89.25 /begin FUNCTION_LIST KF7-320A.15[4] R301.23.ADV_calculation_1_1_2 /end FUNCTION_LIST /end CHARACTERISTIC
/begin CHARACTERISTIC mAPASCDMX "Kick going down prevention upper limit limiter" VALUE 0x00009014 REC_UWORD_C 0 COMP_0005 0 7208.85 /begin FUNCTION_LIST KF7-340.5[4] KF7-340.5P[2] KF7-410.19[2] KF7-410.20[N] /end FUNCTION_LIST /end CHARACTERISTIC
/begin CHARACTERISTIC mAPOFULL "Accelerator full-open threshold" VALUE 0x00009040 REC_UWORD_C 0 COMP_0005 0 7208.85 /begin FUNCTION_LIST KF7-340.1M[8] KF7-410.17M[5] R301.20.AmbientComp_1_0_2 /end FUNCTION_LIST /end CHARACTERISTIC
/begin CHARACTERISTIC mAPOMAX "Control control MAX accelerator open-degree" VALUE 0x00009048 REC_UWORD_C 0 COMP_0040 0 7208.85 /begin FUNCTION_LIST KF7-330.5[53] KF7-360.7M[9] /end FUNCTION_LIST /end CHARACTERISTIC
/begin CHARACTERISTIC mAPSFDLIM "Drive power upper limit limiter (APS limiter)" VALUE 0x00009060 REC_UWORD_C 0 COMP_0014_S 0 65535 /begin FUNCTION_LIST KF7-340.8M[8] /end FUNCTION_LIST /end CHARACTERISTIC
/begin CHARACTERISTIC mAPSLIM "APS limiter (accelerator open-degree) threshold" VALUE 0x0000906A REC_UWORD_C 0 COMP_0005 0 7208.85 /begin FUNCTION_LIST KF7-340.8M[8] /end FUNCTION_LIST /end CHARACTERISTIC
/begin CHARACTERISTIC mAPSLIM00 "APS limiter (accelerator open-degree) lower limit value" VALUE 0x0000906C REC_UWORD_C 0 COMP_0005 0 7208.85 /begin FUNCTION_LIST KF7-340.8M[8] /end FUNCTION_LIST /end CHARACTERISTIC
/begin CHARACTERISTIC mATTEMPH "SLPDEC permission AT oil temperature (upper limit)" VALUE 0x00008294 REC_UBYTE_C 0 COMP_0035_S 0 255 /begin FUNCTION_LIST KF7-330.9[8] /end FUNCTION_LIST /end CHARACTERISTIC
/begin CHARACTERISTIC mATTEMPL "SLPDEC permission AT oil temperature (lower limit)" VALUE 0x00008295 REC_UBYTE_C 0 COMP_0035_S 0 255 /begin FUNCTION_LIST KF7-330.9[8] /end FUNCTION_LIST /end CHARACTERISTIC
/begin CHARACTERISTIC mBACOFH "At the time of the A/C drive, compensation air quantity (for BIAS)" VALUE 0x00008189 REC_SBYTE_C 0 COMP_0046 -128 127 /begin FUNCTION_LIST KF7-330.5[53] /end FUNCTION_LIST /end CHARACTERISTIC
/begin CHARACTERISTIC mBACONH "At the time of the A/C drive, compensation air quantity (for BIAS)" VALUE 0x0000818A REC_SBYTE_C 0 COMP_0046 -128 127 /begin FUNCTION_LIST KF7-330.5[53] /end FUNCTION_LIST /end CHARACTERISTIC
/begin CHARACTERISTIC mBPSON "P/S oil pressure proportion compensation air quantity (for BIAS)" VALUE 0x0000818B REC_SBYTE_C 0 COMP_0046 -128 127 /begin FUNCTION_LIST KF7-330.5[53] /end FUNCTION_LIST /end CHARACTERISTIC
/begin CHARACTERISTIC mCNQ "Idle speed target value formation filter coefficient" VALUE 0x00008346 REC_UBYTE_C 0 COMP_0032 0 0.99609375 /begin FUNCTION_LIST KF7-330.4A[53] R301.6.IscAirflow_1_4_5 /end FUNCTION_LIST /end CHARACTERISTIC
/begin CHARACTERISTIC mCRADVRPM "Complete combustion engine speed" VALUE 0x0000835F REC_UBYTE_C 0 COMP_0006 0 3187.5 /begin FUNCTION_LIST KF7-320A.19[7] /end FUNCTION_LIST /end CHARACTERISTIC
/begin CHARACTERISTIC mDACOFL "Acceleration completion judgement" VALUE 0x000083A8 REC_UBYTE_C 0 COMP_0014 0 2550 /begin FUNCTION_LIST KF7-320A.15[4] R301.23.ADV_calculation_1_1_2 /end FUNCTION_LIST /end CHARACTERISTIC
/begin CHARACTERISTIC mDACONL "Acceleration start judgement" VALUE 0x000083A9 REC_UBYTE_C 0 COMP_0014 0 2550 /begin FUNCTION_LIST KF7-320A.15[4] R301.23.ADV_calculation_1_1_2 /end FUNCTION_LIST /end CHARACTERISTIC
/begin CHARACTERISTIC mDAPOFULL "Accelerator full-open judgement hysteresis" VALUE 0x000090E0 REC_UWORD_C 0 COMP_0005 0 7208.85 /begin FUNCTION_LIST KF7-340.1M[8] KF7-410.17M[5] R301.20.AmbientComp_1_0_2 /end FUNCTION_LIST /end CHARACTERISTIC
/begin CHARACTERISTIC mDDPAPO "QDSPT APO compensation change rate" VALUE 0x000090EA REC_UWORD_C 0 COMP_0085 0 25599.609375 /begin FUNCTION_LIST KF7-330.5[53] R301.26.Dashpot_DandN_1_0_2 /end FUNCTION_LIST /end CHARACTERISTIC
/begin CHARACTERISTIC mDGNSTST2 "Right after the start, idle rise quantity decline rate" VALUE 0x0000F699 REC_UBYTE_C 0 COMP_0391_S 0 99.609375 /begin FUNCTION_LIST KF7-330.4A[53] /end FUNCTION_LIST /end CHARACTERISTIC
/begin CHARACTERISTIC mDISCAU "Air-conditioning transient state compensation decrease rate" VALUE 0x00008443 REC_UBYTE_C 0 COMP_0097 0 3.984375 /begin FUNCTION_LIST KF7-330.5[53] /end FUNCTION_LIST /end CHARACTERISTIC
/begin CHARACTERISTIC mDISCLU1 "An electric load transient state compensation decrease rate" VALUE 0x00008449 REC_UBYTE_C 0 COMP_0097 0 3.984375 /begin FUNCTION_LIST KF7-330.5[53] /end FUNCTION_LIST /end CHARACTERISTIC
/begin CHARACTERISTIC mDISCLU2 "An electric load transient state compensation decrease rate" VALUE 0x0000844A REC_UBYTE_C 0 COMP_0097 0 3.984375 /begin FUNCTION_LIST KF7-330.5[53] /end FUNCTION_LIST /end CHARACTERISTIC
/begin CHARACTERISTIC mDISCRU "Radiator fan transient state compensation decrease rate" VALUE 0x0000844B REC_UBYTE_C 0 COMP_0097 0 3.984375 /begin FUNCTION_LIST KF7-330.5[53] R000.1.RS_Integ_1_10_2 /end FUNCTION_LIST /end CHARACTERISTIC
/begin CHARACTERISTIC mDKCRADV "Ignition timing time compensation rate decrease value" VALUE 0x00009100 REC_UWORD_C 0 COMP_0327 0 1.9988175 /begin FUNCTION_LIST KF7-320A.19[7] /end FUNCTION_LIST /end CHARACTERISTIC
/begin CHARACTERISTIC mDLTDDS "D-Ds switchover step value" VALUE 0x00009112 REC_UWORD_C 0 COMP_0410 0 99.9985458 /begin FUNCTION_LIST KF7-340.3M[1] /end FUNCTION_LIST /end CHARACTERISTIC
/begin CHARACTERISTIC mDLTDDS_S "D-Ds switchover Ç´Ç¥Ç› value" VALUE 0x0000F6E4 REC_UWORD_C 0 COMP_0410 0 99.9985458 /begin FUNCTION_LIST KF7-340.3P[2] /end FUNCTION_LIST /end CHARACTERISTIC
/begin CHARACTERISTIC mDLTDLL "Reverse phase delay" VALUE 0x0000846B REC_UBYTE_C 0 COMP_0014 0 2550 /begin FUNCTION_LIST KF7-320A.15[4] R301.23.ADV_calculation_1_1_2 /end FUNCTION_LIST /end CHARACTERISTIC
/begin CHARACTERISTIC mDLTDLS "Reverse phase delay" VALUE 0x0000846C REC_UBYTE_C 0 COMP_0014 0 2550 /begin FUNCTION_LIST KF7-320A.15[4] R301.23.ADV_calculation_1_1_2 /end FUNCTION_LIST /end CHARACTERISTIC
/begin CHARACTERISTIC mDLTNMSK "DLTNE non-reference time" VALUE 0x0000846E REC_UBYTE_C 0 COMP_0014 0 2550 /begin FUNCTION_LIST KF7-330.9[8] /end FUNCTION_LIST /end CHARACTERISTIC
/begin CHARACTERISTIC mDLTTIM "Acceleration judgement sampling time" VALUE 0x00008472 REC_UBYTE_C 0 COMP_0014 0 2550 /begin FUNCTION_LIST KF7-320A.15[4] R301.23.ADV_calculation_1_1_2 /end FUNCTION_LIST /end CHARACTERISTIC
/begin CHARACTERISTIC mDNDHL "At the time of D range idle rotation table switching, rotation change fee" VALUE 0x0000848E REC_UBYTE_C 0 COMP_0397_S 0 199.21875 /begin FUNCTION_LIST KF7-330.4A[53] /end FUNCTION_LIST /end CHARACTERISTIC
/begin CHARACTERISTIC mDNSET0F "NSET0 change rate (at the time of N ÅÃ D switching)" VALUE 0x00008494 REC_UBYTE_C 0 COMP_0014 0 2550 /begin FUNCTION_LIST KF7-330.4A[53] /end FUNCTION_LIST /end CHARACTERISTIC
/begin CHARACTERISTIC mDNSET0GN "NSET0 change rate (after the start, at the time of the lean limit expansion control-in-progress ND select)" VALUE 0x00008495 REC_UBYTE_C 0 COMP_0014 0 2550 /begin FUNCTION_LIST KF7-330.4A[53] /end FUNCTION_LIST /end CHARACTERISTIC
/begin CHARACTERISTIC mDNSET0PS "NSET0 change rate (at the time of PSSW on ÅÃ off)" VALUE 0x00008496 REC_UBYTE_C 0 COMP_0014 0 2550 /begin FUNCTION_LIST KF7-330.4A[53] /end FUNCTION_LIST /end CHARACTERISTIC
/begin CHARACTERISTIC mDNSET0S "NSET0 change rate (at the time of N ÅÃ D switching)" VALUE 0x00008497 REC_UBYTE_C 0 COMP_0014 0 2550 /begin FUNCTION_LIST KF7-330.4A[53] /end FUNCTION_LIST /end CHARACTERISTIC
/begin CHARACTERISTIC mDNSET0SS "NSET0 change rate (at the time of N ÅÃ D switching)" VALUE 0x00008498 REC_UBYTE_C 0 COMP_0008 0 25500 /begin FUNCTION_LIST KF7-330.4A[53] /end FUNCTION_LIST /end CHARACTERISTIC
/begin CHARACTERISTIC mDPPSV0 "The change quantity judgement value (for the weighted average value) of PPSV for 40mS" VALUE 0x000084A1 REC_UBYTE_C 0 COMP_0054 0 5100 /begin FUNCTION_LIST KF7-330.5[53] /end FUNCTION_LIST /end CHARACTERISTIC
/begin CHARACTERISTIC mDPPSV1 "The change quantity judgement value (increase side) 1 of PPSV for 40mS" VALUE 0x000084A2 REC_UBYTE_C 0 COMP_0054 0 5100 /begin FUNCTION_LIST KF7-330.5[53] /end FUNCTION_LIST /end CHARACTERISTIC
/begin CHARACTERISTIC mDPPSV2 "The change quantity judgement value (increase side) 2 of PPSV for 40mS" VALUE 0x000084A3 REC_UBYTE_C 0 COMP_0054 0 5100 /begin FUNCTION_LIST KF7-330.5[53] /end FUNCTION_LIST /end CHARACTERISTIC
/begin CHARACTERISTIC mDPPSV3 "The change quantity judgement value (increase side) 3 of PPSV for 40mS" VALUE 0x000084A4 REC_UBYTE_C 0 COMP_0054 0 5100 /begin FUNCTION_LIST KF7-330.5[53] /end FUNCTION_LIST /end CHARACTERISTIC
/begin CHARACTERISTIC mDPSUI "Power steering triangle compensation initial value" VALUE 0x000084A8 REC_UBYTE_C 0 COMP_0051 0 255 /begin FUNCTION_LIST KF7-330.5[53] /end FUNCTION_LIST /end CHARACTERISTIC
/begin CHARACTERISTIC mDQACOF "At the time of the A/C start, compensation air quantity (inclination)" VALUE 0x000084AA REC_UBYTE_C 0 COMP_0222_S 0 31.875 /begin FUNCTION_LIST KF7-330.5[53] /end FUNCTION_LIST /end CHARACTERISTIC
/begin CHARACTERISTIC mDQACON "At the time of the A/C drive, compensation air quantity (inclination)" VALUE 0x000084AB REC_UBYTE_C 0 COMP_0222_S 0 31.875 /begin FUNCTION_LIST KF7-330.5[53] /end FUNCTION_LIST /end CHARACTERISTIC
/begin CHARACTERISTIC mDQCI "At the time of OPEN, QFBI change rate" VALUE 0x000084AC REC_UBYTE_C 0 COMP_0014 0 2550 /begin FUNCTION_LIST KF7-330.5[53] /end FUNCTION_LIST /end CHARACTERISTIC
/begin CHARACTERISTIC mDQFICD "The amount of air-conditioning compensation air temperature SW compensation" VALUE 0x000084AF REC_UBYTE_C 0 COMP_0051 0 255 /begin FUNCTION_LIST KF7-330.5[53] /end FUNCTION_LIST /end CHARACTERISTIC
/begin CHARACTERISTIC mDQH0LMT "QH0 upper limit judgement hysteresis" VALUE 0x00009134 REC_UWORD_C 0 COMP_0115 0 99.9998565 /begin FUNCTION_LIST KF7-340.1M[8] KF7-410.17M[5] R301.20.AmbientComp_1_0_2 /end FUNCTION_LIST /end CHARACTERISTIC
/begin CHARACTERISTIC mDQPSON "P/S oil pressure proportion compensation air quantity (inclination)" VALUE 0x000084B2 REC_UBYTE_C 0 COMP_0223_S 0 0.049725 /begin FUNCTION_LIST KF7-330.5[53] /end FUNCTION_LIST /end CHARACTERISTIC
/begin CHARACTERISTIC mDQPSU "Power steering triangle compensation decrease rate" VALUE 0x000084B3 REC_UBYTE_C 0 COMP_0224_S 0 7.96875 /begin FUNCTION_LIST KF7-330.5[53] /end FUNCTION_LIST /end CHARACTERISTIC
/begin CHARACTERISTIC mDSHCUT "DSPT prohibition coolant temperature" VALUE 0x000084C4 REC_UBYTE_C 0 COMP_0035 -50 205 /begin FUNCTION_LIST KF7-330.5[53] R301.26.Dashpot_DandN_1_0_2 /end FUNCTION_LIST /end CHARACTERISTIC
/begin CHARACTERISTIC mDSOISC "DECISC decrease rate" VALUE 0x000084C7 REC_UBYTE_C 0 COMP_0225_S 0 1.9921875 /begin FUNCTION_LIST KF7-330.7A[1] /end FUNCTION_LIST /end CHARACTERISTIC
/begin CHARACTERISTIC mDSPAPO "QDSPT APO compensation start open-degree" VALUE 0x00009142 REC_UWORD_C 0 COMP_0005 0 7208.85 /begin FUNCTION_LIST KF7-330.5[53] R301.26.Dashpot_DandN_1_0_2 /end FUNCTION_LIST /end CHARACTERISTIC
/begin CHARACTERISTIC mDSSISC "DECISC increase rate" VALUE 0x000084CC REC_UBYTE_C 0 COMP_0225_S 0 1.9921875 /begin FUNCTION_LIST KF7-330.7A[1] /end FUNCTION_LIST /end CHARACTERISTIC
/begin CHARACTERISTIC mDTLOAD "After electric load SW off, idle rise release delay" VALUE 0x000084E0 REC_UBYTE_C 0 COMP_0014 0 2550 /begin FUNCTION_LIST KF7-330.4A[53] KF7-330.5[53] /end FUNCTION_LIST /end CHARACTERISTIC
/begin CHARACTERISTIC mDTVODA "DLTADV The amount of a change in permission VAPO which isn't acceptable" VALUE 0x000084F0 REC_UBYTE_C 0 COMP_0077 0 28.05 /begin FUNCTION_LIST KF7-320A.15[4] R301.23.ADV_calculation_1_1_2 /end FUNCTION_LIST /end CHARACTERISTIC
/begin CHARACTERISTIC mFBILMT "I-gain gain lower limit limiter" VALUE 0x00008193 REC_SBYTE_C 0 COMP_0277 -128 127 /begin FUNCTION_LIST KF7-330.3[6] KF7-390.3A[15] /end FUNCTION_LIST /end CHARACTERISTIC
/begin CHARACTERISTIC mFDTRNAP1 "Previous switchover accelerator open-degree 1" VALUE 0x000091A0 REC_UWORD_C 0 COMP_0005 0 7208.85 /begin FUNCTION_LIST KF7-340.6M[2] /end FUNCTION_LIST /end CHARACTERISTIC
/begin CHARACTERISTIC mFDTRNAP2 "Previous switchover accelerator open-degree 2" VALUE 0x000091A2 REC_UWORD_C 0 COMP_0005 0 7208.85 /begin FUNCTION_LIST KF7-340.6M[2] /end FUNCTION_LIST /end CHARACTERISTIC
/begin CHARACTERISTIC mFKTAIH "F/B I control upside dead-zone" VALUE 0x00008604 REC_UBYTE_C 0 COMP_0064 0 398.4375 /begin FUNCTION_LIST KF7-330.5[53] /end FUNCTION_LIST /end CHARACTERISTIC
/begin CHARACTERISTIC mFKTAIL "F/B I control bottom side dead-zone" VALUE 0x00008606 REC_UBYTE_C 0 COMP_0064 0 398.4375 /begin FUNCTION_LIST KF7-330.5[53] /end FUNCTION_LIST /end CHARACTERISTIC
/begin CHARACTERISTIC mGDPPSV0 "P/S oil pressure change compensation air quantity operation coefficient" VALUE 0x00008660 REC_UBYTE_C 0 COMP_0142_S 0 7.96875 /begin FUNCTION_LIST KF7-330.5[53] /end FUNCTION_LIST /end CHARACTERISTIC
/begin CHARACTERISTIC mGDPPSV1 "P/S oil pressure change compensation air quantity operation coefficient" VALUE 0x00008661 REC_UBYTE_C 0 COMP_0142_S 0 7.96875 /begin FUNCTION_LIST KF7-330.5[53] /end FUNCTION_LIST /end CHARACTERISTIC
/begin CHARACTERISTIC mGDPPSV2 "P/S oil pressure change compensation air quantity operation coefficient" VALUE 0x00008662 REC_UBYTE_C 0 COMP_0142_S 0 7.96875 /begin FUNCTION_LIST KF7-330.5[53] /end FUNCTION_LIST /end CHARACTERISTIC
/begin CHARACTERISTIC mGDPPSV3 "P/S oil pressure change compensation air quantity operation coefficient" VALUE 0x00008663 REC_UBYTE_C 0 COMP_0142_S 0 7.96875 /begin FUNCTION_LIST KF7-330.5[53] /end FUNCTION_LIST /end CHARACTERISTIC
/begin CHARACTERISTIC mGNSETST "After the start, idle rise rate" VALUE 0x00008675 REC_UBYTE_C 0 COMP_0021 0 99.609375 /begin FUNCTION_LIST KF7-330.4A[53] /end FUNCTION_LIST /end CHARACTERISTIC
/begin CHARACTERISTIC mGNSETTM "N- At the time of the >D select, target idle rotation decline control start time" VALUE 0x00008676 REC_UBYTE_C 0 COMP_0008 0 25500 /begin FUNCTION_LIST KF7-330.4A[53] /end FUNCTION_LIST /end CHARACTERISTIC
/begin CHARACTERISTIC mGNSETUP "N- At the time of the >D select, target idle rotation decline control start idle rise rate" VALUE 0x00008677 REC_UBYTE_C 0 COMP_0009 0 199.21875 /begin FUNCTION_LIST KF7-330.4A[53] /end FUNCTION_LIST /end CHARACTERISTIC
/begin CHARACTERISTIC mGQFBIH "F/B I gain (a high gain)" VALUE 0x000091F0 REC_UWORD_C 0 COMP_0032_S 0 65535 /begin FUNCTION_LIST KF7-330.5[53] /end FUNCTION_LIST /end CHARACTERISTIC
/begin CHARACTERISTIC mGQFBIL "F/B I gain (low gain)" VALUE 0x000091F2 REC_UWORD_C 0 COMP_0032_S 0 65535 /begin FUNCTION_LIST KF7-330.5[53] KF7-351.1[16] /end FUNCTION_LIST /end CHARACTERISTIC
/begin CHARACTERISTIC mHQAC "The amount of A/C load big time reference air" VALUE 0x000086A2 REC_UBYTE_C 0 COMP_0051 0 255 /begin FUNCTION_LIST KF7-330.5[53] /end FUNCTION_LIST /end CHARACTERISTIC
/begin CHARACTERISTIC mHYNPTD "PTD operation speed hysteresis" VALUE 0x000086B3 REC_UBYTE_C 0 COMP_0006 0 3187.5 /begin FUNCTION_LIST KF7-340.7[4] /end FUNCTION_LIST /end CHARACTERISTIC
/begin CHARACTERISTIC mHYVPTD "PTD operation vehicle speed hysteresis" VALUE 0x0000926C REC_UWORD_C 0 COMP_0436 0 6553.5 /begin FUNCTION_LIST KF7-340.7[4] /end FUNCTION_LIST /end CHARACTERISTIC
/begin CHARACTERISTIC mICPLRTO "The reciprocal number of the cup ring point speed ratio" VALUE 0x0000926E REC_UWORD_C 0 COMP_0456 0 1.999970916 /begin FUNCTION_LIST KF7-340.10M[1] /end FUNCTION_LIST /end CHARACTERISTIC
/begin CHARACTERISTIC mICPLRT_S "The reciprocal number of the cup ring point speed ratio" VALUE 0x0000F6EC REC_UWORD_C 0 COMP_0456 0 1.999970916 /begin FUNCTION_LIST KF7-340.10P[N] /end FUNCTION_LIST /end CHARACTERISTIC
/begin CHARACTERISTIC mIDCVSP "DECISC prohibition vehicle speed" VALUE 0x000086EB REC_UBYTE_C 0 COMP_0007 0 510 /begin FUNCTION_LIST KF7-330.7A[1] /end FUNCTION_LIST /end CHARACTERISTIC
/begin CHARACTERISTIC mISCAUI "Air-conditioning transient state compensation initial value" VALUE 0x00008750 REC_UBYTE_C 0 COMP_0051 0 255 /begin FUNCTION_LIST KF7-330.5[53] /end FUNCTION_LIST /end CHARACTERISTIC
/begin CHARACTERISTIC mISCDLY "The method switching delay which calculates NETARGET" VALUE 0x00008755 REC_UBYTE_C 0 COMP_0008 0 25500 /begin FUNCTION_LIST KF7-330.4A[53] /end FUNCTION_LIST /end CHARACTERISTIC
/begin CHARACTERISTIC mISCLUI1 "Electric load transient state compensation initial value" VALUE 0x00008758 REC_UBYTE_C 0 COMP_0051 0 255 /begin FUNCTION_LIST KF7-330.5[53] /end FUNCTION_LIST /end CHARACTERISTIC
/begin CHARACTERISTIC mISCLUI2 "Electric load transient state compensation initial value" VALUE 0x00008759 REC_UBYTE_C 0 COMP_0051 0 255 /begin FUNCTION_LIST KF7-330.5[53] /end FUNCTION_LIST /end CHARACTERISTIC
/begin CHARACTERISTIC mISCNEH "ISC F/B Start bias speed (upper limit value)" VALUE 0x0000875A REC_UBYTE_C 0 COMP_0006 0 3187.5 /begin FUNCTION_LIST KF7-330.3[6] /end FUNCTION_LIST /end CHARACTERISTIC
/begin CHARACTERISTIC mISCNEL "ISC F/B Start bias speed" VALUE 0x0000875B REC_UBYTE_C 0 COMP_0006 0 3187.5 /begin FUNCTION_LIST KF7-330.3[6] /end FUNCTION_LIST /end CHARACTERISTIC
/begin CHARACTERISTIC mISCPSH "The amount of power steering transient state compensation" VALUE 0x0000875C REC_UBYTE_C 0 COMP_0051 0 255 /begin FUNCTION_LIST KF7-330.5[53] /end FUNCTION_LIST /end CHARACTERISTIC
/begin CHARACTERISTIC mISCPST "Power steering SW OFFON éû transient state compensation judgement time" VALUE 0x0000875D REC_UBYTE_C 0 COMP_0014 0 2550 /begin FUNCTION_LIST KF7-330.5[53] /end FUNCTION_LIST /end CHARACTERISTIC
/begin CHARACTERISTIC mISCRT0 "Compensation air quantity compensation rate for retard" VALUE 0x0000875E REC_UBYTE_C 0 COMP_0429_S 0 127.5 /begin FUNCTION_LIST KF7-330.5[53] /end FUNCTION_LIST /end CHARACTERISTIC
/begin CHARACTERISTIC mISCRUIH "Radiator fan excessive compensation decrease rate (MidHigh)" VALUE 0x00008760 REC_UBYTE_C 0 COMP_0051 0 255 /begin FUNCTION_LIST KF7-330.5[53] R000.1.RS_Integ_1_10_2 /end FUNCTION_LIST /end CHARACTERISTIC
/begin CHARACTERISTIC mISCRUIL "Radiator fan excessive compensation decrease rate (OffLow)" VALUE 0x00008761 REC_UBYTE_C 0 COMP_0051 0 255 /begin FUNCTION_LIST KF7-330.5[53] R000.1.RS_Integ_1_10_2 /end FUNCTION_LIST /end CHARACTERISTIC
/begin CHARACTERISTIC mISCSTDLY "ISC F/B Start delay (After it starts.)" VALUE 0x00008763 REC_UBYTE_C 0 COMP_0008 0 25500
 /begin FUNCTION_LIST KF7-330.3[6] KF7-330.4A[53] KF7-330.8[1] R107.1.iss_ariss_1_0_4 R301.6.IscAirflow_1_4_5 /end FUNCTION_LIST
/end CHARACTERISTIC
/begin CHARACTERISTIC mISLMAX1 "ISCLRCB upper limit value" VALUE 0x00009308 REC_UWORD_C 0 COMP_0051 0 65535 /begin FUNCTION_LIST KF7-330.5[53] KF7-351.2[17] R301.6.IscAirflow_1_4_5 /end FUNCTION_LIST /end CHARACTERISTIC
/begin CHARACTERISTIC mISLMIN1 "ISCLRCB lower limit value" VALUE 0x0000930A REC_UWORD_C 0 COMP_0051 0 65535 /begin FUNCTION_LIST KF7-330.5[53] KF7-351.2[17] R301.6.IscAirflow_1_4_5 /end FUNCTION_LIST /end CHARACTERISTIC
/begin CHARACTERISTIC mISON "DECISC completion rotation deviation width" VALUE 0x0000876D REC_UBYTE_C 0 COMP_0006 0 3187.5 /begin FUNCTION_LIST KF7-330.7A[1] /end FUNCTION_LIST /end CHARACTERISTIC
/begin CHARACTERISTIC mISOVSP "DECISC completion vehicle speed" VALUE 0x0000876E REC_UBYTE_C 0 COMP_0007 0 510 /begin FUNCTION_LIST KF7-330.7A[1] /end FUNCTION_LIST /end CHARACTERISTIC
/begin CHARACTERISTIC mISSN "DECISC permission rotation deviation width" VALUE 0x00008770 REC_UBYTE_C 0 COMP_0006 0 3187.5 /begin FUNCTION_LIST KF7-330.7A[1] /end FUNCTION_LIST /end CHARACTERISTIC
/begin CHARACTERISTIC mISSNED "A degree of a DECISC prohibition engine rotation slowdown" VALUE 0x00008771 REC_UBYTE_C 0 COMP_0006 0 3187.5 /begin FUNCTION_LIST KF7-330.7A[1] KF7-330.9[8] /end FUNCTION_LIST /end CHARACTERISTIC
/begin CHARACTERISTIC mISSTWH "DECISC permission upper limit coolant temperature" VALUE 0x00008772 REC_UBYTE_C 0 COMP_0035 -50 205 /begin FUNCTION_LIST KF7-330.7A[1] KF7-330.9[8] /end FUNCTION_LIST /end CHARACTERISTIC
/begin CHARACTERISTIC mISSTWL "DECISC permission lower limit coolant temperature" VALUE 0x00008773 REC_UBYTE_C 0 COMP_0035 -50 205 /begin FUNCTION_LIST KF7-330.7A[1] KF7-330.9[8] /end FUNCTION_LIST /end CHARACTERISTIC
/begin CHARACTERISTIC mISSVSP "DECISC permission vehicle speed" VALUE 0x00008774 REC_UBYTE_C 0 COMP_0007 0 510 /begin FUNCTION_LIST KF7-330.7A[1] /end FUNCTION_LIST /end CHARACTERISTIC
/begin CHARACTERISTIC mK2X "Reverse phase compensation coefficient 1" VALUE 0x0000877B REC_UBYTE_C 0 COMP_0111_S 0 255 /begin FUNCTION_LIST KF7-320A.15[4] R301.23.ADV_calculation_1_1_2 /end FUNCTION_LIST /end CHARACTERISTIC
/begin CHARACTERISTIC mKCRADVIN "Ignition timing time compensation rate initial value" VALUE 0x00009322 REC_UWORD_C 0 COMP_0327 0 1.9988175 /begin FUNCTION_LIST KF7-320A.19[7] /end FUNCTION_LIST /end CHARACTERISTIC
/begin CHARACTERISTIC mKHQAC "The amount of A/C load big time assistant air" VALUE 0x000087A1 REC_UBYTE_C 0 COMP_0051 0 255 /begin FUNCTION_LIST KF7-330.5[53] /end FUNCTION_LIST /end CHARACTERISTIC
/begin CHARACTERISTIC mKLQAC "The amount of A/C load small time assistant air" VALUE 0x000087AF REC_UBYTE_C 0 COMP_0051 0 255 /begin FUNCTION_LIST KF7-330.5[53] /end FUNCTION_LIST /end CHARACTERISTIC
/begin CHARACTERISTIC mKMRCOH "At the time of the delay, retard rate judgement constant high-octane" VALUE 0x000087C3 REC_UBYTE_C 0 COMP_0431_S 0 1.9921875 /begin FUNCTION_LIST KF7-320A.17[N] /end FUNCTION_LIST /end CHARACTERISTIC
/begin CHARACTERISTIC mKMRCOR "At the time of the delay, retard rate judgement constant regular" VALUE 0x000087C4 REC_UBYTE_C 0 COMP_0431_S 0 1.9921875 /begin FUNCTION_LIST KF7-320A.17[N] /end FUNCTION_LIST /end CHARACTERISTIC
/begin CHARACTERISTIC mKMRD1H "At the time of the delay, retard rate 1 high-octane" VALUE 0x000087C8 REC_UBYTE_C 0 COMP_0017 0 255 /begin FUNCTION_LIST KF7-320A.17[N] /end FUNCTION_LIST /end CHARACTERISTIC
/begin CHARACTERISTIC mKMRD1R "At the time of the delay, retard rate 1 regular" VALUE 0x000087C9 REC_UBYTE_C 0 COMP_0017 0 255 /begin FUNCTION_LIST KF7-320A.17[N] /end FUNCTION_LIST /end CHARACTERISTIC
/begin CHARACTERISTIC mKMRD2H "At the time of the delay, retard rate 2 high-octane" VALUE 0x000087CA REC_UBYTE_C 0 COMP_0017 0 255 /begin FUNCTION_LIST KF7-320A.17[N] /end FUNCTION_LIST /end CHARACTERISTIC
/begin CHARACTERISTIC mKMRD2R "At the time of the delay, retard rate 2 regular" VALUE 0x000087CB REC_UBYTE_C 0 COMP_0017 0 255 /begin FUNCTION_LIST KF7-320A.17[N] /end FUNCTION_LIST /end CHARACTERISTIC
/begin CHARACTERISTIC mKQAC "The amount of A/C load assistant air" VALUE 0x000087DA REC_UBYTE_C 0 COMP_0051 0 255 /begin FUNCTION_LIST KF7-330.5[53] /end FUNCTION_LIST /end CHARACTERISTIC
/begin CHARACTERISTIC mKQPS "The amount of power steering load compensation air" VALUE 0x000087DC REC_UBYTE_C 0 COMP_0051 0 255 /begin FUNCTION_LIST KF7-330.5[53] /end FUNCTION_LIST /end CHARACTERISTIC
/begin CHARACTERISTIC mKRET "KDADV decrease time" VALUE 0x000087DF REC_UBYTE_C 0 COMP_0014 0 2550 /begin FUNCTION_LIST KF7-320A.15[4] R301.23.ADV_calculation_1_1_2 /end FUNCTION_LIST /end CHARACTERISTIC
/begin CHARACTERISTIC mLPMTOAA "Air quantity area conversion coefficient" VALUE 0x00009386 REC_UWORD_C 0 COMP_0241_S 0 0.0063999056205 /begin FUNCTION_LIST KF7-330.1M[3] /end FUNCTION_LIST /end CHARACTERISTIC
/begin CHARACTERISTIC mLQAC "The amount of A/C load small time reference air" VALUE 0x00008828 REC_UBYTE_C 0 COMP_0051 0 255 /begin FUNCTION_LIST KF7-330.5[53] /end FUNCTION_LIST /end CHARACTERISTIC
/begin CHARACTERISTIC mMAXRTO "Actual gear ratio upper limit value (extreme Low gear ratio)" VALUE 0x0000939C REC_UWORD_C 0 COMP_0450 0 63.999056205 /begin FUNCTION_LIST KF7-340.9M[3] /end FUNCTION_LIST /end CHARACTERISTIC
/begin CHARACTERISTIC mMAXRTO_S "Actual gear ratio upper limit value (extreme Low gear ratio)" VALUE 0x0000F6F0 REC_UWORD_C 0 COMP_0450 0 63.999056205 /begin FUNCTION_LIST KF7-340.9P[3] /end FUNCTION_LIST /end CHARACTERISTIC
/begin CHARACTERISTIC mMINRTO "Actual gear ratio lower limit value (extreme High gear ratio)" VALUE 0x000093AA REC_UWORD_C 0 COMP_0450 0 63.999056205 /begin FUNCTION_LIST KF7-340.9M[3] /end FUNCTION_LIST /end CHARACTERISTIC
/begin CHARACTERISTIC mMINRTO_S "Actual gear ratio lower limit value (extreme High gear ratio)" VALUE 0x0000F6F2 REC_UWORD_C 0 COMP_0450 0 63.999056205 /begin FUNCTION_LIST KF7-340.9P[3] /end FUNCTION_LIST /end CHARACTERISTIC
/begin CHARACTERISTIC mMMDOFFGP "M mode PTD off gear position" VALUE 0x00008861 REC_UBYTE_C 0 COMP_0004 0 255 /begin FUNCTION_LIST KF7-340.7[4] /end FUNCTION_LIST /end CHARACTERISTIC
/begin CHARACTERISTIC mMRENST "The criteria which unusually judges the amount of air-fuel ratio compensation" VALUE 0x0000886B REC_UBYTE_C 0 COMP_0009 0 199.21875 /begin FUNCTION_LIST KF7-330.5[53] /end FUNCTION_LIST /end CHARACTERISTIC
/begin CHARACTERISTIC mNCVTBLT "CVT oil pressure unusual time idle speed temporary target value" VALUE 0x0000888F REC_UBYTE_C 0 COMP_0006 0 3187.5 /begin FUNCTION_LIST KF7-330.4A[53] /end FUNCTION_LIST /end CHARACTERISTIC
/begin CHARACTERISTIC mNEPS "Power steering SW OFFON éû transient state compensation start engine speed" VALUE 0x000093C6 REC_UWORD_C 0 COMP_0006 0 819187.5 /begin FUNCTION_LIST KF7-330.5[53] /end FUNCTION_LIST /end CHARACTERISTIC
/begin CHARACTERISTIC mNEPTD "PTD operation permission speed" VALUE 0x000088A8 REC_UBYTE_C 0 COMP_0006 0 3187.5 /begin FUNCTION_LIST KF7-340.7[4] /end FUNCTION_LIST /end CHARACTERISTIC
/begin CHARACTERISTIC mNHDLTD "Reverse phase delay switching speed" VALUE 0x000088B6 REC_UBYTE_C 0 COMP_0020 0 12750 /begin FUNCTION_LIST KF7-320A.15[4] R301.23.ADV_calculation_1_1_2 /end FUNCTION_LIST /end CHARACTERISTIC
/begin CHARACTERISTIC mNHLMT "At the time of the acceleration, judgement speed upper limit" VALUE 0x000088B7 REC_UBYTE_C 0 COMP_0020 0 12750 /begin FUNCTION_LIST KF7-320A.15[4] R301.23.ADV_calculation_1_1_2 /end FUNCTION_LIST /end CHARACTERISTIC
/begin CHARACTERISTIC mNLLMT "At the time of the acceleration, judgement speed lower limit" VALUE 0x000088C1 REC_UBYTE_C 0 COMP_0020 0 12750 /begin FUNCTION_LIST KF7-320A.15[4] R301.23.ADV_calculation_1_1_2 /end FUNCTION_LIST /end CHARACTERISTIC
/begin CHARACTERISTIC mNPS "PPSV weighted average coefficient" VALUE 0x000088D8 REC_UBYTE_C 0 COMP_0063 0 0.99609375 /begin FUNCTION_LIST KF7-330.5[53] /end FUNCTION_LIST /end CHARACTERISTIC
/begin CHARACTERISTIC mNPSFAIL "At the time of the P/S oil pressure sensor trouble judgement, NSET00 lower limit value" VALUE 0x000088D9 REC_UBYTE_C 0 COMP_0006 0 3187.5 /begin FUNCTION_LIST KF7-330.4A[53] R000.1.RS_Integ_1_10_2 /end FUNCTION_LIST /end CHARACTERISTIC
/begin CHARACTERISTIC mNSETB "At the time of the NSET00 lower limit (A/T : NEUTD off & REVSD=0 & BRKSW=0)" VALUE 0x000088E8 REC_UBYTE_C 0 COMP_0006 0 3187.5 /begin FUNCTION_LIST KF7-330.4A[53] R000.1.RS_Integ_1_10_2 /end FUNCTION_LIST /end CHARACTERISTIC
/begin CHARACTERISTIC mNSETBR "At the time of the NSET00 lower limit (A/T : NEUTD off & REVSD=1 & BRKSW=0)" VALUE 0x000088E9 REC_UBYTE_C 0 COMP_0006 0 3187.5 /begin FUNCTION_LIST KF7-330.4A[53] R000.1.RS_Integ_1_10_2 /end FUNCTION_LIST /end CHARACTERISTIC
/begin CHARACTERISTIC mNSETFS "At the time of the AFM backup, NSET" VALUE 0x000088EB REC_UBYTE_C 0 COMP_0006 0 3187.5
 /begin FUNCTION_LIST KF7-330.4A[53] KF7-450.1[N] KF7-450.2[1] KF7-450.3[1] KF7-450.4[1] KF7-500.1[54] R000.1.RS_Integ_1_10_2 /end FUNCTION_LIST
/end CHARACTERISTIC
/begin CHARACTERISTIC mNSETH "A/T : NEUTD off & REVSD = 0" VALUE 0x000088EC REC_UBYTE_C 0 COMP_0006 0 3187.5 /begin FUNCTION_LIST KF7-330.4A[53] R000.1.RS_Integ_1_10_2 /end FUNCTION_LIST /end CHARACTERISTIC
/begin CHARACTERISTIC mNSETHEAT "At the time of the heat resisting, NSET00 lower limit value" VALUE 0x000088ED REC_UBYTE_C 0 COMP_0006 0 3187.5 /begin FUNCTION_LIST KF7-330.4A[53] R000.1.RS_Integ_1_10_2 /end FUNCTION_LIST /end CHARACTERISTIC
/begin CHARACTERISTIC mNSETLM "Adjustment control NSET4 upper limit limiter" VALUE 0x000088EE REC_UBYTE_C 0 COMP_0006 0 3187.5 /begin FUNCTION_LIST KF7-330.4A[53] KF7-580.1[8] /end FUNCTION_LIST /end CHARACTERISTIC
/begin CHARACTERISTIC mNSETR "At the time of the NSET00 upper limit (A/T : NEUTD off & REVSD = 1)" VALUE 0x000088F1 REC_UBYTE_C 0 COMP_0006 0 3187.5
 /begin FUNCTION_LIST KF7-330.4A[53] KF7-385.1[32] KF7-385.3[4] KF7-450.1[N] KF7-450.2[1] KF7-450.3[1] KF7-450.4[1] KF7-500.1[54] /end FUNCTION_LIST
/end CHARACTERISTIC
/begin CHARACTERISTIC mNSETREG "A/C At the time of off, NSET00 lower limit value (at the time of the regular)" VALUE 0x000088F2 REC_UBYTE_C 0 COMP_0006 0 3187.5 /begin FUNCTION_LIST KF7-330.4A[53] R000.1.RS_Integ_1_10_2 /end FUNCTION_LIST /end CHARACTERISTIC
/begin CHARACTERISTIC mOVERADV "Over-advance prevention combustion number of times" VALUE 0x00008969 REC_UBYTE_C 0 COMP_0030 0 255 /begin FUNCTION_LIST KF7-320A.19[7] /end FUNCTION_LIST /end CHARACTERISTIC
/begin CHARACTERISTIC mPAMBI "Atomospheric pressure sensor assistant compensation value" VALUE 0x0000940C REC_UWORD_C 0 COMP_0050 0 5119.921875 /begin FUNCTION_LIST KF7-330.5[53] KF7-351.3[11] /end FUNCTION_LIST /end CHARACTERISTIC
/begin CHARACTERISTIC mPBNGHO "At the time of the trouble, atomospheric pressure compensation value" VALUE 0x0000897F REC_UBYTE_C 0 COMP_0009 0 199.21875 /begin FUNCTION_LIST KF7-330.5[53] KF7-351.3[11] /end FUNCTION_LIST /end CHARACTERISTIC
/begin CHARACTERISTIC mQACFHN "The amount of A/C load compensation dead-zone air" VALUE 0x000089F9 REC_UBYTE_C 0 COMP_0051 0 255 /begin FUNCTION_LIST KF7-330.5[53] /end FUNCTION_LIST /end CHARACTERISTIC
/begin CHARACTERISTIC mQALT1 "Alternator load compensation air flow-quantity 1" VALUE 0x000089FA REC_UBYTE_C 0 COMP_0051 0 255 /begin FUNCTION_LIST KF7-330.5[53] /end FUNCTION_LIST /end CHARACTERISTIC
/begin CHARACTERISTIC mQALT2 "Alternator load compensation air flow-quantity 2" VALUE 0x000089FB REC_UBYTE_C 0 COMP_0051 0 255 /begin FUNCTION_LIST KF7-330.5[53] /end FUNCTION_LIST /end CHARACTERISTIC
/begin CHARACTERISTIC mQCIAT "At the time of the M1 mode, at the time of OPEN, in the top of QFBI, lower limit value compensation value" VALUE 0x000089FD REC_UBYTE_C 0 COMP_0051 0 255 /begin FUNCTION_LIST KF7-330.5[53] /end FUNCTION_LIST /end CHARACTERISTIC
/begin CHARACTERISTIC mQCIM "At the time of OPEN, F/B I-gain lower limit value" VALUE 0x000089FE REC_UBYTE_C 0 COMP_0051 0 255 /begin FUNCTION_LIST KF7-330.5[53] /end FUNCTION_LIST /end CHARACTERISTIC
/begin CHARACTERISTIC mQHLMMTUP "When M mode rotation synchronous control works, QH0 upper limit" VALUE 0x00009462 REC_UWORD_C 0 COMP_0146 0 99.998480265 /begin FUNCTION_LIST KF7-340.1M[8] KF7-410.17M[5] R301.20.AmbientComp_1_0_2 /end FUNCTION_LIST /end CHARACTERISTIC
/begin CHARACTERISTIC mQLEAK "Omission air flow-quantity" VALUE 0x00008A11 REC_UBYTE_C 0 COMP_0276 0 1020
 /begin FUNCTION_LIST KF7-330.5[53] KF7-340.1M[8] KF7-350.1M[5] R301.6.IscAirflow_1_4_5 /end FUNCTION_LIST
/end CHARACTERISTIC
/begin CHARACTERISTIC mQMREST "The amount of air-fuel ratio deviation compensation air" VALUE 0x00008A16 REC_UBYTE_C 0 COMP_0051 0 255 /begin FUNCTION_LIST KF7-330.5[53] /end FUNCTION_LIST /end CHARACTERISTIC
/begin CHARACTERISTIC mQPSDRPML "QPSD operation upper limit speed" VALUE 0x00008A17 REC_UBYTE_C 0 COMP_0000 0 6375 /begin FUNCTION_LIST KF7-330.5[53] /end FUNCTION_LIST /end CHARACTERISTIC
/begin CHARACTERISTIC mQPSNF "The amount of P/S oil pressure proportion compensation dead-zone air" VALUE 0x00008A18 REC_UBYTE_C 0 COMP_0220 0 255 /begin FUNCTION_LIST KF7-330.5[53] /end FUNCTION_LIST /end CHARACTERISTIC
/begin CHARACTERISTIC mQPSON "For power steering compensation" VALUE 0x00008A19 REC_UBYTE_C 0 COMP_0051 0 255 /begin FUNCTION_LIST KF7-330.5[53] /end FUNCTION_LIST /end CHARACTERISTIC
/begin CHARACTERISTIC mQRFNH "Radiator fan High éû air compensation flow-quantity" VALUE 0x00008A1A REC_UBYTE_C 0 COMP_0051 0 255 /begin FUNCTION_LIST KF7-330.5[53] KF7-390.3A[15] /end FUNCTION_LIST /end CHARACTERISTIC
/begin CHARACTERISTIC mQRFNL "Radiator fan Low éû air compensation flow-quantity" VALUE 0x00008A1B REC_UBYTE_C 0 COMP_0051 0 255 /begin FUNCTION_LIST KF7-330.5[53] KF7-390.3A[15] /end FUNCTION_LIST /end CHARACTERISTIC
/begin CHARACTERISTIC mQRFNM "Radiator fan Mid éû air compensation flow-quantity" VALUE 0x00008A1C REC_UBYTE_C 0 COMP_0051 0 255 /begin FUNCTION_LIST KF7-330.5[53] KF7-390.3A[15] /end FUNCTION_LIST /end CHARACTERISTIC
/begin CHARACTERISTIC mQTASINT1 "QTASEEP1 initial value" VALUE 0x0000946E REC_UWORD_C 0 COMP_0051 0 65535
 /begin FUNCTION_LIST KF7-330.5[53] KF7-351.1[16] KF7-351.2[17] R301.6.IscAirflow_1_4_5 R901.1.Diag_on_can_app_1_6_2 /end FUNCTION_LIST
/end CHARACTERISTIC
/begin CHARACTERISTIC mRLMT "ADV compensation retard limiter" VALUE 0x00008AA5 REC_UBYTE_C 0 COMP_0017 0 255 /begin FUNCTION_LIST KF7-320A.15[4] R301.23.ADV_calculation_1_1_2 /end FUNCTION_LIST /end CHARACTERISTIC
/begin CHARACTERISTIC mRMINHR "Actual gear ratio computed lower limit speed" VALUE 0x00008AA9 REC_UBYTE_C 0 COMP_0254_S 0 1020 /begin FUNCTION_LIST KF7-340.9M[3] /end FUNCTION_LIST /end CHARACTERISTIC
/begin CHARACTERISTIC mRMINHR_S "Actual gear ratio computed lower limit speed" VALUE 0x0000F6A8 REC_UBYTE_C 0 COMP_0254_S 0 1020 /begin FUNCTION_LIST KF7-340.9P[3] /end FUNCTION_LIST /end CHARACTERISTIC
/begin CHARACTERISTIC mRMINHV "Actual gear ratio computed lower limit vehicle speed" VALUE 0x00008AAA REC_UBYTE_C 0 COMP_0436 0 25.5 /begin FUNCTION_LIST KF7-340.9M[3] /end FUNCTION_LIST /end CHARACTERISTIC
/begin CHARACTERISTIC mRMINHV_S "Actual gear ratio computed lower limit vehicle speed" VALUE 0x0000F6A9 REC_UBYTE_C 0 COMP_0436 0 25.5 /begin FUNCTION_LIST KF7-340.9P[3] /end FUNCTION_LIST /end CHARACTERISTIC
/begin CHARACTERISTIC mRRATIO "Reverse gear ratio" VALUE 0x000094E2 REC_UWORD_C 0 COMP_0450 0 63.999056205 /begin FUNCTION_LIST KF7-340.9M[3] /end FUNCTION_LIST /end CHARACTERISTIC
/begin CHARACTERISTIC mRRATIO_S "Reverse gear ratio" VALUE 0x0000F702 REC_UWORD_C 0 COMP_0450 0 63.999056205 /begin FUNCTION_LIST KF7-340.9P[3] /end FUNCTION_LIST /end CHARACTERISTIC
/begin CHARACTERISTIC mRTBYGF "Effect radius/final gear ratio with the tire" VALUE 0x000094E4 REC_UWORD_C 0 COMP_0256_S 0 0.3999941832 /begin FUNCTION_LIST KF7-340.6M[2] KF7-340.8M[8] KF7-340.15[3] /end FUNCTION_LIST /end CHARACTERISTIC
/begin CHARACTERISTIC mRTBYGF_S "Effect radius/final gear ratio with the tire" VALUE 0x0000F704 REC_UWORD_C 0 COMP_0256_S 0 0.3999941832 /begin FUNCTION_LIST KF7-340.6P[2] KF7-340.8P[8] /end FUNCTION_LIST /end CHARACTERISTIC
/begin CHARACTERISTIC mRTOTREND "Up-shift start judgement value" VALUE 0x00008ADC REC_UBYTE_C 0 COMP_0425 0 99.99999981 /begin FUNCTION_LIST KF7-340.9M[3] /end FUNCTION_LIST /end CHARACTERISTIC
/begin CHARACTERISTIC mRTOTRST "Up-shift start judgement value" VALUE 0x00008ADD REC_UBYTE_C 0 COMP_0425 0 99.99999981 /begin FUNCTION_LIST KF7-340.9M[3] /end FUNCTION_LIST /end CHARACTERISTIC
/begin CHARACTERISTIC mSLPINNE "Permission speed" VALUE 0x00008B0C REC_UBYTE_C 0 COMP_0006 0 3187.5 /begin FUNCTION_LIST KF7-330.9[8] /end FUNCTION_LIST /end CHARACTERISTIC
/begin CHARACTERISTIC mSLPMAX "Speed ratio upper limit" VALUE 0x00008B0D REC_UBYTE_C 0 COMP_0186 0 3.984375 /begin FUNCTION_LIST KF7-330.9[8] /end FUNCTION_LIST /end CHARACTERISTIC
/begin CHARACTERISTIC mSLPNOUT "AT output shaft speed lower limit" VALUE 0x0000950E REC_UWORD_C 0 COMP_0443 0 65535 /begin FUNCTION_LIST KF7-330.9[8] /end FUNCTION_LIST /end CHARACTERISTIC
/begin CHARACTERISTIC mSLPOUTN "Completion speed" VALUE 0x00008B0E REC_UBYTE_C 0 COMP_0006 0 3187.5 /begin FUNCTION_LIST KF7-330.9[8] /end FUNCTION_LIST /end CHARACTERISTIC
/begin CHARACTERISTIC mSLPRTOH "SLPDEC permission RATIO" VALUE 0x00009510 REC_UWORD_C 0 COMP_0450 0 63.999056205 /begin FUNCTION_LIST KF7-330.9[8] /end FUNCTION_LIST /end CHARACTERISTIC
/begin CHARACTERISTIC mSLPVSP "Permission vehicle speed" VALUE 0x00008B0F REC_UBYTE_C 0 COMP_0007 0 510 /begin FUNCTION_LIST KF7-330.9[8] /end FUNCTION_LIST /end CHARACTERISTIC
/begin CHARACTERISTIC mSTPRTO "Actual gear ratio switchover rate step value" VALUE 0x00009568 REC_UWORD_C 0 COMP_0290 0 0.999985458 /begin FUNCTION_LIST KF7-340.9M[3] /end FUNCTION_LIST /end CHARACTERISTIC
/begin CHARACTERISTIC mSTPRTO_S "Actual gear ratio switchover rate step value" VALUE 0x0000F706 REC_UWORD_C 0 COMP_0290 0 0.999985458 /begin FUNCTION_LIST KF7-340.9P[3] /end FUNCTION_LIST /end CHARACTERISTIC
/begin CHARACTERISTIC mSTSTAT0 "Torque room stage time upper limit value" VALUE 0x00008B46 REC_UBYTE_C 0 COMP_0008 0 25500 /begin FUNCTION_LIST KF7-320A.19[7] /end FUNCTION_LIST /end CHARACTERISTIC
/begin CHARACTERISTIC mSTSTAT1 "Torque decline stage time upper limit value" VALUE 0x00008B47 REC_UBYTE_C 0 COMP_0008 0 25500 /begin FUNCTION_LIST KF7-320A.19[7] /end FUNCTION_LIST /end CHARACTERISTIC
/begin CHARACTERISTIC mTALPEST "Time to judge the amount of air-fuel ratio compensation unusually" VALUE 0x00008B6F REC_UBYTE_C 0 COMP_0008 0 25500 /begin FUNCTION_LIST KF7-330.5[53] /end FUNCTION_LIST /end CHARACTERISTIC
/begin CHARACTERISTIC mTANGHO "At the time of the trouble, intake air temperature compensation value" VALUE 0x00008B74 REC_UBYTE_C 0 COMP_0009 0 199.21875 /begin FUNCTION_LIST KF7-330.5[53] KF7-351.3[11] /end FUNCTION_LIST /end CHARACTERISTIC
/begin CHARACTERISTIC mTANSTDHL "At the time of the D range idle rotation table switching judgement start, intake air temperature" VALUE 0x00008B7D REC_UBYTE_C 0 COMP_0035 -50 205 /begin FUNCTION_LIST KF7-330.4A[53] /end FUNCTION_LIST /end CHARACTERISTIC
/begin CHARACTERISTIC mTHONDY "IDLE SW After on, delay" VALUE 0x00008BE6 REC_UBYTE_C 0 COMP_0014 0 2550 /begin FUNCTION_LIST KF7-330.3[6] /end FUNCTION_LIST /end CHARACTERISTIC
/begin CHARACTERISTIC mTIPRQA "At the time of A/C switch on, Pd pressure balance pressure detection delay" VALUE 0x00008BF9 REC_UBYTE_C 0 COMP_0008 0 25500 /begin FUNCTION_LIST KF7-330.5[53] /end FUNCTION_LIST /end CHARACTERISTIC
/begin CHARACTERISTIC mTMBRKOF "At the time of brake off, compensation prohibition delay" VALUE 0x00008C21 REC_UBYTE_C 0 COMP_0014 0 2550 /begin FUNCTION_LIST KF7-330.5[53] /end FUNCTION_LIST /end CHARACTERISTIC
/begin CHARACTERISTIC mTMENST "After the start, compensation control permission delay time" VALUE 0x00008C3A REC_UBYTE_C 0 COMP_0008 0 25500 /begin FUNCTION_LIST KF7-330.5[53] /end FUNCTION_LIST /end CHARACTERISTIC
/begin CHARACTERISTIC mTMHADI "After idle off, time" VALUE 0x00008C50 REC_UBYTE_C 0 COMP_0014 0 2550 /begin FUNCTION_LIST KF7-320A.15[4] R301.23.ADV_calculation_1_1_2 /end FUNCTION_LIST /end CHARACTERISTIC
/begin CHARACTERISTIC mTMHEAT "At the time of the heat resisting, idle rise continuation time" VALUE 0x00008C52 REC_UBYTE_C 0 COMP_0013 0 255 /begin FUNCTION_LIST KF7-330.4A[53] R000.1.RS_Integ_1_10_2 /end FUNCTION_LIST /end CHARACTERISTIC
/begin CHARACTERISTIC mTMISTY "At the time of the start, ISC compensation delay time" VALUE 0x00008C58 REC_UBYTE_C 0 COMP_0014 0 2550 /begin FUNCTION_LIST KF7-330.8[1] R301.6.IscAirflow_1_4_5 /end FUNCTION_LIST /end CHARACTERISTIC
/begin CHARACTERISTIC mTMNSETS2 "Right after the start, idle rise time" VALUE 0x00008C64 REC_UBYTE_C 0 COMP_0008 0 25500 /begin FUNCTION_LIST KF7-330.4A[53] /end FUNCTION_LIST /end CHARACTERISTIC
/begin CHARACTERISTIC mTMPSOF "Power steering ONOFF éû QFBI fixed time" VALUE 0x00008C6D REC_UBYTE_C 0 COMP_0014 0 2550 /begin FUNCTION_LIST KF7-330.5[53] /end FUNCTION_LIST /end CHARACTERISTIC
/begin CHARACTERISTIC mTMPSON "Power steering SW OFFON éû transient state compensation judgement time" VALUE 0x00008C6E REC_UBYTE_C 0 COMP_0008 0 25500 /begin FUNCTION_LIST KF7-330.5[53] /end FUNCTION_LIST /end CHARACTERISTIC
/begin CHARACTERISTIC mTNSETDHL "After the start, D range idle rotation table switching judgement time" VALUE 0x00008CBB REC_UBYTE_C 0 COMP_0013 0 255 /begin FUNCTION_LIST KF7-330.4A[53] /end FUNCTION_LIST /end CHARACTERISTIC
/begin CHARACTERISTIC mTRAD2VSP "TTRADV2 Choice vehicle speed" VALUE 0x00008CE3 REC_UBYTE_C 0 COMP_0007 0 510 /begin FUNCTION_LIST KF7-320A.15[4] R301.23.ADV_calculation_1_1_2 /end FUNCTION_LIST /end CHARACTERISTIC
/begin CHARACTERISTIC mTRADIDTM "An idle off delay for TTRADV22" VALUE 0x00008CE4 REC_UBYTE_C 0 COMP_0014 0 2550 /begin FUNCTION_LIST KF7-320A.15[4] R301.23.ADV_calculation_1_1_2 /end FUNCTION_LIST /end CHARACTERISTIC
/begin CHARACTERISTIC mTRFCD "F/C excuse judgement delay" VALUE 0x00008CE7 REC_UBYTE_C 0 COMP_0014 0 2550 /begin FUNCTION_LIST KF7-320A.15[4] R301.23.ADV_calculation_1_1_2 /end FUNCTION_LIST /end CHARACTERISTIC
/begin CHARACTERISTIC mTSTPVSP "Switchover step ílêÿÇË is changed, vehicle speed" VALUE 0x00009632 REC_UWORD_C 0 COMP_0436 0 6553.5 /begin FUNCTION_LIST KF7-340.6M[2] /end FUNCTION_LIST /end CHARACTERISTIC
/begin CHARACTERISTIC mTVHADS "After idle off, TVO value lower limit" VALUE 0x00008D03 REC_UBYTE_C 0 COMP_0002 0 89.25 /begin FUNCTION_LIST KF7-320A.15[4] R301.23.ADV_calculation_1_1_2 /end FUNCTION_LIST /end CHARACTERISTIC
/begin CHARACTERISTIC mTVOADV "TVO upper limit value" VALUE 0x00008D04 REC_UBYTE_C 0 COMP_0002 0 89.25 /begin FUNCTION_LIST KF7-320A.15[4] R301.23.ADV_calculation_1_1_2 /end FUNCTION_LIST /end CHARACTERISTIC
/begin CHARACTERISTIC mTWCRADV "At the time of the start, ignition timing compensation control upper limit coolant temperature" VALUE 0x00008D22 REC_UBYTE_C 0 COMP_0035 -50 205 /begin FUNCTION_LIST KF7-320A.19[7] /end FUNCTION_LIST /end CHARACTERISTIC
/begin CHARACTERISTIC mTWHEAT "At the time of the heat resisting, idle rise start coolant temperature" VALUE 0x00008D2E REC_UBYTE_C 0 COMP_0035 -50 205 /begin FUNCTION_LIST KF7-330.4A[53] R000.1.RS_Integ_1_10_2 /end FUNCTION_LIST /end CHARACTERISTIC
/begin CHARACTERISTIC mTWHLMT "At the time of the acceleration, judgement coolant temperature upper limit" VALUE 0x00008D30 REC_UBYTE_C 0 COMP_0035 -50 205 /begin FUNCTION_LIST KF7-320A.15[4] R301.23.ADV_calculation_1_1_2 /end FUNCTION_LIST /end CHARACTERISTIC
/begin CHARACTERISTIC mTWLLMT "At the time of the acceleration, judgement coolant temperature lower limit" VALUE 0x00008D45 REC_UBYTE_C 0 COMP_0035 -50 205 /begin FUNCTION_LIST KF7-320A.15[4] R301.23.ADV_calculation_1_1_2 /end FUNCTION_LIST /end CHARACTERISTIC
/begin CHARACTERISTIC mTWNDH "N- At the time of the >D select, target idle rotation decline control start coolant temperature upper limit" VALUE 0x00008D4B REC_UBYTE_C 0 COMP_0035 -50 205 /begin FUNCTION_LIST KF7-330.4A[53] /end FUNCTION_LIST /end CHARACTERISTIC
/begin CHARACTERISTIC mTWNDL "N- At the time of the >D select, target idle rotation decline control start coolant temperature lower limit" VALUE 0x00008D4E REC_UBYTE_C 0 COMP_0035 -50 205 /begin FUNCTION_LIST KF7-330.4A[53] /end FUNCTION_LIST /end CHARACTERISTIC
/begin CHARACTERISTIC mTWPIG "Pre-ignition avoidance control lower limit coolant temperature" VALUE 0x00008D5E REC_UBYTE_C 0 COMP_0035 -50 205 /begin FUNCTION_LIST KF7-330.4A[53] KF7-360.9M[43] R000.1.RS_Integ_1_10_2 /end FUNCTION_LIST /end CHARACTERISTIC
/begin CHARACTERISTIC mTWRMN "At the time of the regular judgement, idle rotation UP coolant temperature" VALUE 0x00008D64 REC_UBYTE_C 0 COMP_0035 -50 205 /begin FUNCTION_LIST KF7-330.4A[53] R000.1.RS_Integ_1_10_2 /end FUNCTION_LIST /end CHARACTERISTIC
/begin CHARACTERISTIC mVOL_S "Engine displacement" VALUE 0x0000F6C1 REC_UBYTE_C 0 COMP_0362 0 6375
 /begin FUNCTION_LIST KF7-340.1P[7] KF7-340.2P[1] KF7-340.8P[8] KF7-350.4P[13] KF7-410.11P[4] KF7-410.17P[1] R000.1.RS_Integ_1_10_2 R301.20.AmbientComp_1_0_2 /end FUNCTION_LIST
/end CHARACTERISTIC
/begin CHARACTERISTIC mVSPLLM "At the time of the acceleration, judgement vehicle speed lower limit" VALUE 0x00008E14 REC_UBYTE_C 0 COMP_0007 0 510 /begin FUNCTION_LIST KF7-320A.15[4] R301.23.ADV_calculation_1_1_2 /end FUNCTION_LIST /end CHARACTERISTIC
/begin CHARACTERISTIC mVSPLMT "At the time of the acceleration, judgement vehicle speed upper limit" VALUE 0x00008E15 REC_UBYTE_C 0 COMP_0007 0 510 /begin FUNCTION_LIST KF7-320A.15[4] R301.23.ADV_calculation_1_1_2 /end FUNCTION_LIST /end CHARACTERISTIC
/begin CHARACTERISTIC mVSPPTD "PTD operation permission vehicle speed" VALUE 0x00009670 REC_UWORD_C 0 COMP_0436 0 6553.5 /begin FUNCTION_LIST KF7-340.7[4] /end FUNCTION_LIST /end CHARACTERISTIC
/begin CHARACTERISTIC mVTCADH "At the time of the failsafe, retard quantity (at the time of the high coolant temperature)" VALUE 0x00008E21 REC_UBYTE_C 0 COMP_0245 -64 191 /begin FUNCTION_LIST KF7-320A.22[5] /end FUNCTION_LIST /end CHARACTERISTIC
/begin CHARACTERISTIC mVTCADL "At the time of the failsafe, retard quantity (at the time of the low coolant temperature)" VALUE 0x00008E22 REC_UBYTE_C 0 COMP_0245 -64 191 /begin FUNCTION_LIST KF7-320A.22[5] /end FUNCTION_LIST /end CHARACTERISTIC
/begin CHARACTERISTIC mVTCDEVF "CVTC deviation dead-zone" VALUE 0x00008E28 REC_UBYTE_C 0 COMP_0048 0 127.5 /begin FUNCTION_LIST KF7-320A.22[5] /end FUNCTION_LIST /end CHARACTERISTIC
/begin CHARACTERISTIC mVTCTWH "A coolant temperature upper limit for the VTC drive permission" VALUE 0x00008E4F REC_UBYTE_C 0 COMP_0035 -50 205 /begin FUNCTION_LIST KF7-320A.22[5] KF7-393.1C[8] /end FUNCTION_LIST /end CHARACTERISTIC
/begin CHARACTERISTIC mZLADFLM "Drive power lower limit limiter (control for the area attribute)" VALUE 0x00008F86 REC_SWORD_C 0 COMP_0030_S -32768 32767 /begin FUNCTION_LIST KF7-340.8M[8] /end FUNCTION_LIST /end CHARACTERISTIC
/begin CHARACTERISTIC mZLADFM_S "Drive power lower limit limiter (control for the area attribute)" VALUE 0x0000F6C6 REC_SWORD_C 0 COMP_0030_S -32768 32767 /begin FUNCTION_LIST KF7-340.8P[8] /end FUNCTION_LIST /end CHARACTERISTIC
/begin CHARACTERISTIC mZUADFLM "Drive power upper limit limiter (control for the area attribute)" VALUE 0x00008F88 REC_SWORD_C 0 COMP_0030_S -32768 32767 /begin FUNCTION_LIST KF7-340.8M[8] /end FUNCTION_LIST /end CHARACTERISTIC
/begin CHARACTERISTIC mZUADFM_S "Drive power upper limit limiter (control for the area attribute)" VALUE 0x0000F6C8 REC_SWORD_C 0 COMP_0030_S -32768 32767 /begin FUNCTION_LIST KF7-340.8P[8] /end FUNCTION_LIST /end CHARACTERISTIC
/begin CHARACTERISTIC mMTFDD "D range target drive power map" MAP 0x0000B9F2 REC_UWORD_C 0 COMP_0123_S -32768 32767
 /begin AXIS_DESCR COM_AXIS NO_INPUT_QUANTITY COMP_0005 16 0 7208.85 AXIS_PTS_REF mMTFKAPO /end AXIS_DESCR
 /begin AXIS_DESCR COM_AXIS NO_INPUT_QUANTITY COMP_0436 16 0 6553.5 AXIS_PTS_REF mMTFKVSP /end AXIS_DESCR
 /begin FUNCTION_LIST KF7-340.3M[1] KF7-340.5[4] KF7-340.5P[2] KF7-410.19[2] /end FUNCTION_LIST
/end CHARACTERISTIC
/begin CHARACTERISTIC mMTFDDS "Ds range target drive power map" MAP 0x0000BBF2 REC_UWORD_C 0 COMP_0123_S -32768 32767
 /begin AXIS_DESCR COM_AXIS NO_INPUT_QUANTITY COMP_0005 16 0 7208.85 AXIS_PTS_REF mMTFKAPO /end AXIS_DESCR
 /begin AXIS_DESCR COM_AXIS NO_INPUT_QUANTITY COMP_0436 16 0 6553.5 AXIS_PTS_REF mMTFKVSP /end AXIS_DESCR
 /begin FUNCTION_LIST KF7-340.3M[1] /end FUNCTION_LIST
/end CHARACTERISTIC
/begin CHARACTERISTIC mMTFDDS_S "Ds range target drive power map (redundant operation vice-operation part)" MAP 0x0000FC0C REC_UWORD_C 0 COMP_0123_S -32768 32767
 /begin AXIS_DESCR COM_AXIS NO_INPUT_QUANTITY COMP_0005 16 0 7208.85 AXIS_PTS_REF mMTFKAP_S /end AXIS_DESCR
 /begin AXIS_DESCR COM_AXIS NO_INPUT_QUANTITY COMP_0436 16 0 6553.5 AXIS_PTS_REF mMTFKVS_S /end AXIS_DESCR
 /begin FUNCTION_LIST KF7-340.3P[2] /end FUNCTION_LIST
/end CHARACTERISTIC
/begin CHARACTERISTIC mMTFDD_S "D range target drive power map (redundant operation vice-operation part)" MAP 0x0000FE0C REC_UWORD_C 0 COMP_0123_S -32768 32767
 /begin AXIS_DESCR COM_AXIS NO_INPUT_QUANTITY COMP_0005 16 0 7208.85 AXIS_PTS_REF mMTFKAP_S /end AXIS_DESCR
 /begin AXIS_DESCR COM_AXIS NO_INPUT_QUANTITY COMP_0436 16 0 6553.5 AXIS_PTS_REF mMTFKVS_S /end AXIS_DESCR
 /begin FUNCTION_LIST KF7-340.3P[2] KF7-340.5P[2] /end FUNCTION_LIST
/end CHARACTERISTIC
/begin CHARACTERISTIC mMTTE "QH0/ torque conversion map" MAP 0x0000BDF2 REC_UWORD_C 0 COMP_0226 -3276.8 3276.7
 /begin AXIS_DESCR COM_AXIS NO_INPUT_QUANTITY COMP_0020 16 0 12750 AXIS_PTS_REF mNTTE0 /end AXIS_DESCR
 /begin AXIS_DESCR COM_AXIS NO_INPUT_QUANTITY COMP_0410 16 0 99.9985458 AXIS_PTS_REF mQHTTE /end AXIS_DESCR
 /begin FUNCTION_LIST KF7-340.1M[8] KF7-340.1P[7] KF7-340.2M[2] KF7-340.8M[8] KF7-360.8M[4] KF7-360.9M[43] KF7-360.12[6] KF7-385.3[4] KF7-410.11M[4] KF7-410.11P[4] KF7-410.17M[5] KF7-410.17P[1] R000.1.RS_Integ_1_10_2 R301.8.Inverse_filter_1_1_3 R301.20.AmbientComp_1_0_2 /end FUNCTION_LIST
/end CHARACTERISTIC
/begin CHARACTERISTIC mMTTE_S "QH0 torque conversion map" MAP 0x0001000C REC_UWORD_C 0 COMP_0226 -3276.8 3276.7
 /begin AXIS_DESCR COM_AXIS NO_INPUT_QUANTITY COMP_0020 16 0 12750 AXIS_PTS_REF mNTTE0_S /end AXIS_DESCR
 /begin AXIS_DESCR COM_AXIS NO_INPUT_QUANTITY COMP_0410 16 0 99.9985458 AXIS_PTS_REF mQHTTE_S /end AXIS_DESCR
 /begin FUNCTION_LIST KF7-340.1P[7] KF7-340.2P[1] KF7-340.8P[8] KF7-410.11P[4] KF7-410.17P[1] R000.1.RS_Integ_1_10_2 R301.20.AmbientComp_1_0_2 /end FUNCTION_LIST
/end CHARACTERISTIC
/begin CHARACTERISTIC mTEHOSMAP "TTEPTD torque compensation map" MAP 0x0000C4F2 REC_UWORD_C 0 COMP_0271 0 199.99696053
 /begin AXIS_DESCR COM_AXIS NO_INPUT_QUANTITY COMP_0450 8 0 63.999056205 AXIS_PTS_REF mTEHOSRTO /end AXIS_DESCR
 /begin AXIS_DESCR COM_AXIS NO_INPUT_QUANTITY COMP_0065 8 0 204796.875 AXIS_PTS_REF mTEHOSNE /end AXIS_DESCR
 /begin FUNCTION_LIST KF7-340.8M[8] /end FUNCTION_LIST
/end CHARACTERISTIC
/begin CHARACTERISTIC mTADVC1 "Jar sound compensation table (coolant temperature)" CURVE 0x0000CDCE REC_UBYTE_C 0 COMP_0017 0 255
 /begin AXIS_DESCR FIX_AXIS NO_INPUT_QUANTITY COMP_0280_S 16 -40 110 FIX_AXIS_PAR_DIST 0 1 16 /end AXIS_DESCR
 /begin FUNCTION_LIST KF7-320A.23[N] /end FUNCTION_LIST
/end CHARACTERISTIC
/begin CHARACTERISTIC mTADVC2 "Jar sound compensation table (engine speed)" CURVE 0x0000CDDE REC_UBYTE_C 0 COMP_0017 0 255
 /begin AXIS_DESCR FIX_AXIS NO_INPUT_QUANTITY COMP_0271_S 16 0 6000 FIX_AXIS_PAR_DIST 0 1 16 /end AXIS_DESCR
 /begin FUNCTION_LIST KF7-320A.23[N] /end FUNCTION_LIST
/end CHARACTERISTIC
/begin CHARACTERISTIC mTAISMX "ISC opening area upper limit value table" CURVE 0x0000E4EA REC_UWORD_C 0 COMP_0042 0 52.428
 /begin AXIS_DESCR FIX_AXIS NO_INPUT_QUANTITY COMP_0280_S 16 -40 110 FIX_AXIS_PAR_DIST 0 1 16 /end AXIS_DESCR
 /begin FUNCTION_LIST KF7-330.1M[3] /end FUNCTION_LIST
/end CHARACTERISTIC
/begin CHARACTERISTIC mTAISMX_S "ISC opening area upper limit value table" CURVE 0x00010378 REC_UWORD_C 0 COMP_0042 0 52.428
 /begin AXIS_DESCR FIX_AXIS NO_INPUT_QUANTITY COMP_0280_S 16 -40 110 FIX_AXIS_PAR_DIST 0 1 16 /end AXIS_DESCR
 /begin FUNCTION_LIST KF7-330.1P[3] /end FUNCTION_LIST
/end CHARACTERISTIC
/begin CHARACTERISTIC mTAISNH "ISC opening area upper limit engine speed compensation table" CURVE 0x0000E50A REC_UWORD_C 0 COMP_0042 0 52.428
 /begin AXIS_DESCR FIX_AXIS NO_INPUT_QUANTITY COMP_0271_S 16 0 6000 FIX_AXIS_PAR_DIST 0 1 16 /end AXIS_DESCR
 /begin FUNCTION_LIST KF7-330.1M[3] /end FUNCTION_LIST
/end CHARACTERISTIC
/begin CHARACTERISTIC mTAISNH_S "ISC opening area upper limit engine speed compensation table" CURVE 0x00010398 REC_UWORD_C 0 COMP_0042 0 52.428
 /begin AXIS_DESCR FIX_AXIS NO_INPUT_QUANTITY COMP_0271_S 16 0 6000 FIX_AXIS_PAR_DIST 0 1 16 /end AXIS_DESCR
 /begin FUNCTION_LIST KF7-330.1P[3] /end FUNCTION_LIST
/end CHARACTERISTIC
/begin CHARACTERISTIC mTDECMX "DECISC basic value table" CURVE 0x0000CF5E REC_UBYTE_C 0 COMP_0220 0 255
 /begin AXIS_DESCR FIX_AXIS NO_INPUT_QUANTITY COMP_0268_S 16 0 120 FIX_AXIS_PAR_DIST 0 1 16 /end AXIS_DESCR
 /begin FUNCTION_LIST KF7-330.7A[1] /end FUNCTION_LIST
/end CHARACTERISTIC
/begin CHARACTERISTIC mTFNCRADV "At the time of the start, ignition timing rotation compensation value table" CURVE 0x0000EA3A REC_UWORD_C 0 COMP_0063 0 255.99609375
 /begin AXIS_DESCR FIX_AXIS NO_INPUT_QUANTITY COMP_0283_S 16 0 3000 FIX_AXIS_PAR_DIST 0 1 16 /end AXIS_DESCR
 /begin FUNCTION_LIST KF7-320A.19[7] /end FUNCTION_LIST
/end CHARACTERISTIC
/begin CHARACTERISTIC mTIDELAY "CLOSE control switchover table" CURVE 0x0000D252 REC_UBYTE_C 0 COMP_0008 0 25500
 /begin AXIS_DESCR FIX_AXIS NO_INPUT_QUANTITY COMP_0271_S 16 0 6000 FIX_AXIS_PAR_DIST 0 1 16 /end AXIS_DESCR
 /begin FUNCTION_LIST KF7-330.3[6] KF7-376.2[21] KF7-390.3A[15] /end FUNCTION_LIST
/end CHARACTERISTIC
/begin CHARACTERISTIC mTKMRTPH "Torque going down stage judgement ITAC table high-octane" CURVE 0x0000D3CA REC_UBYTE_C 0 COMP_0009 0 199.21875
 /begin AXIS_DESCR FIX_AXIS NO_INPUT_QUANTITY COMP_0271_S 16 0 6000 FIX_AXIS_PAR_DIST 0 1 16 /end AXIS_DESCR
 /begin FUNCTION_LIST KF7-320A.17[N] /end FUNCTION_LIST
/end CHARACTERISTIC
/begin CHARACTERISTIC mTKMRTPR "Torque going down stage judgement ITAC table regular" CURVE 0x0000D3DA REC_UBYTE_C 0 COMP_0009 0 199.21875
 /begin AXIS_DESCR FIX_AXIS NO_INPUT_QUANTITY COMP_0271_S 16 0 6000 FIX_AXIS_PAR_DIST 0 1 16 /end AXIS_DESCR
 /begin FUNCTION_LIST KF7-320A.17[N] /end FUNCTION_LIST
/end CHARACTERISTIC
/begin CHARACTERISTIC mTKMRTRQH "Torque going down stage retard quantity table high-octane" CURVE 0x0000D3F2 REC_UBYTE_C 0 COMP_0017 0 255
 /begin AXIS_DESCR FIX_AXIS NO_INPUT_QUANTITY COMP_0271_S 16 0 6000 FIX_AXIS_PAR_DIST 0 1 16 /end AXIS_DESCR
 /begin FUNCTION_LIST KF7-320A.17[N] /end FUNCTION_LIST
/end CHARACTERISTIC
/begin CHARACTERISTIC mTKMRTRQR "Torque going down stage retard quantity table regular" CURVE 0x0000D402 REC_UBYTE_C 0 COMP_0017 0 255
 /begin AXIS_DESCR FIX_AXIS NO_INPUT_QUANTITY COMP_0271_S 16 0 6000 FIX_AXIS_PAR_DIST 0 1 16 /end AXIS_DESCR
 /begin FUNCTION_LIST KF7-320A.17[N] /end FUNCTION_LIST
/end CHARACTERISTIC
/begin CHARACTERISTIC mTNETAGT "NSET0 addition table" CURVE 0x0000D5F4 REC_UBYTE_C 0 COMP_0064 0 398.4375
 /begin AXIS_DESCR FIX_AXIS NO_INPUT_QUANTITY COMP_0429 16 0 15 FIX_AXIS_PAR_DIST 0 1 16 /end AXIS_DESCR
 /begin FUNCTION_LIST KF7-330.4A[53] /end FUNCTION_LIST
/end CHARACTERISTIC
/begin CHARACTERISTIC mTNMEMDH "D range idle speed high eye setup value table" CURVE 0x0000D640 REC_UBYTE_C 0 COMP_0006 0 3187.5
 /begin AXIS_DESCR FIX_AXIS NO_INPUT_QUANTITY COMP_0280_S 16 -40 110 FIX_AXIS_PAR_DIST 0 1 16 /end AXIS_DESCR
 /begin FUNCTION_LIST KF7-330.4A[53] KF7-330.5[53] /end FUNCTION_LIST
/end CHARACTERISTIC
/begin CHARACTERISTIC mTNMEMDL "D range idle speed low eye setup value table" CURVE 0x0000D650 REC_UBYTE_C 0 COMP_0006 0 3187.5
 /begin AXIS_DESCR FIX_AXIS NO_INPUT_QUANTITY COMP_0280_S 16 -40 110 FIX_AXIS_PAR_DIST 0 1 16 /end AXIS_DESCR
 /begin FUNCTION_LIST KF7-330.4A[53] KF7-330.5[53] /end FUNCTION_LIST
/end CHARACTERISTIC
/begin CHARACTERISTIC mTNQD1 "D range NSET0 maintenance air quantity table (6, 8 cylinder)" CURVE 0x0000D678 REC_UBYTE_C 0 COMP_0493 0 1020
 /begin AXIS_DESCR FIX_AXIS NO_INPUT_QUANTITY COMP_0292_S 16 0 1500 FIX_AXIS_PAR_DIST 0 1 16 /end AXIS_DESCR
 /begin FUNCTION_LIST KF7-330.4A[53] KF7-330.5[53] /end FUNCTION_LIST
/end CHARACTERISTIC
/begin CHARACTERISTIC mTNQN1 "N range NSET0 maintenance air quantity table (6, 8 cylinder)" CURVE 0x0000D698 REC_UBYTE_C 0 COMP_0493 0 1020
 /begin AXIS_DESCR FIX_AXIS NO_INPUT_QUANTITY COMP_0292_S 16 0 1500 FIX_AXIS_PAR_DIST 0 1 16 /end AXIS_DESCR
 /begin FUNCTION_LIST KF7-330.4A[53] KF7-330.5[53] /end FUNCTION_LIST
/end CHARACTERISTIC
/begin CHARACTERISTIC mTNQND "Loss in weight compensation reference value table" CURVE 0x0000D6A8 REC_UBYTE_C 0 COMP_0293 0 510
 /begin AXIS_DESCR FIX_AXIS NO_INPUT_QUANTITY COMP_0292_S 16 0 1500 FIX_AXIS_PAR_DIST 0 1 16 /end AXIS_DESCR
 /begin FUNCTION_LIST KF7-330.9[8] /end FUNCTION_LIST
/end CHARACTERISTIC
/begin CHARACTERISTIC mTQCINDHL "When idle rotation declines at the time of the intermadiate coolant temperature, covering air flow-quantity table" CURVE 0x0000D798 REC_UBYTE_C 0 COMP_0051 0 255
 /begin AXIS_DESCR FIX_AXIS NO_INPUT_QUANTITY COMP_0280_S 16 -40 110 FIX_AXIS_PAR_DIST 0 1 16 /end AXIS_DESCR
 /begin FUNCTION_LIST KF7-330.5[53] /end FUNCTION_LIST
/end CHARACTERISTIC
/begin CHARACTERISTIC mTQH0LMT "QH0 upper limit table" CURVE 0x0000EE32 REC_UWORD_C 0 COMP_0410 0 99.9985458
 /begin AXIS_DESCR FIX_AXIS NO_INPUT_QUANTITY COMP_0271_S 16 0 6000 FIX_AXIS_PAR_DIST 0 1 16 /end AXIS_DESCR
 /begin FUNCTION_LIST KF7-340.1M[8] KF7-410.17M[5] R301.20.AmbientComp_1_0_2 /end FUNCTION_LIST
/end CHARACTERISTIC
/begin CHARACTERISTIC mTTRQRTO "Torque converter torque ratio table" CURVE 0x0000F45E REC_UWORD_C 0 COMP_0450 0 63.999056205
 /begin AXIS_DESCR FIX_AXIS NO_INPUT_QUANTITY COMP_0297_S 16 0 0.9 FIX_AXIS_PAR_DIST 0 1 16 /end AXIS_DESCR
 /begin FUNCTION_LIST KF7-340.10M[1] /end FUNCTION_LIST
/end CHARACTERISTIC
/begin CHARACTERISTIC mTTRQRT_S "Torque converter torque ratio table" CURVE 0x000107B2 REC_UWORD_C 0 COMP_0450 0 63.999056205
 /begin AXIS_DESCR FIX_AXIS NO_INPUT_QUANTITY COMP_0297_S 16 0 0.9 FIX_AXIS_PAR_DIST 0 1 16 /end AXIS_DESCR
 /begin FUNCTION_LIST KF7-340.10P[N] /end FUNCTION_LIST
/end CHARACTERISTIC
/begin CHARACTERISTIC mTTWISC "Coolant temperature compensation table" CURVE 0x0000DC62 REC_UBYTE_C 0 COMP_0009 0 199.21875
 /begin AXIS_DESCR FIX_AXIS NO_INPUT_QUANTITY COMP_0280_S 16 -40 110 FIX_AXIS_PAR_DIST 0 1 16 /end AXIS_DESCR
 /begin FUNCTION_LIST KF7-330.5[53] /end FUNCTION_LIST
/end CHARACTERISTIC
/begin CHARACTERISTIC mTVTHNKTP "VTCNK threshold TP table" CURVE 0x0000DD66 REC_UBYTE_C 0 COMP_0001 0 31.875
 /begin AXIS_DESCR COM_AXIS NO_INPUT_QUANTITY COMP_0020 16 0 12750 AXIS_PTS_REF mTVTHNEI /end AXIS_DESCR
 /begin FUNCTION_LIST KF7-320A.22[5] /end FUNCTION_LIST
/end CHARACTERISTIC
/begin CHARACTERISTIC mTQH0SH_S "Volume flow-quantity ratio table 2 (high flow-quantity proportion)" CURVE 0x00010588 REC_UWORD_C 0 COMP_0146 0 99.998480265
 /begin AXIS_DESCR COM_AXIS NO_INPUT_QUANTITY COMP_0304_S 32 0 0.000040959375 AXIS_PTS_REF mTGADNH_S /end AXIS_DESCR
 /begin FUNCTION_LIST KF7-340.1P[7] KF7-340.2P[1] KF7-350.4P[13] KF7-410.17P[1] R301.20.AmbientComp_1_0_2 /end FUNCTION_LIST
/end CHARACTERISTIC
/begin CHARACTERISTIC mTQH0ST_S "Volume flow-quantity ratio table 1" CURVE 0x000105C8 REC_UWORD_C 0 COMP_0146 0 99.998480265
 /begin AXIS_DESCR COM_AXIS NO_INPUT_QUANTITY COMP_0303_S 32 0 2.5599609375E-06 AXIS_PTS_REF mTGADNV_S /end AXIS_DESCR
 /begin FUNCTION_LIST KF7-340.1P[7] KF7-340.2P[1] KF7-340.8P[8] KF7-350.4P[13] KF7-410.11P[4] KF7-410.17P[1] R000.1.RS_Integ_1_10_2 R301.20.AmbientComp_1_0_2 /end FUNCTION_LIST
/end CHARACTERISTIC
/begin CHARACTERISTIC mTTGTVO_S "Opening area => target throttle open-degree conversion table" CURVE 0x00010772 REC_UWORD_C 0 COMP_0130 0 1802.2125
 /begin AXIS_DESCR COM_AXIS NO_INPUT_QUANTITY COMP_0041 32 0 52.428 AXIS_PTS_REF mATGTVO_S /end AXIS_DESCR
 /begin FUNCTION_LIST KF7-340.1P[7] KF7-340.2P[1] KF7-350.1P[4] KF7-350.4P[13] KF7-410.11P[4] KF7-410.17P[1] R000.1.RS_Integ_1_10_2 R301.20.AmbientComp_1_0_2 /end FUNCTION_LIST
/end CHARACTERISTIC
/begin CHARACTERISTIC mTQCIMAX1 "At the time of OPEN, F/B I-gain upper limit value table (6, 8 cylinder car kind)" CURVE 0x0000D794 REC_UBYTE_C 0 COMP_0293 0 510
 /begin AXIS_DESCR FIX_AXIS NO_INPUT_QUANTITY COMP_0305_S 4 -40 80 FIX_AXIS_PAR_DIST 0 1 4 /end AXIS_DESCR
 /begin FUNCTION_LIST KF7-330.5[53] /end FUNCTION_LIST
/end CHARACTERISTIC
/begin CHARACTERISTIC mTSTPTRN "PTD ON/ off switchover step value table" CURVE 0x0000F19E REC_UWORD_C 0 COMP_0290 0 0.999985458
 /begin AXIS_DESCR FIX_AXIS NO_INPUT_QUANTITY COMP_0307_S 4 0 768 FIX_AXIS_PAR_DIST 0 1 4 /end AXIS_DESCR
 /begin FUNCTION_LIST KF7-340.6M[2] /end FUNCTION_LIST
/end CHARACTERISTIC
/begin CHARACTERISTIC mTSTPTRNL "At the time of low speed, PTD ON/ off switchover step value table" CURVE 0x0000F1A6 REC_UWORD_C 0 COMP_0290 0 0.999985458
 /begin AXIS_DESCR FIX_AXIS NO_INPUT_QUANTITY COMP_0307_S 4 0 768 FIX_AXIS_PAR_DIST 0 1 4 /end AXIS_DESCR
 /begin FUNCTION_LIST KF7-340.6M[2] /end FUNCTION_LIST
/end CHARACTERISTIC
/begin CHARACTERISTIC mTTRADV1 "Initial retard quantity table 1" CURVE 0x0000DB3E REC_UBYTE_C 0 COMP_0017 0 255
 /begin AXIS_DESCR FIX_AXIS NO_INPUT_QUANTITY COMP_0308_S 4 0 4.2 FIX_AXIS_PAR_DIST 0 1 4 /end AXIS_DESCR
 /begin FUNCTION_LIST KF7-320A.15[4] R301.23.ADV_calculation_1_1_2 /end FUNCTION_LIST
/end CHARACTERISTIC
/begin CHARACTERISTIC mTTRADV2 "Initial retard quantity table 2" CURVE 0x0000DB42 REC_UBYTE_C 0 COMP_0017 0 255
 /begin AXIS_DESCR FIX_AXIS NO_INPUT_QUANTITY COMP_0308_S 4 0 4.2 FIX_AXIS_PAR_DIST 0 1 4 /end AXIS_DESCR
 /begin FUNCTION_LIST KF7-320A.15[4] R301.23.ADV_calculation_1_1_2 /end FUNCTION_LIST
/end CHARACTERISTIC
/begin CHARACTERISTIC mTTRADV22 "Initial retard quantity table 22 (When it steps from the idle.)" CURVE 0x0000DB46 REC_UBYTE_C 0 COMP_0017 0 255
 /begin AXIS_DESCR FIX_AXIS NO_INPUT_QUANTITY COMP_0308_S 4 0 4.2 FIX_AXIS_PAR_DIST 0 1 4 /end AXIS_DESCR
 /begin FUNCTION_LIST KF7-320A.15[4] R301.23.ADV_calculation_1_1_2 /end FUNCTION_LIST
/end CHARACTERISTIC
/begin CHARACTERISTIC mTTRADV3 "Initial retard quantity table 3" CURVE 0x0000DB4A REC_UBYTE_C 0 COMP_0017 0 255
 /begin AXIS_DESCR FIX_AXIS NO_INPUT_QUANTITY COMP_0308_S 4 0 4.2 FIX_AXIS_PAR_DIST 0 1 4 /end AXIS_DESCR
 /begin FUNCTION_LIST KF7-320A.15[4] R301.23.ADV_calculation_1_1_2 /end FUNCTION_LIST
/end CHARACTERISTIC
/begin CHARACTERISTIC mTTRADV4 "Initial retard quantity table 4" CURVE 0x0000DB4E REC_UBYTE_C 0 COMP_0017 0 255
 /begin AXIS_DESCR FIX_AXIS NO_INPUT_QUANTITY COMP_0308_S 4 0 4.2 FIX_AXIS_PAR_DIST 0 1 4 /end AXIS_DESCR
 /begin FUNCTION_LIST KF7-320A.15[4] R301.23.ADV_calculation_1_1_2 /end FUNCTION_LIST
/end CHARACTERISTIC
/begin CHARACTERISTIC mTVTCNK "VTCNK knock retard quantity table" CURVE 0x0000DD0A REC_UBYTE_C 0 COMP_0245 -64 191
 /begin AXIS_DESCR FIX_AXIS NO_INPUT_QUANTITY COMP_0508_S 4 -48 0 FIX_AXIS_PAR_DIST 0 1 4 /end AXIS_DESCR
 /begin FUNCTION_LIST KF7-320A.22[5] /end FUNCTION_LIST
/end CHARACTERISTIC
/begin CHARACTERISTIC mTRATIO_S "Gear ratio table" CURVE 0x00010608 REC_UWORD_C 0 COMP_0450 0 63.999056205
 /begin AXIS_DESCR FIX_AXIS NO_INPUT_QUANTITY COMP_0068 5 0 4 FIX_AXIS_PAR_DIST 0 1 5 /end AXIS_DESCR
 /begin FUNCTION_LIST KF7-340.9P[3] /end FUNCTION_LIST
/end CHARACTERISTIC
/begin CHARACTERISTIC mRATIOD1 "During actual gear shift, RATIO switchover speed" CURVE 0x0000E3EC REC_UWORD_C 0 COMP_0313_S 0 7.99985745
 /begin AXIS_DESCR FIX_AXIS NO_INPUT_QUANTITY COMP_0314_S 8 0 49.28 FIX_AXIS_PAR_DIST 0 1 8 /end AXIS_DESCR
 /begin FUNCTION_LIST KF7-340.9M[3] /end FUNCTION_LIST
/end CHARACTERISTIC
/begin CHARACTERISTIC mRATIOD2 "After actual gear shift completion, RATIO switchover speed" CURVE 0x0000E3FC REC_UWORD_C 0 COMP_0313_S 0 7.99985745
 /begin AXIS_DESCR FIX_AXIS NO_INPUT_QUANTITY COMP_0314_S 8 0 49.28 FIX_AXIS_PAR_DIST 0 1 8 /end AXIS_DESCR
 /begin FUNCTION_LIST KF7-340.9M[3] /end FUNCTION_LIST
/end CHARACTERISTIC
/begin CHARACTERISTIC mTCRADV "CRADV table" CURVE 0x0000CF06 REC_UBYTE_C 0 COMP_0017 0 255
 /begin AXIS_DESCR FIX_AXIS NO_INPUT_QUANTITY COMP_0278_S 8 -40 100 FIX_AXIS_PAR_DIST 0 1 8 /end AXIS_DESCR
 /begin FUNCTION_LIST KF7-320A.19[7] /end FUNCTION_LIST
/end CHARACTERISTIC
/begin CHARACTERISTIC mTFNALMT "Rotation compensation value upper limit table" CURVE 0x0000EA2A REC_UWORD_C 0 COMP_0063 0 255.99609375
 /begin AXIS_DESCR FIX_AXIS NO_INPUT_QUANTITY COMP_0278_S 8 -40 100 FIX_AXIS_PAR_DIST 0 1 8 /end AXIS_DESCR
 /begin FUNCTION_LIST KF7-320A.19[7] /end FUNCTION_LIST
/end CHARACTERISTIC
/begin CHARACTERISTIC mTGNSTST2 "Right after the start, idle rise rate table" CURVE 0x0000D116 REC_UBYTE_C 0 COMP_0021 0 99.609375
 /begin AXIS_DESCR FIX_AXIS NO_INPUT_QUANTITY COMP_0278_S 8 -40 100 FIX_AXIS_PAR_DIST 0 1 8 /end AXIS_DESCR
 /begin FUNCTION_LIST KF7-330.4A[53] /end FUNCTION_LIST
/end CHARACTERISTIC
/begin CHARACTERISTIC mTIDUTY "QFBI initial value" CURVE 0x0000D262 REC_UBYTE_C 0 COMP_0051 0 255
 /begin AXIS_DESCR FIX_AXIS NO_INPUT_QUANTITY COMP_0278_S 8 -40 100 FIX_AXIS_PAR_DIST 0 1 8 /end AXIS_DESCR
 /begin FUNCTION_LIST KF7-330.5[53] R301.19.ISC_PID_cont_1_0_2 /end FUNCTION_LIST
/end CHARACTERISTIC
/begin CHARACTERISTIC mTISCPAMB "Atomospheric pressure compensation table" CURVE 0x0000D2B2 REC_UBYTE_C 0 COMP_0009 0 199.21875
 /begin AXIS_DESCR COM_AXIS NO_INPUT_QUANTITY COMP_0054 8 0 5100 AXIS_PTS_REF mTHIPAMB /end AXIS_DESCR
 /begin FUNCTION_LIST KF7-330.5[53] KF7-351.3[11] /end FUNCTION_LIST
/end CHARACTERISTIC
/begin CHARACTERISTIC mTISCTA "Intake air temperature compensation table" CURVE 0x0000D2EA REC_UBYTE_C 0 COMP_0009 0 199.21875
 /begin AXIS_DESCR FIX_AXIS NO_INPUT_QUANTITY COMP_0278_S 8 -40 100 FIX_AXIS_PAR_DIST 0 1 8 /end AXIS_DESCR
 /begin FUNCTION_LIST KF7-330.5[53] KF7-351.3[11] /end FUNCTION_LIST
/end CHARACTERISTIC
/begin CHARACTERISTIC mTKADVA "K2Y table" CURVE 0x0000D30A REC_UBYTE_C 0 COMP_0111_S 0 255
 /begin AXIS_DESCR FIX_AXIS NO_INPUT_QUANTITY COMP_0325_S 8 0 56 FIX_AXIS_PAR_DIST 0 1 8 /end AXIS_DESCR
 /begin FUNCTION_LIST KF7-320A.15[4] R301.23.ADV_calculation_1_1_2 /end FUNCTION_LIST
/end CHARACTERISTIC
/begin CHARACTERISTIC mTKADVR "K1 table" CURVE 0x0000D312 REC_UBYTE_C 0 COMP_0111_S 0 255
 /begin AXIS_DESCR FIX_AXIS NO_INPUT_QUANTITY COMP_0325_S 8 0 56 FIX_AXIS_PAR_DIST 0 1 8 /end AXIS_DESCR
 /begin FUNCTION_LIST KF7-320A.15[4] R301.23.ADV_calculation_1_1_2 /end FUNCTION_LIST
/end CHARACTERISTIC
/begin CHARACTERISTIC mTNMEMH "NMEMH reference table" CURVE 0x0000D660 REC_UBYTE_C 0 COMP_0006 0 3187.5
 /begin AXIS_DESCR FIX_AXIS NO_INPUT_QUANTITY COMP_0327_S 8 10 80 FIX_AXIS_PAR_DIST 0 1 8 /end AXIS_DESCR
 /begin FUNCTION_LIST KF7-330.4A[53] R000.1.RS_Integ_1_10_2 /end FUNCTION_LIST
/end CHARACTERISTIC
/begin CHARACTERISTIC mTQENST "When engine rotation declines, air compensation quantity table" CURVE 0x0000D7AC REC_UBYTE_C 0 COMP_0051 0 255
 /begin AXIS_DESCR FIX_AXIS NO_INPUT_QUANTITY COMP_0020 8 0 350 FIX_AXIS_PAR_DIST 0 1 8 /end AXIS_DESCR
 /begin FUNCTION_LIST KF7-330.5[53] /end FUNCTION_LIST
/end CHARACTERISTIC
/begin CHARACTERISTIC mTQFBIMIN "F/B I-gain lower limit value table" CURVE 0x0000D7BC REC_SBYTE_C 0 COMP_0277 -128 127
 /begin AXIS_DESCR FIX_AXIS NO_INPUT_QUANTITY COMP_0278_S 8 -40 100 FIX_AXIS_PAR_DIST 0 1 8 /end AXIS_DESCR
 /begin FUNCTION_LIST KF7-330.5[53] R301.19.ISC_PID_cont_1_0_2 /end FUNCTION_LIST
/end CHARACTERISTIC
/begin CHARACTERISTIC mTQFBIMX1 "F/B I-gain upper limit value table (6, 8 cylinder)" CURVE 0x0000D7C4 REC_UBYTE_C 0 COMP_0293 0 510
 /begin AXIS_DESCR FIX_AXIS NO_INPUT_QUANTITY COMP_0278_S 8 -40 100 FIX_AXIS_PAR_DIST 0 1 8 /end AXIS_DESCR
 /begin FUNCTION_LIST KF7-330.5[53] KF7-500.38A[4] R301.19.ISC_PID_cont_1_0_2 /end FUNCTION_LIST
/end CHARACTERISTIC
/begin CHARACTERISTIC mTQH0VSP "QH0 upper limit vehicle speed table" CURVE 0x0000EE52 REC_UWORD_C 0 COMP_0115 0 99.9998565
 /begin AXIS_DESCR FIX_AXIS NO_INPUT_QUANTITY COMP_0328_S 8 0 44.8 FIX_AXIS_PAR_DIST 0 1 8 /end AXIS_DESCR
 /begin FUNCTION_LIST KF7-340.1M[8] KF7-410.17M[5] R301.20.AmbientComp_1_0_2 /end FUNCTION_LIST
/end CHARACTERISTIC
/begin CHARACTERISTIC mTQTW "Coolant temperature compensation air flow-quantity table" CURVE 0x0000D7D4 REC_UBYTE_C 0 COMP_0276 0 1020
 /begin AXIS_DESCR FIX_AXIS NO_INPUT_QUANTITY COMP_0278_S 8 -40 100 FIX_AXIS_PAR_DIST 0 1 8 /end AXIS_DESCR
 /begin FUNCTION_LIST KF7-330.5[53] KF7-385.1[32] KF7-385.3[4] /end FUNCTION_LIST
/end CHARACTERISTIC
/begin CHARACTERISTIC mTSLPISC "Torque converter load compensation coefficient table" CURVE 0x0000D8C2 REC_UBYTE_C 0 COMP_0526_S -2 1.984375
 /begin AXIS_DESCR COM_AXIS NO_INPUT_QUANTITY COMP_0186 8 0 3.984375 AXIS_PTS_REF mSLPRT /end AXIS_DESCR
 /begin FUNCTION_LIST KF7-330.9[8] /end FUNCTION_LIST
/end CHARACTERISTIC
/begin CHARACTERISTIC mTTATRD "R-> D switching delay timetable" CURVE 0x0000D962 REC_UBYTE_C 0 COMP_0008 0 25500
 /begin AXIS_DESCR FIX_AXIS NO_INPUT_QUANTITY COMP_0278_S 8 -40 100 FIX_AXIS_PAR_DIST 0 1 8 /end AXIS_DESCR
 /begin FUNCTION_LIST KF7-330.4A[53] /end FUNCTION_LIST
/end CHARACTERISTIC
/begin CHARACTERISTIC mTTISSL "Transient state compensation time table" CURVE 0x0000DA82 REC_UBYTE_C 0 COMP_0014 0 2550
 /begin AXIS_DESCR COM_AXIS NO_INPUT_QUANTITY COMP_0006 8 0 3187.5 AXIS_PTS_REF mNSLP /end AXIS_DESCR
 /begin FUNCTION_LIST KF7-330.9[8] /end FUNCTION_LIST
/end CHARACTERISTIC
/begin CHARACTERISTIC mTTNSETST "After the start, idle rise time table" CURVE 0x0000DACE REC_UBYTE_C 0 COMP_0049 0 255
 /begin AXIS_DESCR FIX_AXIS NO_INPUT_QUANTITY COMP_0278_S 8 -40 100 FIX_AXIS_PAR_DIST 0 1 8 /end AXIS_DESCR
 /begin FUNCTION_LIST KF7-330.4A[53] KF7-390.3A[15] /end FUNCTION_LIST
/end CHARACTERISTIC
/begin CHARACTERISTIC mTTRSLP "Torque converter load loss in weight compensation air quantity transient state compensation quantity table" CURVE 0x0000DB5A REC_UBYTE_C 0 COMP_0293 0 510
 /begin AXIS_DESCR COM_AXIS NO_INPUT_QUANTITY COMP_0006 8 0 3187.5 AXIS_PTS_REF mNSLP /end AXIS_DESCR
 /begin FUNCTION_LIST KF7-330.9[8] /end FUNCTION_LIST
/end CHARACTERISTIC
/begin CHARACTERISTIC mTVTCTRM "VTCMBT compensation quantity table" CURVE 0x0000DD1E REC_UBYTE_C 0 COMP_0245 -64 191
 /begin AXIS_DESCR FIX_AXIS NO_INPUT_QUANTITY COMP_0530_S 8 -64 48 FIX_AXIS_PAR_DIST 0 1 8 /end AXIS_DESCR
 /begin FUNCTION_LIST KF7-320A.22[5] /end FUNCTION_LIST
/end CHARACTERISTIC
/begin CHARACTERISTIC mTISBCP "Slowdown load compensation quantity table" CURVE 0x0000EA9A REC_UWORD_C 0 COMP_0324 0 511.9921875
 /begin AXIS_DESCR COM_AXIS NO_INPUT_QUANTITY COMP_0006 4 0 3187.5 AXIS_PTS_REF mNEDWN /end AXIS_DESCR
 /begin FUNCTION_LIST KF7-330.5[53] /end FUNCTION_LIST
/end CHARACTERISTIC
/begin CHARACTERISTIC mTNISBC "Slowdown load compensation start speed table" CURVE 0x0000D61C REC_UBYTE_C 0 COMP_0006 0 3187.5
 /begin AXIS_DESCR COM_AXIS NO_INPUT_QUANTITY COMP_0006 4 0 3187.5 AXIS_PTS_REF mNEDWN /end AXIS_DESCR
 /begin FUNCTION_LIST KF7-330.5[53] /end FUNCTION_LIST
/end CHARACTERISTIC
/begin CHARACTERISTIC mTTMQBC "Slowdown load compensation start time table" CURVE 0x0000DABA REC_UBYTE_C 0 COMP_0014 0 2550
 /begin AXIS_DESCR COM_AXIS NO_INPUT_QUANTITY COMP_0006 4 0 3187.5 AXIS_PTS_REF mNEDWN /end AXIS_DESCR
 /begin FUNCTION_LIST KF7-330.5[53] /end FUNCTION_LIST
/end CHARACTERISTIC
/begin CHARACTERISTIC mfVSPRNG "0:Not DGN  1:DGN" VALUE 0x0001022E REC_UBYTE_C 0 COMP_0283 0 1 BIT_MASK 0x0004
 /begin FUNCTION_LIST KF7-330.9[8] KF7-340.13[4] KF7-500.2A[29] KF7-505.47[3] KF7-505.49[3] KF7-525.2[6] KF7-525.2S[10] /end FUNCTION_LIST
/end CHARACTERISTIC
/begin AXIS_PTS mMTFKAPO "0.11deg" 0x0000E22C NO_INPUT_QUANTITY REC_AXIS_UWORD 0 COMP_0005 16 0 7208.85 /end AXIS_PTS
/begin AXIS_PTS mMTFKVSP "0.1km/h" 0x0000E24C NO_INPUT_QUANTITY REC_AXIS_UWORD 0 COMP_0436 16 0 6553.5 /end AXIS_PTS
/begin AXIS_PTS mMTFKAP_S "0.11deg" 0x000102F8 NO_INPUT_QUANTITY REC_AXIS_UWORD 0 COMP_0005 16 0 7208.85 /end AXIS_PTS
/begin AXIS_PTS mMTFKVS_S "0.1km/h" 0x00010318 NO_INPUT_QUANTITY REC_AXIS_UWORD 0 COMP_0436 16 0 6553.5 /end AXIS_PTS
/begin AXIS_PTS mNTTE0 "50rpm" 0x0000CC48 NO_INPUT_QUANTITY REC_AXIS_UBYTE 0 COMP_0020 16 0 12750 /end AXIS_PTS
/begin AXIS_PTS mQHTTE "100/65536%" 0x0000E34C NO_INPUT_QUANTITY REC_AXIS_UWORD 0 COMP_0410 16 0 99.9985458 /end AXIS_PTS
/begin AXIS_PTS mNTTE0_S "50rpm" 0x00010257 NO_INPUT_QUANTITY REC_AXIS_UBYTE 0 COMP_0020 16 0 12750 /end AXIS_PTS
/begin AXIS_PTS mQHTTE_S "100/65536%" 0x00010358 NO_INPUT_QUANTITY REC_AXIS_UWORD 0 COMP_0410 16 0 99.9985458 /end AXIS_PTS
/begin AXIS_PTS mTEHOSRTO "1/1024-" 0x0000E94A NO_INPUT_QUANTITY REC_AXIS_UWORD 0 COMP_0450 8 0 63.999056205 /end AXIS_PTS
/begin AXIS_PTS mTEHOSNE "3.125rpm" 0x0000E93A NO_INPUT_QUANTITY REC_AXIS_UWORD 0 COMP_0065 8 0 204796.875 /end AXIS_PTS
/begin AXIS_PTS mTVTHNEI "50rpm" 0x0000DD56 NO_INPUT_QUANTITY REC_AXIS_UBYTE 0 COMP_0020 16 0 12750 /end AXIS_PTS
/begin AXIS_PTS mTGADNH_S "6.25E-10cm**2/rp" 0x000104E8 NO_INPUT_QUANTITY REC_AXIS_UWORD 0 COMP_0304_S 32 0 0.000040959375 /end AXIS_PTS
/begin AXIS_PTS mTGADNV_S "3.90625E-11cm**2/rp" 0x00010528 NO_INPUT_QUANTITY REC_AXIS_UWORD 0 COMP_0303_S 32 0 2.5599609375E-06 /end AXIS_PTS
/begin AXIS_PTS mATGTVO_S "0.0008cm^2" 0x00010268 NO_INPUT_QUANTITY REC_AXIS_UWORD 0 COMP_0041 32 0 52.428 /end AXIS_PTS
/begin AXIS_PTS mTHIPAMB "20mV" 0x0000D1CA NO_INPUT_QUANTITY REC_AXIS_UBYTE 0 COMP_0054 8 0 5100 /end AXIS_PTS
/begin AXIS_PTS mSLPRT "1/64-" 0x0000CD09 NO_INPUT_QUANTITY REC_AXIS_UBYTE 0 COMP_0186 8 0 3.984375 /end AXIS_PTS
/begin AXIS_PTS mNSLP "12.5rpm" 0x0000CC40 NO_INPUT_QUANTITY REC_AXIS_UBYTE 0 COMP_0006 8 0 3187.5 /end AXIS_PTS
/begin AXIS_PTS mNEDWN "12.5rpm" 0x0000CBF9 NO_INPUT_QUANTITY REC_AXIS_UBYTE 0 COMP_0006 4 0 3187.5 /end AXIS_PTS
/begin MEASUREMENT wfDI "Adjustment mode distinction SW" UBYTE COMP_0283 1 100 0 1 BIT_MASK 0x0040 ECU_ADDRESS 0xFFFF49C2 /begin FUNCTION_LIST KF7-340.1P[7] /end FUNCTION_LIST /end MEASUREMENT
/begin MEASUREMENT fDI "Adjustment mode distinction SW" UBYTE COMP_0283 1 100 0 1 BIT_MASK 0x0040 ECU_ADDRESS 0xFFFF49C3 /begin FUNCTION_LIST KF7-340.1P[7] /end FUNCTION_LIST /end MEASUREMENT
/begin MEASUREMENT wfCANMASK "Receive and transmit counter clear requirement flag" UBYTE COMP_0283 1 100 0 1 BIT_MASK 0x0020 ECU_ADDRESS 0xFFFF49C9 /begin FUNCTION_LIST KF7-340.13[4] /end FUNCTION_LIST /end MEASUREMENT
/begin MEASUREMENT wfPTDCANNG "PTDCAN fail flag" UBYTE COMP_0283 1 100 0 1 BIT_MASK 0x0004 ECU_ADDRESS 0xFFFF49D2 /begin FUNCTION_LIST KF7-340.13[4] KF7-505.47[3] KF7-505.49[3] /end FUNCTION_LIST /end MEASUREMENT
/begin MEASUREMENT fCANMASK "Receive and transmit counter clear requirement flag" UBYTE COMP_0283 1 100 0 1 BIT_MASK 0x0020 ECU_ADDRESS 0xFFFF49D9 /begin FUNCTION_LIST KF7-340.13[4] KF7-410.21[3] KF7-500.69[25] KF7-580.1[8] /end FUNCTION_LIST /end MEASUREMENT
/begin MEASUREMENT fPTDCANNG "PTDCAN fail flag" UBYTE COMP_0283 1 100 0 1 BIT_MASK 0x0004 ECU_ADDRESS 0xFFFF49E2 /begin FUNCTION_LIST KF7-340.13[4] KF7-505.47[3] KF7-505.49[3] /end FUNCTION_LIST /end MEASUREMENT
/begin MEASUREMENT fFTEINRNG "Inertia compensation quantity unusual flag" UBYTE COMP_0283 1 100 0 1 BIT_MASK 0x0004 ECU_ADDRESS 0xFFFF42C1 /begin FUNCTION_LIST KF7-340.11[4] /end FUNCTION_LIST /end MEASUREMENT
/begin MEASUREMENT fMRENST "Air-fuel ratio unusual time ëœ engine stall fail judgement flag" UBYTE COMP_0283 1 100 0 1 BIT_MASK 0x0004 ECU_ADDRESS 0xFFFF42D6 /begin FUNCTION_LIST KF7-330.5[53] /end FUNCTION_LIST /end MEASUREMENT
/begin MEASUREMENT fBCMNG "The condition judgment flag of the CAN communication BCM system" UBYTE COMP_0283 1 100 0 1 BIT_MASK 0x0040 ECU_ADDRESS 0xFFFF4312 /begin FUNCTION_LIST KF7-330.4A[53] KF7-500.69[25] R000.1.RS_Integ_1_10_2 /end FUNCTION_LIST /end MEASUREMENT
/begin MEASUREMENT fEPSNG "The condition judgment flag of the CAN communication EPS system" UBYTE COMP_0283 1 100 0 1 BIT_MASK 0x0010 ECU_ADDRESS 0xFFFF4320 /begin FUNCTION_LIST KF7-330.4A[53] KF7-500.69[25] R000.1.RS_Integ_1_10_2 /end FUNCTION_LIST /end MEASUREMENT
/begin MEASUREMENT fFISCV "ISCV mode switching timing distinction" UBYTE COMP_0283 1 100 0 1 BIT_MASK 0x0040 ECU_ADDRESS 0xFFFF4328 /begin FUNCTION_LIST KF7-330.4A[53] KF7-500.26[17] /end FUNCTION_LIST /end MEASUREMENT
/begin MEASUREMENT fUSMNG "The condition judgment flag of the CAN communication USM system" UBYTE COMP_0283 1 100 0 1 BIT_MASK 0x0020 ECU_ADDRESS 0xFFFF4340 /begin FUNCTION_LIST KF7-330.4A[53] KF7-500.69[25] R000.1.RS_Integ_1_10_2 /end FUNCTION_LIST /end MEASUREMENT
/begin MEASUREMENT afVSPSHL "Vehicle speed select flag" UBYTE COMP_0283 1 100 0 1 BIT_MASK 0x0004 ECU_ADDRESS 0xFFFF4359
 /begin FUNCTION_LIST KF7-340.3M[1] KF7-340.3P[2] KF7-340.5[4] KF7-340.5P[2] KF7-340.9M[3] KF7-340.9P[3] KF7-410.19[2] KF7-505.49[3] /end FUNCTION_LIST
/end MEASUREMENT
/begin MEASUREMENT fVSPSHL "Vehicle speed select flag" UBYTE COMP_0283 1 100 0 1 BIT_MASK 0x0004 ECU_ADDRESS 0xFFFF436A
 /begin FUNCTION_LIST KF7-340.3M[1] KF7-340.3P[2] KF7-340.5[4] KF7-340.5P[2] KF7-340.9M[3] KF7-340.9P[3] KF7-410.19[2] KF7-505.49[3] /end FUNCTION_LIST
/end MEASUREMENT
/begin MEASUREMENT wfLOAD2 "LOAD2 SW" UBYTE COMP_0283 1 100 0 1 BIT_MASK 0x0020 ECU_ADDRESS 0xFFFF8A84 /begin FUNCTION_LIST KF7-330.4A[53] KF7-330.5[53] KF7-351.1[16] KF7-351.2[17] /end FUNCTION_LIST /end MEASUREMENT
/begin MEASUREMENT wfLOADSW "LOAD SW" UBYTE COMP_0283 1 100 0 1 BIT_MASK 0x0010 ECU_ADDRESS 0xFFFF8A84 /begin FUNCTION_LIST KF7-330.4A[53] KF7-330.5[53] /end FUNCTION_LIST /end MEASUREMENT
/begin MEASUREMENT fLOAD2 "LOAD2 SW" UBYTE COMP_0283 1 100 0 1 BIT_MASK 0x0020 ECU_ADDRESS 0xFFFF8A87 /begin FUNCTION_LIST KF7-330.4A[53] KF7-330.5[53] KF7-351.1[16] KF7-351.2[17] /end FUNCTION_LIST /end MEASUREMENT
/begin MEASUREMENT fLOADSW "LOAD SW" UBYTE COMP_0283 1 100 0 1 BIT_MASK 0x0010 ECU_ADDRESS 0xFFFF8A87 /begin FUNCTION_LIST KF7-330.4A[53] KF7-330.5[53] /end FUNCTION_LIST /end MEASUREMENT
/begin MEASUREMENT wfATRNG1 "-" UBYTE COMP_0283 1 100 0 1 BIT_MASK 0x0020 ECU_ADDRESS 0xFFFF8A8F /begin FUNCTION_LIST KF7-330.5[53] /end FUNCTION_LIST /end MEASUREMENT
/begin MEASUREMENT wfFMAPSEL "D-Ds switching flag" UBYTE COMP_0283 1 100 0 1 BIT_MASK 0x0004 ECU_ADDRESS 0xFFFF8A8F /begin FUNCTION_LIST KF7-340.3M[1] KF7-340.3P[2] /end FUNCTION_LIST /end MEASUREMENT
/begin MEASUREMENT wfMSFT "M mode signal" UBYTE COMP_0283 1 100 0 1 BIT_MASK 0x0010 ECU_ADDRESS 0xFFFF8A90 /begin FUNCTION_LIST KF7-330.5[53] KF7-340.7[4] KF7-340.11[4] KF7-385.1[32] /end FUNCTION_LIST /end MEASUREMENT
/begin MEASUREMENT wfREVSW "-" UBYTE COMP_0283 1 100 0 1 BIT_MASK 0x0002 ECU_ADDRESS 0xFFFF8A90 /begin FUNCTION_LIST KF7-330.4A[53] KF7-360.9M[43] KF7-376.2[21] /end FUNCTION_LIST /end MEASUREMENT
/begin MEASUREMENT wfTCSACT "TCS movement signal" UBYTE COMP_0283 1 100 0 1 BIT_MASK 0x0020 ECU_ADDRESS 0xFFFF8A91 /begin FUNCTION_LIST KF7-340.11[4] /end FUNCTION_LIST /end MEASUREMENT
/begin MEASUREMENT fATRNG1 "AT shift range signal 1st" UBYTE COMP_0283 1 100 0 1 BIT_MASK 0x0020 ECU_ADDRESS 0xFFFF8A92 /begin FUNCTION_LIST KF7-330.5[53] /end FUNCTION_LIST /end MEASUREMENT
/begin MEASUREMENT fFMAPSEL "D-Ds switching flag" UBYTE COMP_0283 1 100 0 1 BIT_MASK 0x0004 ECU_ADDRESS 0xFFFF8A92 /begin FUNCTION_LIST KF7-340.3M[1] KF7-340.3P[2] /end FUNCTION_LIST /end MEASUREMENT
/begin MEASUREMENT fMSFT "M mode signal" UBYTE COMP_0283 1 100 0 1 BIT_MASK 0x0010 ECU_ADDRESS 0xFFFF8A93 /begin FUNCTION_LIST KF7-330.5[53] KF7-340.7[4] KF7-340.11[4] KF7-385.1[32] /end FUNCTION_LIST /end MEASUREMENT
/begin MEASUREMENT fREVSW "Reverse switch" UBYTE COMP_0283 1 100 0 1 BIT_MASK 0x0002 ECU_ADDRESS 0xFFFF8A93 DISPLAY_IDENTIFIER Vbx_gear_rvr
 /begin FUNCTION_LIST KF7-330.4A[53] KF7-360.9M[43] KF7-376.2[21] R102.1M.PEDFM_1_0_9 R102.1P.PEDFM_1_0_2 R204.1.CanComm_1_9_2 R301.5.FuelCut_1_2_2 R301.6.IscAirflow_1_4_5 R301.23.ADV_calculation_1_1_2 /end FUNCTION_LIST
/end MEASUREMENT
/begin MEASUREMENT fTCSACT "TCS movement signal" UBYTE COMP_0283 1 100 0 1 BIT_MASK 0x0020 ECU_ADDRESS 0xFFFF8A94 /begin FUNCTION_LIST KF7-340.11[4] /end FUNCTION_LIST /end MEASUREMENT
/begin MEASUREMENT wfISCFB "ISC OPEN/CLOSED judgement" UBYTE COMP_0283 1 100 0 1 BIT_MASK 0x0080 ECU_ADDRESS 0xFFFF8A95
 /begin FUNCTION_LIST KF7-330.3[6] KF7-330.4A[53] KF7-330.5[53] KF7-351.3[11] KF7-390.3A[15] KF7-500.7[12] KF7-580.1[8] /end FUNCTION_LIST
/end MEASUREMENT
/begin MEASUREMENT fREVSD "Reverse judgement" UBYTE COMP_0283 1 100 0 1 BIT_MASK 0x0040 ECU_ADDRESS 0xFFFF245A
 /begin FUNCTION_LIST KF7-330.4A[53] KF7-385.1[32] KF7-385.3[4] KF7-450.1[N] KF7-450.2[1] KF7-450.3[1] KF7-450.4[1] R000.1.RS_Integ_1_10_2 /end FUNCTION_LIST
/end MEASUREMENT
/begin MEASUREMENT fACDTMPH "Air-conditioning requirement judgement direct evaporator temperature deviation (High) formation flag" UBYTE COMP_0283 1 100 0 1 BIT_MASK 0x0080 ECU_ADDRESS 0xFFFF2462 /begin FUNCTION_LIST KF7-330.4A[53] /end FUNCTION_LIST /end MEASUREMENT
/begin MEASUREMENT fACDTMPL "Air-conditioning requirement judgement direct evaporator temperature deviation (Low) formation flag" UBYTE COMP_0283 1 100 0 1 BIT_MASK 0x0040 ECU_ADDRESS 0xFFFF2462 /begin FUNCTION_LIST KF7-330.4A[53] /end FUNCTION_LIST /end MEASUREMENT
/begin MEASUREMENT fACDTMPM "Air-conditioning requirement judgement direct evaporator temperature deviation (Mid) formation" UBYTE COMP_0283 1 100 0 1 BIT_MASK 0x0020 ECU_ADDRESS 0xFFFF2462 /begin FUNCTION_LIST KF7-330.4A[53] /end FUNCTION_LIST /end MEASUREMENT
/begin MEASUREMENT fBATCURK "Hysteresis flag" UBYTE COMP_0283 1 100 0 1 BIT_MASK 0x0001 ECU_ADDRESS 0xFFFF2466 /begin FUNCTION_LIST KF7-330.4A[53] KF7-330.5[53] KF7-351.2[17] /end FUNCTION_LIST /end MEASUREMENT
/begin MEASUREMENT fBATOK "Battery charging judgement condition formation progress flag" UBYTE COMP_0283 1 100 0 1 BIT_MASK 0x0080 ECU_ADDRESS 0xFFFF2467 /begin FUNCTION_LIST KF7-330.4A[53] /end FUNCTION_LIST /end MEASUREMENT
/begin MEASUREMENT fBATOUT "Battery electric discharge judgement condition formation progress flag" UBYTE COMP_0283 1 100 0 1 BIT_MASK 0x0040 ECU_ADDRESS 0xFFFF2467 /begin FUNCTION_LIST KF7-330.4A[53] /end FUNCTION_LIST /end MEASUREMENT
/begin MEASUREMENT fDACOFL "VAPO change quantity wrong point" UBYTE COMP_0283 1 100 0 1 BIT_MASK 0x0002 ECU_ADDRESS 0xFFFF246B /begin FUNCTION_LIST KF7-320A.15[4] /end FUNCTION_LIST /end MEASUREMENT
/begin MEASUREMENT fDACONL "VAPO change quantity wrong point" UBYTE COMP_0283 1 100 0 1 BIT_MASK 0x0001 ECU_ADDRESS 0xFFFF246B /begin FUNCTION_LIST KF7-320A.15[4] /end FUNCTION_LIST /end MEASUREMENT
/begin MEASUREMENT fDSHCUT "A flag for the QDSPT operation" UBYTE COMP_0283 1 100 0 1 BIT_MASK 0x0008 ECU_ADDRESS 0xFFFF246E /begin FUNCTION_LIST KF7-330.5[53] /end FUNCTION_LIST /end MEASUREMENT
/begin MEASUREMENT fDVAPO40 "VAPO change quantity wrong point" UBYTE COMP_0283 1 100 0 1 BIT_MASK 0x0040 ECU_ADDRESS 0xFFFF2470 /begin FUNCTION_LIST KF7-320A.15[4] /end FUNCTION_LIST /end MEASUREMENT
/begin MEASUREMENT fENSTST "At the time of the start, compensation control permission flag" UBYTE COMP_0283 1 100 0 1 BIT_MASK 0x0040 ECU_ADDRESS 0xFFFF2473 /begin FUNCTION_LIST KF7-330.5[53] /end FUNCTION_LIST /end MEASUREMENT
/begin MEASUREMENT fFATVAS "The amount of a change in VAPO" UBYTE COMP_0283 1 100 0 1 BIT_MASK 0x0040 ECU_ADDRESS 0xFFFF2477 /begin FUNCTION_LIST KF7-320A.15[4] R301.23.ADV_calculation_1_1_2 /end FUNCTION_LIST /end MEASUREMENT
/begin MEASUREMENT fFIUP "DUETTE idle rise requirement flag" UBYTE COMP_0283 1 100 0 1 BIT_MASK 0x0004 ECU_ADDRESS 0xFFFF247C /begin FUNCTION_LIST KF7-330.4A[53] KF7-385.1[32] /end FUNCTION_LIST /end MEASUREMENT
/begin MEASUREMENT fFPTDONR "PTD control-in-progress flag" UBYTE COMP_0283 1 100 0 1 BIT_MASK 0x0010 ECU_ADDRESS 0xFFFF2480
 /begin FUNCTION_LIST KF7-340.1M[8] KF7-340.4[1] KF7-340.6M[2] KF7-340.8M[8] KF7-410.17M[5] /end FUNCTION_LIST
/end MEASUREMENT
/begin MEASUREMENT fFQH0LMT "Hysteresis flag" UBYTE COMP_0283 1 100 0 1 BIT_MASK 0x0080 ECU_ADDRESS 0xFFFF2481
 /begin FUNCTION_LIST KF7-340.1M[8] KF7-340.1P[7] KF7-410.17M[5] KF7-410.17P[1] R301.20.AmbientComp_1_0_2 /end FUNCTION_LIST
/end MEASUREMENT
/begin MEASUREMENT fFSTRR "Stratified/homogeneous combustion switching flag" UBYTE COMP_0283 1 100 0 1 BIT_MASK 0x0080 ECU_ADDRESS 0xFFFF2483
 /begin FUNCTION_LIST KF7-320A.15[4] KF7-330.4A[53] KF7-330.5[53] KF7-351.1[16] KF7-351.2[17] KF7-376.3[2] KF7-377.1A[19] KF7-379.2[1] R000.1.RS_Integ_1_10_2 R301.23.ADV_calculation_1_1_2 /end FUNCTION_LIST
/end MEASUREMENT
/begin MEASUREMENT fHYNPTD "PTD operation speed hysteresis flag" UBYTE COMP_0283 1 100 0 1 BIT_MASK 0x0002 ECU_ADDRESS 0xFFFF2487 /begin FUNCTION_LIST KF7-340.7[4] /end FUNCTION_LIST /end MEASUREMENT
/begin MEASUREMENT fHYVPTD "PTD operation vehicle speed hysteresis flag" UBYTE COMP_0283 1 100 0 1 BIT_MASK 0x0001 ECU_ADDRESS 0xFFFF2487 /begin FUNCTION_LIST KF7-340.7[4] /end FUNCTION_LIST /end MEASUREMENT
/begin MEASUREMENT fINV "Throb repression control switching flag" UBYTE COMP_0283 1 100 0 1 BIT_MASK 0x0004 ECU_ADDRESS 0xFFFF2488
 /begin FUNCTION_LIST KF7-320A.15[4] KF7-360.8M[4] KF7-360.8P[3] R301.8.Inverse_filter_1_1_3 R301.23.ADV_calculation_1_1_2 /end FUNCTION_LIST
/end MEASUREMENT
/begin MEASUREMENT fISCPSH "Power steering transient state compensation time timer set permission" UBYTE COMP_0283 1 100 0 1 BIT_MASK 0x0010 ECU_ADDRESS 0xFFFF2489 /begin FUNCTION_LIST KF7-330.5[53] /end FUNCTION_LIST /end MEASUREMENT
/begin MEASUREMENT fNALT2 "At the time of the battery electric discharge, UP rotation flag" UBYTE COMP_0283 1 100 0 1 BIT_MASK 0x0020 ECU_ADDRESS 0xFFFF248F /begin FUNCTION_LIST KF7-330.4A[53] /end FUNCTION_LIST /end MEASUREMENT
/begin MEASUREMENT fNALTDWN "An electric load small compensation air quantity flag" UBYTE COMP_0283 1 100 0 1 BIT_MASK 0x0010 ECU_ADDRESS 0xFFFF248F /begin FUNCTION_LIST KF7-330.4A[53] /end FUNCTION_LIST /end MEASUREMENT
/begin MEASUREMENT fNALTUP "An electric load big compensation quantity flag" UBYTE COMP_0283 1 100 0 1 BIT_MASK 0x0008 ECU_ADDRESS 0xFFFF248F /begin FUNCTION_LIST KF7-330.4A[53] /end FUNCTION_LIST /end MEASUREMENT
/begin MEASUREMENT fPDPRH "Air-conditioning requirement judgement Pd pressure (High) flag" UBYTE COMP_0283 1 100 0 1 BIT_MASK 0x0008 ECU_ADDRESS 0xFFFF2494 /begin FUNCTION_LIST KF7-330.4A[53] /end FUNCTION_LIST /end MEASUREMENT
/begin MEASUREMENT fPDPRL "Air-conditioning requirement judgement Pd pressure (Low) flag" UBYTE COMP_0283 1 100 0 1 BIT_MASK 0x0004 ECU_ADDRESS 0xFFFF2494 /begin FUNCTION_LIST KF7-330.4A[53] /end FUNCTION_LIST /end MEASUREMENT
/begin MEASUREMENT fPDPRM "Air-conditioning requirement judgement Pd pressure (Mid) flag" UBYTE COMP_0283 1 100 0 1 BIT_MASK 0x0002 ECU_ADDRESS 0xFFFF2494 /begin FUNCTION_LIST KF7-330.4A[53] /end FUNCTION_LIST /end MEASUREMENT
/begin MEASUREMENT fPTDARBON "ASCD order value switching flag" UBYTE COMP_0283 1 100 0 1 BIT_MASK 0x0080 ECU_ADDRESS 0xFFFF2497 /begin FUNCTION_LIST KF7-340.8M[8] /end FUNCTION_LIST /end MEASUREMENT
/begin MEASUREMENT fPTDSPOFF "PTD, as soon as possible, off flag" UBYTE COMP_0283 1 100 0 1 BIT_MASK 0x0040 ECU_ADDRESS 0xFFFF2497 /begin FUNCTION_LIST KF7-340.6M[2] KF7-340.6P[2] KF7-340.7[4] /end FUNCTION_LIST /end MEASUREMENT
/begin MEASUREMENT fTMISTY "At the time of the start, ISC compensation delay progress flag" UBYTE COMP_0283 1 100 0 1 BIT_MASK 0x0080 ECU_ADDRESS 0xFFFF249F /begin FUNCTION_LIST KF7-330.8[1] /end FUNCTION_LIST /end MEASUREMENT
/begin MEASUREMENT fTRAD2VSP "TTRADV2 choice vehicle speed hysteresis judgement flag" UBYTE COMP_0283 1 100 0 1 BIT_MASK 0x0004 ECU_ADDRESS 0xFFFF24A0 /begin FUNCTION_LIST KF7-320A.15[4] /end FUNCTION_LIST /end MEASUREMENT
/begin MEASUREMENT fTRFCD "tTRFCD progress judgement flag" UBYTE COMP_0283 1 100 0 1 BIT_MASK 0x0002 ECU_ADDRESS 0xFFFF24A0 /begin FUNCTION_LIST KF7-320A.15[4] /end FUNCTION_LIST /end MEASUREMENT
/begin MEASUREMENT fTWPIG "Pre-ignition avoidance control lower limit coolant temperature" UBYTE COMP_0283 1 100 0 1 BIT_MASK 0x0004 ECU_ADDRESS 0xFFFF24A2 /begin FUNCTION_LIST KF7-330.4A[53] KF7-360.9M[43] /end FUNCTION_LIST /end MEASUREMENT
/begin MEASUREMENT fTWRMN "Hysteresis flag (-3Åé)" UBYTE COMP_0283 1 100 0 1 BIT_MASK 0x0002 ECU_ADDRESS 0xFFFF24A2 /begin FUNCTION_LIST KF7-330.4A[53] /end FUNCTION_LIST /end MEASUREMENT
/begin MEASUREMENT fVTCTWH "A coolant temperature upper limit hysteresis flag for the VTC condition" UBYTE COMP_0283 1 100 0 1 BIT_MASK 0x0008 ECU_ADDRESS 0xFFFF24A8 /begin FUNCTION_LIST KF7-320A.22[5] KF7-393.1C[8] /end FUNCTION_LIST /end MEASUREMENT
/begin MEASUREMENT fAAPO0_S "The flag which has set up AAPO0_S" UBYTE COMP_0283 1 100 0 1 BIT_MASK 0x0080 ECU_ADDRESS 0xFFFF24AD /begin FUNCTION_LIST KF7-340.1P[7] /end FUNCTION_LIST /end MEASUREMENT
/begin MEASUREMENT fFPDONR_S "PTD control-in-progress flag" UBYTE COMP_0283 1 100 0 1 BIT_MASK 0x0040 ECU_ADDRESS 0xFFFF24AD /begin FUNCTION_LIST KF7-340.1P[7] KF7-340.8P[8] KF7-410.17P[1] /end FUNCTION_LIST /end MEASUREMENT
/begin MEASUREMENT fPDARON_S "ASCD order value switching flag" UBYTE COMP_0283 1 100 0 1 BIT_MASK 0x0010 ECU_ADDRESS 0xFFFF24AD /begin FUNCTION_LIST KF7-340.8P[8] /end FUNCTION_LIST /end MEASUREMENT
/begin MEASUREMENT fFPTDINH "PTD un-permission signal" UBYTE COMP_0283 1 100 0 1 BIT_MASK 0x0004 ECU_ADDRESS 0xFFFF24B8 /begin FUNCTION_LIST KF7-340.7[4] KF7-505.47[3] /end FUNCTION_LIST /end MEASUREMENT
/begin MEASUREMENT fIDLEUP "At the time of IDLE, engine rotation rise requirement signal" UBYTE COMP_0283 1 100 0 1 BIT_MASK 0x0020 ECU_ADDRESS 0xFFFF24BA /begin FUNCTION_LIST KF7-330.4A[53] KF7-385.1[32] KF7-390.3A[15] /end FUNCTION_LIST /end MEASUREMENT
/begin MEASUREMENT fIDELAY "ISC CLOSED control switchover flag" UBYTE COMP_0283 1 100 0 1 BIT_MASK 0x0040 ECU_ADDRESS 0xFFFF24C3 /begin FUNCTION_LIST KF7-330.3[6] KF7-376.2[21] /end FUNCTION_LIST /end MEASUREMENT
/begin MEASUREMENT fQADVFBPI "PI control flag" UBYTE COMP_0283 1 100 0 1 BIT_MASK 0x0010 ECU_ADDRESS 0xFFFF24C4 /begin FUNCTION_LIST KF7-330.4A[53] /end FUNCTION_LIST /end MEASUREMENT
/begin MEASUREMENT afQACRON "Air conditioning activation compensation airflow trigger" UBYTE COMP_0283 1 100 0 1 BIT_MASK 0x0010 ECU_ADDRESS 0xFFFF24C6 /begin FUNCTION_LIST KF7-330.5[53] /end FUNCTION_LIST /end MEASUREMENT
/begin MEASUREMENT fQACRON "Air conditioning activation compensation airflow trigger" UBYTE COMP_0283 1 100 0 1 BIT_MASK 0x0010 ECU_ADDRESS 0xFFFF24C7 /begin FUNCTION_LIST KF7-330.5[53] R301.6.IscAirflow_1_4_5 /end FUNCTION_LIST /end MEASUREMENT
/begin MEASUREMENT afALTCNT "Alternator generating electricity voltage variable control permission flag" UBYTE COMP_0283 1 100 0 1 BIT_MASK 0x0020 ECU_ADDRESS 0xFFFF24CD /begin FUNCTION_LIST KF7-330.5[53] KF7-351.2[17] KF7-580.1[8] /end FUNCTION_LIST /end MEASUREMENT
/begin MEASUREMENT afFLSWPT "Hysteresis flag" UBYTE COMP_0283 1 100 0 1 BIT_MASK 0x0008 ECU_ADDRESS 0xFFFF24CF
 /begin FUNCTION_LIST KF7-340.1M[8] KF7-340.1P[7] KF7-340.5[4] KF7-340.5P[2] KF7-385.3[4] /end FUNCTION_LIST
/end MEASUREMENT
/begin MEASUREMENT afGNDSLCT "After the start, during the lean limit expansion system, N-D select flag" UBYTE COMP_0283 1 100 0 1 BIT_MASK 0x0010 ECU_ADDRESS 0xFFFF24D0 /begin FUNCTION_LIST KF7-330.4A[53] KF7-390.3A[15] /end FUNCTION_LIST /end MEASUREMENT
/begin MEASUREMENT afISCADVH "Ignition timing operation allowable occasion judgement flag H" UBYTE COMP_0283 1 100 0 1 BIT_MASK 0x0004 ECU_ADDRESS 0xFFFF24D0 /begin FUNCTION_LIST KF7-330.5[53] KF7-351.1[16] KF7-390.3A[15] /end FUNCTION_LIST /end MEASUREMENT
/begin MEASUREMENT afPTDFAIL "PTD fail flag" UBYTE COMP_0283 1 100 0 1 BIT_MASK 0x0040 ECU_ADDRESS 0xFFFF24D1
 /begin FUNCTION_LIST KF7-340.5[4] KF7-340.5P[2] KF7-340.7[4] KF7-340.8M[8] KF7-340.8P[8] KF7-340.13[4] /end FUNCTION_LIST
/end MEASUREMENT
/begin MEASUREMENT afPTDON "Drive power control executive flag" UBYTE COMP_0283 1 100 0 1 BIT_MASK 0x0020 ECU_ADDRESS 0xFFFF24D1
 /begin FUNCTION_LIST KF7-340.5[4] KF7-340.5P[2] KF7-340.6M[2] KF7-340.7[4] KF7-340.15[3] KF7-340.16[4] /end FUNCTION_LIST
/end MEASUREMENT
/begin MEASUREMENT afCRUIS2_S "After the ASCD permission, in the cruise, flag" UBYTE COMP_0283 1 100 0 1 BIT_MASK 0x0080 ECU_ADDRESS 0xFFFF24D3 /begin FUNCTION_LIST KF7-340.5P[2] /end FUNCTION_LIST /end MEASUREMENT
/begin MEASUREMENT fALTCNT "Alternator generating electricity voltage variable control permission flag" UBYTE COMP_0283 1 100 0 1 BIT_MASK 0x0020 ECU_ADDRESS 0xFFFF24D4 /begin FUNCTION_LIST KF7-330.5[53] KF7-351.2[17] KF7-580.1[8] /end FUNCTION_LIST /end MEASUREMENT
/begin MEASUREMENT fFLSWPT "Hysteresis flag" UBYTE COMP_0283 1 100 0 1 BIT_MASK 0x0008 ECU_ADDRESS 0xFFFF24D6
 /begin FUNCTION_LIST KF7-340.1M[8] KF7-340.1P[7] KF7-340.5[4] KF7-340.5P[2] KF7-385.3[4] KF7-410.17M[5] KF7-410.17P[1] R301.20.AmbientComp_1_0_2 /end FUNCTION_LIST
/end MEASUREMENT
/begin MEASUREMENT fGNDSLCT "After the start, during the lean limit expansion system, N-D select flag" UBYTE COMP_0283 1 100 0 1 BIT_MASK 0x0010 ECU_ADDRESS 0xFFFF24D7 /begin FUNCTION_LIST KF7-330.4A[53] KF7-390.3A[15] /end FUNCTION_LIST /end MEASUREMENT
/begin MEASUREMENT fISCADVH "Ignition timing operation allowable occasion judgement flag H" UBYTE COMP_0283 1 100 0 1 BIT_MASK 0x0004 ECU_ADDRESS 0xFFFF24D7
 /begin FUNCTION_LIST KF7-330.5[53] KF7-351.1[16] KF7-390.3A[15] R301.19.ISC_PID_cont_1_0_2 /end FUNCTION_LIST
/end MEASUREMENT
/begin MEASUREMENT fPTDFAIL "PTD fail flag" UBYTE COMP_0283 1 100 0 1 BIT_MASK 0x0040 ECU_ADDRESS 0xFFFF24D8
 /begin FUNCTION_LIST KF7-340.5[4] KF7-340.5P[2] KF7-340.7[4] KF7-340.8M[8] KF7-340.8P[8] KF7-340.13[4] /end FUNCTION_LIST
/end MEASUREMENT
/begin MEASUREMENT fPTDON "Drive power control executive flag" UBYTE COMP_0283 1 100 0 1 BIT_MASK 0x0020 ECU_ADDRESS 0xFFFF24D8
 /begin FUNCTION_LIST KF7-340.5[4] KF7-340.5P[2] KF7-340.6M[2] KF7-340.7[4] KF7-340.15[3] KF7-340.16[4] /end FUNCTION_LIST
/end MEASUREMENT
/begin MEASUREMENT fCRUIS2_S "After the ASCD permission, in the cruise, flag" UBYTE COMP_0283 1 100 0 1 BIT_MASK 0x0080 ECU_ADDRESS 0xFFFF24DA /begin FUNCTION_LIST KF7-340.5P[2] /end FUNCTION_LIST /end MEASUREMENT
/begin MEASUREMENT tINRNGDLY "The judgement time when a compensation calculation is unusual" UBYTE COMP_0202_S 1 100 0 255 ECU_ADDRESS 0xFFFF4490 /begin FUNCTION_LIST KF7-340.11[4] /end FUNCTION_LIST /end MEASUREMENT
/begin MEASUREMENT tTRADIDTM "An idle off delay timer for TTRADV22" UBYTE COMP_0203_S 1 100 0 255 ECU_ADDRESS 0xFFFF4677 /begin FUNCTION_LIST KF7-320A.15[4] /end FUNCTION_LIST /end MEASUREMENT
/begin MEASUREMENT tACONDY "At the time of air-conditioning on, delay timer" UBYTE COMP_0202_S 1 100 0 255 ECU_ADDRESS 0xFFFF251F /begin FUNCTION_LIST KF7-330.5[53] KF7-376.2[21] KF7-376.3[2] /end FUNCTION_LIST /end MEASUREMENT
/begin MEASUREMENT tBATOK "Battery charging condition timer" UBYTE COMP_0202_S 1 100 0 255 ECU_ADDRESS 0xFFFF2529 /begin FUNCTION_LIST KF7-330.4A[53] /end FUNCTION_LIST /end MEASUREMENT
/begin MEASUREMENT tBATOUT "Battery electric discharge condition timer" UBYTE COMP_0202_S 1 100 0 255 ECU_ADDRESS 0xFFFF252A /begin FUNCTION_LIST KF7-330.4A[53] /end FUNCTION_LIST /end MEASUREMENT
/begin MEASUREMENT tDNSET0SS "NSET1 addition timer" UBYTE COMP_0202_S 1 100 0 255 ECU_ADDRESS 0xFFFF253C /begin FUNCTION_LIST KF7-330.4A[53] /end FUNCTION_LIST /end MEASUREMENT
/begin MEASUREMENT tIDELAY "ISC CLOSED switchover timer" UBYTE COMP_0202_S 1 100 0 255 ECU_ADDRESS 0xFFFF2554 /begin FUNCTION_LIST KF7-330.3[6] KF7-376.2[21] /end FUNCTION_LIST /end MEASUREMENT
/begin MEASUREMENT tISCDLY "ISC F/B start delay timer" UBYTE COMP_0202_S 1 100 0 255 ECU_ADDRESS 0xFFFF255B /begin FUNCTION_LIST KF7-330.4A[53] /end FUNCTION_LIST /end MEASUREMENT
/begin MEASUREMENT tISCSTDLY "ISC learning operation start judgement timer" UBYTE COMP_0202_S 1 100 0 255 ECU_ADDRESS 0xFFFF255E /begin FUNCTION_LIST KF7-330.3[6] KF7-330.4A[53] KF7-330.8[1] /end FUNCTION_LIST /end MEASUREMENT
/begin MEASUREMENT tNALTDWN "An electric load small compensation air quantity timer" UBYTE COMP_0202_S 1 100 0 255 ECU_ADDRESS 0xFFFF256F /begin FUNCTION_LIST KF7-330.4A[53] /end FUNCTION_LIST /end MEASUREMENT
/begin MEASUREMENT tNALTUP "An electric load big compensation air quantity timer" UBYTE COMP_0202_S 1 100 0 255 ECU_ADDRESS 0xFFFF2570 /begin FUNCTION_LIST KF7-330.4A[53] /end FUNCTION_LIST /end MEASUREMENT
/begin MEASUREMENT tSTSTAT0 "After starter SW on, timer 0" UBYTE COMP_0202_S 1 100 0 255 ECU_ADDRESS 0xFFFF2589 /begin FUNCTION_LIST KF7-320A.19[7] /end FUNCTION_LIST /end MEASUREMENT
/begin MEASUREMENT tSTSTAT1 "After starter SW on, timer 1" UBYTE COMP_0202_S 1 100 0 255 ECU_ADDRESS 0xFFFF258A /begin FUNCTION_LIST KF7-320A.19[7] /end FUNCTION_LIST /end MEASUREMENT
/begin MEASUREMENT tTALPEST "Time to judge the amount of air-fuel ratio compensation unusually" UBYTE COMP_0202_S 1 100 0 255 ECU_ADDRESS 0xFFFF258C /begin FUNCTION_LIST KF7-330.5[53] /end FUNCTION_LIST /end MEASUREMENT
/begin MEASUREMENT tTATRD "R- >D switching delay timer" UBYTE COMP_0202_S 1 100 0 255 ECU_ADDRESS 0xFFFF2594 /begin FUNCTION_LIST KF7-330.4A[53] /end FUNCTION_LIST /end MEASUREMENT
/begin MEASUREMENT tTIPRQA "At the time of A/C switch on, Pd pressure balance pressure detection delay" UBYTE COMP_0202_S 1 100 0 255 ECU_ADDRESS 0xFFFF259F /begin FUNCTION_LIST KF7-330.5[53] /end FUNCTION_LIST /end MEASUREMENT
/begin MEASUREMENT tTMPSON "Power steering SW OFFON éû transient state compensation judgement time" UBYTE COMP_0202_S 1 100 0 255 ECU_ADDRESS 0xFFFF25B0 /begin FUNCTION_LIST KF7-330.5[53] /end FUNCTION_LIST /end MEASUREMENT
/begin MEASUREMENT tDACOFL "Acceleration completion judgement" UBYTE COMP_0203_S 1 100 0 255 ECU_ADDRESS 0xFFFF25DF /begin FUNCTION_LIST KF7-320A.15[4] /end FUNCTION_LIST /end MEASUREMENT
/begin MEASUREMENT tDACONL "Acceleration start judgement" UBYTE COMP_0203_S 1 100 0 255 ECU_ADDRESS 0xFFFF25E0 /begin FUNCTION_LIST KF7-320A.15[4] /end FUNCTION_LIST /end MEASUREMENT
/begin MEASUREMENT tDLTDLY "Reverse phase control delay timer" UBYTE COMP_0203_S 1 100 0 255 ECU_ADDRESS 0xFFFF25E4 /begin FUNCTION_LIST KF7-320A.15[4] /end FUNCTION_LIST /end MEASUREMENT
/begin MEASUREMENT tDLTNMSK "DLTNE non-reference time" UBYTE COMP_0203_S 1 100 0 255 ECU_ADDRESS 0xFFFF25E5 /begin FUNCTION_LIST KF7-330.9[8] /end FUNCTION_LIST /end MEASUREMENT
/begin MEASUREMENT tDLTTIM "Phase control completion judgement timer" UBYTE COMP_0203_S 1 100 0 255 ECU_ADDRESS 0xFFFF25E6 /begin FUNCTION_LIST KF7-320A.15[4] /end FUNCTION_LIST /end MEASUREMENT
/begin MEASUREMENT tDNSET0BF "A timer (at the time of brake SW OFFON switching) for the NSET0 change rate" UBYTE COMP_0203_S 1 100 0 255 ECU_ADDRESS 0xFFFF25E9 /begin FUNCTION_LIST KF7-330.4A[53] /end FUNCTION_LIST /end MEASUREMENT
/begin MEASUREMENT tDNSET0BS "A timer (at the time of brake SW ONOFF switching) for the NSET0 change rate" UBYTE COMP_0203_S 1 100 0 255 ECU_ADDRESS 0xFFFF25EA /begin FUNCTION_LIST KF7-330.4A[53] /end FUNCTION_LIST /end MEASUREMENT
/begin MEASUREMENT tDNSET0F "NSET0 addition timer" UBYTE COMP_0203_S 1 100 0 255 ECU_ADDRESS 0xFFFF25EB /begin FUNCTION_LIST KF7-330.4A[53] /end FUNCTION_LIST /end MEASUREMENT
/begin MEASUREMENT tDNSET0GN "NSET0 change rate (after the start, at the time of the lean limit expansion control-in-progress ND select) timer" UBYTE COMP_0203_S 1 100 0 255 ECU_ADDRESS 0xFFFF25EC /begin FUNCTION_LIST KF7-330.4A[53] /end FUNCTION_LIST /end MEASUREMENT
/begin MEASUREMENT tDNSET0PS "NSET0 change rate (at the time of PS SW on ÅÃ off)" UBYTE COMP_0203_S 1 100 0 255 ECU_ADDRESS 0xFFFF25ED /begin FUNCTION_LIST KF7-330.4A[53] /end FUNCTION_LIST /end MEASUREMENT
/begin MEASUREMENT tDNSET0S "NSET1 addition timer" UBYTE COMP_0203_S 1 100 0 255 ECU_ADDRESS 0xFFFF25EE /begin FUNCTION_LIST KF7-330.4A[53] /end FUNCTION_LIST /end MEASUREMENT
/begin MEASUREMENT tDQCI "QFBI change rate timer" UBYTE COMP_0203_S 1 100 0 255 ECU_ADDRESS 0xFFFF25F0 /begin FUNCTION_LIST KF7-330.5[53] /end FUNCTION_LIST /end MEASUREMENT
/begin MEASUREMENT tDTLOAD "After electric load SW off, idle rise release delay" UBYTE COMP_0203_S 1 100 0 255 ECU_ADDRESS 0xFFFF25FB /begin FUNCTION_LIST KF7-330.4A[53] KF7-330.5[53] /end FUNCTION_LIST /end MEASUREMENT
/begin MEASUREMENT tISCPST "Power steering transient state compensation time" UBYTE COMP_0203_S 1 100 0 255 ECU_ADDRESS 0xFFFF2605 /begin FUNCTION_LIST KF7-330.5[53] /end FUNCTION_LIST /end MEASUREMENT
/begin MEASUREMENT tKRET "KDADV decrease timer" UBYTE COMP_0203_S 1 100 0 255 ECU_ADDRESS 0xFFFF260A /begin FUNCTION_LIST KF7-320A.15[4] /end FUNCTION_LIST /end MEASUREMENT
/begin MEASUREMENT tRFQDLY1 "ISC load compensation delay timer 1" UBYTE COMP_0203_S 1 100 0 255 ECU_ADDRESS 0xFFFF262A /begin FUNCTION_LIST KF7-330.5[53] KF7-377.1A[19] /end FUNCTION_LIST /end MEASUREMENT
/begin MEASUREMENT tRFQDLY2 "ISC load compensation delay timer 2" UBYTE COMP_0203_S 1 100 0 255 ECU_ADDRESS 0xFFFF262B /begin FUNCTION_LIST KF7-330.5[53] KF7-377.1A[19] /end FUNCTION_LIST /end MEASUREMENT
/begin MEASUREMENT tTHONDY "IDLE SW After on, delay" UBYTE COMP_0203_S 1 100 0 255 ECU_ADDRESS 0xFFFF264D /begin FUNCTION_LIST KF7-330.3[6] /end FUNCTION_LIST /end MEASUREMENT
/begin MEASUREMENT tTMBRKOF "At the time of brake off, compensation prohibition delay" UBYTE COMP_0203_S 1 100 0 255 ECU_ADDRESS 0xFFFF2656 /begin FUNCTION_LIST KF7-330.5[53] /end FUNCTION_LIST /end MEASUREMENT
/begin MEASUREMENT tTMHADI "Phase control idle condition timer" UBYTE COMP_0203_S 1 100 0 255 ECU_ADDRESS 0xFFFF265A /begin FUNCTION_LIST KF7-320A.15[4] /end FUNCTION_LIST /end MEASUREMENT
/begin MEASUREMENT tTMINVDEC "At the time of the slowdown, inverse operation timer" UBYTE COMP_0203_S 1 100 0 255 ECU_ADDRESS 0xFFFF265C
 /begin FUNCTION_LIST KF7-340.1M[8] KF7-340.1P[7] KF7-360.8A[N] KF7-360.8M[4] KF7-360.8P[3] R301.8.Inverse_filter_1_1_3 /end FUNCTION_LIST
/end MEASUREMENT
/begin MEASUREMENT tTMISSL "A timer for torque converter load loss in weight compensation air quantity transient state compensation" UBYTE COMP_0203_S 1 100 0 255 ECU_ADDRESS 0xFFFF265E /begin FUNCTION_LIST KF7-330.9[8] /end FUNCTION_LIST /end MEASUREMENT
/begin MEASUREMENT tTMISTY "At the time of the start, ISC compensation delay timer" UBYTE COMP_0203_S 1 100 0 255 ECU_ADDRESS 0xFFFF265F /begin FUNCTION_LIST KF7-330.8[1] /end FUNCTION_LIST /end MEASUREMENT
/begin MEASUREMENT tTMPSOF "Power steering ONOFF éû QFBI fixed time timer" UBYTE COMP_0203_S 1 100 0 255 ECU_ADDRESS 0xFFFF2663 /begin FUNCTION_LIST KF7-330.5[53] /end FUNCTION_LIST /end MEASUREMENT
/begin MEASUREMENT tTRFCD "F/C excuse judgement delay" UBYTE COMP_0203_S 1 100 0 255 ECU_ADDRESS 0xFFFF2676 /begin FUNCTION_LIST KF7-320A.15[4] /end FUNCTION_LIST /end MEASUREMENT
/begin MEASUREMENT avAPASCDAD "Addition open-degree for AT gear shift" UWORD COMP_0005 1 100 0 7208.85 ECU_ADDRESS 0xFFFF40F6 /begin FUNCTION_LIST KF7-340.5[4] KF7-340.5P[2] KF7-410.19[2] KF7-410.20[N] /end FUNCTION_LIST /end MEASUREMENT
/begin MEASUREMENT avQFBI "F/B I-gain air flow-quantity" SWORD COMP_0277 1 100 -32768 32767 ECU_ADDRESS 0xFFFF22E8
 /begin FUNCTION_LIST KF7-330.5[53] KF7-330.7A[1] KF7-330.8[1] KF7-351.1[16] KF7-351.2[17] KF7-351.3[11] KF7-500.38A[4] /end FUNCTION_LIST
/end MEASUREMENT
/begin MEASUREMENT avQLDALT "Alternator load compensation air flow-quantity" UBYTE COMP_0051 1 100 0 255 ECU_ADDRESS 0xFFFF2348 /begin FUNCTION_LIST KF7-330.4A[53] KF7-330.5[53] KF7-386.3[8] KF7-390.3A[15] /end FUNCTION_LIST /end MEASUREMENT
/begin MEASUREMENT avQSISC "A low response compensation flow-quantity" UWORD COMP_0051 1 100 0 65535 ECU_ADDRESS 0xFFFF234A
 /begin FUNCTION_LIST KF7-330.5[53] KF7-340.1M[8] KF7-350.1P[4] KF7-351.3[11] KF7-580.1[8] /end FUNCTION_LIST
/end MEASUREMENT
/begin MEASUREMENT avRATIO "Actual gear ratio" UWORD COMP_0450 1 100 0 63.999056205 ECU_ADDRESS 0xFFFF234C
 /begin FUNCTION_LIST KF7-330.9[8] KF7-340.6M[2] KF7-340.8M[8] KF7-340.9M[3] KF7-340.9P[3] KF7-340.15[3] KF7-360.8M[4] KF7-360.9M[43] KF7-385.2[18] /end FUNCTION_LIST
/end MEASUREMENT
/begin MEASUREMENT avTECOM "Engine torque order value" SWORD COMP_0228 1 100 -3276.8 3276.7 ECU_ADDRESS 0xFFFF4186 /begin FUNCTION_LIST KF7-340.8M[8] KF7-340.8P[8] /end FUNCTION_LIST /end MEASUREMENT
/begin MEASUREMENT avTGTVO "Final target throttle open-degree" UWORD COMP_0130 1 100 0 1802.2125 ECU_ADDRESS 0xFFFF40E4
 /begin FUNCTION_LIST KF7-340.1M[8] KF7-350.1M[5] KF7-350.4M[14] KF7-350.4P[13] KF7-360.1[12] KF7-500.1[54] KF7-505.15[4] KF7-505.16[1] KF7-505.32[6] KF7-525.2[6] KF7-525.2S[10] /end FUNCTION_LIST
/end MEASUREMENT
/begin MEASUREMENT avTTEIF "Inverse filter output torque" SWORD COMP_0228 1 100 -3276.8 3276.7 ECU_ADDRESS 0xFFFF2396 /begin FUNCTION_LIST KF7-340.11[4] KF7-360.8M[4] KF7-360.9M[43] KF7-385.3[4] /end FUNCTION_LIST /end MEASUREMENT
/begin MEASUREMENT avVTCNOW "An incumbent VTC operation angle" UBYTE COMP_0256 1 100 -64 63.5 ECU_ADDRESS 0xFFFF23A2
 /begin FUNCTION_LIST KF7-320A.22[5] KF7-350.4M[14] KF7-393.1C[8] KF7-500.7[12] KF7-500.47B[15] KF7-580.1[8] /end FUNCTION_LIST
/end MEASUREMENT
/begin MEASUREMENT avVTCNOW_R#1 "An incumbent VTC operation angle" UBYTE COMP_0256 1 100 -64 63.5 ECU_ADDRESS 0xFFFF23A2
 /begin FUNCTION_LIST KF7-320A.22[5] KF7-350.4M[14] KF7-393.1C[8] KF7-500.7[12] KF7-500.47B[15] KF7-580.1[8] /end FUNCTION_LIST
/end MEASUREMENT
/begin MEASUREMENT avVTCNOW_R#2 "An incumbent VTC operation angle" UBYTE COMP_0256 1 100 -64 63.5 ECU_ADDRESS 0xFFFF23A3
 /begin FUNCTION_LIST KF7-320A.22[5] KF7-350.4M[14] KF7-393.1C[8] KF7-500.7[12] KF7-500.47B[15] KF7-580.1[8] /end FUNCTION_LIST
/end MEASUREMENT
/begin MEASUREMENT bvQICREG "IC Reg load signal" UBYTE COMP_0051 1 100 0 255 ECU_ADDRESS 0xFFFF22DD /begin FUNCTION_LIST KF7-330.5[53] /end FUNCTION_LIST /end MEASUREMENT
/begin MEASUREMENT vAAPO0_S "TVO= 0 o'clock omission area" UWORD COMP_0042 1 100 0 52.428 ECU_ADDRESS 0xFFFF1C2E /begin FUNCTION_LIST KF7-340.1P[7] /end FUNCTION_LIST /end MEASUREMENT
/begin MEASUREMENT vAAPO_S "Accelerator opening area" UWORD COMP_0042 1 100 0 52.428 ECU_ADDRESS 0xFFFF1C2C
 /begin FUNCTION_LIST KF7-340.1P[7] KF7-340.2P[1] KF7-410.17P[1] R301.20.AmbientComp_1_0_2 /end FUNCTION_LIST
/end MEASUREMENT
/begin MEASUREMENT vACIOF "QFBI just before becoming A/C switch on" SWORD COMP_0277 1 100 -32768 32767 ECU_ADDRESS 0xFFFF10E6 /begin FUNCTION_LIST KF7-330.5[53] /end FUNCTION_LIST /end MEASUREMENT
/begin MEASUREMENT vACION "QFBI just before becoming A/C switch off" SWORD COMP_0277 1 100 -32768 32767 ECU_ADDRESS 0xFFFF10E8 /begin FUNCTION_LIST KF7-330.5[53] /end FUNCTION_LIST /end MEASUREMENT
/begin MEASUREMENT vADDFD "The addition drive power" UWORD COMP_0014_S 1 100 0 65535 ECU_ADDRESS 0xFFFF1E10 /begin FUNCTION_LIST KF7-340.8M[8] KF7-340.8P[8] KF7-340.15[3] /end FUNCTION_LIST /end MEASUREMENT
/begin MEASUREMENT vADDFDAPS "The APS limiter drive power" UWORD COMP_0014_S 1 100 0 65535 ECU_ADDRESS 0xFFFF1E12 /begin FUNCTION_LIST KF7-340.8M[8] KF7-340.8P[8] /end FUNCTION_LIST /end MEASUREMENT
/begin MEASUREMENT vADVC1 "Jar sound compensation value (coolant temperature)" UBYTE COMP_0017 1 100 0 255 ECU_ADDRESS 0xFFFF1104 /begin FUNCTION_LIST KF7-320A.23[N] /end FUNCTION_LIST /end MEASUREMENT
/begin MEASUREMENT vADVC2 "Jar sound compensation value (engine speed)" UBYTE COMP_0017 1 100 0 255 ECU_ADDRESS 0xFFFF1105 /begin FUNCTION_LIST KF7-320A.23[N] /end FUNCTION_LIST /end MEASUREMENT
/begin MEASUREMENT vADVJAR "Jar sound compensation value" UBYTE COMP_0017 1 100 0 255 ECU_ADDRESS 0xFFFF1107 /begin FUNCTION_LIST KF7-320A.18[4] KF7-320A.23[N] /end FUNCTION_LIST /end MEASUREMENT
/begin MEASUREMENT vAISCMX "ISC opening area upper limit value" UWORD COMP_0042 1 100 0 52.428 ECU_ADDRESS 0xFFFF1E16 /begin FUNCTION_LIST KF7-330.1M[3] /end FUNCTION_LIST /end MEASUREMENT
/begin MEASUREMENT vAISCMX1 "ISC opening area upper limit value (for TR)" UWORD COMP_0042 1 100 0 52.428 ECU_ADDRESS 0xFFFF1126 /begin FUNCTION_LIST KF7-330.1M[3] /end FUNCTION_LIST /end MEASUREMENT
/begin MEASUREMENT vAISCMX_S "ISC opening area upper limit value" UWORD COMP_0042 1 100 0 52.428 ECU_ADDRESS 0xFFFF1C30 /begin FUNCTION_LIST KF7-330.1P[3] /end FUNCTION_LIST /end MEASUREMENT
/begin MEASUREMENT vAISCNEH "The amount of ISC opening area upper limit value rotation compensation" UWORD COMP_0042 1 100 0 52.428 ECU_ADDRESS 0xFFFF1128 /begin FUNCTION_LIST KF7-330.1M[3] /end FUNCTION_LIST /end MEASUREMENT
/begin MEASUREMENT vAISCNH_S "The amount of ISC opening area upper limit value rotation compensation" UWORD COMP_0042 1 100 0 52.428 ECU_ADDRESS 0xFFFF1C32 /begin FUNCTION_LIST KF7-330.1P[3] /end FUNCTION_LIST /end MEASUREMENT
/begin MEASUREMENT vAISMX1_S "ISC opening area upper limit value (for TR)" UWORD COMP_0042 1 100 0 52.428 ECU_ADDRESS 0xFFFF1C34 /begin FUNCTION_LIST KF7-330.1P[3] /end FUNCTION_LIST /end MEASUREMENT
/begin MEASUREMENT vAPASCDAD "Addition open-degree for AT gear shift" UWORD COMP_0005 1 100 0 7208.85 ECU_ADDRESS 0xFFFF41B6 /begin FUNCTION_LIST KF7-340.5[4] KF7-340.5P[2] KF7-410.19[2] KF7-410.20[N] /end FUNCTION_LIST /end MEASUREMENT
/begin MEASUREMENT vAPOFMAX "At the time of off idle, APOMAX" UWORD COMP_0005 1 100 0 7208.85 ECU_ADDRESS 0xFFFF286A /begin FUNCTION_LIST KF7-330.5[53] R301.26.Dashpot_DandN_1_0_2 /end FUNCTION_LIST /end MEASUREMENT
/begin MEASUREMENT vAPOST "Accelerator open-degree (Main)" UWORD COMP_0005 1 100 0 7208.85 ECU_ADDRESS 0xFFFF1008
 /begin FUNCTION_LIST KF7-340.1M[8] KF7-340.1P[7] KF7-340.2M[2] KF7-340.2P[1] KF7-340.3M[1] KF7-340.3P[2] KF7-340.4[1] KF7-340.5[4] KF7-340.6M[2] KF7-340.9M[3] KF7-360.7M[9] KF7-360.8A[N] KF7-360.8M[4] KF7-360.9M[43] KF7-410.17M[5] KF7-410.19[2] KF7-410.20[N] KF7-505.17[3] KF7-505.26[2] R102.1M.PEDFM_1_0_9 R301.8.Inverse_filter_1_1_3 R301.20.AmbientComp_1_0_2 R301.21.SafetyLevel2_1_0_2 /end FUNCTION_LIST
/end MEASUREMENT
/begin MEASUREMENT vAPOST_S "Control control target open-degree" UWORD COMP_0005 1 100 0 7208.85 ECU_ADDRESS 0xFFFF1C36
 /begin FUNCTION_LIST KF7-340.2P[1] KF7-340.5P[2] KF7-360.7P[8] KF7-505.17[3] KF7-505.26[2] R102.1P.PEDFM_1_0_2 R301.21.SafetyLevel2_1_0_2 /end FUNCTION_LIST
/end MEASUREMENT
/begin MEASUREMENT vAQISC0 "ISC opening area basic value" UWORD COMP_0042 1 100 0 52.428 ECU_ADDRESS 0xFFFF117C /begin FUNCTION_LIST KF7-330.1M[3] KF7-330.1P[3] KF7-350.1P[4] /end FUNCTION_LIST /end MEASUREMENT
/begin MEASUREMENT vAQSISC_S "The amount of ISC air" UWORD COMP_0042 1 100 0 52.428 ECU_ADDRESS 0xFFFF1C3A /begin FUNCTION_LIST KF7-330.1P[3] KF7-350.1P[4] KF7-350.4P[13] /end FUNCTION_LIST /end MEASUREMENT
/begin MEASUREMENT vATAPASCD "ASCD open-degree for the AT transmission" UBYTE COMP_0022_S 1 100 0 0.99999984 ECU_ADDRESS 0xFFFF1E1D /begin FUNCTION_LIST KF7-340.5[4] KF7-340.5P[2] /end FUNCTION_LIST /end MEASUREMENT
/begin MEASUREMENT vATIOF "QFBI just before ATRNG1 becomes 1" SWORD COMP_0277 1 100 -32768 32767 ECU_ADDRESS 0xFFFF1180 /begin FUNCTION_LIST KF7-330.5[53] /end FUNCTION_LIST /end MEASUREMENT
/begin MEASUREMENT vATION "QFBI just before ATRNG1 becomes 0" SWORD COMP_0277 1 100 -32768 32767 ECU_ADDRESS 0xFFFF1182 /begin FUNCTION_LIST KF7-330.5[53] /end FUNCTION_LIST /end MEASUREMENT
/begin MEASUREMENT vATPDAP_S "PTD open-degree (vice-operation part) for the AT transmission" UBYTE COMP_0022_S 1 100 0 0.99999984 ECU_ADDRESS 0xFFFF1F64 /begin FUNCTION_LIST KF7-340.5P[2] /end FUNCTION_LIST /end MEASUREMENT
/begin MEASUREMENT vATPTDAPO "PTD open-degree for the AT transmission" UBYTE COMP_0022_S 1 100 0 0.99999984 ECU_ADDRESS 0xFFFF1E1E /begin FUNCTION_LIST KF7-340.5[4] KF7-340.5P[2] /end FUNCTION_LIST /end MEASUREMENT
/begin MEASUREMENT vATRNG "AT shift range signal" UBYTE COMP_0068 1 100 0 255 ECU_ADDRESS 0xFFFF48EA /begin FUNCTION_LIST KF7-340.9M[3] KF7-340.9P[3] KF7-360.9M[43] /end FUNCTION_LIST /end MEASUREMENT
/begin MEASUREMENT vAVEPPSV "P/S oil pressure sensor voltage weighted average value" UBYTE COMP_0054 1 100 0 5100 ECU_ADDRESS 0xFFFF1194 /begin FUNCTION_LIST KF7-330.5[53] /end FUNCTION_LIST /end MEASUREMENT
/begin MEASUREMENT vAVEPSV40 "The amount of change of AVEPPSV for 40mS" UBYTE COMP_0054 1 100 0 5100 ECU_ADDRESS 0xFFFF1195 /begin FUNCTION_LIST KF7-330.5[53] /end FUNCTION_LIST /end MEASUREMENT
/begin MEASUREMENT vBATCURK "Battery balance electric current weighted average value" UWORD COMP_0558_S 1 100 -128 127.99609375 ECU_ADDRESS 0xFFFF8978 /begin FUNCTION_LIST KF7-330.4A[53] KF7-330.5[53] KF7-351.2[17] /end FUNCTION_LIST /end MEASUREMENT
/begin MEASUREMENT vCQFBI "F/B I Advantage operation counter" UWORD COMP_0032_S 1 100 0 65535 ECU_ADDRESS 0xFFFF1016 /begin FUNCTION_LIST KF7-330.5[53] /end FUNCTION_LIST /end MEASUREMENT
/begin MEASUREMENT vDECISC "Air quantity 2 which becomes proper at the time of the slowdown" UWORD COMP_0396 1 100 0 511.9921875 ECU_ADDRESS 0xFFFF1254
 /begin FUNCTION_LIST KF7-330.5[53] KF7-330.7A[1] KF7-330.9[8] R301.6.IscAirflow_1_4_5 /end FUNCTION_LIST
/end MEASUREMENT
/begin MEASUREMENT vDENST "Engine rotation decline fee" UBYTE COMP_0006 1 100 0 3187.5 ECU_ADDRESS 0xFFFF1262 /begin FUNCTION_LIST KF7-330.5[53] /end FUNCTION_LIST /end MEASUREMENT
/begin MEASUREMENT vDETENST "When rotation declines, the amount of compensation air" UBYTE COMP_0051 1 100 0 255 ECU_ADDRESS 0xFFFF1263 /begin FUNCTION_LIST KF7-330.5[53] R301.19.ISC_PID_cont_1_0_2 /end FUNCTION_LIST /end MEASUREMENT
/begin MEASUREMENT vDEVATMP "Evaporator temperature deviation" UBYTE COMP_0570_S 1 100 0 84.9999915 ECU_ADDRESS 0xFFFF897D /begin FUNCTION_LIST KF7-330.4A[53] KF7-377.1A[19] /end FUNCTION_LIST /end MEASUREMENT
/begin MEASUREMENT vDIFTFD "PTD-ON/ off drive power step" UWORD COMP_0014_S 1 100 0 65535 ECU_ADDRESS 0xFFFF126A /begin FUNCTION_LIST KF7-340.6M[2] /end FUNCTION_LIST /end MEASUREMENT
/begin MEASUREMENT vDISCST2 "At the time of the start, ISC compensation quantity 2" UWORD COMP_0324 1 100 0 511.9921875 ECU_ADDRESS 0xFFFF126E /begin FUNCTION_LIST KF7-330.8[1] /end FUNCTION_LIST /end MEASUREMENT
/begin MEASUREMENT vDLTDLY "Reverse phase delay" UBYTE COMP_0014 1 100 0 2550 ECU_ADDRESS 0xFFFF1276 /begin FUNCTION_LIST KF7-320A.15[4] R301.23.ADV_calculation_1_1_2 /end FUNCTION_LIST /end MEASUREMENT
/begin MEASUREMENT vDLTNAV "A difference in engine speed" SWORD COMP_0262 1 100 -409600 409587.5 ECU_ADDRESS 0xFFFF1278 /begin FUNCTION_LIST KF7-320A.15[4] R301.23.ADV_calculation_1_1_2 /end FUNCTION_LIST /end MEASUREMENT
/begin MEASUREMENT vDNACSTS "Air-conditioning direct evaporator temperature status" UBYTE COMP_0068 1 100 0 255 ECU_ADDRESS 0xFFFF1290 /begin FUNCTION_LIST KF7-330.4A[53] /end FUNCTION_LIST /end MEASUREMENT
/begin MEASUREMENT vDNADV "The amount of reverse phase control" SBYTE COMP_0018 1 100 -128 127 ECU_ADDRESS 0xFFFF1291 /begin FUNCTION_LIST KF7-320A.15[4] R301.23.ADV_calculation_1_1_2 /end FUNCTION_LIST /end MEASUREMENT
/begin MEASUREMENT vDTVO3 "For 30mS, delta-TVO" UBYTE COMP_0280 1 100 0 89.25 ECU_ADDRESS 0xFFFF1E7E /begin FUNCTION_LIST KF7-320A.15[4] /end FUNCTION_LIST /end MEASUREMENT
/begin MEASUREMENT vDVAPO40 "Virtual accelerator open-degree change (for 40mS)" UWORD COMP_0077 1 100 0 7208.85 ECU_ADDRESS 0xFFFF12AE /begin FUNCTION_LIST KF7-320A.15[4] R301.23.ADV_calculation_1_1_2 /end FUNCTION_LIST /end MEASUREMENT
/begin MEASUREMENT vETSMODE "E-TS actual mode signal" UBYTE COMP_0068 1 100 0 255 ECU_ADDRESS 0xFFFF4936 /begin FUNCTION_LIST KF7-330.4A[53] KF7-360.7M[9] /end FUNCTION_LIST /end MEASUREMENT
/begin MEASUREMENT vEVATMP "Evaporator actual temperature" UBYTE COMP_0591_S 1 100 -30 54.9999915 ECU_ADDRESS 0xFFFF8994 /begin FUNCTION_LIST KF7-330.4A[53] KF7-580.1[8] /end FUNCTION_LIST /end MEASUREMENT
/begin MEASUREMENT vFHINJEX "Homogeneous injection executive judgement" UBYTE COMP_0068 1 100 0 255 ECU_ADDRESS 0xFFFF1FCF /begin FUNCTION_LIST KF7-320A.21[N] /end FUNCTION_LIST /end MEASUREMENT
/begin MEASUREMENT vGDPPSV "P/S oil pressure change compensation air quantity operation coefficient" UBYTE COMP_0084_S 1 100 0 7.96875 ECU_ADDRESS 0xFFFF13C5 /begin FUNCTION_LIST KF7-330.5[53] /end FUNCTION_LIST /end MEASUREMENT
/begin MEASUREMENT vGNSETST2 "After the start, idle rise rate (Right after it starts.)" UBYTE COMP_0021 1 100 0 99.609375 ECU_ADDRESS 0xFFFF13D6 /begin FUNCTION_LIST KF7-330.4A[53] /end FUNCTION_LIST /end MEASUREMENT
/begin MEASUREMENT vGQFBI "F/B I gain" UWORD COMP_0032_S 1 100 0 65535 ECU_ADDRESS 0xFFFF13DC /begin FUNCTION_LIST KF7-330.5[53] KF7-351.1[16] /end FUNCTION_LIST /end MEASUREMENT
/begin MEASUREMENT vHNRPM10 "Engine speed (100mS sample value)" UBYTE COMP_0020 1 100 0 12750 ECU_ADDRESS 0xFFFF89A4 /begin FUNCTION_LIST KF7-320A.19[7] /end FUNCTION_LIST /end MEASUREMENT
/begin MEASUREMENT vINDGP "At the time of the M mode, a gear position signal for the indicator" UBYTE COMP_0068 1 100 0 255 ECU_ADDRESS 0xFFFF89A8 /begin FUNCTION_LIST KF7-330.5[53] KF7-340.7[4] /end FUNCTION_LIST /end MEASUREMENT
/begin MEASUREMENT vINPLMTH "Input speed upper limit allowable value" UWORD COMP_0443 1 100 0 65535 ECU_ADDRESS 0xFFFF1468 /begin FUNCTION_LIST KF7-340.10M[1] KF7-340.10P[N] KF7-505.47[3] /end FUNCTION_LIST /end MEASUREMENT
/begin MEASUREMENT vINPLMTL "Input speed lower limit allowable value" UWORD COMP_0443 1 100 0 65535 ECU_ADDRESS 0xFFFF146A /begin FUNCTION_LIST KF7-340.9M[3] KF7-340.9P[3] /end FUNCTION_LIST /end MEASUREMENT
/begin MEASUREMENT vINPNE "Estimated turbine rotation" UWORD COMP_0065 1 100 0 204796.875 ECU_ADDRESS 0xFFFF146E /begin FUNCTION_LIST KF7-330.9[8] /end FUNCTION_LIST /end MEASUREMENT
/begin MEASUREMENT vINPRT "Gear ratio" UWORD COMP_0450 1 100 0 63.999056205 ECU_ADDRESS 0xFFFF1472 /begin FUNCTION_LIST KF7-330.9[8] /end FUNCTION_LIST /end MEASUREMENT
/begin MEASUREMENT vINRLMH "At the time of a change in gear ratio, limiter upper limit" SWORD COMP_0228 1 100 -3276.8 3276.7 ECU_ADDRESS 0xFFFF2E5A /begin FUNCTION_LIST KF7-340.11[4] /end FUNCTION_LIST /end MEASUREMENT
/begin MEASUREMENT vINRLML "At the time of a change in gear ratio, limiter lower limit" SWORD COMP_0228 1 100 -3276.8 3276.7 ECU_ADDRESS 0xFFFF2E5C /begin FUNCTION_LIST KF7-340.11[4] /end FUNCTION_LIST /end MEASUREMENT
/begin MEASUREMENT vINRLMV "Vehicle speed limiter" UWORD COMP_0196 1 100 0 6553.5 ECU_ADDRESS 0xFFFF2E5E /begin FUNCTION_LIST KF7-340.11[4] /end FUNCTION_LIST /end MEASUREMENT
/begin MEASUREMENT vISCAU "Load compensation (transient state compensation) air-conditioning compensation" UWORD COMP_0444 1 100 0 255.99609375 ECU_ADDRESS 0xFFFF1476 /begin FUNCTION_LIST KF7-330.5[53] R301.6.IscAirflow_1_4_5 /end FUNCTION_LIST /end MEASUREMENT
/begin MEASUREMENT vISCBCP "The amount of slowdown load compensation" UWORD COMP_0324 1 100 0 511.9921875 ECU_ADDRESS 0xFFFF1478 /begin FUNCTION_LIST KF7-330.5[53] /end FUNCTION_LIST /end MEASUREMENT
/begin MEASUREMENT vISCBFN "Load compensation (transient state compensation) air-conditioning blower fan compensation" UWORD COMP_0444 1 100 0 255.99609375 ECU_ADDRESS 0xFFFF147A /begin FUNCTION_LIST KF7-330.5[53] /end FUNCTION_LIST /end MEASUREMENT
/begin MEASUREMENT vISCDEF "Load compensation (transient state compensation) rear defogger compensation" UWORD COMP_0444 1 100 0 255.99609375 ECU_ADDRESS 0xFFFF147E /begin FUNCTION_LIST KF7-330.5[53] /end FUNCTION_LIST /end MEASUREMENT
/begin MEASUREMENT vISCHLH "Load compensation (transient state compensation) headlights compensation (HighI)" UWORD COMP_0444 1 100 0 255.99609375 ECU_ADDRESS 0xFFFF1480 /begin FUNCTION_LIST KF7-330.5[53] /end FUNCTION_LIST /end MEASUREMENT
/begin MEASUREMENT vISCLRC21 "Idle speed learning value" SWORD COMP_0277 1 100 -32768 32767 ECU_ADDRESS 0xFFFFA4B6 /begin FUNCTION_LIST KF7-330.5[53] KF7-351.2[17] /end FUNCTION_LIST /end MEASUREMENT
/begin MEASUREMENT vISCLU1 "Load compensation (transient state compensation) electric load compensation" UWORD COMP_0444 1 100 0 255.99609375 ECU_ADDRESS 0xFFFF1492 /begin FUNCTION_LIST KF7-330.5[53] /end FUNCTION_LIST /end MEASUREMENT
/begin MEASUREMENT vISCLU2 "Load compensation (transient state compensation) electric load compensation" UWORD COMP_0444 1 100 0 255.99609375 ECU_ADDRESS 0xFFFF1494 /begin FUNCTION_LIST KF7-330.5[53] /end FUNCTION_LIST /end MEASUREMENT
/begin MEASUREMENT vISCPB "Atomospheric pressure compensation value" UBYTE COMP_0009 1 100 0 199.21875 ECU_ADDRESS 0xFFFF2E62 /begin FUNCTION_LIST KF7-330.5[53] KF7-351.3[11] R301.6.IscAirflow_1_4_5 /end FUNCTION_LIST /end MEASUREMENT
/begin MEASUREMENT vISCRTD "The amount of compensation air for retard" UBYTE COMP_0051 1 100 0 255 ECU_ADDRESS 0xFFFF1496 /begin FUNCTION_LIST KF7-330.5[53] R301.19.ISC_PID_cont_1_0_2 /end FUNCTION_LIST /end MEASUREMENT
/begin MEASUREMENT vISCRU "Load compensation (transient state compensation) radiator fan compensation" UWORD COMP_0444 1 100 0 255.99609375 ECU_ADDRESS 0xFFFF1498 /begin FUNCTION_LIST KF7-330.5[53] R000.1.RS_Integ_1_10_2 /end FUNCTION_LIST /end MEASUREMENT
/begin MEASUREMENT vISCSST "At the time of the start, ISC compensation value 2" UBYTE COMP_0293 1 100 0 510 ECU_ADDRESS 0xFFFF149A /begin FUNCTION_LIST KF7-330.8[1] /end FUNCTION_LIST /end MEASUREMENT
/begin MEASUREMENT vISCST "At the time of the start, the amount of ISC compensation" UBYTE COMP_0293 1 100 0 510 ECU_ADDRESS 0xFFFF149C
 /begin FUNCTION_LIST KF7-330.5[53] KF7-330.8[1] R301.6.IscAirflow_1_4_5 R301.19.ISC_PID_cont_1_0_2 /end FUNCTION_LIST
/end MEASUREMENT
/begin MEASUREMENT vISCST1 "At the time of the start, ISC compensation quantity 1" UWORD COMP_0324 1 100 0 511.9921875 ECU_ADDRESS 0xFFFF14A0 /begin FUNCTION_LIST KF7-330.8[1] /end FUNCTION_LIST /end MEASUREMENT
/begin MEASUREMENT vISCSTT "At the time of the start, ISC compensation value 1" UBYTE COMP_0293 1 100 0 510 ECU_ADDRESS 0xFFFF14A8 /begin FUNCTION_LIST KF7-330.8[1] /end FUNCTION_LIST /end MEASUREMENT
/begin MEASUREMENT vISCTA "Intake air temperature compensation value" UBYTE COMP_0009 1 100 0 199.21875 ECU_ADDRESS 0xFFFF2E63 /begin FUNCTION_LIST KF7-330.5[53] KF7-351.3[11] R301.6.IscAirflow_1_4_5 /end FUNCTION_LIST /end MEASUREMENT
/begin MEASUREMENT vK1 "Reverse phase compensation coefficient 3" UBYTE COMP_0111_S 1 100 0 255 ECU_ADDRESS 0xFFFF14BA /begin FUNCTION_LIST KF7-320A.15[4] R301.23.ADV_calculation_1_1_2 /end FUNCTION_LIST /end MEASUREMENT
/begin MEASUREMENT vK2Y "Reverse phase compensation coefficient 2" UBYTE COMP_0111_S 1 100 0 255 ECU_ADDRESS 0xFFFF14BB /begin FUNCTION_LIST KF7-320A.15[4] R301.23.ADV_calculation_1_1_2 /end FUNCTION_LIST /end MEASUREMENT
/begin MEASUREMENT vKCRADV "Ignition timing time compensation rate" UWORD COMP_0456 1 100 0 1.999970916 ECU_ADDRESS 0xFFFF14C2 /begin FUNCTION_LIST KF7-320A.19[7] /end FUNCTION_LIST /end MEASUREMENT
/begin MEASUREMENT vKDADV "The amount of retard quantity compensation" UBYTE COMP_0021 1 100 0 99.609375 ECU_ADDRESS 0xFFFF14C4 /begin FUNCTION_LIST KF7-320A.15[4] R301.23.ADV_calculation_1_1_2 /end FUNCTION_LIST /end MEASUREMENT
/begin MEASUREMENT vKMRLBT "At the time of the delay, the amount of retard" UBYTE COMP_0017 1 100 0 255 ECU_ADDRESS 0xFFFF14E2 /begin FUNCTION_LIST KF7-320A.17[N] KF7-320A.18[4] KF7-386.1[4] KF7-386.2[4] /end FUNCTION_LIST /end MEASUREMENT
/begin MEASUREMENT vKMRRTD "At the time of the increase, the amount of retard" UBYTE COMP_0017 1 100 0 255 ECU_ADDRESS 0xFFFF14E4 /begin FUNCTION_LIST KF7-320A.17[N] /end FUNCTION_LIST /end MEASUREMENT
/begin MEASUREMENT vKMRTP "Torque going down stage judgement ITAC" UBYTE COMP_0009 1 100 0 199.21875 ECU_ADDRESS 0xFFFF14E5 /begin FUNCTION_LIST KF7-320A.17[N] /end FUNCTION_LIST /end MEASUREMENT
/begin MEASUREMENT vKMRTRQ "The amount of torque going down stage retard" UBYTE COMP_0017 1 100 0 255 ECU_ADDRESS 0xFFFF14E6 /begin FUNCTION_LIST KF7-320A.17[N] /end FUNCTION_LIST /end MEASUREMENT
/begin MEASUREMENT vKTEINR "After compensation is calculated, the amount of engine torque compensation" SWORD COMP_0228 1 100 -3276.8 3276.7 ECU_ADDRESS 0xFFFF1500 /begin FUNCTION_LIST KF7-340.11[4] KF7-360.9M[43] KF7-360.9P[22] /end FUNCTION_LIST /end MEASUREMENT
/begin MEASUREMENT vLIMADDFD "After the running resistance control limiter, the addition drive power" UWORD COMP_0014_S 1 100 0 65535 ECU_ADDRESS 0xFFFF1518 /begin FUNCTION_LIST KF7-340.8M[8] /end FUNCTION_LIST /end MEASUREMENT
/begin MEASUREMENT vLIMZOKFD "After the area attribute control limiter, the addition drive power" SWORD COMP_0030_S 1 100 -32768 32767 ECU_ADDRESS 0xFFFF151A /begin FUNCTION_LIST KF7-340.8M[8] /end FUNCTION_LIST /end MEASUREMENT
/begin MEASUREMENT vMAXTP "-" UWORD COMP_0144 1 100 0 31.999495335 ECU_ADDRESS 0xFFFF1560 /begin FUNCTION_LIST KF7-340.1M[8] /end FUNCTION_LIST /end MEASUREMENT
/begin MEASUREMENT vMFREQ "Radiator fan cooling requirement" UBYTE COMP_0027 1 100 0 255 ECU_ADDRESS 0xFFFF1590 /begin FUNCTION_LIST KF7-330.5[53] KF7-377.1A[19] KF7-580.1[8] /end FUNCTION_LIST /end MEASUREMENT
/begin MEASUREMENT vMTFDFK "The first delay weight coefficient" UWORD COMP_0290 1 100 0 0.999985458 ECU_ADDRESS 0xFFFF15B8 /begin FUNCTION_LIST KF7-340.4[1] /end FUNCTION_LIST /end MEASUREMENT
/begin MEASUREMENT vMTTE "QH0/ torque conversion map work RAM" UWORD COMP_0226 1 100 -3276.8 3276.7 ECU_ADDRESS 0xFFFF15BC
 /begin FUNCTION_LIST KF7-340.1M[8] KF7-340.1P[7] KF7-340.2M[2] KF7-340.8M[8] KF7-360.8M[4] KF7-360.9M[43] KF7-360.12[6] KF7-385.3[4] KF7-410.11M[4] KF7-410.11P[4] KF7-410.17M[5] KF7-410.17P[1] /end FUNCTION_LIST
/end MEASUREMENT
/begin MEASUREMENT vNACMAX "Air-conditioning requirement maximum speed" UBYTE COMP_0006 1 100 0 3187.5 ECU_ADDRESS 0xFFFF15C3 /begin FUNCTION_LIST KF7-330.4A[53] /end FUNCTION_LIST /end MEASUREMENT
/begin MEASUREMENT vNACSTS "Air-conditioning Pd pressure status" UBYTE COMP_0068 1 100 0 255 ECU_ADDRESS 0xFFFF15C4 /begin FUNCTION_LIST KF7-330.4A[53] /end FUNCTION_LIST /end MEASUREMENT
/begin MEASUREMENT vNACUP "Air-conditioning requirement UP speed" UBYTE COMP_0006 1 100 0 3187.5 ECU_ADDRESS 0xFFFF15C5 /begin FUNCTION_LIST KF7-330.4A[53] /end FUNCTION_LIST /end MEASUREMENT
/begin MEASUREMENT vNBASE "Air-conditioning requirement, at least, speed" UBYTE COMP_0006 1 100 0 3187.5 ECU_ADDRESS 0xFFFF15C8 /begin FUNCTION_LIST KF7-330.4A[53] /end FUNCTION_LIST /end MEASUREMENT
/begin MEASUREMENT vNEALT "An electric load big time speed UP fee" UBYTE COMP_0006 1 100 0 3187.5 ECU_ADDRESS 0xFFFF15CD /begin FUNCTION_LIST KF7-330.4A[53] /end FUNCTION_LIST /end MEASUREMENT
/begin MEASUREMENT vNETARGET "Idle speed target value" UWORD COMP_0476 1 100 0 12799.8046875 ECU_ADDRESS 0xFFFF8A4A DISPLAY_IDENTIFIER Vxx_is_n_sp
 /begin FUNCTION_LIST KF7-330.4A[53] KF7-330.5[53] KF7-390.3A[15] KF7-500.7[12] KF7-500.38A[4] R204.1.CanComm_1_9_2 R301.6.IscAirflow_1_4_5 R301.19.ISC_PID_cont_1_0_2 Rxxx.1.Diagnostic_cycle_1_0_1 /end FUNCTION_LIST
/end MEASUREMENT
/begin MEASUREMENT vNETBAI "NSET0 addition value compensation gain" UBYTE COMP_0063 1 100 0 0.99609375 ECU_ADDRESS 0xFFFF21D4 /begin FUNCTION_LIST KF7-330.4A[53] /end FUNCTION_LIST /end MEASUREMENT
/begin MEASUREMENT vNETPLUS "NSET0 addition value" UWORD COMP_0582_S 1 100 0 3199.9495335 ECU_ADDRESS 0xFFFF21D6 /begin FUNCTION_LIST KF7-330.4A[53] R301.6.IscAirflow_1_4_5 /end FUNCTION_LIST /end MEASUREMENT
/begin MEASUREMENT vNISCBC "Slowdown load compensation start speed" UBYTE COMP_0006 1 100 0 3187.5 ECU_ADDRESS 0xFFFF15DE /begin FUNCTION_LIST KF7-330.5[53] /end FUNCTION_LIST /end MEASUREMENT
/begin MEASUREMENT vNSET00D "D range idle speed setup value" UBYTE COMP_0006 1 100 0 3187.5 ECU_ADDRESS 0xFFFF15F0 /begin FUNCTION_LIST KF7-330.4A[53] KF7-330.5[53] /end FUNCTION_LIST /end MEASUREMENT
/begin MEASUREMENT vNSET00N "N range idle speed setup value" UBYTE COMP_0006 1 100 0 3187.5 ECU_ADDRESS 0xFFFF15F1 /begin FUNCTION_LIST KF7-330.4A[53] KF7-330.5[53] /end FUNCTION_LIST /end MEASUREMENT
/begin MEASUREMENT vNSET3 "After the start, time compensation" UBYTE COMP_0009 1 100 0 199.21875 ECU_ADDRESS 0xFFFF15F2 /begin FUNCTION_LIST KF7-330.4A[53] /end FUNCTION_LIST /end MEASUREMENT
/begin MEASUREMENT vNSETAC "Air-conditioning requirement engine speed" UBYTE COMP_0006 1 100 0 3187.5 ECU_ADDRESS 0xFFFF15F3 /begin FUNCTION_LIST KF7-330.4A[53] /end FUNCTION_LIST /end MEASUREMENT
/begin MEASUREMENT vNSETPIG0 "Pre-ignition avoidance target idle speed setup value" UBYTE COMP_0006 1 100 0 3187.5 ECU_ADDRESS 0xFFFF15F6 /begin FUNCTION_LIST KF7-330.4A[53] R000.1.RS_Integ_1_10_2 /end FUNCTION_LIST /end MEASUREMENT
/begin MEASUREMENT vNSETTBL "NSET0 TIMEM reference value" UBYTE COMP_0006 1 100 0 3187.5 ECU_ADDRESS 0xFFFF15F7
 /begin FUNCTION_LIST KF7-330.4A[53] KF7-330.5[53] KF7-351.1[16] KF7-351.2[17] KF7-385.1[32] KF7-385.3[4] R000.1.RS_Integ_1_10_2 /end FUNCTION_LIST
/end MEASUREMENT
/begin MEASUREMENT vNSETVB "At the time of the battery decline, idle speed" UBYTE COMP_0006 1 100 0 3187.5 ECU_ADDRESS 0xFFFF3025 /begin FUNCTION_LIST KF7-330.4A[53] /end FUNCTION_LIST /end MEASUREMENT
/begin MEASUREMENT vNSLPRT "Normalized speed ratio" UWORD COMP_0610_S 1 100 0 1.06664766 ECU_ADDRESS 0xFFFF15F8 /begin FUNCTION_LIST KF7-340.10M[1] /end FUNCTION_LIST /end MEASUREMENT
/begin MEASUREMENT vNSLPRT_S "Normalized speed ratio" UWORD COMP_0610_S 1 100 0 1.06664766 ECU_ADDRESS 0xFFFF1C46 /begin FUNCTION_LIST KF7-340.10P[N] /end FUNCTION_LIST /end MEASUREMENT
/begin MEASUREMENT vNSTEPN "Engine speed adjustment EEPROM reading value" UBYTE COMP_0006 1 100 0 3187.5 ECU_ADDRESS 0xFFFF3026 /begin FUNCTION_LIST KF7-330.4A[53] /end FUNCTION_LIST /end MEASUREMENT
/begin MEASUREMENT vPTDAPO "Target drive power equivalent accelerator open-degree" UWORD COMP_0005 1 100 0 7208.85 ECU_ADDRESS 0xFFFF1EF8 /begin FUNCTION_LIST KF7-340.5[4] KF7-340.5P[2] KF7-410.19[2] /end FUNCTION_LIST /end MEASUREMENT
/begin MEASUREMENT vPTDAPO_S "Target drive power equivalent accelerator open-degree (vice-operation part)" UWORD COMP_0005 1 100 0 7208.85 ECU_ADDRESS 0xFFFF1F66 /begin FUNCTION_LIST KF7-340.5P[2] /end FUNCTION_LIST /end MEASUREMENT
/begin MEASUREMENT vQAACV "Air flow-quantity order value" UWORD COMP_0051 1 100 0 65535 ECU_ADDRESS 0xFFFF102C
 /begin FUNCTION_LIST KF7-330.1M[3] KF7-330.5[53] KF7-351.3[11] KF7-580.1[8] R301.6.IscAirflow_1_4_5 R301.19.ISC_PID_cont_1_0_2 /end FUNCTION_LIST
/end MEASUREMENT
/begin MEASUREMENT vQAACV0 "Air flow-quantity order value" UWORD COMP_0051 1 100 0 65535 ECU_ADDRESS 0xFFFF16AC /begin FUNCTION_LIST KF7-330.5[53] R301.6.IscAirflow_1_4_5 /end FUNCTION_LIST /end MEASUREMENT
/begin MEASUREMENT vQAC "A/C At the time of on, load compensation air flow-quantity" UBYTE COMP_0051 1 100 0 255 ECU_ADDRESS 0xFFFF102E /begin FUNCTION_LIST KF7-330.5[53] /end FUNCTION_LIST /end MEASUREMENT
/begin MEASUREMENT vQACN "At the time of A/C on computed this time, load compensation air flow-quantity" UBYTE COMP_0051 1 100 0 255 ECU_ADDRESS 0xFFFF16AE /begin FUNCTION_LIST KF7-330.5[53] /end FUNCTION_LIST /end MEASUREMENT
/begin MEASUREMENT vQACROFF "At the time of the A/C start, load compensation air flow-quantity" UBYTE COMP_0051 1 100 0 255 ECU_ADDRESS 0xFFFF16AF /begin FUNCTION_LIST KF7-330.5[53] R301.6.IscAirflow_1_4_5 /end FUNCTION_LIST /end MEASUREMENT
/begin MEASUREMENT vQACROLD "QAC just before becoming air-conditioning relay off" UBYTE COMP_0051 1 100 0 255 ECU_ADDRESS 0xFFFF16B0 /begin FUNCTION_LIST KF7-330.5[53] /end FUNCTION_LIST /end MEASUREMENT
/begin MEASUREMENT vQACRON "At the time of the A/C drive, load compensation air flow-quantity" UBYTE COMP_0051 1 100 0 255 ECU_ADDRESS 0xFFFF16B1 /begin FUNCTION_LIST KF7-330.5[53] R301.6.IscAirflow_1_4_5 /end FUNCTION_LIST /end MEASUREMENT
/begin MEASUREMENT vQADVFBI "ADV F/B compensation quantity (I-gain)" SBYTE COMP_0277 1 100 -128 127 ECU_ADDRESS 0xFFFF21FF /begin FUNCTION_LIST KF7-330.3[6] KF7-390.3A[15] /end FUNCTION_LIST /end MEASUREMENT
/begin MEASUREMENT vQALTMX "An electric load compensation upper limit limiter" UBYTE COMP_0051 1 100 0 255 ECU_ADDRESS 0xFFFF16B5 /begin FUNCTION_LIST KF7-330.4A[53] KF7-330.5[53] /end FUNCTION_LIST /end MEASUREMENT
/begin MEASUREMENT vQBC "A negative pressure compensation air flow-quantity" UWORD COMP_0324 1 100 0 511.9921875 ECU_ADDRESS 0xFFFF16BA /begin FUNCTION_LIST KF7-330.5[53] /end FUNCTION_LIST /end MEASUREMENT
/begin MEASUREMENT vQBCV "A negative pressure control air flow-quantity" UBYTE COMP_0276 1 100 0 1020 ECU_ADDRESS 0xFFFF16BC /begin FUNCTION_LIST KF7-330.5[53] /end FUNCTION_LIST /end MEASUREMENT
/begin MEASUREMENT vQBCV1 "A negative pressure control air flow-quantity (6&8cyl)" UBYTE COMP_0253_S 1 100 0 2040 ECU_ADDRESS 0xFFFF16BD /begin FUNCTION_LIST KF7-330.5[53] /end FUNCTION_LIST /end MEASUREMENT
/begin MEASUREMENT vQCIMAX "At the time of OPEN, F/B I upper limit value" UBYTE COMP_0051 1 100 0 255 ECU_ADDRESS 0xFFFF16C2 /begin FUNCTION_LIST KF7-330.5[53] /end FUNCTION_LIST /end MEASUREMENT
/begin MEASUREMENT vQCIMAX1 "At the time of OPEN, F/B I upper limit value (6, 8 cylinder car kind)" UBYTE COMP_0293 1 100 0 510 ECU_ADDRESS 0xFFFF16C3 /begin FUNCTION_LIST KF7-330.5[53] /end FUNCTION_LIST /end MEASUREMENT
/begin MEASUREMENT vQCIMIN "At the time of OPEN, F/B I lower limit value" UBYTE COMP_0051 1 100 0 255 ECU_ADDRESS 0xFFFF16C4 /begin FUNCTION_LIST KF7-330.5[53] /end FUNCTION_LIST /end MEASUREMENT
/begin MEASUREMENT vQCINDHL "When idle rotation declines at the time of the intermadiate coolant temperature, covering air flow-quantity" UBYTE COMP_0051 1 100 0 255 ECU_ADDRESS 0xFFFF16C5 /begin FUNCTION_LIST KF7-330.5[53] /end FUNCTION_LIST /end MEASUREMENT
/begin MEASUREMENT vQCK "(CK) Load change air flow-quantity" UBYTE COMP_0220 1 100 0 255 ECU_ADDRESS 0xFFFF1EFA /begin FUNCTION_LIST KF7-330.5[53] /end FUNCTION_LIST /end MEASUREMENT
/begin MEASUREMENT vQDSPT "Dashpot compensation air flow-quantity" UWORD COMP_0324 1 100 0 511.9921875 ECU_ADDRESS 0xFFFF1030 /begin FUNCTION_LIST KF7-330.5[53] R301.26.Dashpot_DandN_1_0_2 /end FUNCTION_LIST /end MEASUREMENT
/begin MEASUREMENT vQDSPTM "A variable for the QDSPT operation" UWORD COMP_0324 1 100 0 511.9921875 ECU_ADDRESS 0xFFFF16C8 /begin FUNCTION_LIST KF7-330.5[53] R301.26.Dashpot_DandN_1_0_2 /end FUNCTION_LIST /end MEASUREMENT
/begin MEASUREMENT vQENST "When rotation declines, the amount of compensation" UBYTE COMP_0051 1 100 0 255 ECU_ADDRESS 0xFFFF16CA /begin FUNCTION_LIST KF7-330.5[53] /end FUNCTION_LIST /end MEASUREMENT
/begin MEASUREMENT vQFBI "F/B I-gain air flow-quantity" SWORD COMP_0277 1 100 -32768 32767 ECU_ADDRESS 0xFFFF22EE
 /begin FUNCTION_LIST KF7-330.5[53] KF7-330.7A[1] KF7-330.8[1] KF7-351.1[16] KF7-351.2[17] KF7-351.3[11] KF7-500.38A[4] R301.6.IscAirflow_1_4_5 R301.19.ISC_PID_cont_1_0_2 R901.1.Diag_on_can_app_1_6_2 /end FUNCTION_LIST
/end MEASUREMENT
/begin MEASUREMENT vQFBIMAX "F/B I Advantage upper limit value" UBYTE COMP_0051 1 100 0 255 ECU_ADDRESS 0xFFFF16D6 /begin FUNCTION_LIST KF7-330.5[53] KF7-500.38A[4] R301.19.ISC_PID_cont_1_0_2 /end FUNCTION_LIST /end MEASUREMENT
/begin MEASUREMENT vQFBIMAX1 "F/B I Advantage upper limit value (for 6, 8 cylinder)" UBYTE COMP_0293 1 100 0 510 ECU_ADDRESS 0xFFFF16D7 /begin FUNCTION_LIST KF7-330.5[53] KF7-500.38A[4] R301.19.ISC_PID_cont_1_0_2 /end FUNCTION_LIST /end MEASUREMENT
/begin MEASUREMENT vQFBIMIN "F/B I Advantage lower limit value" SBYTE COMP_0277 1 100 -128 127 ECU_ADDRESS 0xFFFF16D8
 /begin FUNCTION_LIST KF7-330.5[53] KF7-351.3[11] KF7-500.38A[4] R301.19.ISC_PID_cont_1_0_2 /end FUNCTION_LIST
/end MEASUREMENT
/begin MEASUREMENT vQH0LMT "QH0 upper limit value" UWORD COMP_0146 1 100 0 99.998480265 ECU_ADDRESS 0xFFFF16DE
 /begin FUNCTION_LIST KF7-340.1M[8] KF7-340.1P[7] KF7-385.3[4] KF7-410.17M[5] KF7-410.17P[1] R301.20.AmbientComp_1_0_2 /end FUNCTION_LIST
/end MEASUREMENT
/begin MEASUREMENT vQISC "Idle stabilization air flow-quantity" UWORD COMP_0051 1 100 0 65535 ECU_ADDRESS 0xFFFF16E2
 /begin FUNCTION_LIST KF7-330.5[53] KF7-580.1[8] R301.6.IscAirflow_1_4_5 R301.19.ISC_PID_cont_1_0_2 /end FUNCTION_LIST
/end MEASUREMENT
/begin MEASUREMENT vQLD1N "For QLD steady state compensation" UWORD COMP_0051 1 100 0 65535 ECU_ADDRESS 0xFFFF16E6 /begin FUNCTION_LIST KF7-330.5[53] R301.6.IscAirflow_1_4_5 /end FUNCTION_LIST /end MEASUREMENT
/begin MEASUREMENT vQLD2 "Load compensation (transient state compensation)" UBYTE COMP_0051 1 100 0 255 ECU_ADDRESS 0xFFFF16E8 /begin FUNCTION_LIST KF7-330.5[53] KF7-390.3A[15] R301.6.IscAirflow_1_4_5 /end FUNCTION_LIST /end MEASUREMENT
/begin MEASUREMENT vQLDAC "A/C load compensation air flow-quantity" UBYTE COMP_0051 1 100 0 255 ECU_ADDRESS 0xFFFF16E9 /begin FUNCTION_LIST KF7-330.5[53] KF7-386.3[8] KF7-390.3A[15] /end FUNCTION_LIST /end MEASUREMENT
/begin MEASUREMENT vQLDALT "Alternator load compensation air flow-quantity" UBYTE COMP_0051 1 100 0 255 ECU_ADDRESS 0xFFFF23F6
 /begin FUNCTION_LIST KF7-330.4A[53] KF7-330.5[53] KF7-386.3[8] KF7-390.3A[15] R301.6.IscAirflow_1_4_5 R901.1.Diag_on_can_app_1_6_2 /end FUNCTION_LIST
/end MEASUREMENT
/begin MEASUREMENT vQLDBAT "Battery charging electric load compensation air flow-quantity" UBYTE COMP_0051 1 100 0 255 ECU_ADDRESS 0xFFFF16EA /begin FUNCTION_LIST KF7-330.5[53] /end FUNCTION_LIST /end MEASUREMENT
/begin MEASUREMENT vQLDBFN "Air-conditioning blower fan load steady state compensation air flow-quantity" UBYTE COMP_0051 1 100 0 255 ECU_ADDRESS 0xFFFF16EB /begin FUNCTION_LIST KF7-330.5[53] /end FUNCTION_LIST /end MEASUREMENT
/begin MEASUREMENT vQLDFOG "Front fog-lamp load steady state compensation air flow-quantity" UBYTE COMP_0051 1 100 0 255 ECU_ADDRESS 0xFFFF16EC /begin FUNCTION_LIST KF7-330.5[53] /end FUNCTION_LIST /end MEASUREMENT
/begin MEASUREMENT vQLDHLH "Headlights (High) load steady state compensation air flow-quantity" UBYTE COMP_0051 1 100 0 255 ECU_ADDRESS 0xFFFF16ED /begin FUNCTION_LIST KF7-330.5[53] /end FUNCTION_LIST /end MEASUREMENT
/begin MEASUREMENT vQLDHLL "Headlights (Low) load steady state compensation air flow-quantity" UBYTE COMP_0051 1 100 0 255 ECU_ADDRESS 0xFFFF16EE /begin FUNCTION_LIST KF7-330.5[53] /end FUNCTION_LIST /end MEASUREMENT
/begin MEASUREMENT vQLDN "For idle stabilization PI compensation" UWORD COMP_0051 1 100 0 65535 ECU_ADDRESS 0xFFFF16F0 /begin FUNCTION_LIST KF7-330.5[53] R301.19.ISC_PID_cont_1_0_2 /end FUNCTION_LIST /end MEASUREMENT
/begin MEASUREMENT vQLDPOS "Position light load steady state compensation air flow-quantity" UBYTE COMP_0051 1 100 0 255 ECU_ADDRESS 0xFFFF16F2 /begin FUNCTION_LIST KF7-330.5[53] /end FUNCTION_LIST /end MEASUREMENT
/begin MEASUREMENT vQLDPS2 "P/S load compensation air flow-quantity" UWORD COMP_0051 1 100 0 65535 ECU_ADDRESS 0xFFFF16F4 /begin FUNCTION_LIST KF7-330.5[53] KF7-386.3[8] R301.6.IscAirflow_1_4_5 /end FUNCTION_LIST /end MEASUREMENT
/begin MEASUREMENT vQLDRED "Rear defogger load steady state compensation air flow-quantity" UBYTE COMP_0051 1 100 0 255 ECU_ADDRESS 0xFFFF16F6 /begin FUNCTION_LIST KF7-330.5[53] /end FUNCTION_LIST /end MEASUREMENT
/begin MEASUREMENT vQLDRFN "Radiator fan load compensation air flow-quantity" UBYTE COMP_0051 1 100 0 255 ECU_ADDRESS 0xFFFF1032 /begin FUNCTION_LIST KF7-330.5[53] KF7-386.3[8] KF7-390.3A[15] /end FUNCTION_LIST /end MEASUREMENT
/begin MEASUREMENT vQNE "Target speed maintenance air flow-quantity" UWORD COMP_0051 1 100 0 65535 ECU_ADDRESS 0xFFFF16F8 /begin FUNCTION_LIST KF7-330.5[53] KF7-390.3A[15] R301.19.ISC_PID_cont_1_0_2 /end FUNCTION_LIST /end MEASUREMENT
/begin MEASUREMENT vQNEDN "Loss in weight compensation reference value" UWORD COMP_0051 1 100 0 65535 ECU_ADDRESS 0xFFFF16FA /begin FUNCTION_LIST KF7-330.9[8] /end FUNCTION_LIST /end MEASUREMENT
/begin MEASUREMENT vQPS "-" UBYTE COMP_0051 1 100 0 255 ECU_ADDRESS 0xFFFF16FD /begin FUNCTION_LIST KF7-330.5[53] /end FUNCTION_LIST /end MEASUREMENT
/begin MEASUREMENT vQPSD2 "The amount of P/S oil pressure change compensation air" UWORD COMP_0220 1 100 0 65535 ECU_ADDRESS 0xFFFF16FE /begin FUNCTION_LIST KF7-330.5[53] /end FUNCTION_LIST /end MEASUREMENT
/begin MEASUREMENT vQPSN "P/S oil pressure proportion compensation air quantity (voltage conversion value)" UBYTE COMP_0220 1 100 0 255 ECU_ADDRESS 0xFFFF1700 /begin FUNCTION_LIST KF7-330.5[53] /end FUNCTION_LIST /end MEASUREMENT
/begin MEASUREMENT vQPSU "Power steering load compensation air quantity (transient state)" UWORD COMP_0142_S 1 100 0 2047.96875 ECU_ADDRESS 0xFFFF1702 /begin FUNCTION_LIST KF7-330.5[53] /end FUNCTION_LIST /end MEASUREMENT
/begin MEASUREMENT vQSISC "A low response compensation flow-quantity" UWORD COMP_0051 1 100 0 65535 ECU_ADDRESS 0xFFFF23F8
 /begin FUNCTION_LIST KF7-330.5[53] KF7-340.1M[8] KF7-350.1P[4] KF7-351.3[11] KF7-580.1[8] R301.6.IscAirflow_1_4_5 /end FUNCTION_LIST
/end MEASUREMENT
/begin MEASUREMENT vQTR "Slowdown control air flow-quantity" UWORD COMP_0324 1 100 0 511.9921875 ECU_ADDRESS 0xFFFF1704 /begin FUNCTION_LIST KF7-330.5[53] R301.6.IscAirflow_1_4_5 /end FUNCTION_LIST /end MEASUREMENT
/begin MEASUREMENT vQTW "Coolant temperature compensation air flow-quantity" UBYTE COMP_0276 1 100 0 1020 ECU_ADDRESS 0xFFFF170C /begin FUNCTION_LIST KF7-330.5[53] KF7-390.3A[15] R301.19.ISC_PID_cont_1_0_2 /end FUNCTION_LIST /end MEASUREMENT
/begin MEASUREMENT vRATILM_S "After the limiter, actual gear ratio" UWORD COMP_0450 1 100 0 63.999056205 ECU_ADDRESS 0xFFFF1C4A /begin FUNCTION_LIST KF7-340.9P[3] /end FUNCTION_LIST /end MEASUREMENT
/begin MEASUREMENT vRATIO "Actual gear ratio" UWORD COMP_0450 1 100 0 63.999056205 ECU_ADDRESS 0xFFFF23FA
 /begin FUNCTION_LIST KF7-330.9[8] KF7-340.6M[2] KF7-340.8M[8] KF7-340.9M[3] KF7-340.9P[3] KF7-340.15[3] KF7-360.8M[4] KF7-360.9M[43] KF7-385.2[18] R301.8.Inverse_filter_1_1_3 /end FUNCTION_LIST
/end MEASUREMENT
/begin MEASUREMENT vRATIO0 "CVT target gear ratio" UWORD COMP_0028 1 100 0 2.5599609375 ECU_ADDRESS 0xFFFF88C6 /begin FUNCTION_LIST KF7-340.11[4] /end FUNCTION_LIST /end MEASUREMENT
/begin MEASUREMENT vRATIOCU "Before gear shift, gear ratio" UWORD COMP_0450 1 100 0 63.999056205 ECU_ADDRESS 0xFFFF1716 /begin FUNCTION_LIST KF7-340.9M[3] /end FUNCTION_LIST /end MEASUREMENT
/begin MEASUREMENT vRATIOC_S "Before gear shift, gear ratio" UWORD COMP_0450 1 100 0 63.999056205 ECU_ADDRESS 0xFFFF1C4E /begin FUNCTION_LIST KF7-340.9P[3] /end FUNCTION_LIST /end MEASUREMENT
/begin MEASUREMENT vRATIOLMT "After the limiter, actual gear ratio" UWORD COMP_0450 1 100 0 63.999056205 ECU_ADDRESS 0xFFFF1718
 /begin FUNCTION_LIST KF7-340.8M[8] KF7-340.9M[3] KF7-340.15[3] KF7-385.2[18] KF7-505.47[3] /end FUNCTION_LIST
/end MEASUREMENT
/begin MEASUREMENT vRATIONE "After gear shift, gear ratio" UWORD COMP_0450 1 100 0 63.999056205 ECU_ADDRESS 0xFFFF171A /begin FUNCTION_LIST KF7-340.9M[3] KF7-385.2[18] /end FUNCTION_LIST /end MEASUREMENT
/begin MEASUREMENT vRATION_S "After gear shift, gear ratio" UWORD COMP_0450 1 100 0 63.999056205 ECU_ADDRESS 0xFFFF1C50 /begin FUNCTION_LIST KF7-340.9P[3] /end FUNCTION_LIST /end MEASUREMENT
/begin MEASUREMENT vRATIOPR "Actual gear ratio switchover preparation value" UWORD COMP_0450 1 100 0 63.999056205 ECU_ADDRESS 0xFFFF30F0 /begin FUNCTION_LIST KF7-340.9M[3] /end FUNCTION_LIST /end MEASUREMENT
/begin MEASUREMENT vRATIOP_S "Actual gear ratio basic value" UWORD COMP_0450 1 100 0 63.999056205 ECU_ADDRESS 0xFFFF1C52 /begin FUNCTION_LIST KF7-340.9P[3] /end FUNCTION_LIST /end MEASUREMENT
/begin MEASUREMENT vRATIO_S "Actual gear ratio" UWORD COMP_0450 1 100 0 63.999056205 ECU_ADDRESS 0xFFFF1C4C /begin FUNCTION_LIST KF7-340.6P[2] KF7-340.8P[8] KF7-340.9P[3] /end FUNCTION_LIST /end MEASUREMENT
/begin MEASUREMENT vREFCNTS "After a start starts, the number of REF input" UBYTE COMP_0030 1 100 0 255 ECU_ADDRESS 0xFFFFA091 /begin FUNCTION_LIST KF7-320A.19[7] /end FUNCTION_LIST /end MEASUREMENT
/begin MEASUREMENT vREVRATIO "Actual gear ratio" UWORD COMP_0450 1 100 0 63.999056205 ECU_ADDRESS 0xFFFF1742 /begin FUNCTION_LIST KF7-340.9M[3] KF7-340.9P[3] /end FUNCTION_LIST /end MEASUREMENT
/begin MEASUREMENT vREVRAT_S "Actual gear ratio" UWORD COMP_0450 1 100 0 63.999056205 ECU_ADDRESS 0xFFFF1C54 /begin FUNCTION_LIST KF7-340.9P[3] /end FUNCTION_LIST /end MEASUREMENT
/begin MEASUREMENT vRTORATE "Up-shift progress rate" UBYTE COMP_0425 1 100 0 99.99999981 ECU_ADDRESS 0xFFFF1777 /begin FUNCTION_LIST KF7-340.9M[3] /end FUNCTION_LIST /end MEASUREMENT
/begin MEASUREMENT vRTOTMP "RATIO switchover value" UWORD COMP_0149_S 1 100 0 7.99985745 ECU_ADDRESS 0xFFFF1778 /begin FUNCTION_LIST KF7-340.9M[3] /end FUNCTION_LIST /end MEASUREMENT
/begin MEASUREMENT vRTOTRN "Actual gear ratio switchover rate" UWORD COMP_0290 1 100 0 0.999985458 ECU_ADDRESS 0xFFFF177A /begin FUNCTION_LIST KF7-340.9M[3] /end FUNCTION_LIST /end MEASUREMENT
/begin MEASUREMENT vRTOTRN_S "Actual gear ratio switchover rate" UWORD COMP_0290 1 100 0 0.999985458 ECU_ADDRESS 0xFFFF1C56 /begin FUNCTION_LIST KF7-340.9P[3] /end FUNCTION_LIST /end MEASUREMENT
/begin MEASUREMENT vSLP "Estimated torque converter speed ratio" UWORD COMP_0456 1 100 0 1.999970916 ECU_ADDRESS 0xFFFF179C /begin FUNCTION_LIST KF7-330.9[8] /end FUNCTION_LIST /end MEASUREMENT
/begin MEASUREMENT vSLPDEC "Torque converter load loss in weight compensation air quantity final value" SWORD COMP_0277 1 100 -32768 32767 ECU_ADDRESS 0xFFFF179E /begin FUNCTION_LIST KF7-330.5[53] KF7-330.9[8] R301.6.IscAirflow_1_4_5 /end FUNCTION_LIST /end MEASUREMENT
/begin MEASUREMENT vSLPDEC0 "Torque converter load loss in weight compensation air quantity basic value" SWORD COMP_0277 1 100 -32768 32767 ECU_ADDRESS 0xFFFF17A0 /begin FUNCTION_LIST KF7-330.9[8] /end FUNCTION_LIST /end MEASUREMENT
/begin MEASUREMENT vSLPISC0 "Torque converter load compensation coefficient" SBYTE COMP_0472 1 100 -2 1.984375 ECU_ADDRESS 0xFFFF1038 /begin FUNCTION_LIST KF7-330.9[8] /end FUNCTION_LIST /end MEASUREMENT
/begin MEASUREMENT vSLPRTO "Speed ratio" UWORD COMP_0610_S 1 100 0 1.06664766 ECU_ADDRESS 0xFFFF17A2 /begin FUNCTION_LIST KF7-340.10M[1] /end FUNCTION_LIST /end MEASUREMENT
/begin MEASUREMENT vSLPRTO_S "Speed ratio" UWORD COMP_0610_S 1 100 0 1.06664766 ECU_ADDRESS 0xFFFF1C58 /begin FUNCTION_LIST KF7-340.10P[N] /end FUNCTION_LIST /end MEASUREMENT
/begin MEASUREMENT vSTPTRN "PTD-ON/ off switchover step value" UWORD COMP_0049_S 1 100 0 1.0026855 ECU_ADDRESS 0xFFFF17C4 /begin FUNCTION_LIST KF7-340.6M[2] /end FUNCTION_LIST /end MEASUREMENT
/begin MEASUREMENT vTADNV "PTD normalized opening area" ULONG COMP_0629_S 1 100 0 0.167772159960938 ECU_ADDRESS 0xFFFF17F0 /begin FUNCTION_LIST KF7-340.2M[2] /end FUNCTION_LIST /end MEASUREMENT
/begin MEASUREMENT vTADNVTE "PTD normalized opening area" ULONG COMP_0303_S 1 100 0 0.167772159960938 ECU_ADDRESS 0xFFFF17F8 /begin FUNCTION_LIST KF7-340.1M[8] KF7-410.17M[5] R301.20.AmbientComp_1_0_2 /end FUNCTION_LIST /end MEASUREMENT
/begin MEASUREMENT vTADNVT_S "PTD normalized opening area" ULONG COMP_0156_S 1 100 0 0.1679332212345 ECU_ADDRESS 0xFFFF1C60 /begin FUNCTION_LIST KF7-340.1P[7] KF7-410.17P[1] R301.20.AmbientComp_1_0_2 /end FUNCTION_LIST /end MEASUREMENT
/begin MEASUREMENT vTADNV_S "PTD normalized opening area" ULONG COMP_0156_S 1 100 0 0.1679332212345 ECU_ADDRESS 0xFFFF1C5C /begin FUNCTION_LIST KF7-340.2P[1] /end FUNCTION_LIST /end MEASUREMENT
/begin MEASUREMENT vTADVMst "At the time of the start, a basic ignition timing" SBYTE COMP_0018 1 100 -128 127 ECU_ADDRESS 0xFFFF17FD /begin FUNCTION_LIST KF7-320A.19[7] KF7-320A.20[2] /end FUNCTION_LIST /end MEASUREMENT
/begin MEASUREMENT vTATEVAPO "An opening area for the VAPO computation" UWORD COMP_0042 1 100 0 52.428 ECU_ADDRESS 0xFFFF32B4 /begin FUNCTION_LIST KF7-340.1M[8] /end FUNCTION_LIST /end MEASUREMENT
/begin MEASUREMENT vTATE_S "PTD torque area conversion value (redundant part)" UWORD COMP_0042 1 100 0 52.428 ECU_ADDRESS 0xFFFF1C64
 /begin FUNCTION_LIST KF7-340.1P[7] KF7-410.17P[1] KF7-505.52[1] R301.20.AmbientComp_1_0_2 R301.21.SafetyLevel2_1_0_2 /end FUNCTION_LIST
/end MEASUREMENT
/begin MEASUREMENT vTE1_W "Normalized input torque" UWORD COMP_0502 1 100 0 1.0000051185 ECU_ADDRESS 0xFFFF1846
 /begin FUNCTION_LIST KF7-320A.15[4] KF7-360.8M[4] R301.8.Inverse_filter_1_1_3 R301.23.ADV_calculation_1_1_2 /end FUNCTION_LIST
/end MEASUREMENT
/begin MEASUREMENT vTE2_W "Inverse filter output torque" UWORD COMP_0502 1 100 0 1.0000051185 ECU_ADDRESS 0xFFFF1858
 /begin FUNCTION_LIST KF7-320A.15[4] KF7-360.8M[4] R301.8.Inverse_filter_1_1_3 R301.23.ADV_calculation_1_1_2 /end FUNCTION_LIST
/end MEASUREMENT
/begin MEASUREMENT vTECOM "Engine torque order value" SWORD COMP_0228 1 100 -3276.8 3276.7 ECU_ADDRESS 0xFFFF4246 /begin FUNCTION_LIST KF7-340.8M[8] KF7-340.8P[8] /end FUNCTION_LIST /end MEASUREMENT
/begin MEASUREMENT vTEINER "The amount of inertia compensation control" UBYTE COMP_0503 1 100 0 102 ECU_ADDRESS 0xFFFF32E1 /begin FUNCTION_LIST KF7-340.11[4] /end FUNCTION_LIST /end MEASUREMENT
/begin MEASUREMENT vTFBYAD "Target air-fuel ratio phase compensation value" UWORD COMP_0057 1 100 0 3.999941832 ECU_ADDRESS 0xFFFF18CC
 /begin FUNCTION_LIST KF7-320A.15[4] KF7-379.3[3] KF7-379.4[1] KF7-379.5[3] KF7-500.16[4] KF7-500.24[10] R301.23.ADV_calculation_1_1_2 /end FUNCTION_LIST
/end MEASUREMENT
/begin MEASUREMENT vTFD0 "The target drive power (before the first-ordered filter)" SWORD COMP_0030_S 1 100 -32768 32767 ECU_ADDRESS 0xFFFF18D6
 /begin FUNCTION_LIST KF7-340.2P[1] KF7-340.3M[1] KF7-340.4[1] KF7-340.6M[2] KF7-340.7[4] KF7-340.8M[8] /end FUNCTION_LIST
/end MEASUREMENT
/begin MEASUREMENT vTFD0_S "Target drive power basic value" SWORD COMP_0030_S 1 100 -32768 32767 ECU_ADDRESS 0xFFFF1C72 /begin FUNCTION_LIST KF7-340.3P[2] KF7-340.6P[2] KF7-340.8P[8] /end FUNCTION_LIST /end MEASUREMENT
/begin MEASUREMENT vTFDAPO "The accelerator course drive power" SWORD COMP_0030_S 1 100 -32768 32767 ECU_ADDRESS 0xFFFF18D8 /begin FUNCTION_LIST KF7-340.6M[2] /end FUNCTION_LIST /end MEASUREMENT
/begin MEASUREMENT vTFDAPO_S "The accelerator course drive power" SWORD COMP_0030_S 1 100 -32768 32767 ECU_ADDRESS 0xFFFF1C74 /begin FUNCTION_LIST KF7-340.6P[2] /end FUNCTION_LIST /end MEASUREMENT
/begin MEASUREMENT vTFDCAN "AT The target drive power for the CVT transmission" SWORD COMP_0030_S 1 100 -32768 32767 ECU_ADDRESS 0xFFFF18DA /begin FUNCTION_LIST KF7-340.5[4] KF7-340.8M[8] KF7-410.19[2] /end FUNCTION_LIST /end MEASUREMENT
/begin MEASUREMENT vTFDCAN_S "AT The target drive power for the CVT transmission" SWORD COMP_0030_S 1 100 -32768 32767 ECU_ADDRESS 0xFFFF1C76 /begin FUNCTION_LIST KF7-340.5P[2] KF7-340.8P[8] /end FUNCTION_LIST /end MEASUREMENT
/begin MEASUREMENT vTFDCOM "ASCD drive power order value" SWORD COMP_0030_S 1 100 -32768 32767 ECU_ADDRESS 0xFFFF32F0 /begin FUNCTION_LIST KF7-340.5[4] KF7-340.8M[8] KF7-340.8P[8] KF7-410.19[2] /end FUNCTION_LIST /end MEASUREMENT
/begin MEASUREMENT vTFDCOMF "AT, ASCD drive power order value for the CVT transmission" SWORD COMP_0030_S 1 100 -32768 32767 ECU_ADDRESS 0xFFFF32F4 /begin FUNCTION_LIST KF7-340.8M[8] KF7-340.8P[8] KF7-410.19[2] /end FUNCTION_LIST /end MEASUREMENT
/begin MEASUREMENT vTFDDS "The Ds range target drive power" SWORD COMP_0030_S 1 100 -32768 32767 ECU_ADDRESS 0xFFFF18DE /begin FUNCTION_LIST KF7-340.3M[1] /end FUNCTION_LIST /end MEASUREMENT
/begin MEASUREMENT vTFDDS_S "The Ds range target drive power (redundant operation vice-operation part)" SWORD COMP_0030_S 1 100 -32768 32767 ECU_ADDRESS 0xFFFF1C7A /begin FUNCTION_LIST KF7-340.3P[2] /end FUNCTION_LIST /end MEASUREMENT
/begin MEASUREMENT vTFDD_S "The D range target drive power (final)" SWORD COMP_0030_S 1 100 -32768 32767 ECU_ADDRESS 0xFFFF1C78 /begin FUNCTION_LIST KF7-340.3P[2] KF7-340.8P[8] /end FUNCTION_LIST /end MEASUREMENT
/begin MEASUREMENT vTFDF "After the filter treatment, TFD" SWORD COMP_0030_S 1 100 -32768 32767 ECU_ADDRESS 0xFFFF18E0 /begin FUNCTION_LIST KF7-340.4[1] KF7-340.6M[2] /end FUNCTION_LIST /end MEASUREMENT
/begin MEASUREMENT vTFDPDP_S "PTD target drive power switchover preparation value" SWORD COMP_0030_S 1 100 -32768 32767 ECU_ADDRESS 0xFFFF1C7C /begin FUNCTION_LIST KF7-340.6P[2] KF7-340.8P[8] /end FUNCTION_LIST /end MEASUREMENT
/begin MEASUREMENT vTFDPDR_S "The PTD target drive power (redundant operation vice-operation part)" SWORD COMP_0030_S 1 100 -32768 32767 ECU_ADDRESS 0xFFFF1C7E /begin FUNCTION_LIST KF7-340.8P[8] /end FUNCTION_LIST /end MEASUREMENT
/begin MEASUREMENT vTFDPTDP "PTD target drive power switchover preparation value" SWORD COMP_0030_S 1 100 -32768 32767 ECU_ADDRESS 0xFFFF18E4 /begin FUNCTION_LIST KF7-340.6M[2] KF7-340.8M[8] /end FUNCTION_LIST /end MEASUREMENT
/begin MEASUREMENT vTFDPTDR "The PTD target drive power" SWORD COMP_0030_S 1 100 -32768 32767 ECU_ADDRESS 0xFFFF18E6 /begin FUNCTION_LIST KF7-340.4[1] KF7-340.8M[8] /end FUNCTION_LIST /end MEASUREMENT
/begin MEASUREMENT vTFDPTD_S "The final target drive power" SWORD COMP_0030_S 1 100 -32768 32767 ECU_ADDRESS 0xFFFF1C80 /begin FUNCTION_LIST KF7-340.8P[8] /end FUNCTION_LIST /end MEASUREMENT
/begin MEASUREMENT vTGADNV "Normalized opening area basic value" ULONG COMP_0303_S 1 100 0 0.167772159960938 ECU_ADDRESS 0xFFFF191C /begin FUNCTION_LIST KF7-340.1M[8] KF7-350.4M[14] R000.1.RS_Integ_1_10_2 /end FUNCTION_LIST /end MEASUREMENT
/begin MEASUREMENT vTGADNV_S "TTAAPO/VOL/NE" ULONG COMP_0303_S 1 100 0 0.167772159960938 ECU_ADDRESS 0xFFFF1C84 /begin FUNCTION_LIST KF7-340.1P[7] KF7-340.2P[1] KF7-340.8P[8] KF7-350.4P[13] /end FUNCTION_LIST /end MEASUREMENT
/begin MEASUREMENT vTGALTV "The voltage (after the change rate limitation) that alternator virtual is directed" UBYTE COMP_0033 1 100 0 20400 ECU_ADDRESS 0xFFFF1920 /begin FUNCTION_LIST KF7-330.5[53] /end FUNCTION_LIST /end MEASUREMENT
/begin MEASUREMENT vTGTVO "Final target throttle open-degree" UWORD COMP_0130 1 100 0 1802.2125 ECU_ADDRESS 0xFFFF40EA
 /begin FUNCTION_LIST KF7-340.1M[8] KF7-350.1M[5] KF7-350.4M[14] KF7-350.4P[13] KF7-360.1[12] KF7-500.1[54] KF7-505.15[4] KF7-505.16[1] KF7-505.32[6] KF7-525.2[6] KF7-525.2S[10] R000.1.RS_Integ_1_10_2 R301.13.FFDforDiagOnCAN_1_1_3 R301.21.SafetyLevel2_1_0_2 R901.1.Diag_on_can_app_1_6_2 R904.1.Gst_on_can_1_0_1 /end FUNCTION_LIST
/end MEASUREMENT
/begin MEASUREMENT vTMDDS "D-Ds switchover parameter" UWORD COMP_0146 1 100 0 99.998480265 ECU_ADDRESS 0xFFFF193E /begin FUNCTION_LIST KF7-340.3M[1] /end FUNCTION_LIST /end MEASUREMENT
/begin MEASUREMENT vTMDDS_S "D-Ds switchover parameter (redundant operation vice-operation part)" UWORD COMP_0146 1 100 0 99.998480265 ECU_ADDRESS 0xFFFF1C88 /begin FUNCTION_LIST KF7-340.3P[2] /end FUNCTION_LIST /end MEASUREMENT
/begin MEASUREMENT vTMFDTRN "PTD-ON/ off switchover rate (main operation value)" UWORD COMP_0410 1 100 0 99.9985458 ECU_ADDRESS 0xFFFF1948
 /begin FUNCTION_LIST KF7-340.6M[2] KF7-340.6P[2] KF7-340.8M[8] KF7-340.8P[8] KF7-340.11[4] /end FUNCTION_LIST
/end MEASUREMENT
/begin MEASUREMENT vTMISSL "Transient state compensation time" UBYTE COMP_0014 1 100 0 2550 ECU_ADDRESS 0xFFFF1950 /begin FUNCTION_LIST KF7-330.9[8] /end FUNCTION_LIST /end MEASUREMENT
/begin MEASUREMENT vTMPDTY "Radiator fan drive Duty storage value" UBYTE COMP_0027 1 100 0 255 ECU_ADDRESS 0xFFFF195E /begin FUNCTION_LIST KF7-330.5[53] KF7-377.1A[19] /end FUNCTION_LIST /end MEASUREMENT
/begin MEASUREMENT vTMQBC "Slowdown load compensation time" UBYTE COMP_0014 1 100 0 2550 ECU_ADDRESS 0xFFFF195F /begin FUNCTION_LIST KF7-330.5[53] /end FUNCTION_LIST /end MEASUREMENT
/begin MEASUREMENT vTMQBCT "Slowdown load compensation time" UBYTE COMP_0014 1 100 0 2550 ECU_ADDRESS 0xFFFF1960 /begin FUNCTION_LIST KF7-330.5[53] /end FUNCTION_LIST /end MEASUREMENT
/begin MEASUREMENT vTNETAGT "NSET0 addition table value" UBYTE COMP_0064 1 100 0 398.4375 ECU_ADDRESS 0xFFFF2251 /begin FUNCTION_LIST KF7-330.4A[53] /end FUNCTION_LIST /end MEASUREMENT
/begin MEASUREMENT vTNSETST "After the start, idle rise time" UBYTE COMP_0049 1 100 0 255 ECU_ADDRESS 0xFFFF1972 /begin FUNCTION_LIST KF7-330.4A[53] KF7-390.3A[15] /end FUNCTION_LIST /end MEASUREMENT
/begin MEASUREMENT vTQH0AP "APO/QH0 conversion value" UWORD COMP_0146 1 100 0 99.998480265 ECU_ADDRESS 0xFFFF19A0
 /begin FUNCTION_LIST KF7-340.1M[8] KF7-340.1P[7] KF7-340.2M[2] KF7-385.3[4] KF7-410.17M[5] KF7-410.17P[1] KF7-500.2A[29] KF7-505.50[1] KF7-525.2[6] KF7-525.2S[10] R301.20.AmbientComp_1_0_2 R301.21.SafetyLevel2_1_0_2 /end FUNCTION_LIST
/end MEASUREMENT
/begin MEASUREMENT vTQH0AP_S "APO/QH0 conversion value (redundant)" UWORD COMP_0146 1 100 0 99.998480265 ECU_ADDRESS 0xFFFF1C8A
 /begin FUNCTION_LIST KF7-340.1P[7] KF7-340.2P[1] KF7-505.50[1] R301.21.SafetyLevel2_1_0_2 /end FUNCTION_LIST
/end MEASUREMENT
/begin MEASUREMENT vTQH0PD_S "PTD basic volume flow-quantity ratio" UWORD COMP_0146 1 100 0 99.998480265 ECU_ADDRESS 0xFFFF1C8C /begin FUNCTION_LIST KF7-340.1P[7] KF7-410.17P[1] R301.20.AmbientComp_1_0_2 /end FUNCTION_LIST /end MEASUREMENT
/begin MEASUREMENT vTQH0PTD "PTD basic volume flow-quantity ratio" UWORD COMP_0146 1 100 0 99.998480265 ECU_ADDRESS 0xFFFF19A6
 /begin FUNCTION_LIST KF7-340.1M[8] KF7-340.1P[7] KF7-410.17M[5] R301.20.AmbientComp_1_0_2 /end FUNCTION_LIST
/end MEASUREMENT
/begin MEASUREMENT vTQH0ST "Target basic volume flow-quantity ratio" UWORD COMP_0146 1 100 0 99.998480265 ECU_ADDRESS 0xFFFF19A8 /begin FUNCTION_LIST KF7-340.1M[8] KF7-350.4M[14] /end FUNCTION_LIST /end MEASUREMENT
/begin MEASUREMENT vTQH0ST_S "Target basic volume flow-quantity ratio" UWORD COMP_0410 1 100 0 99.9985458 ECU_ADDRESS 0xFFFF1C8E /begin FUNCTION_LIST KF7-340.1P[7] KF7-340.2P[1] KF7-340.8P[8] KF7-350.4P[13] /end FUNCTION_LIST /end MEASUREMENT
/begin MEASUREMENT vTQH0TE "Torque QH0 conversion value" UWORD COMP_0146 1 100 0 99.998480265 ECU_ADDRESS 0xFFFF19AA /begin FUNCTION_LIST KF7-340.1M[8] KF7-410.17M[5] R301.20.AmbientComp_1_0_2 /end FUNCTION_LIST /end MEASUREMENT
/begin MEASUREMENT vTQH0TE_S "Torque QH0 conversion value" UWORD COMP_0146 1 100 0 99.998480265 ECU_ADDRESS 0xFFFF1C90 /begin FUNCTION_LIST KF7-340.1P[7] KF7-410.17P[1] R301.20.AmbientComp_1_0_2 /end FUNCTION_LIST /end MEASUREMENT
/begin MEASUREMENT vTRADVnew "Initial retard quantity latest value" UBYTE COMP_0017 1 100 0 255 ECU_ADDRESS 0xFFFF19B0 /begin FUNCTION_LIST KF7-320A.15[4] R301.23.ADV_calculation_1_1_2 /end FUNCTION_LIST /end MEASUREMENT
/begin MEASUREMENT vTRGEVA "Evaporator target temperature" UBYTE COMP_0591_S 1 100 -30 54.9999915 ECU_ADDRESS 0xFFFF89CD /begin FUNCTION_LIST KF7-330.4A[53] KF7-580.1[8] /end FUNCTION_LIST /end MEASUREMENT
/begin MEASUREMENT vTRQNTU_S "Rotation synchronous control target torque (vice-operation part)" SWORD COMP_0228 1 100 -3276.8 3276.7 ECU_ADDRESS 0xFFFF352A /begin FUNCTION_LIST KF7-340.1P[7] KF7-360.9P[22] /end FUNCTION_LIST /end MEASUREMENT
/begin MEASUREMENT vTRQRTO "Torque converter torque ratio" UWORD COMP_0450 1 100 0 63.999056205 ECU_ADDRESS 0xFFFF19C8
 /begin FUNCTION_LIST KF7-340.6M[2] KF7-340.8M[8] KF7-340.10M[1] KF7-340.15[3] KF7-360.9M[43] /end FUNCTION_LIST
/end MEASUREMENT
/begin MEASUREMENT vTRQRTO_S "Torque converter torque ratio" UWORD COMP_0450 1 100 0 63.999056205 ECU_ADDRESS 0xFFFF1C92 /begin FUNCTION_LIST KF7-340.6P[2] KF7-340.8P[8] KF7-340.10P[N] /end FUNCTION_LIST /end MEASUREMENT
/begin MEASUREMENT vTRSLP "The amount of torque converter load loss in weight compensation air quantity transient state compensation" UWORD COMP_0051 1 100 0 65535 ECU_ADDRESS 0xFFFF19CC /begin FUNCTION_LIST KF7-330.9[8] /end FUNCTION_LIST /end MEASUREMENT
/begin MEASUREMENT vTTEACC "ACC torque order value" SWORD COMP_0228 1 100 -3276.8 3276.7 ECU_ADDRESS 0xFFFF89D0 /begin FUNCTION_LIST KF7-340.8M[8] KF7-340.8P[8] /end FUNCTION_LIST /end MEASUREMENT
/begin MEASUREMENT vTTEACC_S "ACC torque order value reversal value" SWORD COMP_0228 1 100 -3276.8 3276.7 ECU_ADDRESS 0xFFFF89E8 /begin FUNCTION_LIST KF7-340.8M[8] KF7-340.8P[8] /end FUNCTION_LIST /end MEASUREMENT
/begin MEASUREMENT vTTEAPO_S "Accelerator requested torque" SWORD COMP_0228 1 100 -3276.8 3276.7 ECU_ADDRESS 0xFFFF1C96 /begin FUNCTION_LIST KF7-340.2P[1] KF7-340.6P[2] KF7-340.8P[8] /end FUNCTION_LIST /end MEASUREMENT
/begin MEASUREMENT vTTEHOS1 "Target torque speed compensation value" UWORD COMP_0271 1 100 0 199.99696053 ECU_ADDRESS 0xFFFF19E2 /begin FUNCTION_LIST KF7-340.8M[8] KF7-340.8P[8] /end FUNCTION_LIST /end MEASUREMENT
/begin MEASUREMENT vTTEIF "Inverse filter output torque" SWORD COMP_0228 1 100 -3276.8 3276.7 ECU_ADDRESS 0xFFFF2444
 /begin FUNCTION_LIST KF7-340.11[4] KF7-360.8M[4] KF7-360.9M[43] KF7-385.3[4] R000.1.RS_Integ_1_10_2 R301.5.FuelCut_1_2_2 R301.8.Inverse_filter_1_1_3 /end FUNCTION_LIST
/end MEASUREMENT
/begin MEASUREMENT vTTEPD0_S "PTD target torque basic value" SWORD COMP_0228 1 100 -3276.8 3276.7 ECU_ADDRESS 0xFFFF352E /begin FUNCTION_LIST KF7-340.8P[8] /end FUNCTION_LIST /end MEASUREMENT
/begin MEASUREMENT vTTEPD1_S "After speed compensation, target torque" SWORD COMP_0228 1 100 -3276.8 3276.7 ECU_ADDRESS 0xFFFF3530 /begin FUNCTION_LIST KF7-340.8P[8] /end FUNCTION_LIST /end MEASUREMENT
/begin MEASUREMENT vTTEPDP_S "PTD target torque switchover preparation value (redundant operation vice-operation part)" SWORD COMP_0228 1 100 -3276.8 3276.7 ECU_ADDRESS 0xFFFF1CA0 /begin FUNCTION_LIST KF7-340.8P[8] /end FUNCTION_LIST /end MEASUREMENT
/begin MEASUREMENT vTTEPHH "After highlands, heat area compensation, PTD requested torque" SWORD COMP_0228 1 100 -3276.8 3276.7 ECU_ADDRESS 0xFFFF19F4 /begin FUNCTION_LIST KF7-340.1M[8] KF7-410.17M[5] /end FUNCTION_LIST /end MEASUREMENT
/begin MEASUREMENT vTTEPHH_S "Highlands, heat area compensation value PTD requested torque" SWORD COMP_0228 1 100 -3276.8 3276.7 ECU_ADDRESS 0xFFFF3536 /begin FUNCTION_LIST KF7-340.1P[7] KF7-410.17P[1] /end FUNCTION_LIST /end MEASUREMENT
/begin MEASUREMENT vTTEPTD0 "PTD target engine torque basic value" SWORD COMP_0228 1 100 -3276.8 3276.7 ECU_ADDRESS 0xFFFF19F6 /begin FUNCTION_LIST KF7-340.8M[8] /end FUNCTION_LIST /end MEASUREMENT
/begin MEASUREMENT vTTEPTD1 "After speed compensation, target torque" SWORD COMP_0228 1 100 -3276.8 3276.7 ECU_ADDRESS 0xFFFF19F8 /begin FUNCTION_LIST KF7-340.8M[8] /end FUNCTION_LIST /end MEASUREMENT
/begin MEASUREMENT vTTEPTDP "PTD target torque switchover preparation value" SWORD COMP_0228 1 100 -3276.8 3276.7 ECU_ADDRESS 0xFFFF19FA /begin FUNCTION_LIST KF7-340.8M[8] /end FUNCTION_LIST /end MEASUREMENT
/begin MEASUREMENT vTTEPTD_S "PTD target torque (redundant operation vice-operation part)" SWORD COMP_0228 1 100 -3276.8 3276.7 ECU_ADDRESS 0xFFFF1CA2 /begin FUNCTION_LIST KF7-340.8P[8] KF7-505.51[2] /end FUNCTION_LIST /end MEASUREMENT
/begin MEASUREMENT vTTEP_S "PTD requested torque redundant operation side" SWORD COMP_0228 1 100 -3276.8 3276.7 ECU_ADDRESS 0xFFFF1C9A /begin FUNCTION_LIST KF7-340.1P[7] KF7-505.53[1] R301.21.SafetyLevel2_1_0_2 /end FUNCTION_LIST /end MEASUREMENT
/begin MEASUREMENT vTTPST "The amount of target basic cylinder intake" UWORD COMP_0052 1 100 0 31.99956087 ECU_ADDRESS 0xFFFF3410 /begin FUNCTION_LIST KF7-340.1M[8] KF7-350.4M[14] KF7-450.5[1] /end FUNCTION_LIST /end MEASUREMENT
/begin MEASUREMENT vTVODSP "QDSPT TVO compensation value" UBYTE COMP_0021 1 100 0 99.609375 ECU_ADDRESS 0xFFFF1A3A /begin FUNCTION_LIST KF7-330.5[53] R301.26.Dashpot_DandN_1_0_2 /end FUNCTION_LIST /end MEASUREMENT
/begin MEASUREMENT vTWISC0 "Coolant temperature compensation value" UBYTE COMP_0009 1 100 0 199.21875 ECU_ADDRESS 0xFFFF1A41 /begin FUNCTION_LIST KF7-330.5[53] R301.6.IscAirflow_1_4_5 /end FUNCTION_LIST /end MEASUREMENT
/begin MEASUREMENT vVAPOz4 "Before VAPOi* 10mS" UWORD COMP_0005 1 100 0 7208.85 ECU_ADDRESS 0xFFFF1A74 /begin FUNCTION_LIST KF7-320A.15[4] R301.23.ADV_calculation_1_1_2 /end FUNCTION_LIST /end MEASUREMENT
/begin MEASUREMENT vVSPNET "NSET0 addition table reference vehicle speed" UBYTE COMP_0647_S 1 100 0 15.9375 ECU_ADDRESS 0xFFFF2287 /begin FUNCTION_LIST KF7-330.4A[53] /end FUNCTION_LIST /end MEASUREMENT
/begin MEASUREMENT vVTCDEVL "The deviation (the left bank) of the VTC operation angle" UBYTE COMP_0256 1 100 -64 63.5 ECU_ADDRESS 0xFFFF1AC0 /begin FUNCTION_LIST KF7-320A.22[5] /end FUNCTION_LIST /end MEASUREMENT
/begin MEASUREMENT vVTCDEVR "The deviation (the right bank) of the VTC operation angle" UBYTE COMP_0256 1 100 -64 63.5 ECU_ADDRESS 0xFFFF1AC1 /begin FUNCTION_LIST KF7-320A.22[5] /end FUNCTION_LIST /end MEASUREMENT
/begin MEASUREMENT vVTCNK "The amount of VTC knock compensation" UBYTE COMP_0245 1 100 -64 191 ECU_ADDRESS 0xFFFF1B53 /begin FUNCTION_LIST KF7-320A.22[5] /end FUNCTION_LIST /end MEASUREMENT
/begin MEASUREMENT vVTCNKL "VTC knock compensation quantity (the left bank)" UBYTE COMP_0245 1 100 -64 191 ECU_ADDRESS 0xFFFF1B54 /begin FUNCTION_LIST KF7-320A.22[5] /end FUNCTION_LIST /end MEASUREMENT
/begin MEASUREMENT vVTCNKR "VTC knock compensation quantity (the right bank)" UBYTE COMP_0245 1 100 -64 191 ECU_ADDRESS 0xFFFF1B55 /begin FUNCTION_LIST KF7-320A.22[5] /end FUNCTION_LIST /end MEASUREMENT
/begin MEASUREMENT vVTCNKTP "VTCNK threshold" UBYTE COMP_0001 1 100 0 31.875 ECU_ADDRESS 0xFFFF1B56 /begin FUNCTION_LIST KF7-320A.22[5] /end FUNCTION_LIST /end MEASUREMENT
/begin MEASUREMENT vVTCNOW "An incumbent VTC operation angle" UBYTE COMP_0256 1 100 -64 63.5 ECU_ADDRESS 0xFFFF2450
 /begin FUNCTION_LIST KF7-320A.22[5] KF7-350.4M[14] KF7-393.1C[8] KF7-500.7[12] KF7-500.47B[15] KF7-580.1[8] R301.13.FFDforDiagOnCAN_1_1_3 R901.1.Diag_on_can_app_1_6_2 /end FUNCTION_LIST
/end MEASUREMENT
/begin MEASUREMENT vVTCNOW_R#1 "An incumbent VTC operation angle" UBYTE COMP_0256 1 100 -64 63.5 ECU_ADDRESS 0xFFFF2450
 /begin FUNCTION_LIST KF7-320A.22[5] KF7-350.4M[14] KF7-393.1C[8] KF7-500.7[12] KF7-500.47B[15] KF7-580.1[8] R301.13.FFDforDiagOnCAN_1_1_3 R901.1.Diag_on_can_app_1_6_2 /end FUNCTION_LIST
/end MEASUREMENT
/begin MEASUREMENT vVTCNOW_R#2 "An incumbent VTC operation angle" UBYTE COMP_0256 1 100 -64 63.5 ECU_ADDRESS 0xFFFF2451
 /begin FUNCTION_LIST KF7-320A.22[5] KF7-350.4M[14] KF7-393.1C[8] KF7-500.7[12] KF7-500.47B[15] KF7-580.1[8] R301.13.FFDforDiagOnCAN_1_1_3 R901.1.Diag_on_can_app_1_6_2 /end FUNCTION_LIST
/end MEASUREMENT
/begin MEASUREMENT vVTCNOWI "VTC operation angle" UBYTE COMP_0256 1 100 -64 63.5 ECU_ADDRESS 0xFFFF1046 /begin FUNCTION_LIST KF7-320A.22[5] KF7-580.1[8] /end FUNCTION_LIST /end MEASUREMENT
/begin MEASUREMENT vVTCNOWI_R#1 "VTC operation angle" UBYTE COMP_0256 1 100 -64 63.5 ECU_ADDRESS 0xFFFF1046 /begin FUNCTION_LIST KF7-320A.22[5] KF7-580.1[8] /end FUNCTION_LIST /end MEASUREMENT
/begin MEASUREMENT vVTCNOWI_R#2 "VTC operation angle" UBYTE COMP_0256 1 100 -64 63.5 ECU_ADDRESS 0xFFFF1047 /begin FUNCTION_LIST KF7-320A.22[5] KF7-580.1[8] /end FUNCTION_LIST /end MEASUREMENT
/begin MEASUREMENT vVTCTRGI "VTC target angle" UBYTE COMP_0256 1 100 -64 63.5 ECU_ADDRESS 0xFFFF104A /begin FUNCTION_LIST KF7-320A.22[5] KF7-500.6D[9] KF7-580.1[8] /end FUNCTION_LIST /end MEASUREMENT
/begin MEASUREMENT vVTCTRH "VTC target operation angle computed map reference value (at the time of the high coolant temperature)" UBYTE COMP_0256 1 100 -64 63.5 ECU_ADDRESS 0xFFFF1BB6 /begin FUNCTION_LIST KF7-320A.22[5] KF7-393.1C[8] /end FUNCTION_LIST /end MEASUREMENT
/begin MEASUREMENT vVTCTRHI "Basic target angle computed map reference value" UBYTE COMP_0256 1 100 -64 63.5 ECU_ADDRESS 0xFFFF1BB9 /begin FUNCTION_LIST KF7-320A.22[5] /end FUNCTION_LIST /end MEASUREMENT
/begin MEASUREMENT vVTCTRL "VTC target operation angle computed map reference value (at the time of the low coolant temperature)" UBYTE COMP_0256 1 100 -64 63.5 ECU_ADDRESS 0xFFFF1BBA /begin FUNCTION_LIST KF7-320A.22[5] KF7-393.1C[8] /end FUNCTION_LIST /end MEASUREMENT
/begin MEASUREMENT vVTCTRLI "Basic target angle computed map reference value (a low coolant temperature)" UBYTE COMP_0256 1 100 -64 63.5 ECU_ADDRESS 0xFFFF1BBD /begin FUNCTION_LIST KF7-320A.22[5] /end FUNCTION_LIST /end MEASUREMENT
/begin MEASUREMENT vVTCTRM "The amount of VTCMBT compensation" UBYTE COMP_0245 1 100 -64 191 ECU_ADDRESS 0xFFFF1BBE /begin FUNCTION_LIST KF7-320A.22[5] /end FUNCTION_LIST /end MEASUREMENT
/begin MEASUREMENT vVTCTRML "VTCMBT compensation quantity (the left bank)" UBYTE COMP_0245 1 100 -64 191 ECU_ADDRESS 0xFFFF1BBF /begin FUNCTION_LIST KF7-320A.22[5] /end FUNCTION_LIST /end MEASUREMENT
/begin MEASUREMENT vVTCTRMR "VTCMBT compensation quantity (the right bank)" UBYTE COMP_0245 1 100 -64 191 ECU_ADDRESS 0xFFFF1BC0 /begin FUNCTION_LIST KF7-320A.22[5] /end FUNCTION_LIST /end MEASUREMENT
/begin MEASUREMENT vZADDFD "The control addition drive power for the area attribute" SWORD COMP_0030_S 1 100 -32768 32767 ECU_ADDRESS 0xFFFF1C28 /begin FUNCTION_LIST KF7-340.8M[8] KF7-340.8P[8] KF7-340.16[4] /end FUNCTION_LIST /end MEASUREMENT
/begin MEASUREMENT wvATRNG "AT shift range signal" UBYTE COMP_0068 1 100 0 255 ECU_ADDRESS 0xFFFF47E8 /begin FUNCTION_LIST KF7-340.9M[3] KF7-340.9P[3] KF7-360.9M[43] /end FUNCTION_LIST /end MEASUREMENT
/begin MEASUREMENT wvBATCURK "Battery balance electric current weighted average value" UWORD COMP_0558_S 1 100 -128 127.99609375 ECU_ADDRESS 0xFFFF88EC /begin FUNCTION_LIST KF7-330.4A[53] KF7-330.5[53] KF7-351.2[17] /end FUNCTION_LIST /end MEASUREMENT
/begin MEASUREMENT wvDEVATMP "Evaporator temperature deviation" UBYTE COMP_0570_S 1 100 0 84.9999915 ECU_ADDRESS 0xFFFF88F1 /begin FUNCTION_LIST KF7-330.4A[53] KF7-377.1A[19] /end FUNCTION_LIST /end MEASUREMENT
/begin MEASUREMENT wvETSMODE "E-TS actual mode signal" UBYTE COMP_0068 1 100 0 255 ECU_ADDRESS 0xFFFF4834 /begin FUNCTION_LIST KF7-330.4A[53] KF7-360.7M[9] /end FUNCTION_LIST /end MEASUREMENT
/begin MEASUREMENT wvEVATMP "Evaporator actual temperature" UBYTE COMP_0591_S 1 100 -30 54.9999915 ECU_ADDRESS 0xFFFF8908 /begin FUNCTION_LIST KF7-330.4A[53] KF7-580.1[8] /end FUNCTION_LIST /end MEASUREMENT
/begin MEASUREMENT wvHNRPM10 "Engine speed (100mS sample value)" UBYTE COMP_0020 1 100 0 12750 ECU_ADDRESS 0xFFFF8918 /begin FUNCTION_LIST KF7-320A.19[7] /end FUNCTION_LIST /end MEASUREMENT
/begin MEASUREMENT wvINDGP "M range gear position signal" UBYTE COMP_0068 1 100 0 255 ECU_ADDRESS 0xFFFF891C /begin FUNCTION_LIST KF7-330.5[53] KF7-340.7[4] /end FUNCTION_LIST /end MEASUREMENT
/begin MEASUREMENT wvNETARGET "Idle speed target value" UWORD COMP_0476 1 100 0 12799.8046875 ECU_ADDRESS 0xFFFF8A12
 /begin FUNCTION_LIST KF7-330.4A[53] KF7-330.5[53] KF7-390.3A[15] KF7-500.7[12] KF7-500.38A[4] /end FUNCTION_LIST
/end MEASUREMENT
/begin MEASUREMENT wvRATIO0 "CVT target gear ratio" UWORD COMP_0028 1 100 0 2.5599609375 ECU_ADDRESS 0xFFFF88C0 /begin FUNCTION_LIST KF7-340.11[4] /end FUNCTION_LIST /end MEASUREMENT
/begin MEASUREMENT wvREFCNTS "After a start starts, the number of REF input" UBYTE COMP_0030 1 100 0 255 ECU_ADDRESS 0xFFFFA090 /begin FUNCTION_LIST KF7-320A.19[7] /end FUNCTION_LIST /end MEASUREMENT
/begin MEASUREMENT wvTRGEVA "Evaporator target temperature" UBYTE COMP_0591_S 1 100 -30 54.9999915 ECU_ADDRESS 0xFFFF8941 /begin FUNCTION_LIST KF7-330.4A[53] KF7-580.1[8] /end FUNCTION_LIST /end MEASUREMENT
/begin MEASUREMENT wvTTEACC "ACC torque order value" SWORD COMP_0228 1 100 -3276.8 3276.7 ECU_ADDRESS 0xFFFF8944 /begin FUNCTION_LIST KF7-340.8M[8] KF7-340.8P[8] /end FUNCTION_LIST /end MEASUREMENT
/begin MEASUREMENT wvTTEACC_S "ACC torque order value reversal value" SWORD COMP_0228 1 100 -3276.8 3276.7 ECU_ADDRESS 0xFFFF895C /begin FUNCTION_LIST KF7-340.8M[8] KF7-340.8P[8] /end FUNCTION_LIST /end MEASUREMENT
/begin MEASUREMENT VSPRNG "RAM value VSPRNG" UBYTE COMP_0068 1 100 0 255 ECU_ADDRESS 0xFFFF9CFC
 /begin FUNCTION_LIST KF7-330.9[8] KF7-340.13[4] KF7-500.2A[29] KF7-505.47[3] KF7-505.49[3] KF7-525.2[6] KF7-525.2S[10] /end FUNCTION_LIST
/end MEASUREMENT
/* COMPU_METHOD --------------------------------------------------------- */
/begin COMPU_METHOD COMP_0017 "1deg" RAT_FUNC "%8.2" "deg" COEFFS 0 1 0 0 0 1 /end COMPU_METHOD
/begin COMPU_METHOD COMP_0205_S "fixed axis Long" RAT_FUNC "%8.2" "Long" COEFFS 0 1 0 0 0 1 /end COMPU_METHOD
/begin COMPU_METHOD COMP_0290 "1/65536-" RAT_FUNC "%8.6" "-" COEFFS 0 1 0 0 0 0.0000152588 /end COMPU_METHOD
/begin COMPU_METHOD COMP_0068 "1-" RAT_FUNC "%8.2" "-" COEFFS 0 1 0 0 0 1 /end COMPU_METHOD
/begin COMPU_METHOD COMP_0004 "1Å|" RAT_FUNC "%8.2" "Å|" COEFFS 0 1 0 0 0 1 /end COMPU_METHOD
/begin COMPU_METHOD COMP_0429 "1km/h" RAT_FUNC "%8.2" "km/h" COEFFS 0 1 0 0 0 1 /end COMPU_METHOD
/begin COMPU_METHOD COMP_0186 "1/64-" RAT_FUNC "%8.3" "-" COEFFS 0 1 0 0 0 0.015625 /end COMPU_METHOD
/begin COMPU_METHOD COMP_0001 "1/8ms" RAT_FUNC "%8.2" "ms" COEFFS 0 1 0 0 0 0.125 /end COMPU_METHOD
/begin COMPU_METHOD COMP_0020 "50rpm" RAT_FUNC "%8.2" "rpm" COEFFS 0 1 0 0 0 50 /end COMPU_METHOD
/begin COMPU_METHOD COMP_0002 "0.35deg" RAT_FUNC "%8.2" "deg" COEFFS 0 1 0 0 0 0.35 /end COMPU_METHOD
/begin COMPU_METHOD COMP_0014 "10ms" RAT_FUNC "%8.2" "ms" COEFFS 0 1 0 0 0 10 /end COMPU_METHOD
/begin COMPU_METHOD COMP_0006 "12.5rpm" RAT_FUNC "%8.2" "rpm" COEFFS 0 1 0 0 0 12.5 /end COMPU_METHOD
/begin COMPU_METHOD COMP_0008 "100ms" RAT_FUNC "%8.2" "ms" COEFFS 0 1 0 0 0 100 /end COMPU_METHOD
/begin COMPU_METHOD COMP_0196 "0.1Nm" RAT_FUNC "%8.2" "Nm" COEFFS 0 1 0 0 0 0.1 /end COMPU_METHOD
/begin COMPU_METHOD COMP_0009 "100/128%" RAT_FUNC "%8.2" "%" COEFFS 0 1 0 0 0 0.78125 /end COMPU_METHOD
/begin COMPU_METHOD COMP_0013 "1s" RAT_FUNC "%8.2" "s" COEFFS 0 1 0 0 0 1 /end COMPU_METHOD
/begin COMPU_METHOD COMP_0000 "25rpm" RAT_FUNC "%8.2" "rpm" COEFFS 0 1 0 0 0 25 /end COMPU_METHOD
/begin COMPU_METHOD COMP_0014_S "NN" RAT_FUNC "%8.2" "N" COEFFS 0 1 0 0 0 1 /end COMPU_METHOD
/begin COMPU_METHOD COMP_0436 "0.1km/h" RAT_FUNC "%8.2" "km/h" COEFFS 0 1 0 0 0 0.1 /end COMPU_METHOD
/begin COMPU_METHOD COMP_0018 "1deg" RAT_FUNC "%8.2" "deg" COEFFS 0 1 0 0 0 1 /end COMPU_METHOD
/begin COMPU_METHOD COMP_0007 "2km/h" RAT_FUNC "%8.2" "km/h" COEFFS 0 1 0 0 0 2 /end COMPU_METHOD
/begin COMPU_METHOD COMP_0021 "100/256%" RAT_FUNC "%8.2" "%" COEFFS 0 1 0 0 0 0.390625 /end COMPU_METHOD
/begin COMPU_METHOD COMP_0033 "80mV" RAT_FUNC "%8.2" "mV" COEFFS 0 1 0 0 0 80 /end COMPU_METHOD
/begin COMPU_METHOD COMP_0027 "1%" RAT_FUNC "%8.2" "%" COEFFS 0 1 0 0 0 1 /end COMPU_METHOD
/begin COMPU_METHOD COMP_0049 "1sec" RAT_FUNC "%8.2" "sec" COEFFS 0 1 0 0 0 1 /end COMPU_METHOD
/begin COMPU_METHOD COMP_0032 "1/256Å|" RAT_FUNC "%8.4" "Å|" COEFFS 0 1 0 0 0 0.00390625 /end COMPU_METHOD
/begin COMPU_METHOD COMP_0063 "1/256-" RAT_FUNC "%8.4" "-" COEFFS 0 1 0 0 0 0.00390625 /end COMPU_METHOD
/begin COMPU_METHOD COMP_0130 "0.0275deg" RAT_FUNC "%8.3" "deg" COEFFS 0 1 0 0 0 0.0275 /end COMPU_METHOD
/begin COMPU_METHOD COMP_0030 "1âÒ" RAT_FUNC "%8.2" "âÒ" COEFFS 0 1 0 0 0 1 /end COMPU_METHOD
/begin COMPU_METHOD COMP_0443 "1rpm" RAT_FUNC "%8.2" "rpm" COEFFS 0 1 0 0 0 1 /end COMPU_METHOD
/begin COMPU_METHOD COMP_0053_S "deg/150msdeg/150m" RAT_FUNC "%8.2" "deg/150m" COEFFS 0 1 0 0 0 0.35 /end COMPU_METHOD
/begin COMPU_METHOD COMP_0005 "0.11deg" RAT_FUNC "%8.2" "deg" COEFFS 0 1 0 0 0 0.11 /end COMPU_METHOD
/begin COMPU_METHOD COMP_0040 "0.11Å|" RAT_FUNC "%8.2" "Å|" COEFFS 0 1 0 0 0 0.11 /end COMPU_METHOD
/begin COMPU_METHOD COMP_0035_S "∂≥›ƒ∂≥›ƒ" RAT_FUNC "%8.2" "∂≥›ƒ" COEFFS 0 1 0 0 0 1 /end COMPU_METHOD
/begin COMPU_METHOD COMP_0046 "1l/min" RAT_FUNC "%8.2" "l/min" COEFFS 0 1 0 0 0 1 /end COMPU_METHOD
/begin COMPU_METHOD COMP_0048 "64/128degCA" RAT_FUNC "%8.2" "degCA" COEFFS 0 1 0 0 0 0.5 /end COMPU_METHOD
/begin COMPU_METHOD COMP_0054 "20mV" RAT_FUNC "%8.2" "mV" COEFFS 0 1 0 0 0 20 /end COMPU_METHOD
/begin COMPU_METHOD COMP_0050 "5/64mV" RAT_FUNC "%8.3" "mV" COEFFS 0 1 0 0 0 0.078125 /end COMPU_METHOD
/begin COMPU_METHOD COMP_0035 "X-50Åé" RAT_FUNC "%8.2" "Åé" COEFFS 0 1 50 0 0 1 /end COMPU_METHOD
/begin COMPU_METHOD COMP_0228 "0.1Nm" RAT_FUNC "%8.2" "Nm" COEFFS 0 1 0 0 0 0.1 /end COMPU_METHOD
/begin COMPU_METHOD COMP_0262 "12.5rpm" RAT_FUNC "%8.2" "rpm" COEFFS 0 1 0 0 0 12.5 /end COMPU_METHOD
/begin COMPU_METHOD COMP_0085 "100/256/0.11deg" RAT_FUNC "%8.2" "/0.11deg" COEFFS 0 1 0 0 0 0.390625 /end COMPU_METHOD
/begin COMPU_METHOD COMP_0391_S "100/256%/100ms" RAT_FUNC "%8.2" "%/100ms" COEFFS 0 1 0 0 0 0.390625 /end COMPU_METHOD
/begin COMPU_METHOD COMP_0097 "1/64L/min" RAT_FUNC "%8.3" "L/min" COEFFS 0 1 0 0 0 0.015625 /end COMPU_METHOD
/begin COMPU_METHOD COMP_0051 "1L/min" RAT_FUNC "%8.2" "L/min" COEFFS 0 1 0 0 0 1 /end COMPU_METHOD
/begin COMPU_METHOD COMP_0327 "1/32768-" RAT_FUNC "%8.6" "-" COEFFS 0 1 0 0 0 0.0000305 /end COMPU_METHOD
/begin COMPU_METHOD COMP_0410 "100/256/256%" RAT_FUNC "%8.4" "%" COEFFS 0 1 0 0 0 0.00152588 /end COMPU_METHOD
/begin COMPU_METHOD COMP_0425 "100/255%" RAT_FUNC "%8.2" "%" COEFFS 0 1 0 0 0 0.392156862 /end COMPU_METHOD
/begin COMPU_METHOD COMP_0397_S "0.78125rpm/(0.6" RAT_FUNC "%8.2" "rpm/(0.6" COEFFS 0 1 0 0 0 0.78125 /end COMPU_METHOD
/begin COMPU_METHOD COMP_0222_S "37629L/min/0." RAT_FUNC "%8.2" "L/min/0." COEFFS 0 1 0 0 0 0.125 /end COMPU_METHOD
/begin COMPU_METHOD COMP_0115 "100/65536%" RAT_FUNC "%8.4" "%" COEFFS 0 1 0 0 0 0.0015259 /end COMPU_METHOD
/begin COMPU_METHOD COMP_0223_S "1/256/20l/min/mV" RAT_FUNC "%8.5" "l/min/mV" COEFFS 0 1 0 0 0 0.000195 /end COMPU_METHOD
/begin COMPU_METHOD COMP_0224_S "2/64L/min/10" RAT_FUNC "%8.3" "L/min/10" COEFFS 0 1 0 0 0 0.03125 /end COMPU_METHOD
/begin COMPU_METHOD COMP_0225_S "2/256l/min/10" RAT_FUNC "%8.4" "l/min/10" COEFFS 0 1 0 0 0 0.0078125 /end COMPU_METHOD
/begin COMPU_METHOD COMP_0077 "0.11deg/40ms" RAT_FUNC "%8.2" "deg/40ms" COEFFS 0 1 0 0 0 0.11 /end COMPU_METHOD
/begin COMPU_METHOD COMP_0456 "1/(256Å~128)-" RAT_FUNC "%8.6" "-" COEFFS 0 1 0 0 0 0.0000305176 /end COMPU_METHOD
/begin COMPU_METHOD COMP_0256 "64/128degCA" RAT_FUNC "%8.2" "degCA" COEFFS 0 1 64 0 0 0.5 /end COMPU_METHOD
/begin COMPU_METHOD COMP_0277 "1L/min" RAT_FUNC "%8.2" "L/min" COEFFS 0 1 0 0 0 1 /end COMPU_METHOD
/begin COMPU_METHOD COMP_0450 "1/1024-" RAT_FUNC "%8.5" "-" COEFFS 0 1 0 0 0 0.000976563 /end COMPU_METHOD
/begin COMPU_METHOD COMP_0064 "1.5625rpm" RAT_FUNC "%8.2" "rpm" COEFFS 0 1 0 0 0 1.5625 /end COMPU_METHOD
/begin COMPU_METHOD COMP_0142_S "L/minL/min" RAT_FUNC "%8.3" "L/min" COEFFS 0 1 0 0 0 0.03125 /end COMPU_METHOD
/begin COMPU_METHOD COMP_0032_S "1/(L/min/12.5/641/(L/min" RAT_FUNC "%8.2" "1/(L/min" COEFFS 0 1 0 0 0 1 /end COMPU_METHOD
/begin COMPU_METHOD COMP_0429_S "0.5L/min/de" RAT_FUNC "%8.2" "L/min/de" COEFFS 0 1 0 0 0 0.5 /end COMPU_METHOD
/begin COMPU_METHOD COMP_0111_S "deg/50rpmdeg/50rp" RAT_FUNC "%8.2" "deg/50rp" COEFFS 0 1 0 0 0 1 /end COMPU_METHOD
/begin COMPU_METHOD COMP_0431_S "1/128NULL" RAT_FUNC "%8.4" "NULL" COEFFS 0 1 0 0 0 0.0078125 /end COMPU_METHOD
/begin COMPU_METHOD COMP_0220 "1l/min" RAT_FUNC "%8.2" "l/min" COEFFS 0 1 0 0 0 1 /end COMPU_METHOD
/begin COMPU_METHOD COMP_0146 "100/256/256%" RAT_FUNC "%8.4" "%" COEFFS 0 1 0 0 0 0.001525879 /end COMPU_METHOD
/begin COMPU_METHOD COMP_0472 "1/64-" RAT_FUNC "%8.3" "-" COEFFS 0 1 0 0 0 0.015625 /end COMPU_METHOD
/begin COMPU_METHOD COMP_0241_S "9.76563E-08cm**2/L/" RAT_FUNC "%8.6" "cm**2/L/" COEFFS 0 1 0 0 0 0.0000000976563 /end COMPU_METHOD
/begin COMPU_METHOD COMP_0065 "3.125rpm" RAT_FUNC "%8.2" "rpm" COEFFS 0 1 0 0 0 3.125 /end COMPU_METHOD
/begin COMPU_METHOD COMP_0052 "1/2048ms" RAT_FUNC "%8.5" "ms" COEFFS 0 1 0 0 0 0.000488282 /end COMPU_METHOD
/begin COMPU_METHOD COMP_0276 "4L/min" RAT_FUNC "%8.2" "L/min" COEFFS 0 1 0 0 0 4 /end COMPU_METHOD
/begin COMPU_METHOD COMP_0254_S "4rpm" RAT_FUNC "%8.2" "rpm" COEFFS 0 1 0 0 0 4 /end COMPU_METHOD
/begin COMPU_METHOD COMP_0256_S "1/163840m" RAT_FUNC "%8.6" "m" COEFFS 0 1 0 0 0 0.00000610352 /end COMPU_METHOD
/begin COMPU_METHOD COMP_0030_S "NN" RAT_FUNC "%8.2" "N" COEFFS 0 1 0 0 0 1 /end COMPU_METHOD
/begin COMPU_METHOD COMP_0293 "2L/min" RAT_FUNC "%8.2" "L/min" COEFFS 0 1 0 0 0 2 /end COMPU_METHOD
/begin COMPU_METHOD COMP_0057 "1/16384Å|" RAT_FUNC "%8.6" "Å|" COEFFS 0 1 0 0 0 0.0000610352 /end COMPU_METHOD
/begin COMPU_METHOD COMP_0144 "1/2048ms" RAT_FUNC "%8.5" "ms" COEFFS 0 1 0 0 0 0.000488281 /end COMPU_METHOD
/begin COMPU_METHOD COMP_0362 "25cc" RAT_FUNC "%8.2" "cc" COEFFS 0 1 0 0 0 25 /end COMPU_METHOD
/begin COMPU_METHOD COMP_0245 "X-64deg" RAT_FUNC "%8.2" "deg" COEFFS 0 1 64 0 0 1 /end COMPU_METHOD
/begin COMPU_METHOD COMP_0123_S "NN" RAT_FUNC "%8.2" "N" COEFFS 0 1 32768 0 0 1 /end COMPU_METHOD
/begin COMPU_METHOD COMP_0226 "0.1Nm" RAT_FUNC "%8.2" "Nm" COEFFS 0 1 3276.8 0 0 0.1 /end COMPU_METHOD
/begin COMPU_METHOD COMP_0278_S "fixed axis Åé" RAT_FUNC "%8.2" "Åé" COEFFS 0 1 40 0 0 20 /end COMPU_METHOD
/begin COMPU_METHOD COMP_0271_S "fixed axis rpm" RAT_FUNC "%8.2" "rpm" COEFFS 0 1 0 0 0 400 /end COMPU_METHOD
/begin COMPU_METHOD COMP_0271 "100/128/256%" RAT_FUNC "%8.4" "%" COEFFS 0 1 0 0 0 0.003051758 /end COMPU_METHOD
/begin COMPU_METHOD COMP_0280_S "fixed axis Åé" RAT_FUNC "%8.2" "Åé" COEFFS 0 1 40 0 0 10 /end COMPU_METHOD
/begin COMPU_METHOD COMP_0042 "0.0008cm**2" RAT_FUNC "%8.5" "cm**2" COEFFS 0 1 0 0 0 0.0008 /end COMPU_METHOD
/begin COMPU_METHOD COMP_0268_S "fixed axis km/h" RAT_FUNC "%8.2" "km/h" COEFFS 0 1 0 0 0 8 /end COMPU_METHOD
/begin COMPU_METHOD COMP_0283_S "fixed axis rpm" RAT_FUNC "%8.2" "rpm" COEFFS 0 1 0 0 0 200 /end COMPU_METHOD
/begin COMPU_METHOD COMP_0292_S "fixed axis rpm" RAT_FUNC "%8.2" "rpm" COEFFS 0 1 0 0 0 100 /end COMPU_METHOD
/begin COMPU_METHOD COMP_0493 "4l/min" RAT_FUNC "%8.2" "l/min" COEFFS 0 1 0 0 0 4 /end COMPU_METHOD
/begin COMPU_METHOD COMP_0297_S "fixed axis -" RAT_FUNC "%8.3" "-" COEFFS 0 1 0 0 0 0.06 /end COMPU_METHOD
/begin COMPU_METHOD COMP_0304_S "6.25E-10cm**2/rp" RAT_FUNC "%8.6" "cm**2/rp" COEFFS 0 1 0 0 0 0.000000000625 /end COMPU_METHOD
/begin COMPU_METHOD COMP_0303_S "3.90625E-11cm**2/rp" RAT_FUNC "%8.6" "cm**2/rp" COEFFS 0 1 0 0 0 3.90625E-11 /end COMPU_METHOD
/begin COMPU_METHOD COMP_0041 "0.0008cm^2" RAT_FUNC "%8.5" "cm^2" COEFFS 0 1 0 0 0 0.0008 /end COMPU_METHOD
/begin COMPU_METHOD COMP_0305_S "fixed axis Åé" RAT_FUNC "%8.2" "Åé" COEFFS 0 1 40 0 0 40 /end COMPU_METHOD
/begin COMPU_METHOD COMP_0307_S "fixed axis -" RAT_FUNC "%8.2" "-" COEFFS 0 1 0 0 0 256 /end COMPU_METHOD
/begin COMPU_METHOD COMP_0308_S "fixed axis deg" RAT_FUNC "%8.2" "deg" COEFFS 0 1 0 0 0 1.4 /end COMPU_METHOD
/begin COMPU_METHOD COMP_0508_S "fixed axis dgeCA" RAT_FUNC "%8.2" "dgeCA" COEFFS 0 1 48 0 0 16 /end COMPU_METHOD
/begin COMPU_METHOD COMP_0313_S "1/81921/10ms" RAT_FUNC "%8.5" "1/10ms" COEFFS 0 1 0 0 0 0.00012207 /end COMPU_METHOD
/begin COMPU_METHOD COMP_0314_S "fixed axis deg" RAT_FUNC "%8.2" "deg" COEFFS 0 1 0 0 0 7.04 /end COMPU_METHOD
/begin COMPU_METHOD COMP_0325_S "fixed axis deg" RAT_FUNC "%8.2" "deg" COEFFS 0 1 0 0 0 8 /end COMPU_METHOD
/begin COMPU_METHOD COMP_0327_S "fixed axis Åé" RAT_FUNC "%8.2" "Åé" COEFFS 0 1 -10 0 0 10 /end COMPU_METHOD
/begin COMPU_METHOD COMP_0328_S "fixed axis km/h" RAT_FUNC "%8.2" "km/h" COEFFS 0 1 0 0 0 6.4 /end COMPU_METHOD
/begin COMPU_METHOD COMP_0476 "12.5/64rpm" RAT_FUNC "%8.2" "rpm" COEFFS 0 1 0 0 0 0.1953125 /end COMPU_METHOD
/begin COMPU_METHOD COMP_0526_S "1/64-" RAT_FUNC "%8.3" "-" COEFFS 0 1 2 0 0 0.015625 /end COMPU_METHOD
/begin COMPU_METHOD COMP_0530_S "fixed axis dgeCA" RAT_FUNC "%8.2" "dgeCA" COEFFS 0 1 64 0 0 16 /end COMPU_METHOD
/begin COMPU_METHOD COMP_0324 "2/256L/min" RAT_FUNC "%8.4" "L/min" COEFFS 0 1 0 0 0 0.0078125 /end COMPU_METHOD
/begin COMPU_METHOD COMP_0283 "1flag" RAT_FUNC "%8.2" "flag" COEFFS 0 1 0 0 0 1 /end COMPU_METHOD
/begin COMPU_METHOD COMP_0202_S "100ms100ms" RAT_FUNC "%8.2" "100ms" COEFFS 0 1 0 0 0 1 /end COMPU_METHOD
/begin COMPU_METHOD COMP_0203_S "10ms10ms" RAT_FUNC "%8.2" "10ms" COEFFS 0 1 0 0 0 1 /end COMPU_METHOD
/begin COMPU_METHOD COMP_0022_S "--" RAT_FUNC "%8.4" "-" COEFFS 0 1 0 0 0 0.003921568 /end COMPU_METHOD
/begin COMPU_METHOD COMP_0558_S "AA" RAT_FUNC "%8.4" "A" COEFFS 0 1 128 0 0 0.00390625 /end COMPU_METHOD
/begin COMPU_METHOD COMP_0396 "2/256l/min" RAT_FUNC "%8.4" "l/min" COEFFS 0 1 0 0 0 0.0078125 /end COMPU_METHOD
/begin COMPU_METHOD COMP_0570_S "ÅéÅé" RAT_FUNC "%8.2" "Åé" COEFFS 0 1 0 0 0 0.3333333 /end COMPU_METHOD
/begin COMPU_METHOD COMP_0582_S "rpmrpm" RAT_FUNC "%8.3" "rpm" COEFFS 0 1 0 0 0 0.0488281 /end COMPU_METHOD
/begin COMPU_METHOD COMP_0028 "1/(100*256)-" RAT_FUNC "%8.6" "-" COEFFS 0 1 0 0 0 0.0000390625 /end COMPU_METHOD
/begin COMPU_METHOD COMP_0280 "0.35deg/30ms" RAT_FUNC "%8.2" "deg/30ms" COEFFS 0 1 0 0 0 0.35 /end COMPU_METHOD
/begin COMPU_METHOD COMP_0591_S "ÅéÅé" RAT_FUNC "%8.2" "Åé" COEFFS 0 1 30 0 0 0.3333333 /end COMPU_METHOD
/begin COMPU_METHOD COMP_0084_S "l/minl/min" RAT_FUNC "%8.3" "l/min" COEFFS 0 1 0 0 0 0.03125 /end COMPU_METHOD
/begin COMPU_METHOD COMP_0444 "1/256L/min" RAT_FUNC "%8.4" "L/min" COEFFS 0 1 0 0 0 0.00390625 /end COMPU_METHOD
/begin COMPU_METHOD COMP_0610_S "--" RAT_FUNC "%8.6" "-" COEFFS 0 1 0 0 0 0.000016276 /end COMPU_METHOD
/begin COMPU_METHOD COMP_0253_S "8L/min" RAT_FUNC "%8.2" "L/min" COEFFS 0 1 0 0 0 8 /end COMPU_METHOD
/begin COMPU_METHOD COMP_0149_S "--" RAT_FUNC "%8.5" "-" COEFFS 0 1 0 0 0 0.00012207 /end COMPU_METHOD
/begin COMPU_METHOD COMP_0049_S "--" RAT_FUNC "%8.6" "-" COEFFS 0 1 0 0 0 0.0000153 /end COMPU_METHOD
/begin COMPU_METHOD COMP_0629_S "cm^2/rpm/cccm^2/rpm" RAT_FUNC "%8.6" "cm^2/rpm" COEFFS 0 1 0 0 0 3.90625E-11 /end COMPU_METHOD
/begin COMPU_METHOD COMP_0156_S "cm^2/rpm/cccm^2/rpm" RAT_FUNC "%8.6" "cm^2/rpm" COEFFS 0 1 0 0 0 0.0000000000391 /end COMPU_METHOD
/begin COMPU_METHOD COMP_0502 "1/65535Å|" RAT_FUNC "%8.6" "Å|" COEFFS 0 1 0 0 0 0.0000152591 /end COMPU_METHOD
/begin COMPU_METHOD COMP_0503 "0.4Nm" RAT_FUNC "%8.2" "Nm" COEFFS 0 1 0 0 0 0.4 /end COMPU_METHOD
/begin COMPU_METHOD COMP_0647_S "km/hkm/h" RAT_FUNC "%8.3" "km/h" COEFFS 0 1 0 0 0 0.0625 /end COMPU_METHOD
/* RECORD_LAYOUT ------------------------------------------------------ */
/begin RECORD_LAYOUT REC_UBYTE_C FNC_VALUES 1 UBYTE COLUMN_DIR DIRECT /end RECORD_LAYOUT
/begin RECORD_LAYOUT REC_UWORD_C FNC_VALUES 1 UWORD COLUMN_DIR DIRECT /end RECORD_LAYOUT
/begin RECORD_LAYOUT REC_SWORD_C FNC_VALUES 1 SWORD COLUMN_DIR DIRECT /end RECORD_LAYOUT
/begin RECORD_LAYOUT REC_SBYTE_C FNC_VALUES 1 SBYTE COLUMN_DIR DIRECT /end RECORD_LAYOUT
/begin RECORD_LAYOUT REC_AXIS_UBYTE AXIS_PTS_X 1 UBYTE INDEX_INCR DIRECT /end RECORD_LAYOUT
/begin RECORD_LAYOUT REC_AXIS_UWORD AXIS_PTS_X 1 UWORD INDEX_INCR DIRECT /end RECORD_LAYOUT
/end MODULE
/end PROJECT
