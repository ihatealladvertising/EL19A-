ASAP2_VERSION 1 3_BETA
/begin PROJECT TK_X91_EUR_VC ""
/begin HEADER "" /* key HEADER ++ "comment" Ç… Par.scomment */ PROJECT_NO TK_X91_EUR_VC /* key PROJECT_NO ++ project number Ç… car_eng_desti_lot */ VERSION "7V4YHZEB2" /* key VERSION ++ version number Ç… mProgver */ /end HEADER
/begin MODULE DIM ""
/begin MOD_COMMON "" DEPOSIT ABSOLUTE BYTE_ORDER MSB_FIRST /* ﬁ≤ƒµ∞¿ﬁ∞Ç™ÿÃﬂ⁄∞ΩÇ≥ÇÍÇÈ */ /end MOD_COMMON
/begin MEASUREMENT vAL3FNM_R#16 "Parameter operation number of times" UWORD COMP_0016 1 100 0 65535 ECU_ADDRESS 0xFFFFA1E8 /begin FUNCTION_LIST /end FUNCTION_LIST /end MEASUREMENT
/begin MEASUREMENT vAL3FSM "Parameter integration value" ULONG COMP_0550_S 1 100 0 131072.093921892 ECU_ADDRESS 0xFFFFA1EC /begin FUNCTION_LIST /end FUNCTION_LIST /end MEASUREMENT
/begin MEASUREMENT vAL3FSM_R#1 "Parameter integration value" ULONG COMP_0550_S 1 100 0 131072.093921892 ECU_ADDRESS 0xFFFFA1EC /begin FUNCTION_LIST /end FUNCTION_LIST /end MEASUREMENT
/begin MEASUREMENT vAL3FSM_R#2 "Parameter integration value" ULONG COMP_0550_S 1 100 0 131072.093921892 ECU_ADDRESS 0xFFFFA1F0 /begin FUNCTION_LIST /end FUNCTION_LIST /end MEASUREMENT
/begin MEASUREMENT vAL3FSM_R#3 "Parameter integration value" ULONG COMP_0550_S 1 100 0 131072.093921892 ECU_ADDRESS 0xFFFFA1F4 /begin FUNCTION_LIST /end FUNCTION_LIST /end MEASUREMENT
/begin MEASUREMENT vAL3FSM_R#4 "Parameter integration value" ULONG COMP_0550_S 1 100 0 131072.093921892 ECU_ADDRESS 0xFFFFA1F8 /begin FUNCTION_LIST /end FUNCTION_LIST /end MEASUREMENT
/begin MEASUREMENT vAL3FSM_R#5 "Parameter integration value" ULONG COMP_0550_S 1 100 0 131072.093921892 ECU_ADDRESS 0xFFFFA1FC /begin FUNCTION_LIST /end FUNCTION_LIST /end MEASUREMENT
/begin MEASUREMENT vAL3FSM_R#6 "Parameter integration value" ULONG COMP_0550_S 1 100 0 131072.093921892 ECU_ADDRESS 0xFFFFA200 /begin FUNCTION_LIST /end FUNCTION_LIST /end MEASUREMENT
/begin MEASUREMENT vAL3FSM_R#7 "Parameter integration value" ULONG COMP_0550_S 1 100 0 131072.093921892 ECU_ADDRESS 0xFFFFA204 /begin FUNCTION_LIST /end FUNCTION_LIST /end MEASUREMENT
/begin MEASUREMENT vAL3FSM_R#8 "Parameter integration value" ULONG COMP_0550_S 1 100 0 131072.093921892 ECU_ADDRESS 0xFFFFA208 /begin FUNCTION_LIST /end FUNCTION_LIST /end MEASUREMENT
/begin MEASUREMENT vAL3FSM_R#9 "Parameter integration value" ULONG COMP_0550_S 1 100 0 131072.093921892 ECU_ADDRESS 0xFFFFA20C /begin FUNCTION_LIST /end FUNCTION_LIST /end MEASUREMENT
/begin MEASUREMENT vAL3FSM_R#10 "Parameter integration value" ULONG COMP_0550_S 1 100 0 131072.093921892 ECU_ADDRESS 0xFFFFA210 /begin FUNCTION_LIST /end FUNCTION_LIST /end MEASUREMENT
/begin MEASUREMENT vAL3FSM_R#11 "Parameter integration value" ULONG COMP_0550_S 1 100 0 131072.093921892 ECU_ADDRESS 0xFFFFA214 /begin FUNCTION_LIST /end FUNCTION_LIST /end MEASUREMENT
/begin MEASUREMENT vAL3FSM_R#12 "Parameter integration value" ULONG COMP_0550_S 1 100 0 131072.093921892 ECU_ADDRESS 0xFFFFA218 /begin FUNCTION_LIST /end FUNCTION_LIST /end MEASUREMENT
/begin MEASUREMENT vAL3FSM_R#13 "Parameter integration value" ULONG COMP_0550_S 1 100 0 131072.093921892 ECU_ADDRESS 0xFFFFA21C /begin FUNCTION_LIST /end FUNCTION_LIST /end MEASUREMENT
/begin MEASUREMENT vAL3FSM_R#14 "Parameter integration value" ULONG COMP_0550_S 1 100 0 131072.093921892 ECU_ADDRESS 0xFFFFA220 /begin FUNCTION_LIST /end FUNCTION_LIST /end MEASUREMENT
/begin MEASUREMENT vAL3FSM_R#15 "Parameter integration value" ULONG COMP_0550_S 1 100 0 131072.093921892 ECU_ADDRESS 0xFFFFA224 /begin FUNCTION_LIST /end FUNCTION_LIST /end MEASUREMENT
/begin MEASUREMENT vAL3FSM_R#16 "Parameter integration value" ULONG COMP_0550_S 1 100 0 131072.093921892 ECU_ADDRESS 0xFFFFA228 /begin FUNCTION_LIST /end FUNCTION_LIST /end MEASUREMENT
/begin MEASUREMENT vAL3FUL "At the time of the LEKAL3 operation, PST2FL" UBYTE COMP_0371 1 100 0 510 ECU_ADDRESS 0xFFFFA22C /begin FUNCTION_LIST /end FUNCTION_LIST /end MEASUREMENT
/begin MEASUREMENT vAL3MN "LEKAL3 minimum value" UBYTE COMP_0232 1 100 0 1.9921875 ECU_ADDRESS 0xFFFFA22D /begin FUNCTION_LIST /end FUNCTION_LIST /end MEASUREMENT
/begin MEASUREMENT vAL3MN0 "Parameter MIN value" UBYTE COMP_0232 1 100 0 1.9921875 ECU_ADDRESS 0xFFFFA22E /begin FUNCTION_LIST /end FUNCTION_LIST /end MEASUREMENT
/begin MEASUREMENT vAL3MN0_R#1 "Parameter MIN value" UBYTE COMP_0232 1 100 0 1.9921875 ECU_ADDRESS 0xFFFFA22E /begin FUNCTION_LIST /end FUNCTION_LIST /end MEASUREMENT
/begin MEASUREMENT vAL3MN0_R#2 "Parameter MIN value" UBYTE COMP_0232 1 100 0 1.9921875 ECU_ADDRESS 0xFFFFA22F /begin FUNCTION_LIST /end FUNCTION_LIST /end MEASUREMENT
/begin MEASUREMENT vAL3MN0_R#3 "Parameter MIN value" UBYTE COMP_0232 1 100 0 1.9921875 ECU_ADDRESS 0xFFFFA230 /begin FUNCTION_LIST /end FUNCTION_LIST /end MEASUREMENT
/begin MEASUREMENT vAL3MN0_R#4 "Parameter MIN value" UBYTE COMP_0232 1 100 0 1.9921875 ECU_ADDRESS 0xFFFFA231 /begin FUNCTION_LIST /end FUNCTION_LIST /end MEASUREMENT
/begin MEASUREMENT vAL3MN0_R#5 "Parameter MIN value" UBYTE COMP_0232 1 100 0 1.9921875 ECU_ADDRESS 0xFFFFA232 /begin FUNCTION_LIST /end FUNCTION_LIST /end MEASUREMENT
/begin MEASUREMENT vAL3MN0_R#6 "Parameter MIN value" UBYTE COMP_0232 1 100 0 1.9921875 ECU_ADDRESS 0xFFFFA233 /begin FUNCTION_LIST /end FUNCTION_LIST /end MEASUREMENT
/begin MEASUREMENT vAL3MN0_R#7 "Parameter MIN value" UBYTE COMP_0232 1 100 0 1.9921875 ECU_ADDRESS 0xFFFFA234 /begin FUNCTION_LIST /end FUNCTION_LIST /end MEASUREMENT
/begin MEASUREMENT vAL3MN0_R#8 "Parameter MIN value" UBYTE COMP_0232 1 100 0 1.9921875 ECU_ADDRESS 0xFFFFA235 /begin FUNCTION_LIST /end FUNCTION_LIST /end MEASUREMENT
/begin MEASUREMENT vAL3MN2 "At the time of the 0.04inch leak-down, LEKAL3 minimum value" UBYTE COMP_0232 1 100 0 1.9921875 ECU_ADDRESS 0xFFFFA236 /begin FUNCTION_LIST /end FUNCTION_LIST /end MEASUREMENT
/begin MEASUREMENT vAL3MTF "At the time of the LEKAL3 operation, PST2MT" UBYTE COMP_0054 1 100 0 5100 ECU_ADDRESS 0xFFFFA237 /begin FUNCTION_LIST /end FUNCTION_LIST /end MEASUREMENT
/begin MEASUREMENT vAL3MX "LEKAL3 maximum value" UBYTE COMP_0232 1 100 0 1.9921875 ECU_ADDRESS 0xFFFFA238 /begin FUNCTION_LIST /end FUNCTION_LIST /end MEASUREMENT
/begin MEASUREMENT vAL3MX0 "Parameter MAX value" UBYTE COMP_0232 1 100 0 1.9921875 ECU_ADDRESS 0xFFFFA239 /begin FUNCTION_LIST /end FUNCTION_LIST /end MEASUREMENT
/begin MEASUREMENT vAL3MX0_R#1 "Parameter MAX value" UBYTE COMP_0232 1 100 0 1.9921875 ECU_ADDRESS 0xFFFFA239 /begin FUNCTION_LIST /end FUNCTION_LIST /end MEASUREMENT
/begin MEASUREMENT vAL3MX0_R#2 "Parameter MAX value" UBYTE COMP_0232 1 100 0 1.9921875 ECU_ADDRESS 0xFFFFA23A /begin FUNCTION_LIST /end FUNCTION_LIST /end MEASUREMENT
/begin MEASUREMENT vAL3MX0_R#3 "Parameter MAX value" UBYTE COMP_0232 1 100 0 1.9921875 ECU_ADDRESS 0xFFFFA23B /begin FUNCTION_LIST /end FUNCTION_LIST /end MEASUREMENT
/begin MEASUREMENT vAL3MX0_R#4 "Parameter MAX value" UBYTE COMP_0232 1 100 0 1.9921875 ECU_ADDRESS 0xFFFFA23C /begin FUNCTION_LIST /end FUNCTION_LIST /end MEASUREMENT
/begin MEASUREMENT vAL3MX0_R#5 "Parameter MAX value" UBYTE COMP_0232 1 100 0 1.9921875 ECU_ADDRESS 0xFFFFA23D /begin FUNCTION_LIST /end FUNCTION_LIST /end MEASUREMENT
/begin MEASUREMENT vAL3MX0_R#6 "Parameter MAX value" UBYTE COMP_0232 1 100 0 1.9921875 ECU_ADDRESS 0xFFFFA23E /begin FUNCTION_LIST /end FUNCTION_LIST /end MEASUREMENT
/begin MEASUREMENT vAL3MX0_R#7 "Parameter MAX value" UBYTE COMP_0232 1 100 0 1.9921875 ECU_ADDRESS 0xFFFFA23F /begin FUNCTION_LIST /end FUNCTION_LIST /end MEASUREMENT
/begin MEASUREMENT vAL3MX0_R#8 "Parameter MAX value" UBYTE COMP_0232 1 100 0 1.9921875 ECU_ADDRESS 0xFFFFA240 /begin FUNCTION_LIST /end FUNCTION_LIST /end MEASUREMENT
/begin MEASUREMENT vAL3MX2 "At the time of the 0.04inch leak-down, LEKAL3 maximum value" UBYTE COMP_0232 1 100 0 1.9921875 ECU_ADDRESS 0xFFFFA241 /begin FUNCTION_LIST /end FUNCTION_LIST /end MEASUREMENT
/begin MEASUREMENT vAL3NM "Parameter operation number of times" UBYTE COMP_0016 1 100 0 255 ECU_ADDRESS 0xFFFFA242 /begin FUNCTION_LIST /end FUNCTION_LIST /end MEASUREMENT
/begin MEASUREMENT vAL3NM_R#1 "Parameter operation number of times" UBYTE COMP_0016 1 100 0 255 ECU_ADDRESS 0xFFFFA242 /begin FUNCTION_LIST /end FUNCTION_LIST /end MEASUREMENT
/begin MEASUREMENT vAL3NM_R#2 "Parameter operation number of times" UBYTE COMP_0016 1 100 0 255 ECU_ADDRESS 0xFFFFA243 /begin FUNCTION_LIST /end FUNCTION_LIST /end MEASUREMENT
/begin MEASUREMENT vAL3NM_R#3 "Parameter operation number of times" UBYTE COMP_0016 1 100 0 255 ECU_ADDRESS 0xFFFFA244 /begin FUNCTION_LIST /end FUNCTION_LIST /end MEASUREMENT
/begin MEASUREMENT vAL3NM_R#4 "Parameter operation number of times" UBYTE COMP_0016 1 100 0 255 ECU_ADDRESS 0xFFFFA245 /begin FUNCTION_LIST /end FUNCTION_LIST /end MEASUREMENT
/begin MEASUREMENT vAL3NM_R#5 "Parameter operation number of times" UBYTE COMP_0016 1 100 0 255 ECU_ADDRESS 0xFFFFA246 /begin FUNCTION_LIST /end FUNCTION_LIST /end MEASUREMENT
/begin MEASUREMENT vAL3NM_R#6 "Parameter operation number of times" UBYTE COMP_0016 1 100 0 255 ECU_ADDRESS 0xFFFFA247 /begin FUNCTION_LIST /end FUNCTION_LIST /end MEASUREMENT
/begin MEASUREMENT vAL3NM_R#7 "Parameter operation number of times" UBYTE COMP_0016 1 100 0 255 ECU_ADDRESS 0xFFFFA248 /begin FUNCTION_LIST /end FUNCTION_LIST /end MEASUREMENT
/begin MEASUREMENT vAL3NM_R#8 "Parameter operation number of times" UBYTE COMP_0016 1 100 0 255 ECU_ADDRESS 0xFFFFA249 /begin FUNCTION_LIST /end FUNCTION_LIST /end MEASUREMENT
/begin MEASUREMENT vAL3PA1 "At the time of the LEKAL3 operation, PAMLK1" UWORD COMP_0050 1 100 0 5119.921875 ECU_ADDRESS 0xFFFFA24A /begin FUNCTION_LIST /end FUNCTION_LIST /end MEASUREMENT
/begin MEASUREMENT vAL3PA2 "At the time of the LEKAL3 operation, PAMLK2" UWORD COMP_0050 1 100 0 5119.921875 ECU_ADDRESS 0xFFFFA24C /begin FUNCTION_LIST /end FUNCTION_LIST /end MEASUREMENT
/begin MEASUREMENT vAL3PA3 "At the time of the LEAK3 operation, PAMVM1" UWORD COMP_0050 1 100 0 5119.921875 ECU_ADDRESS 0xFFFFA24E /begin FUNCTION_LIST /end FUNCTION_LIST /end MEASUREMENT
/begin MEASUREMENT vAL3PA4 "At the time of the LEAK3 operation, PAMVM2" UWORD COMP_0050 1 100 0 5119.921875 ECU_ADDRESS 0xFFFFA250 /begin FUNCTION_LIST /end FUNCTION_LIST /end MEASUREMENT
/begin MEASUREMENT vAL3S2E1 "At the time of the LEKAL3 operation, PST1EV1" UWORD COMP_0050 1 100 0 5119.921875 ECU_ADDRESS 0xFFFFA252 /begin FUNCTION_LIST /end FUNCTION_LIST /end MEASUREMENT
/begin MEASUREMENT vAL3S2E2 "At the time of the LEKAL3 operation, PST1EV2" UWORD COMP_0050 1 100 0 5119.921875 ECU_ADDRESS 0xFFFFA254 /begin FUNCTION_LIST /end FUNCTION_LIST /end MEASUREMENT
/begin MEASUREMENT vAL3S2PM "At the time of the LEKAL3 operation, PST2PM" SWORD COMP_0491 1 100 -2560 2559.921875 ECU_ADDRESS 0xFFFFA256 /begin FUNCTION_LIST /end FUNCTION_LIST /end MEASUREMENT
/begin MEASUREMENT vAL3SM "Parameter integration value" UWORD COMP_0232 1 100 0 511.9921875 ECU_ADDRESS 0xFFFFA258 /begin FUNCTION_LIST /end FUNCTION_LIST /end MEASUREMENT
/begin MEASUREMENT vAL3SM_R#1 "Parameter integration value" UWORD COMP_0232 1 100 0 511.9921875 ECU_ADDRESS 0xFFFFA258 /begin FUNCTION_LIST /end FUNCTION_LIST /end MEASUREMENT
/begin MEASUREMENT vAL3SM_R#2 "Parameter integration value" UWORD COMP_0232 1 100 0 511.9921875 ECU_ADDRESS 0xFFFFA25A /begin FUNCTION_LIST /end FUNCTION_LIST /end MEASUREMENT
/begin MEASUREMENT vAL3SM_R#3 "Parameter integration value" UWORD COMP_0232 1 100 0 511.9921875 ECU_ADDRESS 0xFFFFA25C /begin FUNCTION_LIST /end FUNCTION_LIST /end MEASUREMENT
/begin MEASUREMENT vAL3SM_R#4 "Parameter integration value" UWORD COMP_0232 1 100 0 511.9921875 ECU_ADDRESS 0xFFFFA25E /begin FUNCTION_LIST /end FUNCTION_LIST /end MEASUREMENT
/begin MEASUREMENT vAL3SM_R#5 "Parameter integration value" UWORD COMP_0232 1 100 0 511.9921875 ECU_ADDRESS 0xFFFFA260 /begin FUNCTION_LIST /end FUNCTION_LIST /end MEASUREMENT
/begin MEASUREMENT vAL3SM_R#6 "Parameter integration value" UWORD COMP_0232 1 100 0 511.9921875 ECU_ADDRESS 0xFFFFA262 /begin FUNCTION_LIST /end FUNCTION_LIST /end MEASUREMENT
/begin MEASUREMENT vAL3SM_R#7 "Parameter integration value" UWORD COMP_0232 1 100 0 511.9921875 ECU_ADDRESS 0xFFFFA264 /begin FUNCTION_LIST /end FUNCTION_LIST /end MEASUREMENT
/begin MEASUREMENT vAL3SM_R#8 "Parameter integration value" UWORD COMP_0232 1 100 0 511.9921875 ECU_ADDRESS 0xFFFFA266 /begin FUNCTION_LIST /end FUNCTION_LIST /end MEASUREMENT
/begin MEASUREMENT vAL3SPV "At the time of the LEKAL3 operation, space capacity" UBYTE COMP_0150 1 100 0 127.5 ECU_ADDRESS 0xFFFFA268 /begin FUNCTION_LIST /end FUNCTION_LIST /end MEASUREMENT
/begin MEASUREMENT vAL3TFA "At the time of the LEKAL3 operation, TFA" UBYTE COMP_0035 1 100 -50 205 ECU_ADDRESS 0xFFFFA269 /begin FUNCTION_LIST /end FUNCTION_LIST /end MEASUREMENT
/begin MEASUREMENT vAL3TFI "At the time of the LEKAL3 operation, TFINT" UBYTE COMP_0035 1 100 -50 205 ECU_ADDRESS 0xFFFFA26A /begin FUNCTION_LIST /end FUNCTION_LIST /end MEASUREMENT
/begin MEASUREMENT vAL3TMB "At the time of the LEKAL3 operation, TANBMN" UBYTE COMP_0035 1 100 -50 205 ECU_ADDRESS 0xFFFFA26B /begin FUNCTION_LIST /end FUNCTION_LIST /end MEASUREMENT
/begin MEASUREMENT vAL3TWI "At the time of the LEKAL3 operation, TWINT" UBYTE COMP_0035 1 100 -50 205 ECU_ADDRESS 0xFFFFA26C /begin FUNCTION_LIST /end FUNCTION_LIST /end MEASUREMENT
/begin MEASUREMENT vAL3TWN "At the time of the LEKAL3 operation, TWN" UBYTE COMP_0035 1 100 -50 205 ECU_ADDRESS 0xFFFFA26D /begin FUNCTION_LIST /end FUNCTION_LIST /end MEASUREMENT
/begin MEASUREMENT vALEV16f "Purge learning ALPEVP delta condition" UBYTE COMP_0004 1 100 0 255 ECU_ADDRESS 0xFFFF112A /begin FUNCTION_LIST /end FUNCTION_LIST /end MEASUREMENT
/begin MEASUREMENT vALNENDf "The whole area reflection learning control executive flag" UBYTE COMP_0004 1 100 0 255 ECU_ADDRESS 0xFFFF281C /begin FUNCTION_LIST /end FUNCTION_LIST /end MEASUREMENT
/begin MEASUREMENT vALNJDGf "The whole area reflection learning permission condition flag" UBYTE COMP_0004 1 100 0 255 ECU_ADDRESS 0xFFFF112B /begin FUNCTION_LIST /end FUNCTION_LIST /end MEASUREMENT
/begin MEASUREMENT vALPC1 "Map learning area" UBYTE COMP_0068 1 100 0 255 ECU_ADDRESS 0xFFFF1004 /begin FUNCTION_LIST /end FUNCTION_LIST /end MEASUREMENT
/begin MEASUREMENT vALPC1_R#1 "Map learning area" UBYTE COMP_0068 1 100 0 255 ECU_ADDRESS 0xFFFF1004 /begin FUNCTION_LIST /end FUNCTION_LIST /end MEASUREMENT
/begin MEASUREMENT vALPC1_R#2 "Map learning area" UBYTE COMP_0068 1 100 0 255 ECU_ADDRESS 0xFFFF1005 /begin FUNCTION_LIST /end FUNCTION_LIST /end MEASUREMENT
/begin MEASUREMENT vALPCLPf "The rest O2 F/B ALPHA clamp value computation" UBYTE COMP_0004 1 100 0 255 ECU_ADDRESS 0xFFFF1136 /begin FUNCTION_LIST /end FUNCTION_LIST /end MEASUREMENT
/begin MEASUREMENT vALPEVP "Latest ALPHA conversion value (for EVP)" UWORD COMP_0031 1 100 0 255.99609375 ECU_ADDRESS 0xFFFF1138 /begin FUNCTION_LIST /end FUNCTION_LIST /end MEASUREMENT
/begin MEASUREMENT vALPEVP_R#1 "Latest ALPHA conversion value (for EVP)" UWORD COMP_0031 1 100 0 255.99609375 ECU_ADDRESS 0xFFFF1138 /begin FUNCTION_LIST /end FUNCTION_LIST /end MEASUREMENT
/begin MEASUREMENT vALPEVP_R#2 "Latest ALPHA conversion value (for EVP)" UWORD COMP_0031 1 100 0 255.99609375 ECU_ADDRESS 0xFFFF113A /begin FUNCTION_LIST /end FUNCTION_LIST /end MEASUREMENT
/begin MEASUREMENT vALPEVP16 "Before 16 turns, ALPHA conversion value" UWORD COMP_0031 1 100 0 255.99609375 ECU_ADDRESS 0xFFFF113C /begin FUNCTION_LIST /end FUNCTION_LIST /end MEASUREMENT
/begin MEASUREMENT vALPEVP16_R#1 "Before 16 turns, ALPHA conversion value" UWORD COMP_0031 1 100 0 255.99609375 ECU_ADDRESS 0xFFFF113C /begin FUNCTION_LIST /end FUNCTION_LIST /end MEASUREMENT
/begin MEASUREMENT vALPEVP16_R#2 "Before 16 turns, ALPHA conversion value" UWORD COMP_0031 1 100 0 255.99609375 ECU_ADDRESS 0xFFFF113E /begin FUNCTION_LIST /end FUNCTION_LIST /end MEASUREMENT
/begin MEASUREMENT vALPHAA "Lambda control compensation coefficient" UWORD COMP_0031 1 100 0 255.99609375 ECU_ADDRESS 0xFFFF4098 /begin FUNCTION_LIST /end FUNCTION_LIST /end MEASUREMENT
/begin MEASUREMENT vALPJDGEf "Learning condition 16 turns progress flag" UBYTE COMP_0004 1 100 0 255 ECU_ADDRESS 0xFFFF1148 /begin FUNCTION_LIST /end FUNCTION_LIST /end MEASUREMENT
/begin MEASUREMENT vALPLIMf "In the top of ALPHA, lower limit value judgement" UBYTE COMP_0004 1 100 0 255 ECU_ADDRESS 0xFFFF1149 /begin FUNCTION_LIST /end FUNCTION_LIST /end MEASUREMENT
/begin MEASUREMENT vALPLMEf "ALPHA limiter arrival flag" UBYTE COMP_0004 1 100 0 255 ECU_ADDRESS 0xFFFF114A /begin FUNCTION_LIST /end FUNCTION_LIST /end MEASUREMENT
/begin MEASUREMENT vALPMXX "After the lean, at the time of the rich-shift, air-fuel ratio compensation lower limit choice value" UBYTE COMP_0027 1 100 0 255 ECU_ADDRESS 0xFFFF114B /begin FUNCTION_LIST /end FUNCTION_LIST /end MEASUREMENT
/begin MEASUREMENT vALRNOKLf "A learning value whole area reflection control lean side start condition flag by the region" UBYTE COMP_0004 1 100 0 255 ECU_ADDRESS 0xFFFF114C /begin FUNCTION_LIST /end FUNCTION_LIST /end MEASUREMENT
/begin MEASUREMENT vALRNOKRf "A learning value whole area reflection control rich side start condition flag by the region" UBYTE COMP_0004 1 100 0 255 ECU_ADDRESS 0xFFFF114D /begin FUNCTION_LIST /end FUNCTION_LIST /end MEASUREMENT
/begin MEASUREMENT vALSHKI "At the time of the purge cut, alpha initialization value" UBYTE COMP_0027 1 100 0 255 ECU_ADDRESS 0xFFFF114E /begin FUNCTION_LIST /end FUNCTION_LIST /end MEASUREMENT
/begin MEASUREMENT vALTCCN "C terminal control condition" UBYTE COMP_0004 1 100 0 255 ECU_ADDRESS 0xFFFF1006 /begin FUNCTION_LIST /end FUNCTION_LIST /end MEASUREMENT
/begin MEASUREMENT vALTDUTY0 "Alternator DUTY order reference value" UBYTE COMP_0047 1 100 0 127.5 ECU_ADDRESS 0xFFFF114F /begin FUNCTION_LIST /end FUNCTION_LIST /end MEASUREMENT
/begin MEASUREMENT vALTF "Field coil energizing DUTY" UBYTE COMP_0047 1 100 0 127.5 ECU_ADDRESS 0xFFFF1D8F /begin FUNCTION_LIST /end FUNCTION_LIST /end MEASUREMENT
/begin MEASUREMENT vALTFBF "Usually, control field coil energizing DUTY" UBYTE COMP_0047 1 100 0 127.5 ECU_ADDRESS 0xFFFF1D90 /begin FUNCTION_LIST /end FUNCTION_LIST /end MEASUREMENT
/begin MEASUREMENT vALTMX "Output DUTY upper limit value" UBYTE COMP_0047 1 100 0 127.5 ECU_ADDRESS 0xFFFF23AC /begin FUNCTION_LIST /end FUNCTION_LIST /end MEASUREMENT
/begin MEASUREMENT vALTN "Alternator speed" UBYTE COMP_0020 1 100 0 12750 ECU_ADDRESS 0xFFFF1156 /begin FUNCTION_LIST /end FUNCTION_LIST /end MEASUREMENT
/begin MEASUREMENT vALTNRMX "Alternator number" UBYTE COMP_0068 1 100 0 255 ECU_ADDRESS 0xFFFF38DE /begin FUNCTION_LIST /end FUNCTION_LIST /end MEASUREMENT
/begin MEASUREMENT vALTR "Atomospheric pressure detection value" UWORD COMP_0017_S 1 100 0 2047.96875 ECU_ADDRESS 0xFFFFB55C /begin FUNCTION_LIST /end FUNCTION_LIST /end MEASUREMENT
/begin MEASUREMENT vALTV "Target generating electricity voltage" UBYTE COMP_0033 1 100 0 20400 ECU_ADDRESS 0xFFFF1166 /begin FUNCTION_LIST /end FUNCTION_LIST /end MEASUREMENT
/begin MEASUREMENT vALTVBH "Alternator DUTY voltage F/B I-gain compensation value" UBYTE COMP_0359 1 100 -64 63.5 ECU_ADDRESS 0xFFFF1167 /begin FUNCTION_LIST /end FUNCTION_LIST /end MEASUREMENT
/begin MEASUREMENT vALTWORK "ALTF (two bytes)" UWORD COMP_0269 1 100 0 127.998046875 ECU_ADDRESS 0xFFFF1D92 /begin FUNCTION_LIST /end FUNCTION_LIST /end MEASUREMENT
/begin MEASUREMENT vAM1DATA20 "A/T self-diagnosis result (DT6 = 20h)" UBYTE COMP_0068 1 100 0 255 ECU_ADDRESS 0xFFFF48B9 /begin FUNCTION_LIST /end FUNCTION_LIST /end MEASUREMENT
/begin MEASUREMENT vAM1DATA21 "A/T self-diagnosis result (DT6 = 21h)" UBYTE COMP_0068 1 100 0 255 ECU_ADDRESS 0xFFFF48BA /begin FUNCTION_LIST /end FUNCTION_LIST /end MEASUREMENT
/begin MEASUREMENT vAM1DATA30 "A/T self-diagnosis result (DT6 = 30h)" UBYTE COMP_0068 1 100 0 255 ECU_ADDRESS 0xFFFF48BB /begin FUNCTION_LIST /end FUNCTION_LIST /end MEASUREMENT
/begin MEASUREMENT vAM1DATA31 "A/T self-diagnosis result (DT6 = 31h)" UBYTE COMP_0068 1 100 0 255 ECU_ADDRESS 0xFFFF48BC /begin FUNCTION_LIST /end FUNCTION_LIST /end MEASUREMENT
/begin MEASUREMENT vAM1DATA32 "A/T self-diagnosis result (DT6 = 32h)" UBYTE COMP_0068 1 100 0 255 ECU_ADDRESS 0xFFFF48BD /begin FUNCTION_LIST /end FUNCTION_LIST /end MEASUREMENT
/begin MEASUREMENT vAM1DATA40 "A/T self-diagnosis result (DT6 = 40h)" UBYTE COMP_0068 1 100 0 255 ECU_ADDRESS 0xFFFF48BE /begin FUNCTION_LIST /end FUNCTION_LIST /end MEASUREMENT
/begin MEASUREMENT vAM1DATA41 "A/T self-diagnosis result (DT6 = 41h)" UBYTE COMP_0068 1 100 0 255 ECU_ADDRESS 0xFFFF48BF /begin FUNCTION_LIST /end FUNCTION_LIST /end MEASUREMENT
/begin MEASUREMENT vAM1DATA42 "A/T self-diagnosis result (DT6 = 42h)" UBYTE COMP_0068 1 100 0 255 ECU_ADDRESS 0xFFFF48C0 /begin FUNCTION_LIST /end FUNCTION_LIST /end MEASUREMENT
/begin MEASUREMENT vAM1DATA50 "A/T self-diagnosis result (DT6 = 50h)" UBYTE COMP_0068 1 100 0 255 ECU_ADDRESS 0xFFFF48C1 /begin FUNCTION_LIST /end FUNCTION_LIST /end MEASUREMENT
/begin MEASUREMENT vAM1DATA51 "A/T self-diagnosis result (DT6 = 51h)" UBYTE COMP_0068 1 100 0 255 ECU_ADDRESS 0xFFFF48C2 /begin FUNCTION_LIST /end FUNCTION_LIST /end MEASUREMENT
/begin MEASUREMENT vAM1DATA52 "A/T self-diagnosis result (DT6 = 52h)" UBYTE COMP_0068 1 100 0 255 ECU_ADDRESS 0xFFFF48C3 /begin FUNCTION_LIST /end FUNCTION_LIST /end MEASUREMENT
/begin MEASUREMENT vAM1DATA53 "A/T self-diagnosis result (DT6 = 53h)" UBYTE COMP_0068 1 100 0 255 ECU_ADDRESS 0xFFFF48C4 /begin FUNCTION_LIST /end FUNCTION_LIST /end MEASUREMENT
/begin MEASUREMENT vANGOCT1 "Energizing limitation position 1 (high rank word)" UWORD COMP_0554_S 1 100 0 13743685632 ECU_ADDRESS 0xFFFF1168 /begin FUNCTION_LIST /end FUNCTION_LIST /end MEASUREMENT
/begin MEASUREMENT vANGOCT2 "Energizing limitation position 2 (high rank word)" UWORD COMP_0554_S 1 100 0 13743685632 ECU_ADDRESS 0xFFFF116A /begin FUNCTION_LIST /end FUNCTION_LIST /end MEASUREMENT
/begin MEASUREMENT vAPASS0S "The sign of vAPASS0" UBYTE COMP_0004 1 100 0 255 ECU_ADDRESS 0xFFFF1170 /begin FUNCTION_LIST /end FUNCTION_LIST /end MEASUREMENT
/begin MEASUREMENT vAPASS1S "The sign of vAPASS1" UBYTE COMP_0004 1 100 0 255 ECU_ADDRESS 0xFFFF1172 /begin FUNCTION_LIST /end FUNCTION_LIST /end MEASUREMENT
/begin MEASUREMENT vAPASS2S "The sign of vAPASS2" UBYTE COMP_0004 1 100 0 255 ECU_ADDRESS 0xFFFF1174 /begin FUNCTION_LIST /end FUNCTION_LIST /end MEASUREMENT
/begin MEASUREMENT vAPFSASCD "Accelerator drum open-degree for ASCD" UWORD COMP_0005 1 100 0 7208.85 ECU_ADDRESS 0xFFFF1E18 /begin FUNCTION_LIST /end FUNCTION_LIST /end MEASUREMENT
/begin MEASUREMENT vAPOFORCE "The accelerator pedal drive power" SWORD COMP_0030_S 1 100 -32768 32767 ECU_ADDRESS 0xFFFF41B8 /begin FUNCTION_LIST /end FUNCTION_LIST /end MEASUREMENT
/begin MEASUREMENT vAPOFRZ40 "Accelerator pedal ratio (before 40mS)" UWORD COMP_0362_S 1 100 0 8191.875 ECU_ADDRESS 0xFFFF286C /begin FUNCTION_LIST /end FUNCTION_LIST /end MEASUREMENT
/begin MEASUREMENT vAPOFS1 "Accelerator open-degree for the target open-degree operation" UBYTE COMP_0002 1 100 0 89.25 ECU_ADDRESS 0xFFFF286E /begin FUNCTION_LIST /end FUNCTION_LIST /end MEASUREMENT
/begin MEASUREMENT vAPOFSR40 "Accelerator pedal ratio (before 40mS)" UWORD COMP_0362_S 1 100 0 8191.875 ECU_ADDRESS 0xFFFF2870 /begin FUNCTION_LIST /end FUNCTION_LIST /end MEASUREMENT
/begin MEASUREMENT vAPOFSR80 "Accelerator pedal ratio (before 80mS)" UWORD COMP_0362_S 1 100 0 8191.875 ECU_ADDRESS 0xFFFF2872 /begin FUNCTION_LIST /end FUNCTION_LIST /end MEASUREMENT
/begin MEASUREMENT vAPOFSZ40 "Before APOFS 40mS, value" UWORD COMP_0005 1 100 0 7208.85 ECU_ADDRESS 0xFFFF2874 /begin FUNCTION_LIST /end FUNCTION_LIST /end MEASUREMENT
/begin MEASUREMENT vAPOFSZ80 "Before APOFS 80mS, value" UWORD COMP_0005 1 100 0 7208.85 ECU_ADDRESS 0xFFFF2876 /begin FUNCTION_LIST /end FUNCTION_LIST /end MEASUREMENT
/begin MEASUREMENT vAPOK_S "(SubCPU) APO for the table reference" UBYTE COMP_0002 1 100 0 89.25 ECU_ADDRESS 0xFFFF4028 /begin FUNCTION_LIST /end FUNCTION_LIST /end MEASUREMENT
/begin MEASUREMENT vAPOKz0 "Before APOKi* 10mS" UBYTE COMP_0002 1 100 0 89.25 ECU_ADDRESS 0xFFFF38DF /begin FUNCTION_LIST /end FUNCTION_LIST /end MEASUREMENT
/begin MEASUREMENT vAPOKz1 "Before APOKi* 10mS" UBYTE COMP_0002 1 100 0 89.25 ECU_ADDRESS 0xFFFF38E0 /begin FUNCTION_LIST /end FUNCTION_LIST /end MEASUREMENT
/begin MEASUREMENT vAPOKz2 "Before APOKi* 10mS" UBYTE COMP_0002 1 100 0 89.25 ECU_ADDRESS 0xFFFF38E1 /begin FUNCTION_LIST /end FUNCTION_LIST /end MEASUREMENT
/begin MEASUREMENT vAPOKz3 "Before APOKi* 10mS" UBYTE COMP_0002 1 100 0 89.25 ECU_ADDRESS 0xFFFF38E2 /begin FUNCTION_LIST /end FUNCTION_LIST /end MEASUREMENT
/begin MEASUREMENT vAPOPASS "Passing control target open-degree" UWORD COMP_0005 1 100 0 7208.85 ECU_ADDRESS 0xFFFF1176 /begin FUNCTION_LIST /end FUNCTION_LIST /end MEASUREMENT
/begin MEASUREMENT vAPOSR0_S "Drive side accelerator pedal ratio (vice-operation part)" UWORD COMP_0362_S 1 100 0 8191.875 ECU_ADDRESS 0xFFFF34E4 /begin FUNCTION_LIST /end FUNCTION_LIST /end MEASUREMENT
/begin MEASUREMENT vAPOSTR0 "Drive side accelerator pedal ratio" UWORD COMP_0362_S 1 100 0 8191.875 ECU_ADDRESS 0xFFFF287A /begin FUNCTION_LIST /end FUNCTION_LIST /end MEASUREMENT
/begin MEASUREMENT vAPOz1 "Accelerator open-degree (before 10mS)" UWORD COMP_0005 1 100 0 7208.85 ECU_ADDRESS 0xFFFF38E4 /begin FUNCTION_LIST /end FUNCTION_LIST /end MEASUREMENT
/begin MEASUREMENT vAPOz10 "Accelerator open-degree (before 100mS)" UWORD COMP_0005 1 100 0 7208.85 ECU_ADDRESS 0xFFFF38E6 /begin FUNCTION_LIST /end FUNCTION_LIST /end MEASUREMENT
/begin MEASUREMENT vAPOz2 "Accelerator open-degree (before 20mS)" UWORD COMP_0005 1 100 0 7208.85 ECU_ADDRESS 0xFFFF38E8 /begin FUNCTION_LIST /end FUNCTION_LIST /end MEASUREMENT
/begin MEASUREMENT vAPOz3 "Accelerator open-degree (before 30mS)" UWORD COMP_0005 1 100 0 7208.85 ECU_ADDRESS 0xFFFF38EA /begin FUNCTION_LIST /end FUNCTION_LIST /end MEASUREMENT
/begin MEASUREMENT vAPOz4 "Accelerator open-degree (before 40mS)" UWORD COMP_0005 1 100 0 7208.85 ECU_ADDRESS 0xFFFF38EC /begin FUNCTION_LIST /end FUNCTION_LIST /end MEASUREMENT
/begin MEASUREMENT vAPOz5 "Accelerator open-degree (before 50mS)" UWORD COMP_0005 1 100 0 7208.85 ECU_ADDRESS 0xFFFF38EE /begin FUNCTION_LIST /end FUNCTION_LIST /end MEASUREMENT
/begin MEASUREMENT vAPOz6 "Accelerator open-degree (before 60mS)" UWORD COMP_0005 1 100 0 7208.85 ECU_ADDRESS 0xFFFF38F0 /begin FUNCTION_LIST /end FUNCTION_LIST /end MEASUREMENT
/begin MEASUREMENT vAPOz7 "Accelerator open-degree (before 70mS)" UWORD COMP_0005 1 100 0 7208.85 ECU_ADDRESS 0xFFFF38F2 /begin FUNCTION_LIST /end FUNCTION_LIST /end MEASUREMENT
/begin MEASUREMENT vAPOz8 "Accelerator open-degree (before 80mS)" UWORD COMP_0005 1 100 0 7208.85 ECU_ADDRESS 0xFFFF38F4 /begin FUNCTION_LIST /end FUNCTION_LIST /end MEASUREMENT
/begin MEASUREMENT vAPOz9 "Accelerator open-degree (before 90mS)" UWORD COMP_0005 1 100 0 7208.85 ECU_ADDRESS 0xFFFF38F6 /begin FUNCTION_LIST /end FUNCTION_LIST /end MEASUREMENT
/begin MEASUREMENT vAPPFCNT "Present failure counter : invalid value of the alternator power transmitted by the USM.    Stored in E2PROM." UBYTE COMP_0068 1 100 0 255 ECU_ADDRESS 0xFFFFA26E /begin FUNCTION_LIST /end FUNCTION_LIST /end MEASUREMENT
/begin MEASUREMENT vAPPLIKEY "Application Key made available for further use" UWORD COMP_0068 1 100 0 65535 ECU_ADDRESS 0xFFFF38F8 /begin FUNCTION_LIST /end FUNCTION_LIST /end MEASUREMENT
/begin MEASUREMENT vAPPTIM "APP total executive time" ULONG COMP_0376 1 100 0 429496729.5 ECU_ADDRESS 0xFFFF1F9C /begin FUNCTION_LIST /end FUNCTION_LIST /end MEASUREMENT
/begin MEASUREMENT vAPS1CNT "APS1 movement average number of times counter" UWORD COMP_0004 1 100 0 65535 ECU_ADDRESS 0xFFFF38FE /begin FUNCTION_LIST /end FUNCTION_LIST /end MEASUREMENT
/begin MEASUREMENT vAPS1SUM "APS1V total peace" ULONG COMP_0023 1 100 0 21474836475 ECU_ADDRESS 0xFFFF3904 /begin FUNCTION_LIST /end FUNCTION_LIST /end MEASUREMENT
/begin MEASUREMENT vAPS1VOD "After the lower limit limiter treatment, accelerator 1 open-degree (before 100mS)" UWORD COMP_0023 1 100 0 327675 ECU_ADDRESS 0xFFFF390A /begin FUNCTION_LIST /end FUNCTION_LIST /end MEASUREMENT
/begin MEASUREMENT vAPS2CNT "APS2 movement average number of times counter" UWORD COMP_0004 1 100 0 65535 ECU_ADDRESS 0xFFFF390E /begin FUNCTION_LIST /end FUNCTION_LIST /end MEASUREMENT
/begin MEASUREMENT vAPS2SUM "APS2V total peace" ULONG COMP_0023 1 100 0 21474836475 ECU_ADDRESS 0xFFFF3910 /begin FUNCTION_LIST /end FUNCTION_LIST /end MEASUREMENT
/begin MEASUREMENT vAPS2VOD "After the lower limit limiter treatment, accelerator 2 open-degree (before 100mS)" UWORD COMP_0023 1 100 0 327675 ECU_ADDRESS 0xFFFF3916 /begin FUNCTION_LIST /end FUNCTION_LIST /end MEASUREMENT
/begin MEASUREMENT vAPSCCTRZ "Counter of accelerator pedal safety case detected failure N Åã 1 (memorized)" UBYTE COMP_0068 1 100 0 255 ECU_ADDRESS 0xFFFFA26F /begin FUNCTION_LIST /end FUNCTION_LIST /end MEASUREMENT
/begin MEASUREMENT vAPSVOK "RAM for the IDLEA operation" UWORD COMP_0023 1 100 0 327675 ECU_ADDRESS 0xFFFF391E /begin FUNCTION_LIST /end FUNCTION_LIST /end MEASUREMENT
/begin MEASUREMENT vARADLYf "In the region judgement NG delay, flag" UBYTE COMP_0004 1 100 0 255 ECU_ADDRESS 0xFFFF287C /begin FUNCTION_LIST /end FUNCTION_LIST /end MEASUREMENT
/begin MEASUREMENT vARAJBFf "A flag without a diagnosis region condition judgement delay" UBYTE COMP_0004 1 100 0 255 ECU_ADDRESS 0xFFFF287D /begin FUNCTION_LIST /end FUNCTION_LIST /end MEASUREMENT
/begin MEASUREMENT vARAJUGf "Diagnosis region condition formation flag" UBYTE COMP_0004 1 100 0 255 ECU_ADDRESS 0xFFFF287E /begin FUNCTION_LIST /end FUNCTION_LIST /end MEASUREMENT
/begin MEASUREMENT vARBGSTG "airbag write stage" UBYTE COMP_0068 1 100 0 255 ECU_ADDRESS 0xFFFF3920 /begin FUNCTION_LIST /end FUNCTION_LIST /end MEASUREMENT
/begin MEASUREMENT vARBTRG "AirBag Trigger" UBYTE COMP_0068 1 100 0 255 ECU_ADDRESS 0xFFFF4040 /begin FUNCTION_LIST /end FUNCTION_LIST /end MEASUREMENT
/begin MEASUREMENT vASCD2SW "After the double collation, ASCD SW" UBYTE COMP_0068 1 100 0 255 ECU_ADDRESS 0xFFFF3618 /begin FUNCTION_LIST /end FUNCTION_LIST /end MEASUREMENT
/begin MEASUREMENT vASCD50MS "An APP counter for the ASCD control" UBYTE COMP_0068 1 100 0 255 ECU_ADDRESS 0xFFFF2882 /begin FUNCTION_LIST /end FUNCTION_LIST /end MEASUREMENT
/begin MEASUREMENT vASCD5SW "For the 5-times collation" UBYTE COMP_0068 1 100 0 255 ECU_ADDRESS 0xFFFF3921 /begin FUNCTION_LIST /end FUNCTION_LIST /end MEASUREMENT
/begin MEASUREMENT vASCD5SW_R#1 "For the 5-times collation" UBYTE COMP_0068 1 100 0 255 ECU_ADDRESS 0xFFFF3921 /begin FUNCTION_LIST /end FUNCTION_LIST /end MEASUREMENT
/begin MEASUREMENT vASCD5SW_R#2 "For the 5-times collation" UBYTE COMP_0068 1 100 0 255 ECU_ADDRESS 0xFFFF3922 /begin FUNCTION_LIST /end FUNCTION_LIST /end MEASUREMENT
/begin MEASUREMENT vASCD5SW_R#3 "For the 5-times collation" UBYTE COMP_0068 1 100 0 255 ECU_ADDRESS 0xFFFF3923 /begin FUNCTION_LIST /end FUNCTION_LIST /end MEASUREMENT
/begin MEASUREMENT vASCD5SW_R#4 "For the 5-times collation" UBYTE COMP_0068 1 100 0 255 ECU_ADDRESS 0xFFFF3924 /begin FUNCTION_LIST /end FUNCTION_LIST /end MEASUREMENT
/begin MEASUREMENT vASCD5SW_R#5 "For the 5-times collation" UBYTE COMP_0068 1 100 0 255 ECU_ADDRESS 0xFFFF3925 /begin FUNCTION_LIST /end FUNCTION_LIST /end MEASUREMENT
/begin MEASUREMENT vASCDSW "ASCD SW" UBYTE COMP_0068 1 100 0 255 ECU_ADDRESS 0xFFFF2887 /begin FUNCTION_LIST /end FUNCTION_LIST /end MEASUREMENT
/begin MEASUREMENT vASCDSWPR "In front of the double collation, ASCD SW" UBYTE COMP_0068 1 100 0 255 ECU_ADDRESS 0xFFFF3619 /begin FUNCTION_LIST /end FUNCTION_LIST /end MEASUREMENT
/begin MEASUREMENT vASCDSWPRZ "In front of the double collation, ASCD SW (previous value)" UBYTE COMP_0068 1 100 0 255 ECU_ADDRESS 0xFFFF361A /begin FUNCTION_LIST /end FUNCTION_LIST /end MEASUREMENT
/begin MEASUREMENT vASHLGOf "A/F sensor learning permission flag" UBYTE COMP_0004 1 100 0 255 ECU_ADDRESS 0xFFFF288B /begin FUNCTION_LIST /end FUNCTION_LIST /end MEASUREMENT
/begin MEASUREMENT vASHLRCVf "A/F sensor shift learning permission flag" UBYTE COMP_0004 1 100 0 255 ECU_ADDRESS 0xFFFF288C /begin FUNCTION_LIST /end FUNCTION_LIST /end MEASUREMENT
/begin MEASUREMENT vASHTENDf "A/F sensor shift diagnosis completion flag" UBYTE COMP_0004 1 100 0 255 ECU_ADDRESS 0xFFFF288D /begin FUNCTION_LIST /end FUNCTION_LIST /end MEASUREMENT
/begin MEASUREMENT vASRDTQRQ "ASR Dynamic requested torque" UBYTE COMP_0021_S 1 100 -100 410 ECU_ADDRESS 0xFFFF48DA /begin FUNCTION_LIST /end FUNCTION_LIST /end MEASUREMENT
/begin MEASUREMENT vASRSTQRQ "ASR Static requested torque" UBYTE COMP_0021_S 1 100 -100 410 ECU_ADDRESS 0xFFFF48DB /begin FUNCTION_LIST /end FUNCTION_LIST /end MEASUREMENT
/begin MEASUREMENT vATAPACC "ASCD open-degree for the ACC transmission" UBYTE COMP_0022_S 1 100 0 0.99999984 ECU_ADDRESS 0xFFFF1E1C /begin FUNCTION_LIST /end FUNCTION_LIST /end MEASUREMENT
/begin MEASUREMENT vATASLN "Learning quantity area conversion value" SWORD COMP_0379 1 100 -26.2144 26.2136 ECU_ADDRESS 0xFFFFA270 /begin FUNCTION_LIST /end FUNCTION_LIST /end MEASUREMENT
/begin MEASUREMENT vATCUNO "ATCU ROM number" UBYTE COMP_0004 1 100 0 255 ECU_ADDRESS 0xFFFFA272 /begin FUNCTION_LIST /end FUNCTION_LIST /end MEASUREMENT
/begin MEASUREMENT vATCUNO_R#1 "ATCU ROM number" UBYTE COMP_0004 1 100 0 255 ECU_ADDRESS 0xFFFFA272 /begin FUNCTION_LIST /end FUNCTION_LIST /end MEASUREMENT
/begin MEASUREMENT vATCUNO_R#2 "ATCU ROM number" UBYTE COMP_0004 1 100 0 255 ECU_ADDRESS 0xFFFFA273 /begin FUNCTION_LIST /end FUNCTION_LIST /end MEASUREMENT
/begin MEASUREMENT vATCUNO_R#3 "ATCU ROM number" UBYTE COMP_0004 1 100 0 255 ECU_ADDRESS 0xFFFFA274 /begin FUNCTION_LIST /end FUNCTION_LIST /end MEASUREMENT
/begin MEASUREMENT vATCUNO_R#4 "ATCU ROM number" UBYTE COMP_0004 1 100 0 255 ECU_ADDRESS 0xFFFFA275 /begin FUNCTION_LIST /end FUNCTION_LIST /end MEASUREMENT
/begin MEASUREMENT vATCUNO_R#5 "ATCU ROM number" UBYTE COMP_0004 1 100 0 255 ECU_ADDRESS 0xFFFFA276 /begin FUNCTION_LIST /end FUNCTION_LIST /end MEASUREMENT
/begin MEASUREMENT vATCUNO_R#6 "ATCU ROM number" UBYTE COMP_0004 1 100 0 255 ECU_ADDRESS 0xFFFFA277 /begin FUNCTION_LIST /end FUNCTION_LIST /end MEASUREMENT
/begin MEASUREMENT vATMSG1T "ATMSG1 reception interval counter" UBYTE COMP_0014 1 100 0 2550 ECU_ADDRESS 0xFFFF48E5 /begin FUNCTION_LIST /end FUNCTION_LIST /end MEASUREMENT
/begin MEASUREMENT vATMSG2T "ATMSG2 reception interval counter" UBYTE COMP_0014 1 100 0 2550 ECU_ADDRESS 0xFFFF48E6 /begin FUNCTION_LIST /end FUNCTION_LIST /end MEASUREMENT
/begin MEASUREMENT vATRNGZ "AT shift range signal (previous value)" UBYTE COMP_0068 1 100 0 255 ECU_ADDRESS 0xFFFF2892 /begin FUNCTION_LIST /end FUNCTION_LIST /end MEASUREMENT
/begin MEASUREMENT vATSUM "ATCU SUM value" UBYTE COMP_0004 1 100 0 255 ECU_ADDRESS 0xFFFFA278 /begin FUNCTION_LIST /end FUNCTION_LIST /end MEASUREMENT
/begin MEASUREMENT vATSUM_R#1 "ATCU SUM value" UBYTE COMP_0004 1 100 0 255 ECU_ADDRESS 0xFFFFA278 /begin FUNCTION_LIST /end FUNCTION_LIST /end MEASUREMENT
/begin MEASUREMENT vATSUM_R#2 "ATCU SUM value" UBYTE COMP_0004 1 100 0 255 ECU_ADDRESS 0xFFFFA279 /begin FUNCTION_LIST /end FUNCTION_LIST /end MEASUREMENT
/begin MEASUREMENT vATTQCT1T "AT_TorqueControl_RN1 reception interval counter" UBYTE COMP_0014 1 100 0 2550 ECU_ADDRESS 0xFFFF48EC /begin FUNCTION_LIST /end FUNCTION_LIST /end MEASUREMENT
/begin MEASUREMENT vATTQCT2T "AT_TorqueControl_RN2 reception interval counter" UBYTE COMP_0014 1 100 0 2550 ECU_ADDRESS 0xFFFF48ED /begin FUNCTION_LIST /end FUNCTION_LIST /end MEASUREMENT
/begin MEASUREMENT vAUDMY291 "ST drive output value for the UH diagnosis" UWORD COMP_0068 1 100 0 65535 ECU_ADDRESS 0xFFFF1E22 /begin FUNCTION_LIST /end FUNCTION_LIST /end MEASUREMENT
/begin MEASUREMENT vAUDMY292 "ST drive output value for the UH diagnosis" UWORD COMP_0068 1 100 0 65535 ECU_ADDRESS 0xFFFF1E24 /begin FUNCTION_LIST /end FUNCTION_LIST /end MEASUREMENT
/begin MEASUREMENT vAUDMY293 "ST drive output value for the UH diagnosis" UWORD COMP_0068 1 100 0 65535 ECU_ADDRESS 0xFFFF1E26 /begin FUNCTION_LIST /end FUNCTION_LIST /end MEASUREMENT
/begin MEASUREMENT vAUHAFH1 "ST drive output value for the UH diagnosis" UBYTE COMP_0068 1 100 0 255 ECU_ADDRESS 0xFFFF1E28 /begin FUNCTION_LIST /end FUNCTION_LIST /end MEASUREMENT
/begin MEASUREMENT vAUHAFH2 "ST drive output value for the UH diagnosis" UBYTE COMP_0068 1 100 0 255 ECU_ADDRESS 0xFFFF1E29 /begin FUNCTION_LIST /end FUNCTION_LIST /end MEASUREMENT
/begin MEASUREMENT vAUHCDCV1 "ST drive output value for the UH diagnosis" UBYTE COMP_0068 1 100 0 255 ECU_ADDRESS 0xFFFF896B /begin FUNCTION_LIST /end FUNCTION_LIST /end MEASUREMENT
/begin MEASUREMENT vAUHCDCV2 "ST drive output value for the UH diagnosis" UBYTE COMP_0068 1 100 0 255 ECU_ADDRESS 0xFFFF896C /begin FUNCTION_LIST /end FUNCTION_LIST /end MEASUREMENT
/begin MEASUREMENT vAUHCV1_1 "ST drive output value for the UH diagnosis" UBYTE COMP_0068 1 100 0 255 ECU_ADDRESS 0xFFFF896D /begin FUNCTION_LIST /end FUNCTION_LIST /end MEASUREMENT
/begin MEASUREMENT vAUHCV1_2 "ST drive output value for the UH diagnosis" UBYTE COMP_0068 1 100 0 255 ECU_ADDRESS 0xFFFF896E /begin FUNCTION_LIST /end FUNCTION_LIST /end MEASUREMENT
/begin MEASUREMENT vAUHCV2_1 "ST drive output value for the UH diagnosis" UBYTE COMP_0068 1 100 0 255 ECU_ADDRESS 0xFFFF896F /begin FUNCTION_LIST /end FUNCTION_LIST /end MEASUREMENT
/begin MEASUREMENT vAUHCV2_2 "ST drive output value for the UH diagnosis" UBYTE COMP_0068 1 100 0 255 ECU_ADDRESS 0xFFFF8970 /begin FUNCTION_LIST /end FUNCTION_LIST /end MEASUREMENT
/begin MEASUREMENT vAUHDMY "ST drive output value for the UH diagnosis" UWORD COMP_0068 1 100 0 65535 ECU_ADDRESS 0xFFFF1E2A /begin FUNCTION_LIST /end FUNCTION_LIST /end MEASUREMENT
/begin MEASUREMENT vAUHENM1 "ST drive output value for the UH diagnosis" UBYTE COMP_0068 1 100 0 255 ECU_ADDRESS 0xFFFF1E2C /begin FUNCTION_LIST /end FUNCTION_LIST /end MEASUREMENT
/begin MEASUREMENT vAUHENM2 "ST drive output value for the UH diagnosis" UBYTE COMP_0068 1 100 0 255 ECU_ADDRESS 0xFFFF1E2D /begin FUNCTION_LIST /end FUNCTION_LIST /end MEASUREMENT
/begin MEASUREMENT vAUHEV1_1 "ST drive output value for the UH diagnosis" UBYTE COMP_0068 1 100 0 255 ECU_ADDRESS 0xFFFF8971 /begin FUNCTION_LIST /end FUNCTION_LIST /end MEASUREMENT
/begin MEASUREMENT vAUHEV1_2 "ST drive output value for the UH diagnosis" UBYTE COMP_0068 1 100 0 255 ECU_ADDRESS 0xFFFF8972 /begin FUNCTION_LIST /end FUNCTION_LIST /end MEASUREMENT
/begin MEASUREMENT vAUHEV2_1 "ST drive output value for the UH diagnosis" UBYTE COMP_0068 1 100 0 255 ECU_ADDRESS 0xFFFF8973 /begin FUNCTION_LIST /end FUNCTION_LIST /end MEASUREMENT
/begin MEASUREMENT vAUHEV2_2 "ST drive output value for the UH diagnosis" UBYTE COMP_0068 1 100 0 255 ECU_ADDRESS 0xFFFF8974 /begin FUNCTION_LIST /end FUNCTION_LIST /end MEASUREMENT
/begin MEASUREMENT vAUHEVAP "ST drive output value for the UH diagnosis" UBYTE COMP_0068 1 100 0 255 ECU_ADDRESS 0xFFFF1E2E /begin FUNCTION_LIST /end FUNCTION_LIST /end MEASUREMENT
/begin MEASUREMENT vAUHFPR "ST drive output value for the UH diagnosis" UBYTE COMP_0068 1 100 0 255 ECU_ADDRESS 0xFFFF1E2F /begin FUNCTION_LIST /end FUNCTION_LIST /end MEASUREMENT
/begin MEASUREMENT vAUHIGN1 "ST drive output value for the UH diagnosis" UBYTE COMP_0068 1 100 0 255 ECU_ADDRESS 0xFFFF1E30 /begin FUNCTION_LIST /end FUNCTION_LIST /end MEASUREMENT
/begin MEASUREMENT vAUHIGN2 "ST drive output value for the UH diagnosis" UBYTE COMP_0068 1 100 0 255 ECU_ADDRESS 0xFFFF1E31 /begin FUNCTION_LIST /end FUNCTION_LIST /end MEASUREMENT
/begin MEASUREMENT vAUHIGN3 "ST drive output value for the UH diagnosis" UBYTE COMP_0068 1 100 0 255 ECU_ADDRESS 0xFFFF1E32 /begin FUNCTION_LIST /end FUNCTION_LIST /end MEASUREMENT
/begin MEASUREMENT vAUHIGN39 "ST drive output value for the UH diagnosis" UWORD COMP_0068 1 100 0 65535 ECU_ADDRESS 0xFFFF1E34 /begin FUNCTION_LIST /end FUNCTION_LIST /end MEASUREMENT
/begin MEASUREMENT vAUHIGN4 "ST drive output value for the UH diagnosis" UBYTE COMP_0068 1 100 0 255 ECU_ADDRESS 0xFFFF1E36 /begin FUNCTION_LIST /end FUNCTION_LIST /end MEASUREMENT
/begin MEASUREMENT vAUHIGN5 "ST drive output value for the UH diagnosis" UBYTE COMP_0068 1 100 0 255 ECU_ADDRESS 0xFFFF1E37 /begin FUNCTION_LIST /end FUNCTION_LIST /end MEASUREMENT
/begin MEASUREMENT vAUHIGN6 "ST drive output value for the UH diagnosis" UBYTE COMP_0068 1 100 0 255 ECU_ADDRESS 0xFFFF1E38 /begin FUNCTION_LIST /end FUNCTION_LIST /end MEASUREMENT
/begin MEASUREMENT vAUHINJ29 "ST drive output value for the UH diagnosis" UWORD COMP_0068 1 100 0 65535 ECU_ADDRESS 0xFFFF1E3A /begin FUNCTION_LIST /end FUNCTION_LIST /end MEASUREMENT
/begin MEASUREMENT vAUHINJ39 "ST drive output value for the UH diagnosis" UWORD COMP_0068 1 100 0 65535 ECU_ADDRESS 0xFFFF1E3C /begin FUNCTION_LIST /end FUNCTION_LIST /end MEASUREMENT
/begin MEASUREMENT vAUHO2HR1 "ST drive output value for the UH diagnosis" UBYTE COMP_0068 1 100 0 255 ECU_ADDRESS 0xFFFF1E3E /begin FUNCTION_LIST /end FUNCTION_LIST /end MEASUREMENT
/begin MEASUREMENT vAUHO2HR2 "ST drive output value for the UH diagnosis" UBYTE COMP_0068 1 100 0 255 ECU_ADDRESS 0xFFFF1E3F /begin FUNCTION_LIST /end FUNCTION_LIST /end MEASUREMENT
/begin MEASUREMENT vAUHS29DY "ST drive output value for the UH diagnosis" UBYTE COMP_0068 1 100 0 255 ECU_ADDRESS 0xFFFF1E40 /begin FUNCTION_LIST /end FUNCTION_LIST /end MEASUREMENT
/begin MEASUREMENT vAUHS39DY "ST drive output value for the UH diagnosis" UBYTE COMP_0068 1 100 0 255 ECU_ADDRESS 0xFFFF1E41 /begin FUNCTION_LIST /end FUNCTION_LIST /end MEASUREMENT
/begin MEASUREMENT vAUHSOL29 "ST drive output value for the UH diagnosis" UWORD COMP_0068 1 100 0 65535 ECU_ADDRESS 0xFFFF1E42 /begin FUNCTION_LIST /end FUNCTION_LIST /end MEASUREMENT
/begin MEASUREMENT vAUHSOL39 "ST drive output value for the UH diagnosis" UWORD COMP_0068 1 100 0 65535 ECU_ADDRESS 0xFFFF1E44 /begin FUNCTION_LIST /end FUNCTION_LIST /end MEASUREMENT
/begin MEASUREMENT vAUHVIAS1 "ST drive output value for the UH diagnosis" UBYTE COMP_0068 1 100 0 255 ECU_ADDRESS 0xFFFF8975 /begin FUNCTION_LIST /end FUNCTION_LIST /end MEASUREMENT
/begin MEASUREMENT vAUHVIAS2 "ST drive output value for the UH diagnosis" UBYTE COMP_0068 1 100 0 255 ECU_ADDRESS 0xFFFF1E46 /begin FUNCTION_LIST /end FUNCTION_LIST /end MEASUREMENT
/begin MEASUREMENT vAUMOTRLY "ST drive output value for the UH diagnosis" UBYTE COMP_0068 1 100 0 255 ECU_ADDRESS 0xFFFF1E47 /begin FUNCTION_LIST /end FUNCTION_LIST /end MEASUREMENT
/begin MEASUREMENT vAUREG28 "ST drive output value for the UH diagnosis" UWORD COMP_0068 1 100 0 65535 ECU_ADDRESS 0xFFFF1E48 /begin FUNCTION_LIST /end FUNCTION_LIST /end MEASUREMENT
/begin MEASUREMENT vAUREG291 "ST drive output value for the UH diagnosis" UWORD COMP_0068 1 100 0 65535 ECU_ADDRESS 0xFFFF1E4A /begin FUNCTION_LIST /end FUNCTION_LIST /end MEASUREMENT
/begin MEASUREMENT vAUREG292 "ST drive output value for the UH diagnosis" UWORD COMP_0068 1 100 0 65535 ECU_ADDRESS 0xFFFF1E4C /begin FUNCTION_LIST /end FUNCTION_LIST /end MEASUREMENT
/begin MEASUREMENT vAUREG293 "ST drive output value for the UH diagnosis" UWORD COMP_0068 1 100 0 65535 ECU_ADDRESS 0xFFFF1E4E /begin FUNCTION_LIST /end FUNCTION_LIST /end MEASUREMENT
/begin MEASUREMENT vAUREG391 "ST drive output value for the UH diagnosis" UWORD COMP_0068 1 100 0 65535 ECU_ADDRESS 0xFFFF1E50 /begin FUNCTION_LIST /end FUNCTION_LIST /end MEASUREMENT
/begin MEASUREMENT vAUREG392 "ST drive output value for the UH diagnosis" UWORD COMP_0068 1 100 0 65535 ECU_ADDRESS 0xFFFF1E52 /begin FUNCTION_LIST /end FUNCTION_LIST /end MEASUREMENT
/begin MEASUREMENT vAUREG393 "ST drive output value for the UH diagnosis" UWORD COMP_0068 1 100 0 65535 ECU_ADDRESS 0xFFFF1E54 /begin FUNCTION_LIST /end FUNCTION_LIST /end MEASUREMENT
/begin MEASUREMENT vAUREG394 "ST drive output value for the UH diagnosis" UWORD COMP_0068 1 100 0 65535 ECU_ADDRESS 0xFFFF1E56 /begin FUNCTION_LIST /end FUNCTION_LIST /end MEASUREMENT
/begin MEASUREMENT vAUREG395 "ST drive output value for the UH diagnosis" UWORD COMP_0068 1 100 0 65535 ECU_ADDRESS 0xFFFF1E58 /begin FUNCTION_LIST /end FUNCTION_LIST /end MEASUREMENT
/begin MEASUREMENT vAUREG396 "ST drive output value for the UH diagnosis" UWORD COMP_0068 1 100 0 65535 ECU_ADDRESS 0xFFFF1E5A /begin FUNCTION_LIST /end FUNCTION_LIST /end MEASUREMENT
/begin MEASUREMENT vAUTFTMEM "Stored value of vAUTFTMOT" UBYTE COMP_0068 1 100 0 255 ECU_ADDRESS 0xFFFFB562 /begin FUNCTION_LIST /end FUNCTION_LIST /end MEASUREMENT
/begin MEASUREMENT vAVAL3 "LEKAL3 mean" UBYTE COMP_0232 1 100 0 1.9921875 ECU_ADDRESS 0xFFFFA27A /begin FUNCTION_LIST /end FUNCTION_LIST /end MEASUREMENT
/begin MEASUREMENT vAVAL32 "At the time of the 0.04inch leak-down, LEKAL3 mean" UBYTE COMP_0232 1 100 0 1.9921875 ECU_ADDRESS 0xFFFFA27B /begin FUNCTION_LIST /end FUNCTION_LIST /end MEASUREMENT
/begin MEASUREMENT vAVALT "Alternator control DUTY weighted average" UBYTE COMP_0047 1 100 0 127.5 ECU_ADDRESS 0xFFFF1D94 /begin FUNCTION_LIST /end FUNCTION_LIST /end MEASUREMENT
/begin MEASUREMENT vAVDRV0 "FPCM diagnosis judgement value (monitor)" UBYTE COMP_0118 1 100 0 10200 ECU_ADDRESS 0xFFFF118A /begin FUNCTION_LIST /end FUNCTION_LIST /end MEASUREMENT
/begin MEASUREMENT vAVDRV1 "D/R average voltage value 1" UBYTE COMP_0118 1 100 0 10200 ECU_ADDRESS 0xFFFF289C /begin FUNCTION_LIST /end FUNCTION_LIST /end MEASUREMENT
/begin MEASUREMENT vAVDRV2 "D/R average voltage value 2" UBYTE COMP_0118 1 100 0 10200 ECU_ADDRESS 0xFFFF289D /begin FUNCTION_LIST /end FUNCTION_LIST /end MEASUREMENT
/begin MEASUREMENT vAVDRV3 "D/R average voltage value 3" UBYTE COMP_0118 1 100 0 10200 ECU_ADDRESS 0xFFFF289E /begin FUNCTION_LIST /end FUNCTION_LIST /end MEASUREMENT
/begin MEASUREMENT vAVDRVJ "FPCM diagnosis judgement value" UBYTE COMP_0118 1 100 0 10200 ECU_ADDRESS 0xFFFF118B /begin FUNCTION_LIST /end FUNCTION_LIST /end MEASUREMENT
/begin MEASUREMENT vAVEPSVz1 "P/S oil pressure sensor voltage weighted average value (before 10mS)" UBYTE COMP_0054 1 100 0 5100 ECU_ADDRESS 0xFFFF1196 /begin FUNCTION_LIST /end FUNCTION_LIST /end MEASUREMENT
/begin MEASUREMENT vAVEPSVz2 "P/S oil pressure sensor voltage weighted average value (before 20mS)" UBYTE COMP_0054 1 100 0 5100 ECU_ADDRESS 0xFFFF1197 /begin FUNCTION_LIST /end FUNCTION_LIST /end MEASUREMENT
/begin MEASUREMENT vAVEPSVz3 "P/S oil pressure sensor voltage weighted average value (before 30mS)" UBYTE COMP_0054 1 100 0 5100 ECU_ADDRESS 0xFFFF1198 /begin FUNCTION_LIST /end FUNCTION_LIST /end MEASUREMENT
/begin MEASUREMENT vAVEPSVz4 "P/S oil pressure sensor voltage weighted average value (before 40mS)" UBYTE COMP_0054 1 100 0 5100 ECU_ADDRESS 0xFFFF1199 /begin FUNCTION_LIST /end FUNCTION_LIST /end MEASUREMENT
/begin MEASUREMENT vAVETF "Average fuel temperature voltage" UWORD COMP_0023 1 100 0 327675 ECU_ADDRESS 0xFFFF1E5C /begin FUNCTION_LIST /end FUNCTION_LIST /end MEASUREMENT
/begin MEASUREMENT vAVEVPS "At the time of the pull-down F/B, open-degree weighted average value" UWORD COMP_0269 1 100 0 127.998046875 ECU_ADDRESS 0xFFFF28A0 /begin FUNCTION_LIST /end FUNCTION_LIST /end MEASUREMENT
/begin MEASUREMENT vAVEVPSOLD "At the time of the pull-down F/B, open-degree weighted average value OLD" UWORD COMP_0269 1 100 0 127.998046875 ECU_ADDRESS 0xFFFF28A2 /begin FUNCTION_LIST /end FUNCTION_LIST /end MEASUREMENT
/begin MEASUREMENT vAVGAFH1f "Heater electric current value A/D value weighted average value, settlement of initial value" UBYTE COMP_0004 1 100 0 255 ECU_ADDRESS 0xFFFF392C /begin FUNCTION_LIST /end FUNCTION_LIST /end MEASUREMENT
/begin MEASUREMENT vAVIGL2 "At the time of the 0.04inch leak-down, slosh compensation value mean" UWORD COMP_0050 1 100 0 5119.921875 ECU_ADDRESS 0xFFFFA27C /begin FUNCTION_LIST /end FUNCTION_LIST /end MEASUREMENT
/begin MEASUREMENT vAVIGLX "At the time of the 0.02inch leak-down, slosh compensation value mean" UWORD COMP_0050 1 100 0 5119.921875 ECU_ADDRESS 0xFFFFA27E /begin FUNCTION_LIST /end FUNCTION_LIST /end MEASUREMENT
/begin MEASUREMENT vAVILI2 "A parameter mean for the line pressure sensor function diagnosis" UWORD COMP_0050 1 100 0 5119.921875 ECU_ADDRESS 0xFFFFA280 /begin FUNCTION_LIST /end FUNCTION_LIST /end MEASUREMENT
/begin MEASUREMENT vAVPDC "Pull-down number of times mean" UBYTE COMP_0380 1 100 0 15.9375 ECU_ADDRESS 0xFFFFA282 /begin FUNCTION_LIST /end FUNCTION_LIST /end MEASUREMENT
/begin MEASUREMENT vAVPMIN "Fuel pressure weighted average value" UWORD COMP_0164 1 100 0 19.988175 ECU_ADDRESS 0xFFFFA284 /begin FUNCTION_LIST /end FUNCTION_LIST /end MEASUREMENT
/begin MEASUREMENT vAVTOS "TO2S mean" UWORD COMP_0250 1 100 0 262140 ECU_ADDRESS 0xFFFF37CE /begin FUNCTION_LIST /end FUNCTION_LIST /end MEASUREMENT
/begin MEASUREMENT vBARTIO "Brake air mixing coefficient" UWORD COMP_0381 1 100 0 8.0018235 ECU_ADDRESS 0xFFFF28BE /begin FUNCTION_LIST /end FUNCTION_LIST /end MEASUREMENT
/begin MEASUREMENT vBASLRNE "VTC reference corner angle learning value" UBYTE COMP_0048 1 100 0 127.5 ECU_ADDRESS 0xFFFFA289 /begin FUNCTION_LIST /end FUNCTION_LIST /end MEASUREMENT
/begin MEASUREMENT vBASLRNE_R#1 "VTC reference corner angle learning value" UBYTE COMP_0048 1 100 0 127.5 ECU_ADDRESS 0xFFFFA289 /begin FUNCTION_LIST /end FUNCTION_LIST /end MEASUREMENT
/begin MEASUREMENT vBASLRNE_R#2 "VTC reference corner angle learning value" UBYTE COMP_0048 1 100 0 127.5 ECU_ADDRESS 0xFFFFA28A /begin FUNCTION_LIST /end FUNCTION_LIST /end MEASUREMENT
/begin MEASUREMENT vBASLRNI "VTC reference corner angle learning value" UBYTE COMP_0048 1 100 0 127.5 ECU_ADDRESS 0xFFFFA28B /begin FUNCTION_LIST /end FUNCTION_LIST /end MEASUREMENT
/begin MEASUREMENT vBASLRNI_R#1 "VTC reference corner angle learning value" UBYTE COMP_0048 1 100 0 127.5 ECU_ADDRESS 0xFFFFA28B /begin FUNCTION_LIST /end FUNCTION_LIST /end MEASUREMENT
/begin MEASUREMENT vBASLRNI_R#2 "VTC reference corner angle learning value" UBYTE COMP_0048 1 100 0 127.5 ECU_ADDRESS 0xFFFFA28C /begin FUNCTION_LIST /end FUNCTION_LIST /end MEASUREMENT
/begin MEASUREMENT vBASOFS2 "The amount of VTC maximum-retard degree position deviation" UBYTE COMP_0257 1 100 -128 127 ECU_ADDRESS 0xFFFF11AB /begin FUNCTION_LIST /end FUNCTION_LIST /end MEASUREMENT
/begin MEASUREMENT vBASOFS2_R#1 "The amount of VTC maximum-retard degree position deviation" UBYTE COMP_0257 1 100 -128 127 ECU_ADDRESS 0xFFFF11AB /begin FUNCTION_LIST /end FUNCTION_LIST /end MEASUREMENT
/begin MEASUREMENT vBASOFS2_R#2 "The amount of VTC maximum-retard degree position deviation" UBYTE COMP_0257 1 100 -128 127 ECU_ADDRESS 0xFFFF11AC /begin FUNCTION_LIST /end FUNCTION_LIST /end MEASUREMENT
/begin MEASUREMENT vBASOFSE "The amount of VTC reference corner angle deviation" UBYTE COMP_0256 1 100 -64 63.5 ECU_ADDRESS 0xFFFF11AF /begin FUNCTION_LIST /end FUNCTION_LIST /end MEASUREMENT
/begin MEASUREMENT vBASOFSE_R#1 "The amount of VTC reference corner angle deviation" UBYTE COMP_0256 1 100 -64 63.5 ECU_ADDRESS 0xFFFF11AF /begin FUNCTION_LIST /end FUNCTION_LIST /end MEASUREMENT
/begin MEASUREMENT vBASOFSE_R#2 "The amount of VTC reference corner angle deviation" UBYTE COMP_0256 1 100 -64 63.5 ECU_ADDRESS 0xFFFF11B0 /begin FUNCTION_LIST /end FUNCTION_LIST /end MEASUREMENT
/begin MEASUREMENT vBASOFSI "The amount of VTC reference corner angle deviation" UBYTE COMP_0256 1 100 -64 63.5 ECU_ADDRESS 0xFFFF11B1 /begin FUNCTION_LIST /end FUNCTION_LIST /end MEASUREMENT
/begin MEASUREMENT vBASOFSI_R#1 "The amount of VTC reference corner angle deviation" UBYTE COMP_0256 1 100 -64 63.5 ECU_ADDRESS 0xFFFF11B1 /begin FUNCTION_LIST /end FUNCTION_LIST /end MEASUREMENT
/begin MEASUREMENT vBASOFSI_R#2 "The amount of VTC reference corner angle deviation" UBYTE COMP_0256 1 100 -64 63.5 ECU_ADDRESS 0xFFFF11B2 /begin FUNCTION_LIST /end FUNCTION_LIST /end MEASUREMENT
/begin MEASUREMENT vBASPA1 "Reference atomospheric pressure" UWORD COMP_0050 1 100 0 5119.921875 ECU_ADDRESS 0xFFFF11B4 /begin FUNCTION_LIST /end FUNCTION_LIST /end MEASUREMENT
/begin MEASUREMENT vBASTE "VTC basic target angle" UBYTE COMP_0256 1 100 -64 63.5 ECU_ADDRESS 0xFFFF11B6 /begin FUNCTION_LIST /end FUNCTION_LIST /end MEASUREMENT
/begin MEASUREMENT vBASTF1 "Reference fuel temperature voltage" UBYTE COMP_0054 1 100 0 5100 ECU_ADDRESS 0xFFFF11B7 /begin FUNCTION_LIST /end FUNCTION_LIST /end MEASUREMENT
/begin MEASUREMENT vBASTGE "VTC basic target angle" UBYTE COMP_0256 1 100 -64 63.5 ECU_ADDRESS 0xFFFF11BA /begin FUNCTION_LIST /end FUNCTION_LIST /end MEASUREMENT
/begin MEASUREMENT vBASTGI "VTC basic target angle" UBYTE COMP_0256 1 100 -64 63.5 ECU_ADDRESS 0xFFFF11BB /begin FUNCTION_LIST /end FUNCTION_LIST /end MEASUREMENT
/begin MEASUREMENT vBASTI "VTC basic target angle" UBYTE COMP_0256 1 100 -64 63.5 ECU_ADDRESS 0xFFFF11BC /begin FUNCTION_LIST /end FUNCTION_LIST /end MEASUREMENT
/begin MEASUREMENT vBASTRGE "VTC basic target angle" UBYTE COMP_0256 1 100 -64 63.5 ECU_ADDRESS 0xFFFF100A /begin FUNCTION_LIST /end FUNCTION_LIST /end MEASUREMENT
/begin MEASUREMENT vBASTRGI "VTC basic target angle" UBYTE COMP_0256 1 100 -64 63.5 ECU_ADDRESS 0xFFFF100B /begin FUNCTION_LIST /end FUNCTION_LIST /end MEASUREMENT
/begin MEASUREMENT vBATSC "Battery electric current sensor middle sticking voltage" UWORD COMP_0023 1 100 0 327675 ECU_ADDRESS 0xFFFF28C4 /begin FUNCTION_LIST /end FUNCTION_LIST /end MEASUREMENT
/begin MEASUREMENT vBATSENK "Battery electric current sensor output voltage weighted average value" UWORD COMP_0023 1 100 0 327675 ECU_ADDRESS 0xFFFF88A4 /begin FUNCTION_LIST /end FUNCTION_LIST /end MEASUREMENT
/begin MEASUREMENT vBATTMP "Battery liquid temperature estimated value" UBYTE COMP_0035 1 100 -50 205 ECU_ADDRESS 0xFFFFA28E /begin FUNCTION_LIST /end FUNCTION_LIST /end MEASUREMENT
/begin MEASUREMENT vBBLKCTRMZ "Maximum value of counter for detection of blocked button. Saved in EEPROM" UBYTE COMP_0068 1 100 0 255 ECU_ADDRESS 0xFFFF28C6 /begin FUNCTION_LIST /end FUNCTION_LIST /end MEASUREMENT
/begin MEASUREMENT vBCAMIN "Last time, at the time of the CAM input, timer value" ULONG COMP_0189 1 100 0 13743895344 ECU_ADDRESS 0xFFFF1FA4 /begin FUNCTION_LIST /end FUNCTION_LIST /end MEASUREMENT
/begin MEASUREMENT vBCMTRG "BCM_CANHS_RNr_01 Trigger" UBYTE COMP_0068 1 100 0 255 ECU_ADDRESS 0xFFFF4041 /begin FUNCTION_LIST /end FUNCTION_LIST /end MEASUREMENT
/begin MEASUREMENT vBETAW "Knock control value" SWORD COMP_0078 1 100 -128 127.99609375 ECU_ADDRESS 0xFFFF1012 /begin FUNCTION_LIST /end FUNCTION_LIST /end MEASUREMENT
/begin MEASUREMENT vBFACNT "Counter of 100mS for BFAPO_cal" UBYTE COMP_0068 1 100 0 255 ECU_ADDRESS 0xFFFF392D /begin FUNCTION_LIST /end FUNCTION_LIST /end MEASUREMENT
/begin MEASUREMENT vBFCNL2 "Lean side fixed shift renewal number of times counter AFSCNL2 previous value" UBYTE COMP_0030 1 100 0 255 ECU_ADDRESS 0xFFFF28D6 /begin FUNCTION_LIST /end FUNCTION_LIST /end MEASUREMENT
/begin MEASUREMENT vBFCNL3 "Rich side fixed shift renewal number of times counter AFSCNL3 previous value" UBYTE COMP_0030 1 100 0 255 ECU_ADDRESS 0xFFFF28D8 /begin FUNCTION_LIST /end FUNCTION_LIST /end MEASUREMENT
/begin MEASUREMENT vBFCNR2 "Lean side moment fixed shift renewal number of times counter AFSCNR2 previous value" UBYTE COMP_0030 1 100 0 255 ECU_ADDRESS 0xFFFF28DA /begin FUNCTION_LIST /end FUNCTION_LIST /end MEASUREMENT
/begin MEASUREMENT vBFCNR3 "Rich side moment fixed shift renewal number of times counter AFSCNR3 previous value" UBYTE COMP_0030 1 100 0 255 ECU_ADDRESS 0xFFFF28DC /begin FUNCTION_LIST /end FUNCTION_LIST /end MEASUREMENT
/begin MEASUREMENT vBFHOSNC "AFSHOSN renewal counter AFSHOSNC previous value" UBYTE COMP_0030 1 100 0 255 ECU_ADDRESS 0xFFFF28DE /begin FUNCTION_LIST /end FUNCTION_LIST /end MEASUREMENT
/begin MEASUREMENT vBITCNT "A port off applicable bit position for the output check" UWORD COMP_0068 1 100 0 65535 ECU_ADDRESS 0xFFFF28EE /begin FUNCTION_LIST /end FUNCTION_LIST /end MEASUREMENT
/begin MEASUREMENT vBITCNTB "A port off applicable bit position buffer for the output check" UWORD COMP_0068 1 100 0 65535 ECU_ADDRESS 0xFFFF28F0 /begin FUNCTION_LIST /end FUNCTION_LIST /end MEASUREMENT
/begin MEASUREMENT vBKKPTY "The backup of the parity" ULONG COMP_0068 1 100 0 4294967295 ECU_ADDRESS 0xFFFF28F4 /begin FUNCTION_LIST /end FUNCTION_LIST /end MEASUREMENT
/begin MEASUREMENT vBKKSUM "The backup of the checksum" ULONG COMP_0068 1 100 0 4294967295 ECU_ADDRESS 0xFFFF28F8 /begin FUNCTION_LIST /end FUNCTION_LIST /end MEASUREMENT
/begin MEASUREMENT vBKPTY "The backup of the parity" ULONG COMP_0068 1 100 0 4294967295 ECU_ADDRESS 0xFFFF28FC /begin FUNCTION_LIST /end FUNCTION_LIST /end MEASUREMENT
/begin MEASUREMENT vBKSUM "The backup of the checksum" ULONG COMP_0068 1 100 0 4294967295 ECU_ADDRESS 0xFFFF2900 /begin FUNCTION_LIST /end FUNCTION_LIST /end MEASUREMENT
/begin MEASUREMENT vBMMIN1 "BMSNG MIN value for the control" UBYTE COMP_0014 1 100 0 2550 ECU_ADDRESS 0xFFFFA294 /begin FUNCTION_LIST /end FUNCTION_LIST /end MEASUREMENT
/begin MEASUREMENT vBMMIN2 "BMSNG MIN value for the SW function" UBYTE COMP_0014 1 100 0 2550 ECU_ADDRESS 0xFFFFA295 /begin FUNCTION_LIST /end FUNCTION_LIST /end MEASUREMENT
/begin MEASUREMENT vBNCSWTM "BNCSWTM On trouble judgement timer" UWORD COMP_0013 1 100 0 65535 ECU_ADDRESS 0xFFFFA296 /begin FUNCTION_LIST /end FUNCTION_LIST /end MEASUREMENT
/begin MEASUREMENT vBPAMN "PHOSA minimum value" UBYTE COMP_0072 1 100 -8 7.9375 ECU_ADDRESS 0xFFFFA298 /begin FUNCTION_LIST /end FUNCTION_LIST /end MEASUREMENT
/begin MEASUREMENT vBPAMX "PHOSA maximum value" UBYTE COMP_0072 1 100 -8 7.9375 ECU_ADDRESS 0xFFFFA29A /begin FUNCTION_LIST /end FUNCTION_LIST /end MEASUREMENT
/begin MEASUREMENT vBPKSW "parking braking detected" UBYTE COMP_0068 1 100 0 255 ECU_ADDRESS 0xFFFF4042 /begin FUNCTION_LIST /end FUNCTION_LIST /end MEASUREMENT
/begin MEASUREMENT vBPRAM1f "RrO2/S diagnosis stage 1 parameter backup treatment completion judgement" UBYTE COMP_0004 1 100 0 255 ECU_ADDRESS 0xFFFF392E /begin FUNCTION_LIST /end FUNCTION_LIST /end MEASUREMENT
/begin MEASUREMENT vBPSBUF "BPS[] Buffer" UBYTE COMP_0068 1 100 0 255 ECU_ADDRESS 0xFFFF2904 /begin FUNCTION_LIST /end FUNCTION_LIST /end MEASUREMENT
/begin MEASUREMENT vBRAMADR "Backup RAM writing address" ULONG COMP_0068 1 100 0 4294967295 ECU_ADDRESS 0xFFFF2908 /begin FUNCTION_LIST /end FUNCTION_LIST /end MEASUREMENT
/begin MEASUREMENT vBRAMBUF "EEP- ROM writing data storage buffer" UBYTE COMP_0068 1 100 0 255 ECU_ADDRESS 0xFFFF290C /begin FUNCTION_LIST /end FUNCTION_LIST /end MEASUREMENT
/begin MEASUREMENT vBRAMBUF_R#1 "EEP- ROM writing data storage buffer" UBYTE COMP_0068 1 100 0 255 ECU_ADDRESS 0xFFFF290C /begin FUNCTION_LIST /end FUNCTION_LIST /end MEASUREMENT
/begin MEASUREMENT vBRAMBUF_R#2 "EEP- ROM writing data storage buffer" UBYTE COMP_0068 1 100 0 255 ECU_ADDRESS 0xFFFF290D /begin FUNCTION_LIST /end FUNCTION_LIST /end MEASUREMENT
/begin MEASUREMENT vBRAMBUF_R#3 "EEP- ROM writing data storage buffer" UBYTE COMP_0068 1 100 0 255 ECU_ADDRESS 0xFFFF290E /begin FUNCTION_LIST /end FUNCTION_LIST /end MEASUREMENT
/begin MEASUREMENT vBRAMBUF_R#4 "EEP- ROM writing data storage buffer" UBYTE COMP_0068 1 100 0 255 ECU_ADDRESS 0xFFFF290F /begin FUNCTION_LIST /end FUNCTION_LIST /end MEASUREMENT
/begin MEASUREMENT vBRAMBUF_R#5 "EEP- ROM writing data storage buffer" UBYTE COMP_0068 1 100 0 255 ECU_ADDRESS 0xFFFF2910 /begin FUNCTION_LIST /end FUNCTION_LIST /end MEASUREMENT
/begin MEASUREMENT vBRAMBUF_R#6 "EEP- ROM writing data storage buffer" UBYTE COMP_0068 1 100 0 255 ECU_ADDRESS 0xFFFF2911 /begin FUNCTION_LIST /end FUNCTION_LIST /end MEASUREMENT
/begin MEASUREMENT vBRAMBUF_R#7 "EEP- ROM writing data storage buffer" UBYTE COMP_0068 1 100 0 255 ECU_ADDRESS 0xFFFF2912 /begin FUNCTION_LIST /end FUNCTION_LIST /end MEASUREMENT
/begin MEASUREMENT vBRAMBUF_R#8 "EEP- ROM writing data storage buffer" UBYTE COMP_0068 1 100 0 255 ECU_ADDRESS 0xFFFF2913 /begin FUNCTION_LIST /end FUNCTION_LIST /end MEASUREMENT
/begin MEASUREMENT vBRAMBUF_R#9 "EEP- ROM writing data storage buffer" UBYTE COMP_0068 1 100 0 255 ECU_ADDRESS 0xFFFF2914 /begin FUNCTION_LIST /end FUNCTION_LIST /end MEASUREMENT
/begin MEASUREMENT vBRAMBUF_R#10 "EEP- ROM writing data storage buffer" UBYTE COMP_0068 1 100 0 255 ECU_ADDRESS 0xFFFF2915 /begin FUNCTION_LIST /end FUNCTION_LIST /end MEASUREMENT
/begin MEASUREMENT vBRAMBUF_R#11 "EEP- ROM writing data storage buffer" UBYTE COMP_0068 1 100 0 255 ECU_ADDRESS 0xFFFF2916 /begin FUNCTION_LIST /end FUNCTION_LIST /end MEASUREMENT
/begin MEASUREMENT vBRAMBUF_R#12 "EEP- ROM writing data storage buffer" UBYTE COMP_0068 1 100 0 255 ECU_ADDRESS 0xFFFF2917 /begin FUNCTION_LIST /end FUNCTION_LIST /end MEASUREMENT
/begin MEASUREMENT vBRAMBUF_R#13 "EEP- ROM writing data storage buffer" UBYTE COMP_0068 1 100 0 255 ECU_ADDRESS 0xFFFF2918 /begin FUNCTION_LIST /end FUNCTION_LIST /end MEASUREMENT
/begin MEASUREMENT vBRAMBUF_R#14 "EEP- ROM writing data storage buffer" UBYTE COMP_0068 1 100 0 255 ECU_ADDRESS 0xFFFF2919 /begin FUNCTION_LIST /end FUNCTION_LIST /end MEASUREMENT
/begin MEASUREMENT vBRAMBUF_R#15 "EEP- ROM writing data storage buffer" UBYTE COMP_0068 1 100 0 255 ECU_ADDRESS 0xFFFF291A /begin FUNCTION_LIST /end FUNCTION_LIST /end MEASUREMENT
/begin MEASUREMENT vBRAMBUF_R#16 "EEP- ROM writing data storage buffer" UBYTE COMP_0068 1 100 0 255 ECU_ADDRESS 0xFFFF291B /begin FUNCTION_LIST /end FUNCTION_LIST /end MEASUREMENT
/begin MEASUREMENT vBRAMBUF_R#17 "EEP- ROM writing data storage buffer" UBYTE COMP_0068 1 100 0 255 ECU_ADDRESS 0xFFFF291C /begin FUNCTION_LIST /end FUNCTION_LIST /end MEASUREMENT
/begin MEASUREMENT vBRAMBUF_R#18 "EEP- ROM writing data storage buffer" UBYTE COMP_0068 1 100 0 255 ECU_ADDRESS 0xFFFF291D /begin FUNCTION_LIST /end FUNCTION_LIST /end MEASUREMENT
/begin MEASUREMENT vBRAMBUF_R#19 "EEP- ROM writing data storage buffer" UBYTE COMP_0068 1 100 0 255 ECU_ADDRESS 0xFFFF291E /begin FUNCTION_LIST /end FUNCTION_LIST /end MEASUREMENT
/begin MEASUREMENT vBRAMBUF_R#20 "EEP- ROM writing data storage buffer" UBYTE COMP_0068 1 100 0 255 ECU_ADDRESS 0xFFFF291F /begin FUNCTION_LIST /end FUNCTION_LIST /end MEASUREMENT
/begin MEASUREMENT vBRAMBUF_R#21 "EEP- ROM writing data storage buffer" UBYTE COMP_0068 1 100 0 255 ECU_ADDRESS 0xFFFF2920 /begin FUNCTION_LIST /end FUNCTION_LIST /end MEASUREMENT
/begin MEASUREMENT vBRAMBUF_R#22 "EEP- ROM writing data storage buffer" UBYTE COMP_0068 1 100 0 255 ECU_ADDRESS 0xFFFF2921 /begin FUNCTION_LIST /end FUNCTION_LIST /end MEASUREMENT
/begin MEASUREMENT vBRAMBUF_R#23 "EEP- ROM writing data storage buffer" UBYTE COMP_0068 1 100 0 255 ECU_ADDRESS 0xFFFF2922 /begin FUNCTION_LIST /end FUNCTION_LIST /end MEASUREMENT
/begin MEASUREMENT vBRAMBUF_R#24 "EEP- ROM writing data storage buffer" UBYTE COMP_0068 1 100 0 255 ECU_ADDRESS 0xFFFF2923 /begin FUNCTION_LIST /end FUNCTION_LIST /end MEASUREMENT
/begin MEASUREMENT vBRAMBUF_R#25 "EEP- ROM writing data storage buffer" UBYTE COMP_0068 1 100 0 255 ECU_ADDRESS 0xFFFF2924 /begin FUNCTION_LIST /end FUNCTION_LIST /end MEASUREMENT
/begin MEASUREMENT vBRAMBUF_R#26 "EEP- ROM writing data storage buffer" UBYTE COMP_0068 1 100 0 255 ECU_ADDRESS 0xFFFF2925 /begin FUNCTION_LIST /end FUNCTION_LIST /end MEASUREMENT
/begin MEASUREMENT vBRAMBUF_R#27 "EEP- ROM writing data storage buffer" UBYTE COMP_0068 1 100 0 255 ECU_ADDRESS 0xFFFF2926 /begin FUNCTION_LIST /end FUNCTION_LIST /end MEASUREMENT
/begin MEASUREMENT vBRAMBUF_R#28 "EEP- ROM writing data storage buffer" UBYTE COMP_0068 1 100 0 255 ECU_ADDRESS 0xFFFF2927 /begin FUNCTION_LIST /end FUNCTION_LIST /end MEASUREMENT
/begin MEASUREMENT vBRAMBUF_R#29 "EEP- ROM writing data storage buffer" UBYTE COMP_0068 1 100 0 255 ECU_ADDRESS 0xFFFF2928 /begin FUNCTION_LIST /end FUNCTION_LIST /end MEASUREMENT
/begin MEASUREMENT vBRAMBUF_R#30 "EEP- ROM writing data storage buffer" UBYTE COMP_0068 1 100 0 255 ECU_ADDRESS 0xFFFF2929 /begin FUNCTION_LIST /end FUNCTION_LIST /end MEASUREMENT
/begin MEASUREMENT vBRAMBUF_R#31 "EEP- ROM writing data storage buffer" UBYTE COMP_0068 1 100 0 255 ECU_ADDRESS 0xFFFF292A /begin FUNCTION_LIST /end FUNCTION_LIST /end MEASUREMENT
/begin MEASUREMENT vBRAMBUF_R#32 "EEP- ROM writing data storage buffer" UBYTE COMP_0068 1 100 0 255 ECU_ADDRESS 0xFFFF292B /begin FUNCTION_LIST /end FUNCTION_LIST /end MEASUREMENT
/begin MEASUREMENT vBREFIN "Last time, at the time of the REF input, timer value" ULONG COMP_0189 1 100 0 13743895344 ECU_ADDRESS 0xFFFF1FAC /begin FUNCTION_LIST /end FUNCTION_LIST /end MEASUREMENT
/begin MEASUREMENT vBRHOS "The amount of brake air compensation fuel" UBYTE COMP_0384 1 100 0 1.992315 ECU_ADDRESS 0xFFFF292C /begin FUNCTION_LIST /end FUNCTION_LIST /end MEASUREMENT
/begin MEASUREMENT vBRHOS0 "Brake air compensation fuel basic value" UBYTE COMP_0384 1 100 0 1.992315 ECU_ADDRESS 0xFFFF292D /begin FUNCTION_LIST /end FUNCTION_LIST /end MEASUREMENT
/begin MEASUREMENT vBRKCNT "FFD reading condition brake SW on counter" UBYTE COMP_0068 1 100 0 255 ECU_ADDRESS 0xFFFF292E /begin FUNCTION_LIST /end FUNCTION_LIST /end MEASUREMENT
/begin MEASUREMENT vBRKINFS2 "The brake status information is unavailable RAM" UBYTE COMP_0068 1 100 0 255 ECU_ADDRESS 0xFFFF4043 /begin FUNCTION_LIST /end FUNCTION_LIST /end MEASUREMENT
/begin MEASUREMENT vBRKINFST "Brake switch RAM" UBYTE COMP_0068 1 100 0 255 ECU_ADDRESS 0xFFFF1FB0 /begin FUNCTION_LIST /end FUNCTION_LIST /end MEASUREMENT
/begin MEASUREMENT vBRRbuf "Control registor buffer" UWORD COMP_0004 1 100 0 65535 ECU_ADDRESS 0xFFFF3930 /begin FUNCTION_LIST /end FUNCTION_LIST /end MEASUREMENT
/begin MEASUREMENT vBRSTBCTR "Brake_StabilityControl frame reception interval" UBYTE COMP_0014 1 100 0 2550 ECU_ADDRESS 0xFFFF3932 /begin FUNCTION_LIST /end FUNCTION_LIST /end MEASUREMENT
/begin MEASUREMENT vBRSTBCTT "The counter which hasn't received Brake_Stability_Control" UBYTE COMP_0014 1 100 0 2550 ECU_ADDRESS 0xFFFF48F5 /begin FUNCTION_LIST /end FUNCTION_LIST /end MEASUREMENT
/begin MEASUREMENT vBRXGST "Receiving data set memory" UBYTE COMP_0068 1 100 0 255 ECU_ADDRESS 0xFFFF3933 /begin FUNCTION_LIST /end FUNCTION_LIST /end MEASUREMENT
/begin MEASUREMENT vBRXGST_R#1 "Receiving data set memory" UBYTE COMP_0068 1 100 0 255 ECU_ADDRESS 0xFFFF3933 /begin FUNCTION_LIST /end FUNCTION_LIST /end MEASUREMENT
/begin MEASUREMENT vBRXGST_R#2 "Receiving data set memory" UBYTE COMP_0068 1 100 0 255 ECU_ADDRESS 0xFFFF3934 /begin FUNCTION_LIST /end FUNCTION_LIST /end MEASUREMENT
/begin MEASUREMENT vBRXGST_R#3 "Receiving data set memory" UBYTE COMP_0068 1 100 0 255 ECU_ADDRESS 0xFFFF3935 /begin FUNCTION_LIST /end FUNCTION_LIST /end MEASUREMENT
/begin MEASUREMENT vBRXGST_R#4 "Receiving data set memory" UBYTE COMP_0068 1 100 0 255 ECU_ADDRESS 0xFFFF3936 /begin FUNCTION_LIST /end FUNCTION_LIST /end MEASUREMENT
/begin MEASUREMENT vBRXGST_R#5 "Receiving data set memory" UBYTE COMP_0068 1 100 0 255 ECU_ADDRESS 0xFFFF3937 /begin FUNCTION_LIST /end FUNCTION_LIST /end MEASUREMENT
/begin MEASUREMENT vBRXGST_R#6 "Receiving data set memory" UBYTE COMP_0068 1 100 0 255 ECU_ADDRESS 0xFFFF3938 /begin FUNCTION_LIST /end FUNCTION_LIST /end MEASUREMENT
/begin MEASUREMENT vBRXGST_R#7 "Receiving data set memory" UBYTE COMP_0068 1 100 0 255 ECU_ADDRESS 0xFFFF3939 /begin FUNCTION_LIST /end FUNCTION_LIST /end MEASUREMENT
/begin MEASUREMENT vBRXGST_R#8 "Receiving data set memory" UBYTE COMP_0068 1 100 0 255 ECU_ADDRESS 0xFFFF393A /begin FUNCTION_LIST /end FUNCTION_LIST /end MEASUREMENT
/begin MEASUREMENT vBRXGST_R#9 "Receiving data set memory" UBYTE COMP_0068 1 100 0 255 ECU_ADDRESS 0xFFFF393B /begin FUNCTION_LIST /end FUNCTION_LIST /end MEASUREMENT
/begin MEASUREMENT vBRXGST_R#10 "Receiving data set memory" UBYTE COMP_0068 1 100 0 255 ECU_ADDRESS 0xFFFF393C /begin FUNCTION_LIST /end FUNCTION_LIST /end MEASUREMENT
/begin MEASUREMENT vBRXGST_R#11 "Receiving data set memory" UBYTE COMP_0068 1 100 0 255 ECU_ADDRESS 0xFFFF393D /begin FUNCTION_LIST /end FUNCTION_LIST /end MEASUREMENT
/begin MEASUREMENT vBS1FC "A sensor diagnosis counter for the control" UBYTE COMP_0030 1 100 0 255 ECU_ADDRESS 0xFFFF393E /begin FUNCTION_LIST /end FUNCTION_LIST /end MEASUREMENT
/begin MEASUREMENT vBS1FMAX "A sensor diagnosis counter for the control" UBYTE COMP_0030 1 100 0 255 ECU_ADDRESS 0xFFFFB56E /begin FUNCTION_LIST /end FUNCTION_LIST /end MEASUREMENT
/begin MEASUREMENT vBS2FC "A sensor diagnosis counter for the SW function" UBYTE COMP_0030 1 100 0 255 ECU_ADDRESS 0xFFFF393F /begin FUNCTION_LIST /end FUNCTION_LIST /end MEASUREMENT
/begin MEASUREMENT vBS2FMAX "A sensor diagnosis counter for the control" UBYTE COMP_0030 1 100 0 255 ECU_ADDRESS 0xFFFFB56F /begin FUNCTION_LIST /end FUNCTION_LIST /end MEASUREMENT
/begin MEASUREMENT vBSALP0 "Base learning value 0" UWORD COMP_0031 1 100 0 255.99609375 ECU_ADDRESS 0xFFFFA2A4 /begin FUNCTION_LIST /end FUNCTION_LIST /end MEASUREMENT
/begin MEASUREMENT vBSALP0_R#1 "Base learning value 0" UWORD COMP_0031 1 100 0 255.99609375 ECU_ADDRESS 0xFFFFA2A4 /begin FUNCTION_LIST /end FUNCTION_LIST /end MEASUREMENT
/begin MEASUREMENT vBSALP0_R#2 "Base learning value 0" UWORD COMP_0031 1 100 0 255.99609375 ECU_ADDRESS 0xFFFFA2A6 /begin FUNCTION_LIST /end FUNCTION_LIST /end MEASUREMENT
/begin MEASUREMENT vBSALP1 "Base learning value 1" UWORD COMP_0031 1 100 0 255.99609375 ECU_ADDRESS 0xFFFFA2A8 /begin FUNCTION_LIST /end FUNCTION_LIST /end MEASUREMENT
/begin MEASUREMENT vBSALP1_R#1 "Base learning value 1" UWORD COMP_0031 1 100 0 255.99609375 ECU_ADDRESS 0xFFFFA2A8 /begin FUNCTION_LIST /end FUNCTION_LIST /end MEASUREMENT
/begin MEASUREMENT vBSALP1_R#2 "Base learning value 1" UWORD COMP_0031 1 100 0 255.99609375 ECU_ADDRESS 0xFFFFA2AA /begin FUNCTION_LIST /end FUNCTION_LIST /end MEASUREMENT
/begin MEASUREMENT vBSLRN "Base learning value (reference value)" UWORD COMP_0031 1 100 0 255.99609375 ECU_ADDRESS 0xFFFF11C8 /begin FUNCTION_LIST /end FUNCTION_LIST /end MEASUREMENT
/begin MEASUREMENT vBSLRN_R#1 "Base learning value (reference value)" UWORD COMP_0031 1 100 0 255.99609375 ECU_ADDRESS 0xFFFF11C8 /begin FUNCTION_LIST /end FUNCTION_LIST /end MEASUREMENT
/begin MEASUREMENT vBSLRN_R#2 "Base learning value (reference value)" UWORD COMP_0031 1 100 0 255.99609375 ECU_ADDRESS 0xFFFF11CA /begin FUNCTION_LIST /end FUNCTION_LIST /end MEASUREMENT
/begin MEASUREMENT vBSLRNOKf "Base learning condition judgement flag" UBYTE COMP_0004 1 100 0 255 ECU_ADDRESS 0xFFFF11CC /begin FUNCTION_LIST /end FUNCTION_LIST /end MEASUREMENT
/begin MEASUREMENT vBSTRGE "VTC basic target angle (after clutch temperature compensation)" UBYTE COMP_0256 1 100 -64 63.5 ECU_ADDRESS 0xFFFF1014 /begin FUNCTION_LIST /end FUNCTION_LIST /end MEASUREMENT
/begin MEASUREMENT vBSTRGI "VTC basic target angle (after clutch temperature compensation)" UBYTE COMP_0256 1 100 -64 63.5 ECU_ADDRESS 0xFFFF1015 /begin FUNCTION_LIST /end FUNCTION_LIST /end MEASUREMENT
/begin MEASUREMENT vBSVP12 "Reference atomospheric pressure" UWORD COMP_0050 1 100 0 5119.921875 ECU_ADDRESS 0xFFFF2930 /begin FUNCTION_LIST /end FUNCTION_LIST /end MEASUREMENT
/begin MEASUREMENT vBTX "Response requirement registor" UBYTE COMP_0004 1 100 0 255 ECU_ADDRESS 0xFFFF2938 /begin FUNCTION_LIST /end FUNCTION_LIST /end MEASUREMENT
/begin MEASUREMENT vBTXGST "Transmitting data set memory" UBYTE COMP_0068 1 100 0 255 ECU_ADDRESS 0xFFFF3940 /begin FUNCTION_LIST /end FUNCTION_LIST /end MEASUREMENT
/begin MEASUREMENT vBTXGST_R#1 "Transmitting data set memory" UBYTE COMP_0068 1 100 0 255 ECU_ADDRESS 0xFFFF3940 /begin FUNCTION_LIST /end FUNCTION_LIST /end MEASUREMENT
/begin MEASUREMENT vBTXGST_R#2 "Transmitting data set memory" UBYTE COMP_0068 1 100 0 255 ECU_ADDRESS 0xFFFF3941 /begin FUNCTION_LIST /end FUNCTION_LIST /end MEASUREMENT
/begin MEASUREMENT vBTXGST_R#3 "Transmitting data set memory" UBYTE COMP_0068 1 100 0 255 ECU_ADDRESS 0xFFFF3942 /begin FUNCTION_LIST /end FUNCTION_LIST /end MEASUREMENT
/begin MEASUREMENT vBTXGST_R#4 "Transmitting data set memory" UBYTE COMP_0068 1 100 0 255 ECU_ADDRESS 0xFFFF3943 /begin FUNCTION_LIST /end FUNCTION_LIST /end MEASUREMENT
/begin MEASUREMENT vBTXGST_R#5 "Transmitting data set memory" UBYTE COMP_0068 1 100 0 255 ECU_ADDRESS 0xFFFF3944 /begin FUNCTION_LIST /end FUNCTION_LIST /end MEASUREMENT
/begin MEASUREMENT vBTXGST_R#6 "Transmitting data set memory" UBYTE COMP_0068 1 100 0 255 ECU_ADDRESS 0xFFFF3945 /begin FUNCTION_LIST /end FUNCTION_LIST /end MEASUREMENT
/begin MEASUREMENT vBTXGST_R#7 "Transmitting data set memory" UBYTE COMP_0068 1 100 0 255 ECU_ADDRESS 0xFFFF3946 /begin FUNCTION_LIST /end FUNCTION_LIST /end MEASUREMENT
/begin MEASUREMENT vBTXGST_R#8 "Transmitting data set memory" UBYTE COMP_0068 1 100 0 255 ECU_ADDRESS 0xFFFF3947 /begin FUNCTION_LIST /end FUNCTION_LIST /end MEASUREMENT
/begin MEASUREMENT vBTXGST_R#9 "Transmitting data set memory" UBYTE COMP_0068 1 100 0 255 ECU_ADDRESS 0xFFFF3948 /begin FUNCTION_LIST /end FUNCTION_LIST /end MEASUREMENT
/begin MEASUREMENT vBTXGST_R#10 "Transmitting data set memory" UBYTE COMP_0068 1 100 0 255 ECU_ADDRESS 0xFFFF3949 /begin FUNCTION_LIST /end FUNCTION_LIST /end MEASUREMENT
/begin MEASUREMENT vBTXGST_R#11 "Transmitting data set memory" UBYTE COMP_0068 1 100 0 255 ECU_ADDRESS 0xFFFF394A /begin FUNCTION_LIST /end FUNCTION_LIST /end MEASUREMENT
/begin MEASUREMENT vCALTMX "Alternator MAX generating electricity electric current value for the battery electric current sensor function diagnosis" UBYTE COMP_0062_S 1 100 0 255 ECU_ADDRESS 0xFFFF2944 /begin FUNCTION_LIST /end FUNCTION_LIST /end MEASUREMENT
/begin MEASUREMENT vCAMINST "IRQPHASE experience" UBYTE COMP_0068 1 100 0 255 ECU_ADDRESS 0xFFFF1FB1 /begin FUNCTION_LIST /end FUNCTION_LIST /end MEASUREMENT
/begin MEASUREMENT vCANDSP "CAN receiving wheel speed (drive wheel)" UWORD COMP_0436 1 100 0 6553.5 ECU_ADDRESS 0xFFFF1E62 /begin FUNCTION_LIST /end FUNCTION_LIST /end MEASUREMENT
/begin MEASUREMENT vCANSTAS "CAN status" UBYTE COMP_0068 1 100 0 255 ECU_ADDRESS 0xFFFF3A84 /begin FUNCTION_LIST /end FUNCTION_LIST /end MEASUREMENT
/begin MEASUREMENT vCATAR2f "Diagnosis region condition (2) formation flag" UBYTE COMP_0004 1 100 0 255 ECU_ADDRESS 0xFFFF2948 /begin FUNCTION_LIST /end FUNCTION_LIST /end MEASUREMENT
/begin MEASUREMENT vCATARA "Catalyst criteria region" UBYTE COMP_0068 1 100 0 255 ECU_ADDRESS 0xFFFF2949 /begin FUNCTION_LIST /end FUNCTION_LIST /end MEASUREMENT
/begin MEASUREMENT vCATARAf "Catalyst diagnosis condition experience distinction" UBYTE COMP_0004 1 100 0 255 ECU_ADDRESS 0xFFFF294A /begin FUNCTION_LIST /end FUNCTION_LIST /end MEASUREMENT
/begin MEASUREMENT vCATCNGf "A control operation flag for the catalyst diagnosis" UBYTE COMP_0004 1 100 0 255 ECU_ADDRESS 0xFFFF294B /begin FUNCTION_LIST /end FUNCTION_LIST /end MEASUREMENT
/begin MEASUREMENT vCATDGNSTf "A control permission flag for the catalyst diagnosis" UBYTE COMP_0004 1 100 0 255 ECU_ADDRESS 0xFFFF294C /begin FUNCTION_LIST /end FUNCTION_LIST /end MEASUREMENT
/begin MEASUREMENT vCATENDVf "Imaginary stage 2 diagnosis completion flag" UBYTE COMP_0004 1 100 0 255 ECU_ADDRESS 0xFFFF294E /begin FUNCTION_LIST /end FUNCTION_LIST /end MEASUREMENT
/begin MEASUREMENT vCATENDf "IGN SW To off, diagnosis prohibition flag" UBYTE COMP_0004 1 100 0 255 ECU_ADDRESS 0xFFFF294D /begin FUNCTION_LIST /end FUNCTION_LIST /end MEASUREMENT
/begin MEASUREMENT vCATEVPf "A canister purge cut by the catalyst diagnosis" UBYTE COMP_0004 1 100 0 255 ECU_ADDRESS 0xFFFF294F /begin FUNCTION_LIST /end FUNCTION_LIST /end MEASUREMENT
/begin MEASUREMENT vCATIMR "EGR diagnosis completion flag inclusion byte for for 2trip" UBYTE COMP_0004 1 100 0 255 ECU_ADDRESS 0xFFFFA2AD /begin FUNCTION_LIST /end FUNCTION_LIST /end MEASUREMENT
/begin MEASUREMENT vCATJUGf "Diagnosis permission condition formation flag" UBYTE COMP_0004 1 100 0 255 ECU_ADDRESS 0xFFFF2950 /begin FUNCTION_LIST /end FUNCTION_LIST /end MEASUREMENT
/begin MEASUREMENT vCATMIL "Catalyst diagnosis completion mileage integration value" UWORD COMP_0385 1 100 0 105380.28 ECU_ADDRESS 0xFFFFA2AE /begin FUNCTION_LIST /end FUNCTION_LIST /end MEASUREMENT
/begin MEASUREMENT vCATST2f "Stage 2 switchover" UBYTE COMP_0004 1 100 0 255 ECU_ADDRESS 0xFFFF2956 /begin FUNCTION_LIST /end FUNCTION_LIST /end MEASUREMENT
/begin MEASUREMENT vCBSLDM "Base LLC learning counter" UWORD COMP_0016 1 100 0 65535 ECU_ADDRESS 0xFFFF2958 /begin FUNCTION_LIST /end FUNCTION_LIST /end MEASUREMENT
/begin MEASUREMENT vCBTECNT "The counter whose registor check is unusual" UBYTE COMP_0068 1 100 0 255 ECU_ADDRESS 0xFFFFA2B4 /begin FUNCTION_LIST /end FUNCTION_LIST /end MEASUREMENT
/begin MEASUREMENT vCCFALW "Previous carrier of all the failures which cause CC failure" UBYTE COMP_0068 1 100 0 255 ECU_ADDRESS 0xFFFF295B /begin FUNCTION_LIST /end FUNCTION_LIST /end MEASUREMENT
/begin MEASUREMENT vCCMLSEND "DiagCAN Buffer for the RDBLID transmission" UBYTE COMP_0068 1 100 0 255 ECU_ADDRESS 0xFFFF356A /begin FUNCTION_LIST /end FUNCTION_LIST /end MEASUREMENT
/begin MEASUREMENT vCCMLSEND_R#1 "DiagCAN Buffer for the RDBLID transmission" UBYTE COMP_0068 1 100 0 255 ECU_ADDRESS 0xFFFF356A /begin FUNCTION_LIST /end FUNCTION_LIST /end MEASUREMENT
/begin MEASUREMENT vCCMLSEND_R#2 "DiagCAN Buffer for the RDBLID transmission" UBYTE COMP_0068 1 100 0 255 ECU_ADDRESS 0xFFFF356B /begin FUNCTION_LIST /end FUNCTION_LIST /end MEASUREMENT
/begin MEASUREMENT vCCMLSEND_R#3 "DiagCAN Buffer for the RDBLID transmission" UBYTE COMP_0068 1 100 0 255 ECU_ADDRESS 0xFFFF356C /begin FUNCTION_LIST /end FUNCTION_LIST /end MEASUREMENT
/begin MEASUREMENT vCCMLSEND_R#4 "DiagCAN Buffer for the RDBLID transmission" UBYTE COMP_0068 1 100 0 255 ECU_ADDRESS 0xFFFF356D /begin FUNCTION_LIST /end FUNCTION_LIST /end MEASUREMENT
/begin MEASUREMENT vCCMLSEND_R#5 "DiagCAN Buffer for the RDBLID transmission" UBYTE COMP_0068 1 100 0 255 ECU_ADDRESS 0xFFFF356E /begin FUNCTION_LIST /end FUNCTION_LIST /end MEASUREMENT
/begin MEASUREMENT vCCMLSEND_R#6 "DiagCAN Buffer for the RDBLID transmission" UBYTE COMP_0068 1 100 0 255 ECU_ADDRESS 0xFFFF356F /begin FUNCTION_LIST /end FUNCTION_LIST /end MEASUREMENT
/begin MEASUREMENT vCCMLSEND_R#7 "DiagCAN Buffer for the RDBLID transmission" UBYTE COMP_0068 1 100 0 255 ECU_ADDRESS 0xFFFF3570 /begin FUNCTION_LIST /end FUNCTION_LIST /end MEASUREMENT
/begin MEASUREMENT vCCMLSEND_R#8 "DiagCAN Buffer for the RDBLID transmission" UBYTE COMP_0068 1 100 0 255 ECU_ADDRESS 0xFFFF3571 /begin FUNCTION_LIST /end FUNCTION_LIST /end MEASUREMENT
/begin MEASUREMENT vCCMLSEND_R#9 "DiagCAN Buffer for the RDBLID transmission" UBYTE COMP_0068 1 100 0 255 ECU_ADDRESS 0xFFFF3572 /begin FUNCTION_LIST /end FUNCTION_LIST /end MEASUREMENT
/begin MEASUREMENT vCCMLSEND_R#10 "DiagCAN Buffer for the RDBLID transmission" UBYTE COMP_0068 1 100 0 255 ECU_ADDRESS 0xFFFF3573 /begin FUNCTION_LIST /end FUNCTION_LIST /end MEASUREMENT
/begin MEASUREMENT vCCMLSEND_R#11 "DiagCAN Buffer for the RDBLID transmission" UBYTE COMP_0068 1 100 0 255 ECU_ADDRESS 0xFFFF3574 /begin FUNCTION_LIST /end FUNCTION_LIST /end MEASUREMENT
/begin MEASUREMENT vCCMLSEND_R#12 "DiagCAN Buffer for the RDBLID transmission" UBYTE COMP_0068 1 100 0 255 ECU_ADDRESS 0xFFFF3575 /begin FUNCTION_LIST /end FUNCTION_LIST /end MEASUREMENT
/begin MEASUREMENT vCCMLSEND_R#13 "DiagCAN Buffer for the RDBLID transmission" UBYTE COMP_0068 1 100 0 255 ECU_ADDRESS 0xFFFF3576 /begin FUNCTION_LIST /end FUNCTION_LIST /end MEASUREMENT
/begin MEASUREMENT vCCMLSEND_R#14 "DiagCAN Buffer for the RDBLID transmission" UBYTE COMP_0068 1 100 0 255 ECU_ADDRESS 0xFFFF3577 /begin FUNCTION_LIST /end FUNCTION_LIST /end MEASUREMENT
/begin MEASUREMENT vCCMLSEND_R#15 "DiagCAN Buffer for the RDBLID transmission" UBYTE COMP_0068 1 100 0 255 ECU_ADDRESS 0xFFFF3578 /begin FUNCTION_LIST /end FUNCTION_LIST /end MEASUREMENT
/begin MEASUREMENT vCCMLSEND_R#16 "DiagCAN Buffer for the RDBLID transmission" UBYTE COMP_0068 1 100 0 255 ECU_ADDRESS 0xFFFF3579 /begin FUNCTION_LIST /end FUNCTION_LIST /end MEASUREMENT
/begin MEASUREMENT vCCMLSEND_R#17 "DiagCAN Buffer for the RDBLID transmission" UBYTE COMP_0068 1 100 0 255 ECU_ADDRESS 0xFFFF357A /begin FUNCTION_LIST /end FUNCTION_LIST /end MEASUREMENT
/begin MEASUREMENT vCCMLSEND_R#18 "DiagCAN Buffer for the RDBLID transmission" UBYTE COMP_0068 1 100 0 255 ECU_ADDRESS 0xFFFF357B /begin FUNCTION_LIST /end FUNCTION_LIST /end MEASUREMENT
/begin MEASUREMENT vCCMLSEND_R#19 "DiagCAN Buffer for the RDBLID transmission" UBYTE COMP_0068 1 100 0 255 ECU_ADDRESS 0xFFFF357C /begin FUNCTION_LIST /end FUNCTION_LIST /end MEASUREMENT
/begin MEASUREMENT vCCMLSEND_R#20 "DiagCAN Buffer for the RDBLID transmission" UBYTE COMP_0068 1 100 0 255 ECU_ADDRESS 0xFFFF357D /begin FUNCTION_LIST /end FUNCTION_LIST /end MEASUREMENT
/begin MEASUREMENT vCCMLSEND_R#21 "DiagCAN Buffer for the RDBLID transmission" UBYTE COMP_0068 1 100 0 255 ECU_ADDRESS 0xFFFF357E /begin FUNCTION_LIST /end FUNCTION_LIST /end MEASUREMENT
/begin MEASUREMENT vCCMLSEND_R#22 "DiagCAN Buffer for the RDBLID transmission" UBYTE COMP_0068 1 100 0 255 ECU_ADDRESS 0xFFFF357F /begin FUNCTION_LIST /end FUNCTION_LIST /end MEASUREMENT
/begin MEASUREMENT vCCMLSEND_R#23 "DiagCAN Buffer for the RDBLID transmission" UBYTE COMP_0068 1 100 0 255 ECU_ADDRESS 0xFFFF3580 /begin FUNCTION_LIST /end FUNCTION_LIST /end MEASUREMENT
/begin MEASUREMENT vCCMLSEND_R#24 "DiagCAN Buffer for the RDBLID transmission" UBYTE COMP_0068 1 100 0 255 ECU_ADDRESS 0xFFFF3581 /begin FUNCTION_LIST /end FUNCTION_LIST /end MEASUREMENT
/begin MEASUREMENT vCCMLSEND_R#25 "DiagCAN Buffer for the RDBLID transmission" UBYTE COMP_0068 1 100 0 255 ECU_ADDRESS 0xFFFF3582 /begin FUNCTION_LIST /end FUNCTION_LIST /end MEASUREMENT
/begin MEASUREMENT vCCMLSEND_R#26 "DiagCAN Buffer for the RDBLID transmission" UBYTE COMP_0068 1 100 0 255 ECU_ADDRESS 0xFFFF3583 /begin FUNCTION_LIST /end FUNCTION_LIST /end MEASUREMENT
/begin MEASUREMENT vCCMLSEND_R#27 "DiagCAN Buffer for the RDBLID transmission" UBYTE COMP_0068 1 100 0 255 ECU_ADDRESS 0xFFFF3584 /begin FUNCTION_LIST /end FUNCTION_LIST /end MEASUREMENT
/begin MEASUREMENT vCCMLSEND_R#28 "DiagCAN Buffer for the RDBLID transmission" UBYTE COMP_0068 1 100 0 255 ECU_ADDRESS 0xFFFF3585 /begin FUNCTION_LIST /end FUNCTION_LIST /end MEASUREMENT
/begin MEASUREMENT vCCMLSEND_R#29 "DiagCAN Buffer for the RDBLID transmission" UBYTE COMP_0068 1 100 0 255 ECU_ADDRESS 0xFFFF3586 /begin FUNCTION_LIST /end FUNCTION_LIST /end MEASUREMENT
/begin MEASUREMENT vCCMLSEND_R#30 "DiagCAN Buffer for the RDBLID transmission" UBYTE COMP_0068 1 100 0 255 ECU_ADDRESS 0xFFFF3587 /begin FUNCTION_LIST /end FUNCTION_LIST /end MEASUREMENT
/begin MEASUREMENT vCCMLSEND_R#31 "DiagCAN Buffer for the RDBLID transmission" UBYTE COMP_0068 1 100 0 255 ECU_ADDRESS 0xFFFF3588 /begin FUNCTION_LIST /end FUNCTION_LIST /end MEASUREMENT
/begin MEASUREMENT vCCMLSEND_R#32 "DiagCAN Buffer for the RDBLID transmission" UBYTE COMP_0068 1 100 0 255 ECU_ADDRESS 0xFFFF3589 /begin FUNCTION_LIST /end FUNCTION_LIST /end MEASUREMENT
/begin MEASUREMENT vCCMLSEND_R#33 "DiagCAN Buffer for the RDBLID transmission" UBYTE COMP_0068 1 100 0 255 ECU_ADDRESS 0xFFFF358A /begin FUNCTION_LIST /end FUNCTION_LIST /end MEASUREMENT
/begin MEASUREMENT vCCMLSEND_R#34 "DiagCAN Buffer for the RDBLID transmission" UBYTE COMP_0068 1 100 0 255 ECU_ADDRESS 0xFFFF358B /begin FUNCTION_LIST /end FUNCTION_LIST /end MEASUREMENT
/begin MEASUREMENT vCCMLSEND_R#35 "DiagCAN Buffer for the RDBLID transmission" UBYTE COMP_0068 1 100 0 255 ECU_ADDRESS 0xFFFF358C /begin FUNCTION_LIST /end FUNCTION_LIST /end MEASUREMENT
/begin MEASUREMENT vCCMLSEND_R#36 "DiagCAN Buffer for the RDBLID transmission" UBYTE COMP_0068 1 100 0 255 ECU_ADDRESS 0xFFFF358D /begin FUNCTION_LIST /end FUNCTION_LIST /end MEASUREMENT
/begin MEASUREMENT vCCMLSEND_R#37 "DiagCAN Buffer for the RDBLID transmission" UBYTE COMP_0068 1 100 0 255 ECU_ADDRESS 0xFFFF358E /begin FUNCTION_LIST /end FUNCTION_LIST /end MEASUREMENT
/begin MEASUREMENT vCCMLSEND_R#38 "DiagCAN Buffer for the RDBLID transmission" UBYTE COMP_0068 1 100 0 255 ECU_ADDRESS 0xFFFF358F /begin FUNCTION_LIST /end FUNCTION_LIST /end MEASUREMENT
/begin MEASUREMENT vCCMLSEND_R#39 "DiagCAN Buffer for the RDBLID transmission" UBYTE COMP_0068 1 100 0 255 ECU_ADDRESS 0xFFFF3590 /begin FUNCTION_LIST /end FUNCTION_LIST /end MEASUREMENT
/begin MEASUREMENT vCCMLSEND_R#40 "DiagCAN Buffer for the RDBLID transmission" UBYTE COMP_0068 1 100 0 255 ECU_ADDRESS 0xFFFF3591 /begin FUNCTION_LIST /end FUNCTION_LIST /end MEASUREMENT
/begin MEASUREMENT vCCMLSEND_R#41 "DiagCAN Buffer for the RDBLID transmission" UBYTE COMP_0068 1 100 0 255 ECU_ADDRESS 0xFFFF3592 /begin FUNCTION_LIST /end FUNCTION_LIST /end MEASUREMENT
/begin MEASUREMENT vCCMLSEND_R#42 "DiagCAN Buffer for the RDBLID transmission" UBYTE COMP_0068 1 100 0 255 ECU_ADDRESS 0xFFFF3593 /begin FUNCTION_LIST /end FUNCTION_LIST /end MEASUREMENT
/begin MEASUREMENT vCCMLSEND_R#43 "DiagCAN Buffer for the RDBLID transmission" UBYTE COMP_0068 1 100 0 255 ECU_ADDRESS 0xFFFF3594 /begin FUNCTION_LIST /end FUNCTION_LIST /end MEASUREMENT
/begin MEASUREMENT vCCMLSEND_R#44 "DiagCAN Buffer for the RDBLID transmission" UBYTE COMP_0068 1 100 0 255 ECU_ADDRESS 0xFFFF3595 /begin FUNCTION_LIST /end FUNCTION_LIST /end MEASUREMENT
/begin MEASUREMENT vCCMLSEND_R#45 "DiagCAN Buffer for the RDBLID transmission" UBYTE COMP_0068 1 100 0 255 ECU_ADDRESS 0xFFFF3596 /begin FUNCTION_LIST /end FUNCTION_LIST /end MEASUREMENT
/begin MEASUREMENT vCCMLSEND_R#46 "DiagCAN Buffer for the RDBLID transmission" UBYTE COMP_0068 1 100 0 255 ECU_ADDRESS 0xFFFF3597 /begin FUNCTION_LIST /end FUNCTION_LIST /end MEASUREMENT
/begin MEASUREMENT vCCMLSEND_R#47 "DiagCAN Buffer for the RDBLID transmission" UBYTE COMP_0068 1 100 0 255 ECU_ADDRESS 0xFFFF3598 /begin FUNCTION_LIST /end FUNCTION_LIST /end MEASUREMENT
/begin MEASUREMENT vCCMLSEND_R#48 "DiagCAN Buffer for the RDBLID transmission" UBYTE COMP_0068 1 100 0 255 ECU_ADDRESS 0xFFFF3599 /begin FUNCTION_LIST /end FUNCTION_LIST /end MEASUREMENT
/begin MEASUREMENT vCCMLSEND_R#49 "DiagCAN Buffer for the RDBLID transmission" UBYTE COMP_0068 1 100 0 255 ECU_ADDRESS 0xFFFF359A /begin FUNCTION_LIST /end FUNCTION_LIST /end MEASUREMENT
/begin MEASUREMENT vCCMLSEND_R#50 "DiagCAN Buffer for the RDBLID transmission" UBYTE COMP_0068 1 100 0 255 ECU_ADDRESS 0xFFFF359B /begin FUNCTION_LIST /end FUNCTION_LIST /end MEASUREMENT
/begin MEASUREMENT vCCMLSEND_R#51 "DiagCAN Buffer for the RDBLID transmission" UBYTE COMP_0068 1 100 0 255 ECU_ADDRESS 0xFFFF359C /begin FUNCTION_LIST /end FUNCTION_LIST /end MEASUREMENT
/begin MEASUREMENT vCCMLSEND_R#52 "DiagCAN Buffer for the RDBLID transmission" UBYTE COMP_0068 1 100 0 255 ECU_ADDRESS 0xFFFF359D /begin FUNCTION_LIST /end FUNCTION_LIST /end MEASUREMENT
/begin MEASUREMENT vCCMLSEND_R#53 "DiagCAN Buffer for the RDBLID transmission" UBYTE COMP_0068 1 100 0 255 ECU_ADDRESS 0xFFFF359E /begin FUNCTION_LIST /end FUNCTION_LIST /end MEASUREMENT
/begin MEASUREMENT vCCMLSEND_R#54 "DiagCAN Buffer for the RDBLID transmission" UBYTE COMP_0068 1 100 0 255 ECU_ADDRESS 0xFFFF359F /begin FUNCTION_LIST /end FUNCTION_LIST /end MEASUREMENT
/begin MEASUREMENT vCCMLSEND_R#55 "DiagCAN Buffer for the RDBLID transmission" UBYTE COMP_0068 1 100 0 255 ECU_ADDRESS 0xFFFF35A0 /begin FUNCTION_LIST /end FUNCTION_LIST /end MEASUREMENT
/begin MEASUREMENT vCCMLSEND_R#56 "DiagCAN Buffer for the RDBLID transmission" UBYTE COMP_0068 1 100 0 255 ECU_ADDRESS 0xFFFF35A1 /begin FUNCTION_LIST /end FUNCTION_LIST /end MEASUREMENT
/begin MEASUREMENT vCCMLSEND_R#57 "DiagCAN Buffer for the RDBLID transmission" UBYTE COMP_0068 1 100 0 255 ECU_ADDRESS 0xFFFF35A2 /begin FUNCTION_LIST /end FUNCTION_LIST /end MEASUREMENT
/begin MEASUREMENT vCCMLSEND_R#58 "DiagCAN Buffer for the RDBLID transmission" UBYTE COMP_0068 1 100 0 255 ECU_ADDRESS 0xFFFF35A3 /begin FUNCTION_LIST /end FUNCTION_LIST /end MEASUREMENT
/begin MEASUREMENT vCCMLSEND_R#59 "DiagCAN Buffer for the RDBLID transmission" UBYTE COMP_0068 1 100 0 255 ECU_ADDRESS 0xFFFF35A4 /begin FUNCTION_LIST /end FUNCTION_LIST /end MEASUREMENT
/begin MEASUREMENT vCCMLSEND_R#60 "DiagCAN Buffer for the RDBLID transmission" UBYTE COMP_0068 1 100 0 255 ECU_ADDRESS 0xFFFF35A5 /begin FUNCTION_LIST /end FUNCTION_LIST /end MEASUREMENT
/begin MEASUREMENT vCCMLSEND_R#61 "DiagCAN Buffer for the RDBLID transmission" UBYTE COMP_0068 1 100 0 255 ECU_ADDRESS 0xFFFF35A6 /begin FUNCTION_LIST /end FUNCTION_LIST /end MEASUREMENT
/begin MEASUREMENT vCCMLSEND_R#62 "DiagCAN Buffer for the RDBLID transmission" UBYTE COMP_0068 1 100 0 255 ECU_ADDRESS 0xFFFF35A7 /begin FUNCTION_LIST /end FUNCTION_LIST /end MEASUREMENT
/begin MEASUREMENT vCCMLSEND_R#63 "DiagCAN Buffer for the RDBLID transmission" UBYTE COMP_0068 1 100 0 255 ECU_ADDRESS 0xFFFF35A8 /begin FUNCTION_LIST /end FUNCTION_LIST /end MEASUREMENT
/begin MEASUREMENT vCCMLSEND_R#64 "DiagCAN Buffer for the RDBLID transmission" UBYTE COMP_0068 1 100 0 255 ECU_ADDRESS 0xFFFF35A9 /begin FUNCTION_LIST /end FUNCTION_LIST /end MEASUREMENT
/begin MEASUREMENT vCCMLSEND_R#65 "DiagCAN Buffer for the RDBLID transmission" UBYTE COMP_0068 1 100 0 255 ECU_ADDRESS 0xFFFF35AA /begin FUNCTION_LIST /end FUNCTION_LIST /end MEASUREMENT
/begin MEASUREMENT vCCMLSEND_R#66 "DiagCAN Buffer for the RDBLID transmission" UBYTE COMP_0068 1 100 0 255 ECU_ADDRESS 0xFFFF35AB /begin FUNCTION_LIST /end FUNCTION_LIST /end MEASUREMENT
/begin MEASUREMENT vCCMLSEND_R#67 "DiagCAN Buffer for the RDBLID transmission" UBYTE COMP_0068 1 100 0 255 ECU_ADDRESS 0xFFFF35AC /begin FUNCTION_LIST /end FUNCTION_LIST /end MEASUREMENT
/begin MEASUREMENT vCCMLSEND_R#68 "DiagCAN Buffer for the RDBLID transmission" UBYTE COMP_0068 1 100 0 255 ECU_ADDRESS 0xFFFF35AD /begin FUNCTION_LIST /end FUNCTION_LIST /end MEASUREMENT
/begin MEASUREMENT vCCMLSEND_R#69 "DiagCAN Buffer for the RDBLID transmission" UBYTE COMP_0068 1 100 0 255 ECU_ADDRESS 0xFFFF35AE /begin FUNCTION_LIST /end FUNCTION_LIST /end MEASUREMENT
/begin MEASUREMENT vCCMLSEND_R#70 "DiagCAN Buffer for the RDBLID transmission" UBYTE COMP_0068 1 100 0 255 ECU_ADDRESS 0xFFFF35AF /begin FUNCTION_LIST /end FUNCTION_LIST /end MEASUREMENT
/begin MEASUREMENT vCCMLSEND_R#71 "DiagCAN Buffer for the RDBLID transmission" UBYTE COMP_0068 1 100 0 255 ECU_ADDRESS 0xFFFF35B0 /begin FUNCTION_LIST /end FUNCTION_LIST /end MEASUREMENT
/begin MEASUREMENT vCCMLSEND_R#72 "DiagCAN Buffer for the RDBLID transmission" UBYTE COMP_0068 1 100 0 255 ECU_ADDRESS 0xFFFF35B1 /begin FUNCTION_LIST /end FUNCTION_LIST /end MEASUREMENT
/begin MEASUREMENT vCCMLSEND_R#73 "DiagCAN Buffer for the RDBLID transmission" UBYTE COMP_0068 1 100 0 255 ECU_ADDRESS 0xFFFF35B2 /begin FUNCTION_LIST /end FUNCTION_LIST /end MEASUREMENT
/begin MEASUREMENT vCCMLSEND_R#74 "DiagCAN Buffer for the RDBLID transmission" UBYTE COMP_0068 1 100 0 255 ECU_ADDRESS 0xFFFF35B3 /begin FUNCTION_LIST /end FUNCTION_LIST /end MEASUREMENT
/begin MEASUREMENT vCCMLSEND_R#75 "DiagCAN Buffer for the RDBLID transmission" UBYTE COMP_0068 1 100 0 255 ECU_ADDRESS 0xFFFF35B4 /begin FUNCTION_LIST /end FUNCTION_LIST /end MEASUREMENT
/begin MEASUREMENT vCCMLSEND_R#76 "DiagCAN Buffer for the RDBLID transmission" UBYTE COMP_0068 1 100 0 255 ECU_ADDRESS 0xFFFF35B5 /begin FUNCTION_LIST /end FUNCTION_LIST /end MEASUREMENT
/begin MEASUREMENT vCCMLSEND_R#77 "DiagCAN Buffer for the RDBLID transmission" UBYTE COMP_0068 1 100 0 255 ECU_ADDRESS 0xFFFF35B6 /begin FUNCTION_LIST /end FUNCTION_LIST /end MEASUREMENT
/begin MEASUREMENT vCCMLSEND_R#78 "DiagCAN Buffer for the RDBLID transmission" UBYTE COMP_0068 1 100 0 255 ECU_ADDRESS 0xFFFF35B7 /begin FUNCTION_LIST /end FUNCTION_LIST /end MEASUREMENT
/begin MEASUREMENT vCCMLSEND_R#79 "DiagCAN Buffer for the RDBLID transmission" UBYTE COMP_0068 1 100 0 255 ECU_ADDRESS 0xFFFF35B8 /begin FUNCTION_LIST /end FUNCTION_LIST /end MEASUREMENT
/begin MEASUREMENT vCCMLSEND_R#80 "DiagCAN Buffer for the RDBLID transmission" UBYTE COMP_0068 1 100 0 255 ECU_ADDRESS 0xFFFF35B9 /begin FUNCTION_LIST /end FUNCTION_LIST /end MEASUREMENT
/begin MEASUREMENT vCCSLDSYPZ "Compilation of all the cru/sl normal deactivations due to system causes. Saved in E? PROM." UBYTE COMP_0068 1 100 0 255 ECU_ADDRESS 0xFFFF2963 /begin FUNCTION_LIST /end FUNCTION_LIST /end MEASUREMENT
/begin MEASUREMENT vCCSLFALW "Previous carrier of all the failures which cause CC/SL failure" UBYTE COMP_0068 1 100 0 255 ECU_ADDRESS 0xFFFF2964 /begin FUNCTION_LIST /end FUNCTION_LIST /end MEASUREMENT
/begin MEASUREMENT vCCSLFREF "Force request delivered by the control loop of the cruise control and speed limiter strategy" SWORD COMP_0030_S 1 100 -32768 32767 ECU_ADDRESS 0xFFFF41BC /begin FUNCTION_LIST /end FUNCTION_LIST /end MEASUREMENT
/begin MEASUREMENT vCCSLG "Filtered vehicle acceleration for cruise control    and speed limiter" SWORD COMP_0531_S 1 100 -3276.8 3276.7 ECU_ADDRESS 0xFFFF41BE /begin FUNCTION_LIST /end FUNCTION_LIST /end MEASUREMENT
/begin MEASUREMENT vCCSLITM "16sJOB Counter" UBYTE COMP_0068 1 100 0 255 ECU_ADDRESS 0xFFFF3A9C /begin FUNCTION_LIST /end FUNCTION_LIST /end MEASUREMENT
/begin MEASUREMENT vCCYCLCNT "For the CAM diagnosis cycle number of times judgement" UBYTE COMP_0068 1 100 0 255 ECU_ADDRESS 0xFFFF1FB2 /begin FUNCTION_LIST /end FUNCTION_LIST /end MEASUREMENT
/begin MEASUREMENT vCDEVCYL2 "100mS judgement counter of the slosh compensation control" UBYTE COMP_0014 1 100 0 2550 ECU_ADDRESS 0xFFFF2972 /begin FUNCTION_LIST /end FUNCTION_LIST /end MEASUREMENT
/begin MEASUREMENT vCDEVPRS2 "The 2.1/10.1sec judgement counter of the slosh compensation control" UBYTE COMP_0008 1 100 0 25500 ECU_ADDRESS 0xFFFF2973 /begin FUNCTION_LIST /end FUNCTION_LIST /end MEASUREMENT
/begin MEASUREMENT vCDSDPR "A counter for purge concentration change integration quantity compensation" UBYTE COMP_0016 1 100 0 255 ECU_ADDRESS 0xFFFF11D1 /begin FUNCTION_LIST /end FUNCTION_LIST /end MEASUREMENT
/begin MEASUREMENT vCDSDPR_R#1 "A counter for purge concentration change integration quantity compensation" UBYTE COMP_0016 1 100 0 255 ECU_ADDRESS 0xFFFF11D1 /begin FUNCTION_LIST /end FUNCTION_LIST /end MEASUREMENT
/begin MEASUREMENT vCDSDPR_R#2 "A counter for purge concentration change integration quantity compensation" UBYTE COMP_0016 1 100 0 255 ECU_ADDRESS 0xFFFF11D2 /begin FUNCTION_LIST /end FUNCTION_LIST /end MEASUREMENT
/begin MEASUREMENT vCEEPRNG "EEPROM reading trial number of times counter" UBYTE COMP_0030 1 100 0 255 ECU_ADDRESS 0xFFFF2974 /begin FUNCTION_LIST /end FUNCTION_LIST /end MEASUREMENT
/begin MEASUREMENT vCEEPWNG "EEPROM writing trial number of times counter" UBYTE COMP_0030 1 100 0 255 ECU_ADDRESS 0xFFFF2975 /begin FUNCTION_LIST /end FUNCTION_LIST /end MEASUREMENT
/begin MEASUREMENT vCEGRNG "ERG breakage counter" UBYTE COMP_0016 1 100 0 255 ECU_ADDRESS 0xFFFF2976 /begin FUNCTION_LIST /end FUNCTION_LIST /end MEASUREMENT
/begin MEASUREMENT vCERCN1 "Irregular response number of times" UBYTE COMP_0068 1 100 0 255 ECU_ADDRESS 0xFFFF3AA1 /begin FUNCTION_LIST /end FUNCTION_LIST /end MEASUREMENT
/begin MEASUREMENT vCERCN2 "No-response number of times" UBYTE COMP_0068 1 100 0 255 ECU_ADDRESS 0xFFFF3AA2 /begin FUNCTION_LIST /end FUNCTION_LIST /end MEASUREMENT
/begin MEASUREMENT vCEV16REV "A rotation measuring counter for the ALPEVP16 computation" UBYTE COMP_0191 1 100 0 255 ECU_ADDRESS 0xFFFF11D3 /begin FUNCTION_LIST /end FUNCTION_LIST /end MEASUREMENT
/begin MEASUREMENT vCEVREFN "REF integration value for CPC" UBYTE COMP_0287 1 100 0 255 ECU_ADDRESS 0xFFFF11D5 /begin FUNCTION_LIST /end FUNCTION_LIST /end MEASUREMENT
/begin MEASUREMENT vCFCADV "At the time of the fuel cut, ignition timing compensation value judgement" UBYTE COMP_0004 1 100 0 255 ECU_ADDRESS 0xFFFF11D7 /begin FUNCTION_LIST /end FUNCTION_LIST /end MEASUREMENT
/begin MEASUREMENT vCHALENGH "challenge" UBYTE COMP_0068 1 100 0 255 ECU_ADDRESS 0xFFFF3AA3 /begin FUNCTION_LIST /end FUNCTION_LIST /end MEASUREMENT
/begin MEASUREMENT vCHALENGL "challenge" ULONG COMP_0068 1 100 0 4294967295 ECU_ADDRESS 0xFFFF3AA4 /begin FUNCTION_LIST /end FUNCTION_LIST /end MEASUREMENT
/begin MEASUREMENT vCHGOK "Charging complete judgement electric current value" UBYTE COMP_0562_S 1 100 0 31.875 ECU_ADDRESS 0xFFFF11D8 /begin FUNCTION_LIST /end FUNCTION_LIST /end MEASUREMENT
/begin MEASUREMENT vCHGOKVG "Charging complete judgement gain" UBYTE COMP_0563_S 1 100 0 2.55 ECU_ADDRESS 0xFFFF11D9 /begin FUNCTION_LIST /end FUNCTION_LIST /end MEASUREMENT
/begin MEASUREMENT vCHKSUM_1 "The first time SUM value" UWORD COMP_0004 1 100 0 65535 ECU_ADDRESS 0xFFFF3AA8 /begin FUNCTION_LIST /end FUNCTION_LIST /end MEASUREMENT
/begin MEASUREMENT vCHKSUM_2 "The second time SUM value" UWORD COMP_0004 1 100 0 65535 ECU_ADDRESS 0xFFFF3AAA /begin FUNCTION_LIST /end FUNCTION_LIST /end MEASUREMENT
/begin MEASUREMENT vCHLNGBU "challenge" ULONG COMP_0068 1 100 0 4294967295 ECU_ADDRESS 0xFFFFB5C4 /begin FUNCTION_LIST /end FUNCTION_LIST /end MEASUREMENT
/begin MEASUREMENT vCHMODE "Charging condition mode" UBYTE COMP_0068 1 100 0 255 ECU_ADDRESS 0xFFFF11DA /begin FUNCTION_LIST /end FUNCTION_LIST /end MEASUREMENT
/begin MEASUREMENT vCISCVSV "Combustion efficiency compensation coefficient adjustment mode judgement counter" UBYTE COMP_0030 1 100 0 255 ECU_ADDRESS 0xFFFF2989 /begin FUNCTION_LIST /end FUNCTION_LIST /end MEASUREMENT
/begin MEASUREMENT vCJDIAG "CJ125 self-diagnosis result store buffer" UBYTE COMP_0068 1 100 0 255 ECU_ADDRESS 0xFFFF3AAC /begin FUNCTION_LIST /end FUNCTION_LIST /end MEASUREMENT
/begin MEASUREMENT vCJDIAG_R#1 "CJ125 self-diagnosis result store buffer" UBYTE COMP_0068 1 100 0 255 ECU_ADDRESS 0xFFFF3AAC /begin FUNCTION_LIST /end FUNCTION_LIST /end MEASUREMENT
/begin MEASUREMENT vCJDIAG_R#2 "CJ125 self-diagnosis result store buffer" UBYTE COMP_0068 1 100 0 255 ECU_ADDRESS 0xFFFF3AAD /begin FUNCTION_LIST /end FUNCTION_LIST /end MEASUREMENT
/begin MEASUREMENT vCLEJDI "LAN communication completion judgement IGN SW delay" UBYTE COMP_0014 1 100 0 2550 ECU_ADDRESS 0xFFFF298C /begin FUNCTION_LIST /end FUNCTION_LIST /end MEASUREMENT
/begin MEASUREMENT vCLEJDN "LAN communication completion judgement speed delay" UBYTE COMP_0014 1 100 0 2550 ECU_ADDRESS 0xFFFF298D /begin FUNCTION_LIST /end FUNCTION_LIST /end MEASUREMENT
/begin MEASUREMENT vCLGASINF "Diagnosis information the cooling gas load is too low" UBYTE COMP_0068 1 100 0 255 ECU_ADDRESS 0xFFFF298E /begin FUNCTION_LIST /end FUNCTION_LIST /end MEASUREMENT
/begin MEASUREMENT vCLKMNEN "CPU clock monitor permission RAM" UBYTE COMP_0068 1 100 0 255 ECU_ADDRESS 0xFFFF298F /begin FUNCTION_LIST /end FUNCTION_LIST /end MEASUREMENT
/begin MEASUREMENT vCLKMONI "IC3 clock monitor result RAM" UWORD COMP_0029_S 1 100 0 209712 ECU_ADDRESS 0xFFFF2990 /begin FUNCTION_LIST /end FUNCTION_LIST /end MEASUREMENT
/begin MEASUREMENT vCLKMONI1 "vTCLK computed first distinction" UBYTE COMP_0068 1 100 0 255 ECU_ADDRESS 0xFFFF3AAE /begin FUNCTION_LIST /end FUNCTION_LIST /end MEASUREMENT
/begin MEASUREMENT vCLKNG "0.02inch leak diagnosis NG counter" UBYTE COMP_0016 1 100 0 255 ECU_ADDRESS 0xFFFFA2B6 /begin FUNCTION_LIST /end FUNCTION_LIST /end MEASUREMENT
/begin MEASUREMENT vCLREPAD "EEPROM clear object EEP address" UWORD COMP_0068 1 100 0 65535 ECU_ADDRESS 0xFFFF2992 /begin FUNCTION_LIST /end FUNCTION_LIST /end MEASUREMENT
/begin MEASUREMENT vCLRMODE "EEPROM clear treatment mode" UBYTE COMP_0068 1 100 0 255 ECU_ADDRESS 0xFFFF2994 /begin FUNCTION_LIST /end FUNCTION_LIST /end MEASUREMENT
/begin MEASUREMENT vCLRRMAD "EEPROM clear object RAM address" ULONG COMP_0068 1 100 0 4294967295 ECU_ADDRESS 0xFFFF2998 /begin FUNCTION_LIST /end FUNCTION_LIST /end MEASUREMENT
/begin MEASUREMENT vCLSJDG "LAN communication start judgement delay" UBYTE COMP_0014 1 100 0 2550 ECU_ADDRESS 0xFFFF299C /begin FUNCTION_LIST /end FUNCTION_LIST /end MEASUREMENT
/begin MEASUREMENT vCLUSW "State of the clutch pedal RAM" UBYTE COMP_0068 1 100 0 255 ECU_ADDRESS 0xFFFF404F /begin FUNCTION_LIST /end FUNCTION_LIST /end MEASUREMENT
/begin MEASUREMENT vCLUSWI "Clutch Switch status" UBYTE COMP_0068 1 100 0 255 ECU_ADDRESS 0xFFFF4050 /begin FUNCTION_LIST /end FUNCTION_LIST /end MEASUREMENT
/begin MEASUREMENT vCLUSWN "The clutch pedal status information is unavailable RAM" UBYTE COMP_0068 1 100 0 255 ECU_ADDRESS 0xFFFF4051 /begin FUNCTION_LIST /end FUNCTION_LIST /end MEASUREMENT
/begin MEASUREMENT vCMIB "Monitor item counter" UBYTE COMP_0004 1 100 0 255 ECU_ADDRESS 0xFFFF299E /begin FUNCTION_LIST /end FUNCTION_LIST /end MEASUREMENT
/begin MEASUREMENT vCMOIM34 "Monitor clamp timer 3" UBYTE COMP_0030 1 100 0 255 ECU_ADDRESS 0xFFFF29A1 /begin FUNCTION_LIST /end FUNCTION_LIST /end MEASUREMENT
/begin MEASUREMENT vCNASNG "Drain-cut valve function diagnosis (3) NG counter" UBYTE COMP_0016 1 100 0 255 ECU_ADDRESS 0xFFFF11F1 /begin FUNCTION_LIST /end FUNCTION_LIST /end MEASUREMENT
/begin MEASUREMENT vCNCIDL "Purge cut counter" UBYTE COMP_0030 1 100 0 255 ECU_ADDRESS 0xFFFF29A3 /begin FUNCTION_LIST /end FUNCTION_LIST /end MEASUREMENT
/begin MEASUREMENT vCNGDLYE "VTC drive abnormality diagnosis judgement delay" UBYTE COMP_0008 1 100 0 25500 ECU_ADDRESS 0xFFFF11F3 /begin FUNCTION_LIST /end FUNCTION_LIST /end MEASUREMENT
/begin MEASUREMENT vCNGDLYI "VTC drive abnormality diagnosis judgement delay" UBYTE COMP_0008 1 100 0 25500 ECU_ADDRESS 0xFFFF11F4 /begin FUNCTION_LIST /end FUNCTION_LIST /end MEASUREMENT
/begin MEASUREMENT vCNNGKO "Fuel level gauge function diagnosis" UBYTE COMP_0016 1 100 0 255 ECU_ADDRESS 0xFFFFA2B9 /begin FUNCTION_LIST /end FUNCTION_LIST /end MEASUREMENT
/begin MEASUREMENT vCNPDCT "Pull-down number of times counter" UBYTE COMP_0016 1 100 0 255 ECU_ADDRESS 0xFFFF29A6 /begin FUNCTION_LIST /end FUNCTION_LIST /end MEASUREMENT
/begin MEASUREMENT vCNSMCNT "IT MASTER is turned, integration fuel consumption quantity counter" UBYTE COMP_0068 1 100 0 255 ECU_ADDRESS 0xFFFF23B2 /begin FUNCTION_LIST /end FUNCTION_LIST /end MEASUREMENT
/begin MEASUREMENT vCNT10 "AD diagnosis sampling number of times counter" UBYTE COMP_0030 1 100 0 255 ECU_ADDRESS 0xFFFF3AB4 /begin FUNCTION_LIST /end FUNCTION_LIST /end MEASUREMENT
/begin MEASUREMENT vCNTDI "DI input switching number of times" UBYTE COMP_0016 1 100 0 255 ECU_ADDRESS 0xFFFF29A8 /begin FUNCTION_LIST /end FUNCTION_LIST /end MEASUREMENT
/begin MEASUREMENT vCNTDTV "DTVO change number of times" UBYTE COMP_0016 1 100 0 255 ECU_ADDRESS 0xFFFF29A9 /begin FUNCTION_LIST /end FUNCTION_LIST /end MEASUREMENT
/begin MEASUREMENT vCNTEGR "EGR diagnosis completion number of times counter" UBYTE COMP_0016 1 100 0 255 ECU_ADDRESS 0xFFFFA2BB /begin FUNCTION_LIST /end FUNCTION_LIST /end MEASUREMENT
/begin MEASUREMENT vCNTMON "Heat resisting purge monitor clamp number of times" UBYTE COMP_0016 1 100 0 255 ECU_ADDRESS 0xFFFF11F9 /begin FUNCTION_LIST /end FUNCTION_LIST /end MEASUREMENT
/begin MEASUREMENT vCNTMON_R#1 "Heat resisting purge monitor clamp number of times" UBYTE COMP_0016 1 100 0 255 ECU_ADDRESS 0xFFFF11F9 /begin FUNCTION_LIST /end FUNCTION_LIST /end MEASUREMENT
/begin MEASUREMENT vCNTMON_R#2 "Heat resisting purge monitor clamp number of times" UBYTE COMP_0016 1 100 0 255 ECU_ADDRESS 0xFFFF11FA /begin FUNCTION_LIST /end FUNCTION_LIST /end MEASUREMENT
/begin MEASUREMENT vCNTRIP "Mileage for the fuel level gauge diagnosis" ULONG COMP_0389 1 100 0 1685624.33943218 ECU_ADDRESS 0xFFFFA00C /begin FUNCTION_LIST /end FUNCTION_LIST /end MEASUREMENT
/begin MEASUREMENT vCNTRLVSP "In control character, a vehicle speed for the control" UWORD COMP_0436 1 100 0 6553.5 ECU_ADDRESS 0xFFFF11FC /begin FUNCTION_LIST /end FUNCTION_LIST /end MEASUREMENT
/begin MEASUREMENT vCNTRZTVL "Imombilizer strategy" UBYTE COMP_0068 1 100 0 255 ECU_ADDRESS 0xFFFFB5CC /begin FUNCTION_LIST /end FUNCTION_LIST /end MEASUREMENT
/begin MEASUREMENT vCNTSPRG "Return spring diagnosis counter" UWORD COMP_0068 1 100 0 65535 ECU_ADDRESS 0xFFFF3AB6 /begin FUNCTION_LIST /end FUNCTION_LIST /end MEASUREMENT
/begin MEASUREMENT vCNTTMPZ "Electric balance counter temporary value" ULONG COMP_0564_S 1 100 0 16843.0148950532 ECU_ADDRESS 0xFFFF29B4 /begin FUNCTION_LIST /end FUNCTION_LIST /end MEASUREMENT
/begin MEASUREMENT vCOMBLIM "TFDCOMB limit value" SWORD COMP_0030_S 1 100 -32768 32767 ECU_ADDRESS 0xFFFF29BC /begin FUNCTION_LIST /end FUNCTION_LIST /end MEASUREMENT
/begin MEASUREMENT vCOUNT1 "MISx molecule index number" ULONG COMP_0068 1 100 0 4294967295 ECU_ADDRESS 0xFFFF361C /begin FUNCTION_LIST /end FUNCTION_LIST /end MEASUREMENT
/begin MEASUREMENT vCOUNT2 "MISx denominator index number" ULONG COMP_0068 1 100 0 4294967295 ECU_ADDRESS 0xFFFF3620 /begin FUNCTION_LIST /end FUNCTION_LIST /end MEASUREMENT
/begin MEASUREMENT vCOUNTALM "Accelerate limiter prohibition counter" UBYTE COMP_0024 1 100 0 12750 ECU_ADDRESS 0xFFFF29BE /begin FUNCTION_LIST /end FUNCTION_LIST /end MEASUREMENT
/begin MEASUREMENT vCOUNTRER "A counter for resume completion judgment" UBYTE COMP_0024 1 100 0 12750 ECU_ADDRESS 0xFFFF29BF /begin FUNCTION_LIST /end FUNCTION_LIST /end MEASUREMENT
/begin MEASUREMENT vCOUNTRES "A counter for RESswON time measuring" UBYTE COMP_0024 1 100 0 12750 ECU_ADDRESS 0xFFFF29C0 /begin FUNCTION_LIST /end FUNCTION_LIST /end MEASUREMENT
/begin MEASUREMENT vCOUNTSET "A counter for SETswON time measuring" UBYTE COMP_0024 1 100 0 12750 ECU_ADDRESS 0xFFFF29C1 /begin FUNCTION_LIST /end FUNCTION_LIST /end MEASUREMENT
/begin MEASUREMENT vCPBKUPC1 "A backup counter 1 for the hard check" UBYTE COMP_0016 1 100 0 255 ECU_ADDRESS 0xFFFFB5CE /begin FUNCTION_LIST /end FUNCTION_LIST /end MEASUREMENT
/begin MEASUREMENT vCPBKUPC2 "A backup counter 2 for the hard check" UBYTE COMP_0016 1 100 0 255 ECU_ADDRESS 0xFFFFB5CF /begin FUNCTION_LIST /end FUNCTION_LIST /end MEASUREMENT
/begin MEASUREMENT vCPCJUGf "CPC permission is distinguished." UBYTE COMP_0004 1 100 0 255 ECU_ADDRESS 0xFFFF3ABC /begin FUNCTION_LIST /end FUNCTION_LIST /end MEASUREMENT
/begin MEASUREMENT vCPLBKHW "Complement of the secret key. it is saved in EEPROM area (high part)" UWORD COMP_0068 1 100 0 65535 ECU_ADDRESS 0xFFFF3ABE /begin FUNCTION_LIST /end FUNCTION_LIST /end MEASUREMENT
/begin MEASUREMENT vCPLBKLW "Complement of the secret key. it is saved in EEPROM area (low part)" ULONG COMP_0068 1 100 0 4294967295 ECU_ADDRESS 0xFFFF3AC0 /begin FUNCTION_LIST /end FUNCTION_LIST /end MEASUREMENT
/begin MEASUREMENT vCPLSTHW "Complement of the secret key. it is saved in a not erasable area even (high part)" UWORD COMP_0068 1 100 0 65535 ECU_ADDRESS 0xFFFF3ACC /begin FUNCTION_LIST /end FUNCTION_LIST /end MEASUREMENT
/begin MEASUREMENT vCPLSTLW "Complement of the secret key. it is saved in a not erasable area even (low part)" ULONG COMP_0068 1 100 0 4294967295 ECU_ADDRESS 0xFFFF3AD0 /begin FUNCTION_LIST /end FUNCTION_LIST /end MEASUREMENT
/begin MEASUREMENT vCPURAM "Control unit diagnosis judgement value" ULONG COMP_0068 1 100 0 4294967295 ECU_ADDRESS 0xFFFF29C4 /begin FUNCTION_LIST /end FUNCTION_LIST /end MEASUREMENT
/begin MEASUREMENT vCPYTOPAT "Cranking authorization" UBYTE COMP_0068 1 100 0 255 ECU_ADDRESS 0xFFFF3AD4 /begin FUNCTION_LIST /end FUNCTION_LIST /end MEASUREMENT
/begin MEASUREMENT vCRACNTZ0 "Just before the crank corner detection counter clear, value" UBYTE COMP_0068 1 100 0 255 ECU_ADDRESS 0xFFFF1203 /begin FUNCTION_LIST /end FUNCTION_LIST /end MEASUREMENT
/begin MEASUREMENT vCRASHDLV "fCRASHDCL Equal signal at the time of the interruption" UBYTE COMP_0068 1 100 0 255 ECU_ADDRESS 0xFFFF4053 /begin FUNCTION_LIST /end FUNCTION_LIST /end MEASUREMENT
/begin MEASUREMENT vCRASHDTV "An equal signal at the time of the fCRASHDCT interruption" UBYTE COMP_0068 1 100 0 255 ECU_ADDRESS 0xFFFF4054 /begin FUNCTION_LIST /end FUNCTION_LIST /end MEASUREMENT
/begin MEASUREMENT vCRAVEE "Clutch solenoid voltage mean" UWORD COMP_0023 1 100 0 327675 ECU_ADDRESS 0xFFFF1D96 /begin FUNCTION_LIST /end FUNCTION_LIST /end MEASUREMENT
/begin MEASUREMENT vCRAVEE_R#1 "Clutch solenoid voltage mean" UWORD COMP_0023 1 100 0 327675 ECU_ADDRESS 0xFFFF1D96 /begin FUNCTION_LIST /end FUNCTION_LIST /end MEASUREMENT
/begin MEASUREMENT vCRAVEE_R#2 "Clutch solenoid voltage mean" UWORD COMP_0023 1 100 0 327675 ECU_ADDRESS 0xFFFF1D98 /begin FUNCTION_LIST /end FUNCTION_LIST /end MEASUREMENT
/begin MEASUREMENT vCRAVEI "Clutch solenoid voltage mean" UWORD COMP_0023 1 100 0 327675 ECU_ADDRESS 0xFFFF1D9A /begin FUNCTION_LIST /end FUNCTION_LIST /end MEASUREMENT
/begin MEASUREMENT vCRAVEI_R#1 "Clutch solenoid voltage mean" UWORD COMP_0023 1 100 0 327675 ECU_ADDRESS 0xFFFF1D9A /begin FUNCTION_LIST /end FUNCTION_LIST /end MEASUREMENT
/begin MEASUREMENT vCRAVEI_R#2 "Clutch solenoid voltage mean" UWORD COMP_0023 1 100 0 327675 ECU_ADDRESS 0xFFFF1D9C /begin FUNCTION_LIST /end FUNCTION_LIST /end MEASUREMENT
/begin MEASUREMENT vCRCH1 "the CRC of the first log zone record" UWORD COMP_0068 1 100 0 65535 ECU_ADDRESS 0xFFFF3AD6 /begin FUNCTION_LIST /end FUNCTION_LIST /end MEASUREMENT
/begin MEASUREMENT vCRMVE "Clutch solenoid voltage value monitor" UWORD COMP_0023 1 100 0 327675 ECU_ADDRESS 0xFFFF1CFC /begin FUNCTION_LIST /end FUNCTION_LIST /end MEASUREMENT
/begin MEASUREMENT vCRMVE_R#1 "Clutch solenoid voltage value monitor" UWORD COMP_0023 1 100 0 327675 ECU_ADDRESS 0xFFFF1CFC /begin FUNCTION_LIST /end FUNCTION_LIST /end MEASUREMENT
/begin MEASUREMENT vCRMVE_R#2 "Clutch solenoid voltage value monitor" UWORD COMP_0023 1 100 0 327675 ECU_ADDRESS 0xFFFF1CFE /begin FUNCTION_LIST /end FUNCTION_LIST /end MEASUREMENT
/begin MEASUREMENT vCRMVEz1 "Clutch solenoid voltage value monitor (before 1mS)" UWORD COMP_0023 1 100 0 327675 ECU_ADDRESS 0xFFFF1D00 /begin FUNCTION_LIST /end FUNCTION_LIST /end MEASUREMENT
/begin MEASUREMENT vCRMVEz1_R#1 "Clutch solenoid voltage value monitor (before 1mS)" UWORD COMP_0023 1 100 0 327675 ECU_ADDRESS 0xFFFF1D00 /begin FUNCTION_LIST /end FUNCTION_LIST /end MEASUREMENT
/begin MEASUREMENT vCRMVEz1_R#2 "Clutch solenoid voltage value monitor (before 1mS)" UWORD COMP_0023 1 100 0 327675 ECU_ADDRESS 0xFFFF1D02 /begin FUNCTION_LIST /end FUNCTION_LIST /end MEASUREMENT
/begin MEASUREMENT vCRMVEz2 "Clutch solenoid voltage value monitor (before 2mS)" UWORD COMP_0023 1 100 0 327675 ECU_ADDRESS 0xFFFF1D04 /begin FUNCTION_LIST /end FUNCTION_LIST /end MEASUREMENT
/begin MEASUREMENT vCRMVEz2_R#1 "Clutch solenoid voltage value monitor (before 2mS)" UWORD COMP_0023 1 100 0 327675 ECU_ADDRESS 0xFFFF1D04 /begin FUNCTION_LIST /end FUNCTION_LIST /end MEASUREMENT
/begin MEASUREMENT vCRMVEz2_R#2 "Clutch solenoid voltage value monitor (before 2mS)" UWORD COMP_0023 1 100 0 327675 ECU_ADDRESS 0xFFFF1D06 /begin FUNCTION_LIST /end FUNCTION_LIST /end MEASUREMENT
/begin MEASUREMENT vCRMVEz3 "Clutch solenoid voltage value monitor (before 3mS)" UWORD COMP_0023 1 100 0 327675 ECU_ADDRESS 0xFFFF1D08 /begin FUNCTION_LIST /end FUNCTION_LIST /end MEASUREMENT
/begin MEASUREMENT vCRMVEz3_R#1 "Clutch solenoid voltage value monitor (before 3mS)" UWORD COMP_0023 1 100 0 327675 ECU_ADDRESS 0xFFFF1D08 /begin FUNCTION_LIST /end FUNCTION_LIST /end MEASUREMENT
/begin MEASUREMENT vCRMVEz3_R#2 "Clutch solenoid voltage value monitor (before 3mS)" UWORD COMP_0023 1 100 0 327675 ECU_ADDRESS 0xFFFF1D0A /begin FUNCTION_LIST /end FUNCTION_LIST /end MEASUREMENT
/begin MEASUREMENT vCRMVI "Clutch solenoid voltage value monitor" UWORD COMP_0023 1 100 0 327675 ECU_ADDRESS 0xFFFF1D0C /begin FUNCTION_LIST /end FUNCTION_LIST /end MEASUREMENT
/begin MEASUREMENT vCRMVI_R#1 "Clutch solenoid voltage value monitor" UWORD COMP_0023 1 100 0 327675 ECU_ADDRESS 0xFFFF1D0C /begin FUNCTION_LIST /end FUNCTION_LIST /end MEASUREMENT
/begin MEASUREMENT vCRMVI_R#2 "Clutch solenoid voltage value monitor" UWORD COMP_0023 1 100 0 327675 ECU_ADDRESS 0xFFFF1D0E /begin FUNCTION_LIST /end FUNCTION_LIST /end MEASUREMENT
/begin MEASUREMENT vCRMVIz1 "Clutch solenoid voltage value monitor (before 1mS)" UWORD COMP_0023 1 100 0 327675 ECU_ADDRESS 0xFFFF1D10 /begin FUNCTION_LIST /end FUNCTION_LIST /end MEASUREMENT
/begin MEASUREMENT vCRMVIz1_R#1 "Clutch solenoid voltage value monitor (before 1mS)" UWORD COMP_0023 1 100 0 327675 ECU_ADDRESS 0xFFFF1D10 /begin FUNCTION_LIST /end FUNCTION_LIST /end MEASUREMENT
/begin MEASUREMENT vCRMVIz1_R#2 "Clutch solenoid voltage value monitor (before 1mS)" UWORD COMP_0023 1 100 0 327675 ECU_ADDRESS 0xFFFF1D12 /begin FUNCTION_LIST /end FUNCTION_LIST /end MEASUREMENT
/begin MEASUREMENT vCRMVIz2 "Clutch solenoid voltage value monitor (before 2mS)" UWORD COMP_0023 1 100 0 327675 ECU_ADDRESS 0xFFFF1D14 /begin FUNCTION_LIST /end FUNCTION_LIST /end MEASUREMENT
/begin MEASUREMENT vCRMVIz2_R#1 "Clutch solenoid voltage value monitor (before 2mS)" UWORD COMP_0023 1 100 0 327675 ECU_ADDRESS 0xFFFF1D14 /begin FUNCTION_LIST /end FUNCTION_LIST /end MEASUREMENT
/begin MEASUREMENT vCRMVIz2_R#2 "Clutch solenoid voltage value monitor (before 2mS)" UWORD COMP_0023 1 100 0 327675 ECU_ADDRESS 0xFFFF1D16 /begin FUNCTION_LIST /end FUNCTION_LIST /end MEASUREMENT
/begin MEASUREMENT vCRMVIz3 "Clutch solenoid voltage value monitor (before 3mS)" UWORD COMP_0023 1 100 0 327675 ECU_ADDRESS 0xFFFF1D18 /begin FUNCTION_LIST /end FUNCTION_LIST /end MEASUREMENT
/begin MEASUREMENT vCRMVIz3_R#1 "Clutch solenoid voltage value monitor (before 3mS)" UWORD COMP_0023 1 100 0 327675 ECU_ADDRESS 0xFFFF1D18 /begin FUNCTION_LIST /end FUNCTION_LIST /end MEASUREMENT
/begin MEASUREMENT vCRMVIz3_R#2 "Clutch solenoid voltage value monitor (before 3mS)" UWORD COMP_0023 1 100 0 327675 ECU_ADDRESS 0xFFFF1D1A /begin FUNCTION_LIST /end FUNCTION_LIST /end MEASUREMENT
/begin MEASUREMENT vCRSHDET "Event an airbag crash frame level 1 or 2 has been received" UBYTE COMP_0068 1 100 0 255 ECU_ADDRESS 0xFFFF4057 /begin FUNCTION_LIST /end FUNCTION_LIST /end MEASUREMENT
/begin MEASUREMENT vCRSHLVL1 "An airbag crash frame level 1 has been received" UBYTE COMP_0068 1 100 0 255 ECU_ADDRESS 0xFFFF4058 /begin FUNCTION_LIST /end FUNCTION_LIST /end MEASUREMENT
/begin MEASUREMENT vCRSHLVL2 "An airbag crash frame level 2 has been received" UBYTE COMP_0068 1 100 0 255 ECU_ADDRESS 0xFFFF4059 /begin FUNCTION_LIST /end FUNCTION_LIST /end MEASUREMENT
/begin MEASUREMENT vCRSOLE "Clutch solenoid electric current value monitor (exhaust)" UWORD COMP_0033_S 1 100 0 32767.5 ECU_ADDRESS 0xFFFF1D9E /begin FUNCTION_LIST /end FUNCTION_LIST /end MEASUREMENT
/begin MEASUREMENT vCRSOLE_R#1 "Clutch solenoid electric current value monitor (exhaust)" UWORD COMP_0033_S 1 100 0 32767.5 ECU_ADDRESS 0xFFFF1D9E /begin FUNCTION_LIST /end FUNCTION_LIST /end MEASUREMENT
/begin MEASUREMENT vCRSOLE_R#2 "Clutch solenoid electric current value monitor (exhaust)" UWORD COMP_0033_S 1 100 0 32767.5 ECU_ADDRESS 0xFFFF1DA0 /begin FUNCTION_LIST /end FUNCTION_LIST /end MEASUREMENT
/begin MEASUREMENT vCRSOLI "Clutch solenoid electric current value monitor (intake)" UWORD COMP_0033_S 1 100 0 32767.5 ECU_ADDRESS 0xFFFF1DA2 /begin FUNCTION_LIST /end FUNCTION_LIST /end MEASUREMENT
/begin MEASUREMENT vCRSOLI_R#1 "Clutch solenoid electric current value monitor (intake)" UWORD COMP_0033_S 1 100 0 32767.5 ECU_ADDRESS 0xFFFF1DA2 /begin FUNCTION_LIST /end FUNCTION_LIST /end MEASUREMENT
/begin MEASUREMENT vCRSOLI_R#2 "Clutch solenoid electric current value monitor (intake)" UWORD COMP_0033_S 1 100 0 32767.5 ECU_ADDRESS 0xFFFF1DA4 /begin FUNCTION_LIST /end FUNCTION_LIST /end MEASUREMENT
/begin MEASUREMENT vCRT1BUP "The ID condition data that I/O for the TCS fuel cut is local" UBYTE COMP_0004 1 100 0 255 ECU_ADDRESS 0xFFFF4914 /begin FUNCTION_LIST /end FUNCTION_LIST /end MEASUREMENT
/begin MEASUREMENT vCRTLOPT2Z "I/O Local ID executive data previous value" UBYTE COMP_0004 1 100 0 255 ECU_ADDRESS 0xFFFF29CE /begin FUNCTION_LIST /end FUNCTION_LIST /end MEASUREMENT
/begin MEASUREMENT vCRUCMPD1 "Carrier for safety failure diagnosis temp value for EEPROM" UBYTE COMP_0068 1 100 0 255 ECU_ADDRESS 0xFFFF29D0 /begin FUNCTION_LIST /end FUNCTION_LIST /end MEASUREMENT
/begin MEASUREMENT vCRUCMPDW "Previous carrier for safety failure diagnosis" UBYTE COMP_0068 1 100 0 255 ECU_ADDRESS 0xFFFF29D1 /begin FUNCTION_LIST /end FUNCTION_LIST /end MEASUREMENT
/begin MEASUREMENT vCRUCONZ "Cruise control state" UBYTE COMP_0068 1 100 0 255 ECU_ADDRESS 0xFFFF3AD8 /begin FUNCTION_LIST /end FUNCTION_LIST /end MEASUREMENT
/begin MEASUREMENT vCRUSWI1 "Switch order memorized boolean temp value for EEPROM" UBYTE COMP_0068 1 100 0 255 ECU_ADDRESS 0xFFFF29D3 /begin FUNCTION_LIST /end FUNCTION_LIST /end MEASUREMENT
/begin MEASUREMENT vCSACMXDSZ "Maximum duration of SET+ button press" UBYTE COMP_0013 1 100 0 255 ECU_ADDRESS 0xFFFF29D4 /begin FUNCTION_LIST /end FUNCTION_LIST /end MEASUREMENT
/begin MEASUREMENT vCSDEMXDSZ "Maximum duration of SET- button press" UBYTE COMP_0013 1 100 0 255 ECU_ADDRESS 0xFFFF29D5 /begin FUNCTION_LIST /end FUNCTION_LIST /end MEASUREMENT
/begin MEASUREMENT vCSDGNDL "Rationalization crank angle sensor diagnosis delay flag" UWORD COMP_0092 1 100 0 65535 ECU_ADDRESS 0xFFFF29D6 /begin FUNCTION_LIST /end FUNCTION_LIST /end MEASUREMENT
/begin MEASUREMENT vCSDGNF "Crank angle sensor diagnosis NG information inclusion RAM" UBYTE COMP_0068 1 100 0 255 ECU_ADDRESS 0xFFFFA2CA /begin FUNCTION_LIST /end FUNCTION_LIST /end MEASUREMENT
/begin MEASUREMENT vCSM4WDt "CSMM4WD Initial diagnosis flag/counter information label" UBYTE COMP_0016 1 100 0 255 ECU_ADDRESS 0xFFFF3AD9 /begin FUNCTION_LIST /end FUNCTION_LIST /end MEASUREMENT
/begin MEASUREMENT vCSMACCt "CSMACC Initial diagnosis flag/counter information label" UBYTE COMP_0016 1 100 0 255 ECU_ADDRESS 0xFFFF3ADA /begin FUNCTION_LIST /end FUNCTION_LIST /end MEASUREMENT
/begin MEASUREMENT vCSMATt "CSMAT Initial diagnosis flag/counter information label" UBYTE COMP_0016 1 100 0 255 ECU_ADDRESS 0xFFFF3ADB /begin FUNCTION_LIST /end FUNCTION_LIST /end MEASUREMENT
/begin MEASUREMENT vCSMBCMt "CSMBCM Initial diagnosis flag/counter information label" UBYTE COMP_0016 1 100 0 255 ECU_ADDRESS 0xFFFF3ADC /begin FUNCTION_LIST /end FUNCTION_LIST /end MEASUREMENT
/begin MEASUREMENT vCSMEPSt "CSMEPS Initial diagnosis flag/counter information label" UBYTE COMP_0016 1 100 0 255 ECU_ADDRESS 0xFFFF3ADD /begin FUNCTION_LIST /end FUNCTION_LIST /end MEASUREMENT
/begin MEASUREMENT vCSMETSt "CSMETS Initial diagnosis flag/counter information label" UBYTE COMP_0016 1 100 0 255 ECU_ADDRESS 0xFFFF3ADE /begin FUNCTION_LIST /end FUNCTION_LIST /end MEASUREMENT
/begin MEASUREMENT vCSMMETt "CSMMET Initial diagnosis flag/counter information label" UBYTE COMP_0016 1 100 0 255 ECU_ADDRESS 0xFFFF3ADF /begin FUNCTION_LIST /end FUNCTION_LIST /end MEASUREMENT
/begin MEASUREMENT vCSMMUTt "CSMMUTE Initial diagnosis flag/counter information label" UBYTE COMP_0016 1 100 0 255 ECU_ADDRESS 0xFFFF3AE0 /begin FUNCTION_LIST /end FUNCTION_LIST /end MEASUREMENT
/begin MEASUREMENT vCSMUSMt "CSMUSM Initial diagnosis flag/counter information label" UBYTE COMP_0016 1 100 0 255 ECU_ADDRESS 0xFFFF3AE1 /begin FUNCTION_LIST /end FUNCTION_LIST /end MEASUREMENT
/begin MEASUREMENT vCSMVACt "CSMHVAC Initial diagnosis flag/counter information label" UBYTE COMP_0016 1 100 0 255 ECU_ADDRESS 0xFFFF3AE2 /begin FUNCTION_LIST /end FUNCTION_LIST /end MEASUREMENT
/begin MEASUREMENT vCSMVDCt "CSMVDC Initial diagnosis flag/counter information label" UBYTE COMP_0016 1 100 0 255 ECU_ADDRESS 0xFFFF3AE3 /begin FUNCTION_LIST /end FUNCTION_LIST /end MEASUREMENT
/begin MEASUREMENT vCSNGRCL "CAM diagnosis NG judgement number of times (Phase LH)" UBYTE COMP_0016 1 100 0 255 ECU_ADDRESS 0xFFFF29D9 /begin FUNCTION_LIST /end FUNCTION_LIST /end MEASUREMENT
/begin MEASUREMENT vCSRSMXDSZ "Maximum duration of RESUME button press" UBYTE COMP_0013 1 100 0 255 ECU_ADDRESS 0xFFFF29DB /begin FUNCTION_LIST /end FUNCTION_LIST /end MEASUREMENT
/begin MEASUREMENT vCSSUMXDSZ "Maximum duration of SUSPEND button press" UBYTE COMP_0013 1 100 0 255 ECU_ADDRESS 0xFFFF29DC /begin FUNCTION_LIST /end FUNCTION_LIST /end MEASUREMENT
/begin MEASUREMENT vCST1OKf "Catalyst diagnosis judgement (stage 1 OK)" UBYTE COMP_0004 1 100 0 255 ECU_ADDRESS 0xFFFF29DD /begin FUNCTION_LIST /end FUNCTION_LIST /end MEASUREMENT
/begin MEASUREMENT vCST2NGf "Catalyst diagnosis judgement (stage 2NG)" UBYTE COMP_0004 1 100 0 255 ECU_ADDRESS 0xFFFF29DE /begin FUNCTION_LIST /end FUNCTION_LIST /end MEASUREMENT
/begin MEASUREMENT vCST2OKf "Catalyst diagnosis judgement (stage 2 OK)" UBYTE COMP_0004 1 100 0 255 ECU_ADDRESS 0xFFFF29DF /begin FUNCTION_LIST /end FUNCTION_LIST /end MEASUREMENT
/begin MEASUREMENT vCTAINT "TAINT initial delay counter" UBYTE COMP_0016 1 100 0 255 ECU_ADDRESS 0xFFFF1E6C /begin FUNCTION_LIST /end FUNCTION_LIST /end MEASUREMENT
/begin MEASUREMENT vCTEMBMX "Multiplexed state of the clutch pedal switch (1=pressed clutch pedal or not connected)" UBYTE COMP_0068 1 100 0 255 ECU_ADDRESS 0xFFFF41EA /begin FUNCTION_LIST /end FUNCTION_LIST /end MEASUREMENT
/begin MEASUREMENT vCTGBRCPT "Present failure counter: AT_TorqueControl frame reception" UBYTE COMP_0068 1 100 0 255 ECU_ADDRESS 0xFFFFA2CC /begin FUNCTION_LIST /end FUNCTION_LIST /end MEASUREMENT
/begin MEASUREMENT vCTGBTQNG "Present failure counter: AT_TorqueControl value" UBYTE COMP_0068 1 100 0 255 ECU_ADDRESS 0xFFFFA2CD /begin FUNCTION_LIST /end FUNCTION_LIST /end MEASUREMENT
/begin MEASUREMENT vCTOPHSf "DOS data initialization distinction" UBYTE COMP_0004 1 100 0 255 ECU_ADDRESS 0xFFFF1208 /begin FUNCTION_LIST /end FUNCTION_LIST /end MEASUREMENT
/begin MEASUREMENT vCTPALTM "CTP Alternator flame" UBYTE COMP_0283 1 100 0 255 ECU_ADDRESS 0xFFFF3AE5 /begin FUNCTION_LIST /end FUNCTION_LIST /end MEASUREMENT
/begin MEASUREMENT vCTRLOPT1 "DIAGCAN I/O Control option" UBYTE COMP_0004 1 100 0 255 ECU_ADDRESS 0xFFFF3AE6 /begin FUNCTION_LIST /end FUNCTION_LIST /end MEASUREMENT
/begin MEASUREMENT vCTRLOPT2 "DIAGCAN I/O Control control value 1" UBYTE COMP_0004 1 100 0 255 ECU_ADDRESS 0xFFFF3AE7 /begin FUNCTION_LIST /end FUNCTION_LIST /end MEASUREMENT
/begin MEASUREMENT vCTRLOPT3 "DIAGCAN I/O Control control value 2" UBYTE COMP_0004 1 100 0 255 ECU_ADDRESS 0xFFFF3AE8 /begin FUNCTION_LIST /end FUNCTION_LIST /end MEASUREMENT
/begin MEASUREMENT vCTSTPINJ "For the injection compulsory completion timing angle" UWORD COMP_0390 1 100 0 655350 ECU_ADDRESS 0xFFFF1FB6 /begin FUNCTION_LIST /end FUNCTION_LIST /end MEASUREMENT
/begin MEASUREMENT vCUREF "Battery charging efficiency" UBYTE COMP_0373 1 100 0 2.55 ECU_ADDRESS 0xFFFF120C /begin FUNCTION_LIST /end FUNCTION_LIST /end MEASUREMENT
/begin MEASUREMENT vCURTTIME "At present, time" ULONG COMP_0053 1 100 0 4294967295 ECU_ADDRESS 0xFFFF1E70 /begin FUNCTION_LIST /end FUNCTION_LIST /end MEASUREMENT
/begin MEASUREMENT vCUTOFCTP "PTC cut/freeze information" UBYTE COMP_0068 1 100 0 255 ECU_ADDRESS 0xFFFF3AE9 /begin FUNCTION_LIST /end FUNCTION_LIST /end MEASUREMENT
/begin MEASUREMENT vCVBVMN "CVBV diagnosis minimum value" UBYTE COMP_0391 1 100 0 99.705 ECU_ADDRESS 0xFFFFA2CE /begin FUNCTION_LIST /end FUNCTION_LIST /end MEASUREMENT
/begin MEASUREMENT vCVN1ADR "1 byte editing address for the SUM value computation" ULONG COMP_0068 1 100 0 4294967295 ECU_ADDRESS 0xFFFF29EC /begin FUNCTION_LIST /end FUNCTION_LIST /end MEASUREMENT
/begin MEASUREMENT vCVN2ADR1 "2 bytes editing address for the CVN computation" ULONG COMP_0068 1 100 0 4294967295 ECU_ADDRESS 0xFFFF29F0 /begin FUNCTION_LIST /end FUNCTION_LIST /end MEASUREMENT
/begin MEASUREMENT vCVN2ADR2 "1 byte data picking-up address for the CVN computation" ULONG COMP_0068 1 100 0 4294967295 ECU_ADDRESS 0xFFFF29F4 /begin FUNCTION_LIST /end FUNCTION_LIST /end MEASUREMENT
/begin MEASUREMENT vCVN2CNT "An operation counter for the CVN computation" UWORD COMP_0068 1 100 0 65535 ECU_ADDRESS 0xFFFF29F8 /begin FUNCTION_LIST /end FUNCTION_LIST /end MEASUREMENT
/begin MEASUREMENT vCVNTMP1 "SUM computed value (after North America 2005MY)" ULONG COMP_0068 1 100 0 4294967295 ECU_ADDRESS 0xFFFF29FC /begin FUNCTION_LIST /end FUNCTION_LIST /end MEASUREMENT
/begin MEASUREMENT vCVNTMP2 "CVN computed value (after North America 2005MY)" ULONG COMP_0068 1 100 0 4294967295 ECU_ADDRESS 0xFFFF2A00 /begin FUNCTION_LIST /end FUNCTION_LIST /end MEASUREMENT
/begin MEASUREMENT vCVT014 "CVT input rotation sensor pulse periodic measuring measurement mode" UBYTE COMP_0068 1 100 0 255 ECU_ADDRESS 0xFFFF1FB8 /begin FUNCTION_LIST /end FUNCTION_LIST /end MEASUREMENT
/begin MEASUREMENT vCVTCCHKf "CVTC solenoid check signal (L)" UBYTE COMP_0004 1 100 0 255 ECU_ADDRESS 0xFFFF4915 /begin FUNCTION_LIST /end FUNCTION_LIST /end MEASUREMENT
/begin MEASUREMENT vCVTFLEVL "A (CK) load change signal by the CAN receiving data" UBYTE COMP_0068 1 100 0 255 ECU_ADDRESS 0xFFFF4916 /begin FUNCTION_LIST /end FUNCTION_LIST /end MEASUREMENT
/begin MEASUREMENT vCVTFLEVZ "CVTFLEVL bit 0,1 previous value" UBYTE COMP_0068 1 100 0 255 ECU_ADDRESS 0xFFFF2A04 /begin FUNCTION_LIST /end FUNCTION_LIST /end MEASUREMENT
/begin MEASUREMENT vCVTMSG1T "CVTMSG1 reception interval counter" UBYTE COMP_0014 1 100 0 2550 ECU_ADDRESS 0xFFFF4917 /begin FUNCTION_LIST /end FUNCTION_LIST /end MEASUREMENT
/begin MEASUREMENT vCVTMSG2T "CVTMSG2 reception interval counter" UBYTE COMP_0014 1 100 0 2550 ECU_ADDRESS 0xFFFF4918 /begin FUNCTION_LIST /end FUNCTION_LIST /end MEASUREMENT
/begin MEASUREMENT vCVTMSG3T "CVTMSG3 reception interval counter" UBYTE COMP_0014 1 100 0 2550 ECU_ADDRESS 0xFFFF4919 /begin FUNCTION_LIST /end FUNCTION_LIST /end MEASUREMENT
/begin MEASUREMENT vCVTRNGZ "CVT range signal (previous value)" UBYTE COMP_0068 1 100 0 255 ECU_ADDRESS 0xFFFF2A05 /begin FUNCTION_LIST /end FUNCTION_LIST /end MEASUREMENT
/begin MEASUREMENT vCYLCSPHL "A CAM (Phase) LH sensor momentary-disconnection, noise, tooth breaks off, cylinder distinction value for the diagnosis" UBYTE COMP_0567_S 1 100 0 255 ECU_ADDRESS 0xFFFF1219 /begin FUNCTION_LIST /end FUNCTION_LIST /end MEASUREMENT
/begin MEASUREMENT vCYLCSPHR "A CAM (Phase) RH sensor momentary-disconnection, noise, tooth breaks off, cylinder distinction value for the diagnosis" UBYTE COMP_0567_S 1 100 0 255 ECU_ADDRESS 0xFFFF121A /begin FUNCTION_LIST /end FUNCTION_LIST /end MEASUREMENT
/begin MEASUREMENT vCYLDIS "A CAM momentary-disconnection noise tooth breaks off, the cylinder distinction number of times after the diagnosis condition formation" UBYTE COMP_0030 1 100 0 255 ECU_ADDRESS 0xFFFF121B /begin FUNCTION_LIST /end FUNCTION_LIST /end MEASUREMENT
/begin MEASUREMENT vCYLDIS2 "A CAM momentary-disconnection noise tooth breaks off, the cylinder distinction number of times for the diagnosis cancellation" UBYTE COMP_0030 1 100 0 255 ECU_ADDRESS 0xFFFF121C /begin FUNCTION_LIST /end FUNCTION_LIST /end MEASUREMENT
/begin MEASUREMENT vCYLDNOW "Incumbent electric supply cylinder value" UBYTE COMP_0567_S 1 100 0 255 ECU_ADDRESS 0xFFFF121D /begin FUNCTION_LIST /end FUNCTION_LIST /end MEASUREMENT
/begin MEASUREMENT vCYLDNOW1 "Incumbent electric supply cylinder value 1" UBYTE COMP_0567_S 1 100 0 255 ECU_ADDRESS 0xFFFF121E /begin FUNCTION_LIST /end FUNCTION_LIST /end MEASUREMENT
/begin MEASUREMENT vCYLDNOW2 "Incumbent electric supply cylinder value 2" UBYTE COMP_0567_S 1 100 0 255 ECU_ADDRESS 0xFFFF121F /begin FUNCTION_LIST /end FUNCTION_LIST /end MEASUREMENT
/begin MEASUREMENT vCYLRGD "Misfire cylinder distinction counter" UBYTE COMP_0016 1 100 0 255 ECU_ADDRESS 0xFFFF405A /begin FUNCTION_LIST /end FUNCTION_LIST /end MEASUREMENT
/begin MEASUREMENT vDABFHISf "DABF<=DABFHIS# is measured in all the cylinder F/C insides." UBYTE COMP_0004 1 100 0 255 ECU_ADDRESS 0xFFFF1228 /begin FUNCTION_LIST /end FUNCTION_LIST /end MEASUREMENT
/begin MEASUREMENT vDADVSTS "At the time of the acceleration, phase control condition variable" UBYTE COMP_0004 1 100 0 255 ECU_ADDRESS 0xFFFF1229 /begin FUNCTION_LIST /end FUNCTION_LIST /end MEASUREMENT
/begin MEASUREMENT vDANG "The amount of D element compensation" UWORD COMP_0497_S 1 100 -128 127.99609375 ECU_ADDRESS 0xFFFF122A /begin FUNCTION_LIST /end FUNCTION_LIST /end MEASUREMENT
/begin MEASUREMENT vDAPOREF "Pedal pushing speed reference value table reference value" UBYTE COMP_0516_S 1 100 0 31.875 ECU_ADDRESS 0xFFFF2A14 /begin FUNCTION_LIST /end FUNCTION_LIST /end MEASUREMENT
/begin MEASUREMENT vDBEGRQ "Target EGR rate map value (variable)" UBYTE COMP_0141 1 100 0 49.8046875 ECU_ADDRESS 0xFFFF1230 /begin FUNCTION_LIST /end FUNCTION_LIST /end MEASUREMENT
/begin MEASUREMENT vDBMXNEI "At the time of a waste time maximum value, engine speed (retard side)" UBYTE COMP_0020 1 100 0 12750 ECU_ADDRESS 0xFFFFA2D1 /begin FUNCTION_LIST /end FUNCTION_LIST /end MEASUREMENT
/begin MEASUREMENT vDBMXNEI_R#1 "At the time of a waste time maximum value, engine speed (retard side)" UBYTE COMP_0020 1 100 0 12750 ECU_ADDRESS 0xFFFFA2D1 /begin FUNCTION_LIST /end FUNCTION_LIST /end MEASUREMENT
/begin MEASUREMENT vDBMXNEI_R#2 "At the time of a waste time maximum value, engine speed (retard side)" UBYTE COMP_0020 1 100 0 12750 ECU_ADDRESS 0xFFFFA2D2 /begin FUNCTION_LIST /end FUNCTION_LIST /end MEASUREMENT
/begin MEASUREMENT vDBMXOLI "At the time of a waste time maximum value, oil temperature (retard side)" UBYTE COMP_0035 1 100 -50 205 ECU_ADDRESS 0xFFFFA2D3 /begin FUNCTION_LIST /end FUNCTION_LIST /end MEASUREMENT
/begin MEASUREMENT vDBMXOLI_R#1 "At the time of a waste time maximum value, oil temperature (retard side)" UBYTE COMP_0035 1 100 -50 205 ECU_ADDRESS 0xFFFFA2D3 /begin FUNCTION_LIST /end FUNCTION_LIST /end MEASUREMENT
/begin MEASUREMENT vDBMXOLI_R#2 "At the time of a waste time maximum value, oil temperature (retard side)" UBYTE COMP_0035 1 100 -50 205 ECU_ADDRESS 0xFFFFA2D4 /begin FUNCTION_LIST /end FUNCTION_LIST /end MEASUREMENT
/begin MEASUREMENT vDBNOWE "At present, conversion corner equivalent DUTY ratio" UWORD COMP_0038_S 1 100 -3200 3199.90234375 ECU_ADDRESS 0xFFFF1232 /begin FUNCTION_LIST /end FUNCTION_LIST /end MEASUREMENT
/begin MEASUREMENT vDBNOWE_R#1 "At present, conversion corner equivalent DUTY ratio" UWORD COMP_0038_S 1 100 -3200 3199.90234375 ECU_ADDRESS 0xFFFF1232 /begin FUNCTION_LIST /end FUNCTION_LIST /end MEASUREMENT
/begin MEASUREMENT vDBNOWE_R#2 "At present, conversion corner equivalent DUTY ratio" UWORD COMP_0038_S 1 100 -3200 3199.90234375 ECU_ADDRESS 0xFFFF1234 /begin FUNCTION_LIST /end FUNCTION_LIST /end MEASUREMENT
/begin MEASUREMENT vDBNOWI "At present, conversion corner equivalent DUTY ratio" UWORD COMP_0038_S 1 100 -3200 3199.90234375 ECU_ADDRESS 0xFFFF1236 /begin FUNCTION_LIST /end FUNCTION_LIST /end MEASUREMENT
/begin MEASUREMENT vDBNOWI_R#1 "At present, conversion corner equivalent DUTY ratio" UWORD COMP_0038_S 1 100 -3200 3199.90234375 ECU_ADDRESS 0xFFFF1236 /begin FUNCTION_LIST /end FUNCTION_LIST /end MEASUREMENT
/begin MEASUREMENT vDBNOWI_R#2 "At present, conversion corner equivalent DUTY ratio" UWORD COMP_0038_S 1 100 -3200 3199.90234375 ECU_ADDRESS 0xFFFF1238 /begin FUNCTION_LIST /end FUNCTION_LIST /end MEASUREMENT
/begin MEASUREMENT vDBTRGE "Target conversion corner equivalent DUTY ratio" UWORD COMP_0038_S 1 100 -3200 3199.90234375 ECU_ADDRESS 0xFFFF123A /begin FUNCTION_LIST /end FUNCTION_LIST /end MEASUREMENT
/begin MEASUREMENT vDBTRGE_R#1 "Target conversion corner equivalent DUTY ratio" UWORD COMP_0038_S 1 100 -3200 3199.90234375 ECU_ADDRESS 0xFFFF123A /begin FUNCTION_LIST /end FUNCTION_LIST /end MEASUREMENT
/begin MEASUREMENT vDBTRGE_R#2 "Target conversion corner equivalent DUTY ratio" UWORD COMP_0038_S 1 100 -3200 3199.90234375 ECU_ADDRESS 0xFFFF123C /begin FUNCTION_LIST /end FUNCTION_LIST /end MEASUREMENT
/begin MEASUREMENT vDBTRGI "Target conversion corner equivalent DUTY ratio" UWORD COMP_0038_S 1 100 -3200 3199.90234375 ECU_ADDRESS 0xFFFF123E /begin FUNCTION_LIST /end FUNCTION_LIST /end MEASUREMENT
/begin MEASUREMENT vDBTRGI_R#1 "Target conversion corner equivalent DUTY ratio" UWORD COMP_0038_S 1 100 -3200 3199.90234375 ECU_ADDRESS 0xFFFF123E /begin FUNCTION_LIST /end FUNCTION_LIST /end MEASUREMENT
/begin MEASUREMENT vDBTRGI_R#2 "Target conversion corner equivalent DUTY ratio" UWORD COMP_0038_S 1 100 -3200 3199.90234375 ECU_ADDRESS 0xFFFF1240 /begin FUNCTION_LIST /end FUNCTION_LIST /end MEASUREMENT
/begin MEASUREMENT vDCALPf "Slowdown lean clamp judgement flag" UBYTE COMP_0004 1 100 0 255 ECU_ADDRESS 0xFFFF1242 /begin FUNCTION_LIST /end FUNCTION_LIST /end MEASUREMENT
/begin MEASUREMENT vDCEVPS "Drain-cut diagnosis basis DUTY value" UBYTE COMP_0047 1 100 0 127.5 ECU_ADDRESS 0xFFFFA2D5 /begin FUNCTION_LIST /end FUNCTION_LIST /end MEASUREMENT
/begin MEASUREMENT vDCLSTJf "It waits for the slowdown lean clamp start condition rotation delay." UBYTE COMP_0004 1 100 0 255 ECU_ADDRESS 0xFFFF1243 /begin FUNCTION_LIST /end FUNCTION_LIST /end MEASUREMENT
/begin MEASUREMENT vDCSIGN1 "ST drive output value" UBYTE COMP_0068 1 100 0 255 ECU_ADDRESS 0xFFFF1E74 /begin FUNCTION_LIST /end FUNCTION_LIST /end MEASUREMENT
/begin MEASUREMENT vDCSIGN16 "ST drive output value" UBYTE COMP_0068 1 100 0 255 ECU_ADDRESS 0xFFFF1E75 /begin FUNCTION_LIST /end FUNCTION_LIST /end MEASUREMENT
/begin MEASUREMENT vDCTCNTEND "RAM value vDCTCNTEND" UBYTE COMP_0004 1 100 0 255 ECU_ADDRESS 0xFFFF2A24 /begin FUNCTION_LIST /end FUNCTION_LIST /end MEASUREMENT
/begin MEASUREMENT vDCTCNTOKf "DCTCNT (for the bank) count judgement flag" UBYTE COMP_0004 1 100 0 255 ECU_ADDRESS 0xFFFF2A25 /begin FUNCTION_LIST /end FUNCTION_LIST /end MEASUREMENT
/begin MEASUREMENT vDCV1MN "Drain-cut /V function diagnosis (1) minimum value" UBYTE COMP_0054 1 100 0 5100 ECU_ADDRESS 0xFFFFA2D6 /begin FUNCTION_LIST /end FUNCTION_LIST /end MEASUREMENT
/begin MEASUREMENT vDCV1MX "Drain-cut /V function diagnosis (1) maximum value" UBYTE COMP_0054 1 100 0 5100 ECU_ADDRESS 0xFFFFA2D7 /begin FUNCTION_LIST /end FUNCTION_LIST /end MEASUREMENT
/begin MEASUREMENT vDCV2MN "Drain-cut /V function diagnosis (2) minimum value" UBYTE COMP_0054 1 100 0 5100 ECU_ADDRESS 0xFFFFA2D8 /begin FUNCTION_LIST /end FUNCTION_LIST /end MEASUREMENT
/begin MEASUREMENT vDCV2MX "Drain-cut /V function diagnosis (2) maximum value" UBYTE COMP_0054 1 100 0 5100 ECU_ADDRESS 0xFFFFA2D9 /begin FUNCTION_LIST /end FUNCTION_LIST /end MEASUREMENT
/begin MEASUREMENT vDCV3MN "Drain-cut /V function diagnosis (3) minimum value" UBYTE COMP_0054 1 100 0 5100 ECU_ADDRESS 0xFFFFA2DA /begin FUNCTION_LIST /end FUNCTION_LIST /end MEASUREMENT
/begin MEASUREMENT vDCV3MX "Drain-cut /V function diagnosis (3) maximum value" UBYTE COMP_0054 1 100 0 5100 ECU_ADDRESS 0xFFFFA2DB /begin FUNCTION_LIST /end FUNCTION_LIST /end MEASUREMENT
/begin MEASUREMENT vDDCTRG "-" UBYTE COMP_0068 1 100 0 255 ECU_ADDRESS 0xFFFF405B /begin FUNCTION_LIST /end FUNCTION_LIST /end MEASUREMENT
/begin MEASUREMENT vDDLEVPM "An EVP output duty for the DDL monitor" UBYTE COMP_0047 1 100 0 127.5 ECU_ADDRESS 0xFFFF1244 /begin FUNCTION_LIST /end FUNCTION_LIST /end MEASUREMENT
/begin MEASUREMENT vDDLTIPSD "At the time of the sequential injection, output pulse width" UWORD COMP_0394 1 100 0 838848 ECU_ADDRESS 0xFFFF1246 /begin FUNCTION_LIST /end FUNCTION_LIST /end MEASUREMENT
/begin MEASUREMENT vDDLTISTD "At the time of the initial injection, output pulse width" UWORD COMP_0394 1 100 0 838848 ECU_ADDRESS 0xFFFF124A /begin FUNCTION_LIST /end FUNCTION_LIST /end MEASUREMENT
/begin MEASUREMENT vDEBUG1 "-" ULONG COMP_0004 1 100 0 4294967295 ECU_ADDRESS 0xFFFF1250 /begin FUNCTION_LIST /end FUNCTION_LIST /end MEASUREMENT
/begin MEASUREMENT vDEGSTPM "For the EGR breakage diagnosis motor position monitor value difference" UWORD COMP_0140 1 100 0 32767.5 ECU_ADDRESS 0xFFFF1DA6 /begin FUNCTION_LIST /end FUNCTION_LIST /end MEASUREMENT
/begin MEASUREMENT vDEPRSI2 "When a function is diagnosed, a change in line pressure" UWORD COMP_0050 1 100 0 5119.921875 ECU_ADDRESS 0xFFFF2A2A /begin FUNCTION_LIST /end FUNCTION_LIST /end MEASUREMENT
/begin MEASUREMENT vDETRQ "Engine torque change rate limiter" UBYTE COMP_0040_S 1 100 0 5100 ECU_ADDRESS 0xFFFF3AF2 /begin FUNCTION_LIST /end FUNCTION_LIST /end MEASUREMENT
/begin MEASUREMENT vDETRQ1 "Engine torque change rate limiter" UWORD COMP_0193 1 100 0 6553.5 ECU_ADDRESS 0xFFFF1264 /begin FUNCTION_LIST /end FUNCTION_LIST /end MEASUREMENT
/begin MEASUREMENT vDEVPRS "In the leak-down, a change in line pressure" UWORD COMP_0050 1 100 0 5119.921875 ECU_ADDRESS 0xFFFF2A2E /begin FUNCTION_LIST /end FUNCTION_LIST /end MEASUREMENT
/begin MEASUREMENT vDEVPRS02 "A change in line pressure for the 0.02 slosh judgement" UWORD COMP_0050 1 100 0 5119.921875 ECU_ADDRESS 0xFFFF2A30 /begin FUNCTION_LIST /end FUNCTION_LIST /end MEASUREMENT
/begin MEASUREMENT vDEVPRS2 "In the first leak-down inside, a change in line pressure" UWORD COMP_0050 1 100 0 5119.921875 ECU_ADDRESS 0xFFFF2A32 /begin FUNCTION_LIST /end FUNCTION_LIST /end MEASUREMENT
/begin MEASUREMENT vDEVPRSX "In the second leak-down inside, a change in line pressure" UWORD COMP_0050 1 100 0 5119.921875 ECU_ADDRESS 0xFFFF2A34 /begin FUNCTION_LIST /end FUNCTION_LIST /end MEASUREMENT
/begin MEASUREMENT vDEVPS "At the time of the pull-down F/B, a change in purge valve open-degree" UBYTE COMP_0059 1 100 0 127.5 ECU_ADDRESS 0xFFFF2A36 /begin FUNCTION_LIST /end FUNCTION_LIST /end MEASUREMENT
/begin MEASUREMENT vDEVVB "VBSET-VBALT" SBYTE COMP_0397 1 100 -2560 2540 ECU_ADDRESS 0xFFFF1DA8 /begin FUNCTION_LIST /end FUNCTION_LIST /end MEASUREMENT
/begin MEASUREMENT vDEVVB2 "VBALT2-VBALT" UBYTE COMP_0054 1 100 0 5100 ECU_ADDRESS 0xFFFF1DA9 /begin FUNCTION_LIST /end FUNCTION_LIST /end MEASUREMENT
/begin MEASUREMENT vDFMXNEI "At the time of a waste time maximum value, engine speed (advance side)" UBYTE COMP_0020 1 100 0 12750 ECU_ADDRESS 0xFFFFA2DC /begin FUNCTION_LIST /end FUNCTION_LIST /end MEASUREMENT
/begin MEASUREMENT vDFMXNEI_R#1 "At the time of a waste time maximum value, engine speed (advance side)" UBYTE COMP_0020 1 100 0 12750 ECU_ADDRESS 0xFFFFA2DC /begin FUNCTION_LIST /end FUNCTION_LIST /end MEASUREMENT
/begin MEASUREMENT vDFMXNEI_R#2 "At the time of a waste time maximum value, engine speed (advance side)" UBYTE COMP_0020 1 100 0 12750 ECU_ADDRESS 0xFFFFA2DD /begin FUNCTION_LIST /end FUNCTION_LIST /end MEASUREMENT
/begin MEASUREMENT vDFMXOLI "At the time of a waste time maximum value, oil temperature (advance side)" UBYTE COMP_0035 1 100 -50 205 ECU_ADDRESS 0xFFFFA2DE /begin FUNCTION_LIST /end FUNCTION_LIST /end MEASUREMENT
/begin MEASUREMENT vDFMXOLI_R#1 "At the time of a waste time maximum value, oil temperature (advance side)" UBYTE COMP_0035 1 100 -50 205 ECU_ADDRESS 0xFFFFA2DE /begin FUNCTION_LIST /end FUNCTION_LIST /end MEASUREMENT
/begin MEASUREMENT vDFMXOLI_R#2 "At the time of a waste time maximum value, oil temperature (advance side)" UBYTE COMP_0035 1 100 -50 205 ECU_ADDRESS 0xFFFFA2DF /begin FUNCTION_LIST /end FUNCTION_LIST /end MEASUREMENT
/begin MEASUREMENT vDGNAFSZ "Response deterioration lean rich diagnosis parameter" UWORD COMP_0453 1 100 0 131.07 ECU_ADDRESS 0xFFFF1266 /begin FUNCTION_LIST /end FUNCTION_LIST /end MEASUREMENT
/begin MEASUREMENT vDGNEND "Diagnosis completion judgement OK judgement flag" UBYTE COMP_0068 1 100 0 255 ECU_ADDRESS 0xFFFF2A37 /begin FUNCTION_LIST /end FUNCTION_LIST /end MEASUREMENT
/begin MEASUREMENT vDGONBCM "BCM reception diagnostic indicator" UBYTE COMP_0068 1 100 0 255 ECU_ADDRESS 0xFFFF405C /begin FUNCTION_LIST /end FUNCTION_LIST /end MEASUREMENT
/begin MEASUREMENT vDGROMAD "ROM operation address" ULONG COMP_0068 1 100 0 4294967295 ECU_ADDRESS 0xFFFF2A40 /begin FUNCTION_LIST /end FUNCTION_LIST /end MEASUREMENT
/begin MEASUREMENT vDIAGONGR "Authorize the diagnostic on CAN RAM" UBYTE COMP_0068 1 100 0 255 ECU_ADDRESS 0xFFFF405D /begin FUNCTION_LIST /end FUNCTION_LIST /end MEASUREMENT
/begin MEASUREMENT vDIAGUCX1 "diagnosis of mux ecu absent mumber1" UBYTE COMP_0068 1 100 0 255 ECU_ADDRESS 0xFFFF3AF5 /begin FUNCTION_LIST /end FUNCTION_LIST /end MEASUREMENT
/begin MEASUREMENT vDIAGUCX5 "diagnosis of mux ecu absent mumber5" UBYTE COMP_0068 1 100 0 255 ECU_ADDRESS 0xFFFF3AF9 /begin FUNCTION_LIST /end FUNCTION_LIST /end MEASUREMENT
/begin MEASUREMENT vDIAGUCX6 "diagnosis of mux ecu absent mumber6" UBYTE COMP_0068 1 100 0 255 ECU_ADDRESS 0xFFFF3AFA /begin FUNCTION_LIST /end FUNCTION_LIST /end MEASUREMENT
/begin MEASUREMENT vDIAGUCXA "diagnosis of mux ecu absent mumber10" UBYTE COMP_0068 1 100 0 255 ECU_ADDRESS 0xFFFF3AFE /begin FUNCTION_LIST /end FUNCTION_LIST /end MEASUREMENT
/begin MEASUREMENT vDIAGUCXB "diagnosis of mux ecu absent mumber11" UBYTE COMP_0068 1 100 0 255 ECU_ADDRESS 0xFFFF3AFF /begin FUNCTION_LIST /end FUNCTION_LIST /end MEASUREMENT
/begin MEASUREMENT vDIAGUCXC "diagnosis of mux ecu absent mumber12" UBYTE COMP_0068 1 100 0 255 ECU_ADDRESS 0xFFFF3B00 /begin FUNCTION_LIST /end FUNCTION_LIST /end MEASUREMENT
/begin MEASUREMENT vDIAGUCXD "diagnosis of mux ecu absent mumber13" UBYTE COMP_0068 1 100 0 255 ECU_ADDRESS 0xFFFF3B01 /begin FUNCTION_LIST /end FUNCTION_LIST /end MEASUREMENT
/begin MEASUREMENT vDIAGUCXF "diagnosis of mux ecu absent mumber15" UBYTE COMP_0068 1 100 0 255 ECU_ADDRESS 0xFFFF3B03 /begin FUNCTION_LIST /end FUNCTION_LIST /end MEASUREMENT
/begin MEASUREMENT vDIAGUCXG "diagnosis of mux ecu absent mumber16" UBYTE COMP_0068 1 100 0 255 ECU_ADDRESS 0xFFFF3B04 /begin FUNCTION_LIST /end FUNCTION_LIST /end MEASUREMENT
/begin MEASUREMENT vDIAGUCXH "diagnosis of mux ecu absent mumber17" UBYTE COMP_0068 1 100 0 255 ECU_ADDRESS 0xFFFF3B05 /begin FUNCTION_LIST /end FUNCTION_LIST /end MEASUREMENT
/begin MEASUREMENT vDIAGUCXI "diagnosis of mux ecu absent mumber18" UBYTE COMP_0068 1 100 0 255 ECU_ADDRESS 0xFFFF3B06 /begin FUNCTION_LIST /end FUNCTION_LIST /end MEASUREMENT
/begin MEASUREMENT vDIAGUCXJ "diagnosis of mux ecu absent mumber19" UBYTE COMP_0068 1 100 0 255 ECU_ADDRESS 0xFFFF3B07 /begin FUNCTION_LIST /end FUNCTION_LIST /end MEASUREMENT
/begin MEASUREMENT vDIAGUCXL "diagnosis of mux ecu absent mumber21" UBYTE COMP_0068 1 100 0 255 ECU_ADDRESS 0xFFFF3B09 /begin FUNCTION_LIST /end FUNCTION_LIST /end MEASUREMENT
/begin MEASUREMENT vDIAGUCXM "diagnosis of mux ecu absent mumber22" UBYTE COMP_0068 1 100 0 255 ECU_ADDRESS 0xFFFF3B0A /begin FUNCTION_LIST /end FUNCTION_LIST /end MEASUREMENT
/begin MEASUREMENT vDIAGUCXN "diagnosis of mux ecu absent mumber23" UBYTE COMP_0068 1 100 0 255 ECU_ADDRESS 0xFFFF3B0B /begin FUNCTION_LIST /end FUNCTION_LIST /end MEASUREMENT
/begin MEASUREMENT vDIAGUCXO "diagnosis of mux ecu absent mumber24" UBYTE COMP_0068 1 100 0 255 ECU_ADDRESS 0xFFFF3B0C /begin FUNCTION_LIST /end FUNCTION_LIST /end MEASUREMENT
/begin MEASUREMENT vDID0161 "After LSB conversion for the DID$0161 monitor, data" UBYTE COMP_0572_S 1 100 0 255 ECU_ADDRESS 0xFFFF3B0E /begin FUNCTION_LIST /end FUNCTION_LIST /end MEASUREMENT
/begin MEASUREMENT vDID0192 "After LSB conversion for the DID$0192 monitor, data" UBYTE COMP_0572_S 1 100 0 255 ECU_ADDRESS 0xFFFF3B0F /begin FUNCTION_LIST /end FUNCTION_LIST /end MEASUREMENT
/begin MEASUREMENT vDID1301 "After LSB conversion for the DID$1301 monitor, data" UBYTE COMP_0068 1 100 0 255 ECU_ADDRESS 0xFFFF3B10 /begin FUNCTION_LIST /end FUNCTION_LIST /end MEASUREMENT
/begin MEASUREMENT vDID1301_R#1 "After LSB conversion for the DID$1301 monitor, data" UBYTE COMP_0068 1 100 0 255 ECU_ADDRESS 0xFFFF3B10 /begin FUNCTION_LIST /end FUNCTION_LIST /end MEASUREMENT
/begin MEASUREMENT vDID1301_R#2 "After LSB conversion for the DID$1301 monitor, data" UBYTE COMP_0068 1 100 0 255 ECU_ADDRESS 0xFFFF3B11 /begin FUNCTION_LIST /end FUNCTION_LIST /end MEASUREMENT
/begin MEASUREMENT vDID1302 "After LSB conversion for the DID$1302 monitor, data" UBYTE COMP_0068 1 100 0 255 ECU_ADDRESS 0xFFFF3B12 /begin FUNCTION_LIST /end FUNCTION_LIST /end MEASUREMENT
/begin MEASUREMENT vDID1302_R#1 "After LSB conversion for the DID$1302 monitor, data" UBYTE COMP_0068 1 100 0 255 ECU_ADDRESS 0xFFFF3B12 /begin FUNCTION_LIST /end FUNCTION_LIST /end MEASUREMENT
/begin MEASUREMENT vDID1302_R#2 "After LSB conversion for the DID$1302 monitor, data" UBYTE COMP_0068 1 100 0 255 ECU_ADDRESS 0xFFFF3B13 /begin FUNCTION_LIST /end FUNCTION_LIST /end MEASUREMENT
/begin MEASUREMENT vDID1303 "After LSB conversion for the DID$1303 monitor, data" UBYTE COMP_0068 1 100 0 255 ECU_ADDRESS 0xFFFF3B14 /begin FUNCTION_LIST /end FUNCTION_LIST /end MEASUREMENT
/begin MEASUREMENT vDID1303_R#1 "After LSB conversion for the DID$1303 monitor, data" UBYTE COMP_0068 1 100 0 255 ECU_ADDRESS 0xFFFF3B14 /begin FUNCTION_LIST /end FUNCTION_LIST /end MEASUREMENT
/begin MEASUREMENT vDID1303_R#2 "After LSB conversion for the DID$1303 monitor, data" UBYTE COMP_0068 1 100 0 255 ECU_ADDRESS 0xFFFF3B15 /begin FUNCTION_LIST /end FUNCTION_LIST /end MEASUREMENT
/begin MEASUREMENT vDID1304 "After LSB conversion for the DID$1304 monitor, data" UBYTE COMP_0068 1 100 0 255 ECU_ADDRESS 0xFFFF3B16 /begin FUNCTION_LIST /end FUNCTION_LIST /end MEASUREMENT
/begin MEASUREMENT vDID1304_R#1 "After LSB conversion for the DID$1304 monitor, data" UBYTE COMP_0068 1 100 0 255 ECU_ADDRESS 0xFFFF3B16 /begin FUNCTION_LIST /end FUNCTION_LIST /end MEASUREMENT
/begin MEASUREMENT vDID1304_R#2 "After LSB conversion for the DID$1304 monitor, data" UBYTE COMP_0068 1 100 0 255 ECU_ADDRESS 0xFFFF3B17 /begin FUNCTION_LIST /end FUNCTION_LIST /end MEASUREMENT
/begin MEASUREMENT vDID1305 "After LSB conversion for the DID$1305 monitor, data" UBYTE COMP_0068 1 100 0 255 ECU_ADDRESS 0xFFFF3B18 /begin FUNCTION_LIST /end FUNCTION_LIST /end MEASUREMENT
/begin MEASUREMENT vDID1305_R#1 "After LSB conversion for the DID$1305 monitor, data" UBYTE COMP_0068 1 100 0 255 ECU_ADDRESS 0xFFFF3B18 /begin FUNCTION_LIST /end FUNCTION_LIST /end MEASUREMENT
/begin MEASUREMENT vDID1305_R#2 "After LSB conversion for the DID$1305 monitor, data" UBYTE COMP_0068 1 100 0 255 ECU_ADDRESS 0xFFFF3B19 /begin FUNCTION_LIST /end FUNCTION_LIST /end MEASUREMENT
/begin MEASUREMENT vDID1306 "After LSB conversion for the DID$1306 monitor, data" UBYTE COMP_0068 1 100 0 255 ECU_ADDRESS 0xFFFF3B1A /begin FUNCTION_LIST /end FUNCTION_LIST /end MEASUREMENT
/begin MEASUREMENT vDID1306_R#1 "After LSB conversion for the DID$1306 monitor, data" UBYTE COMP_0068 1 100 0 255 ECU_ADDRESS 0xFFFF3B1A /begin FUNCTION_LIST /end FUNCTION_LIST /end MEASUREMENT
/begin MEASUREMENT vDID1306_R#2 "After LSB conversion for the DID$1306 monitor, data" UBYTE COMP_0068 1 100 0 255 ECU_ADDRESS 0xFFFF3B1B /begin FUNCTION_LIST /end FUNCTION_LIST /end MEASUREMENT
/begin MEASUREMENT vDID1307 "After LSB conversion for the DID$1307 monitor, data" UBYTE COMP_0068 1 100 0 255 ECU_ADDRESS 0xFFFF3B1C /begin FUNCTION_LIST /end FUNCTION_LIST /end MEASUREMENT
/begin MEASUREMENT vDID1307_R#1 "After LSB conversion for the DID$1307 monitor, data" UBYTE COMP_0068 1 100 0 255 ECU_ADDRESS 0xFFFF3B1C /begin FUNCTION_LIST /end FUNCTION_LIST /end MEASUREMENT
/begin MEASUREMENT vDID1307_R#2 "After LSB conversion for the DID$1307 monitor, data" UBYTE COMP_0068 1 100 0 255 ECU_ADDRESS 0xFFFF3B1D /begin FUNCTION_LIST /end FUNCTION_LIST /end MEASUREMENT
/begin MEASUREMENT vDID1308 "After LSB conversion for the DID$1308 monitor, data" UBYTE COMP_0068 1 100 0 255 ECU_ADDRESS 0xFFFF3B1E /begin FUNCTION_LIST /end FUNCTION_LIST /end MEASUREMENT
/begin MEASUREMENT vDID1308_R#1 "After LSB conversion for the DID$1308 monitor, data" UBYTE COMP_0068 1 100 0 255 ECU_ADDRESS 0xFFFF3B1E /begin FUNCTION_LIST /end FUNCTION_LIST /end MEASUREMENT
/begin MEASUREMENT vDID1308_R#2 "After LSB conversion for the DID$1308 monitor, data" UBYTE COMP_0068 1 100 0 255 ECU_ADDRESS 0xFFFF3B1F /begin FUNCTION_LIST /end FUNCTION_LIST /end MEASUREMENT
/begin MEASUREMENT vDID1309 "After LSB conversion for the DID$1309 monitor, data" UBYTE COMP_0068 1 100 0 255 ECU_ADDRESS 0xFFFF3B20 /begin FUNCTION_LIST /end FUNCTION_LIST /end MEASUREMENT
/begin MEASUREMENT vDID1309_R#1 "After LSB conversion for the DID$1309 monitor, data" UBYTE COMP_0068 1 100 0 255 ECU_ADDRESS 0xFFFF3B20 /begin FUNCTION_LIST /end FUNCTION_LIST /end MEASUREMENT
/begin MEASUREMENT vDID1309_R#2 "After LSB conversion for the DID$1309 monitor, data" UBYTE COMP_0068 1 100 0 255 ECU_ADDRESS 0xFFFF3B21 /begin FUNCTION_LIST /end FUNCTION_LIST /end MEASUREMENT
/begin MEASUREMENT vDID130A "After LSB conversion for the DID$130A monitor, data" UBYTE COMP_0068 1 100 0 255 ECU_ADDRESS 0xFFFF3B22 /begin FUNCTION_LIST /end FUNCTION_LIST /end MEASUREMENT
/begin MEASUREMENT vDID130A_R#1 "After LSB conversion for the DID$130A monitor, data" UBYTE COMP_0068 1 100 0 255 ECU_ADDRESS 0xFFFF3B22 /begin FUNCTION_LIST /end FUNCTION_LIST /end MEASUREMENT
/begin MEASUREMENT vDID130A_R#2 "After LSB conversion for the DID$130A monitor, data" UBYTE COMP_0068 1 100 0 255 ECU_ADDRESS 0xFFFF3B23 /begin FUNCTION_LIST /end FUNCTION_LIST /end MEASUREMENT
/begin MEASUREMENT vDID130B "After LSB conversion for the DID$130B monitor, data" UBYTE COMP_0068 1 100 0 255 ECU_ADDRESS 0xFFFF3B24 /begin FUNCTION_LIST /end FUNCTION_LIST /end MEASUREMENT
/begin MEASUREMENT vDID130B_R#1 "After LSB conversion for the DID$130B monitor, data" UBYTE COMP_0068 1 100 0 255 ECU_ADDRESS 0xFFFF3B24 /begin FUNCTION_LIST /end FUNCTION_LIST /end MEASUREMENT
/begin MEASUREMENT vDID130B_R#2 "After LSB conversion for the DID$130B monitor, data" UBYTE COMP_0068 1 100 0 255 ECU_ADDRESS 0xFFFF3B25 /begin FUNCTION_LIST /end FUNCTION_LIST /end MEASUREMENT
/begin MEASUREMENT vDID130C "After LSB conversion for the DID$130C monitor, data" UBYTE COMP_0068 1 100 0 255 ECU_ADDRESS 0xFFFF3B26 /begin FUNCTION_LIST /end FUNCTION_LIST /end MEASUREMENT
/begin MEASUREMENT vDID130C_R#1 "After LSB conversion for the DID$130C monitor, data" UBYTE COMP_0068 1 100 0 255 ECU_ADDRESS 0xFFFF3B26 /begin FUNCTION_LIST /end FUNCTION_LIST /end MEASUREMENT
/begin MEASUREMENT vDID130C_R#2 "After LSB conversion for the DID$130C monitor, data" UBYTE COMP_0068 1 100 0 255 ECU_ADDRESS 0xFFFF3B27 /begin FUNCTION_LIST /end FUNCTION_LIST /end MEASUREMENT
/begin MEASUREMENT vDID130D "After LSB conversion for the DID$130D monitor, data" UBYTE COMP_0068 1 100 0 255 ECU_ADDRESS 0xFFFF3B28 /begin FUNCTION_LIST /end FUNCTION_LIST /end MEASUREMENT
/begin MEASUREMENT vDID130D_R#1 "After LSB conversion for the DID$130D monitor, data" UBYTE COMP_0068 1 100 0 255 ECU_ADDRESS 0xFFFF3B28 /begin FUNCTION_LIST /end FUNCTION_LIST /end MEASUREMENT
/begin MEASUREMENT vDID130D_R#2 "After LSB conversion for the DID$130D monitor, data" UBYTE COMP_0068 1 100 0 255 ECU_ADDRESS 0xFFFF3B29 /begin FUNCTION_LIST /end FUNCTION_LIST /end MEASUREMENT
/begin MEASUREMENT vDID130E "After LSB conversion for the DID$130E monitor, data" UBYTE COMP_0068 1 100 0 255 ECU_ADDRESS 0xFFFF3B2A /begin FUNCTION_LIST /end FUNCTION_LIST /end MEASUREMENT
/begin MEASUREMENT vDID130E_R#1 "After LSB conversion for the DID$130E monitor, data" UBYTE COMP_0068 1 100 0 255 ECU_ADDRESS 0xFFFF3B2A /begin FUNCTION_LIST /end FUNCTION_LIST /end MEASUREMENT
/begin MEASUREMENT vDID130E_R#2 "After LSB conversion for the DID$130E monitor, data" UBYTE COMP_0068 1 100 0 255 ECU_ADDRESS 0xFFFF3B2B /begin FUNCTION_LIST /end FUNCTION_LIST /end MEASUREMENT
/begin MEASUREMENT vDID130F "After LSB conversion for the DID$130F monitor, data" UBYTE COMP_0068 1 100 0 255 ECU_ADDRESS 0xFFFF3B2C /begin FUNCTION_LIST /end FUNCTION_LIST /end MEASUREMENT
/begin MEASUREMENT vDID130F_R#1 "After LSB conversion for the DID$130F monitor, data" UBYTE COMP_0068 1 100 0 255 ECU_ADDRESS 0xFFFF3B2C /begin FUNCTION_LIST /end FUNCTION_LIST /end MEASUREMENT
/begin MEASUREMENT vDID130F_R#2 "After LSB conversion for the DID$130F monitor, data" UBYTE COMP_0068 1 100 0 255 ECU_ADDRESS 0xFFFF3B2D /begin FUNCTION_LIST /end FUNCTION_LIST /end MEASUREMENT
/begin MEASUREMENT vDID1310 "After LSB conversion for the DID$1310 monitor, data" UBYTE COMP_0068 1 100 0 255 ECU_ADDRESS 0xFFFF3B2E /begin FUNCTION_LIST /end FUNCTION_LIST /end MEASUREMENT
/begin MEASUREMENT vDID1310_R#1 "After LSB conversion for the DID$1310 monitor, data" UBYTE COMP_0068 1 100 0 255 ECU_ADDRESS 0xFFFF3B2E /begin FUNCTION_LIST /end FUNCTION_LIST /end MEASUREMENT
/begin MEASUREMENT vDID1310_R#2 "After LSB conversion for the DID$1310 monitor, data" UBYTE COMP_0068 1 100 0 255 ECU_ADDRESS 0xFFFF3B2F /begin FUNCTION_LIST /end FUNCTION_LIST /end MEASUREMENT
/begin MEASUREMENT vDID1311 "After LSB conversion for the DID$1311 monitor, data" UBYTE COMP_0068 1 100 0 255 ECU_ADDRESS 0xFFFF3B30 /begin FUNCTION_LIST /end FUNCTION_LIST /end MEASUREMENT
/begin MEASUREMENT vDID1311_R#1 "After LSB conversion for the DID$1311 monitor, data" UBYTE COMP_0068 1 100 0 255 ECU_ADDRESS 0xFFFF3B30 /begin FUNCTION_LIST /end FUNCTION_LIST /end MEASUREMENT
/begin MEASUREMENT vDID1311_R#2 "After LSB conversion for the DID$1311 monitor, data" UBYTE COMP_0068 1 100 0 255 ECU_ADDRESS 0xFFFF3B31 /begin FUNCTION_LIST /end FUNCTION_LIST /end MEASUREMENT
/begin MEASUREMENT vDID1312 "After LSB conversion for the DID$1312 monitor, data" UBYTE COMP_0068 1 100 0 255 ECU_ADDRESS 0xFFFF3B32 /begin FUNCTION_LIST /end FUNCTION_LIST /end MEASUREMENT
/begin MEASUREMENT vDID1312_R#1 "After LSB conversion for the DID$1312 monitor, data" UBYTE COMP_0068 1 100 0 255 ECU_ADDRESS 0xFFFF3B32 /begin FUNCTION_LIST /end FUNCTION_LIST /end MEASUREMENT
/begin MEASUREMENT vDID1312_R#2 "After LSB conversion for the DID$1312 monitor, data" UBYTE COMP_0068 1 100 0 255 ECU_ADDRESS 0xFFFF3B33 /begin FUNCTION_LIST /end FUNCTION_LIST /end MEASUREMENT
/begin MEASUREMENT vDID1313 "After LSB conversion for the DID$1313 monitor, data" UBYTE COMP_0068 1 100 0 255 ECU_ADDRESS 0xFFFF3B34 /begin FUNCTION_LIST /end FUNCTION_LIST /end MEASUREMENT
/begin MEASUREMENT vDID1313_R#1 "After LSB conversion for the DID$1313 monitor, data" UBYTE COMP_0068 1 100 0 255 ECU_ADDRESS 0xFFFF3B34 /begin FUNCTION_LIST /end FUNCTION_LIST /end MEASUREMENT
/begin MEASUREMENT vDID1313_R#2 "After LSB conversion for the DID$1313 monitor, data" UBYTE COMP_0068 1 100 0 255 ECU_ADDRESS 0xFFFF3B35 /begin FUNCTION_LIST /end FUNCTION_LIST /end MEASUREMENT
/begin MEASUREMENT vDID1314 "After LSB conversion for the DID$1314 monitor, data" UBYTE COMP_0068 1 100 0 255 ECU_ADDRESS 0xFFFF3B36 /begin FUNCTION_LIST /end FUNCTION_LIST /end MEASUREMENT
/begin MEASUREMENT vDID1314_R#1 "After LSB conversion for the DID$1314 monitor, data" UBYTE COMP_0068 1 100 0 255 ECU_ADDRESS 0xFFFF3B36 /begin FUNCTION_LIST /end FUNCTION_LIST /end MEASUREMENT
/begin MEASUREMENT vDID1314_R#2 "After LSB conversion for the DID$1314 monitor, data" UBYTE COMP_0068 1 100 0 255 ECU_ADDRESS 0xFFFF3B37 /begin FUNCTION_LIST /end FUNCTION_LIST /end MEASUREMENT
/begin MEASUREMENT vDID1502 "After LSB conversion for the DID$1502 monitor, data" UBYTE COMP_0068 1 100 0 255 ECU_ADDRESS 0xFFFF3B38 /begin FUNCTION_LIST /end FUNCTION_LIST /end MEASUREMENT
/begin MEASUREMENT vDID1502_R#1 "After LSB conversion for the DID$1502 monitor, data" UBYTE COMP_0068 1 100 0 255 ECU_ADDRESS 0xFFFF3B38 /begin FUNCTION_LIST /end FUNCTION_LIST /end MEASUREMENT
/begin MEASUREMENT vDID1502_R#2 "After LSB conversion for the DID$1502 monitor, data" UBYTE COMP_0068 1 100 0 255 ECU_ADDRESS 0xFFFF3B39 /begin FUNCTION_LIST /end FUNCTION_LIST /end MEASUREMENT
/begin MEASUREMENT vDID1503 "After LSB conversion for the DID$1503 monitor, data" UBYTE COMP_0068 1 100 0 255 ECU_ADDRESS 0xFFFF3B3A /begin FUNCTION_LIST /end FUNCTION_LIST /end MEASUREMENT
/begin MEASUREMENT vDID1503_R#1 "After LSB conversion for the DID$1503 monitor, data" UBYTE COMP_0068 1 100 0 255 ECU_ADDRESS 0xFFFF3B3A /begin FUNCTION_LIST /end FUNCTION_LIST /end MEASUREMENT
/begin MEASUREMENT vDID1503_R#2 "After LSB conversion for the DID$1503 monitor, data" UBYTE COMP_0068 1 100 0 255 ECU_ADDRESS 0xFFFF3B3B /begin FUNCTION_LIST /end FUNCTION_LIST /end MEASUREMENT
/begin MEASUREMENT vDID1504 "After LSB conversion for the DID$1504 monitor, data" UBYTE COMP_0068 1 100 0 255 ECU_ADDRESS 0xFFFF3B3C /begin FUNCTION_LIST /end FUNCTION_LIST /end MEASUREMENT
/begin MEASUREMENT vDID1504_R#1 "After LSB conversion for the DID$1504 monitor, data" UBYTE COMP_0068 1 100 0 255 ECU_ADDRESS 0xFFFF3B3C /begin FUNCTION_LIST /end FUNCTION_LIST /end MEASUREMENT
/begin MEASUREMENT vDID1504_R#2 "After LSB conversion for the DID$1504 monitor, data" UBYTE COMP_0068 1 100 0 255 ECU_ADDRESS 0xFFFF3B3D /begin FUNCTION_LIST /end FUNCTION_LIST /end MEASUREMENT
/begin MEASUREMENT vDID1505 "After LSB conversion for the DID$1505 monitor, data" UBYTE COMP_0068 1 100 0 255 ECU_ADDRESS 0xFFFF3B3E /begin FUNCTION_LIST /end FUNCTION_LIST /end MEASUREMENT
/begin MEASUREMENT vDID1505_R#1 "After LSB conversion for the DID$1505 monitor, data" UBYTE COMP_0068 1 100 0 255 ECU_ADDRESS 0xFFFF3B3E /begin FUNCTION_LIST /end FUNCTION_LIST /end MEASUREMENT
/begin MEASUREMENT vDID1505_R#2 "After LSB conversion for the DID$1505 monitor, data" UBYTE COMP_0068 1 100 0 255 ECU_ADDRESS 0xFFFF3B3F /begin FUNCTION_LIST /end FUNCTION_LIST /end MEASUREMENT
/begin MEASUREMENT vDID1506 "After LSB conversion for the DID$1506 monitor, data" UBYTE COMP_0068 1 100 0 255 ECU_ADDRESS 0xFFFF3B40 /begin FUNCTION_LIST /end FUNCTION_LIST /end MEASUREMENT
/begin MEASUREMENT vDID1506_R#1 "After LSB conversion for the DID$1506 monitor, data" UBYTE COMP_0068 1 100 0 255 ECU_ADDRESS 0xFFFF3B40 /begin FUNCTION_LIST /end FUNCTION_LIST /end MEASUREMENT
/begin MEASUREMENT vDID1506_R#2 "After LSB conversion for the DID$1506 monitor, data" UBYTE COMP_0068 1 100 0 255 ECU_ADDRESS 0xFFFF3B41 /begin FUNCTION_LIST /end FUNCTION_LIST /end MEASUREMENT
/begin MEASUREMENT vDID1507 "After LSB conversion for the DID$1507 monitor, data" UBYTE COMP_0068 1 100 0 255 ECU_ADDRESS 0xFFFF3B42 /begin FUNCTION_LIST /end FUNCTION_LIST /end MEASUREMENT
/begin MEASUREMENT vDID1507_R#1 "After LSB conversion for the DID$1507 monitor, data" UBYTE COMP_0068 1 100 0 255 ECU_ADDRESS 0xFFFF3B42 /begin FUNCTION_LIST /end FUNCTION_LIST /end MEASUREMENT
/begin MEASUREMENT vDID1507_R#2 "After LSB conversion for the DID$1507 monitor, data" UBYTE COMP_0068 1 100 0 255 ECU_ADDRESS 0xFFFF3B43 /begin FUNCTION_LIST /end FUNCTION_LIST /end MEASUREMENT
/begin MEASUREMENT vDID1508 "After LSB conversion for the DID$1508 monitor, data" UBYTE COMP_0068 1 100 0 255 ECU_ADDRESS 0xFFFF3B44 /begin FUNCTION_LIST /end FUNCTION_LIST /end MEASUREMENT
/begin MEASUREMENT vDID1508_R#1 "After LSB conversion for the DID$1508 monitor, data" UBYTE COMP_0068 1 100 0 255 ECU_ADDRESS 0xFFFF3B44 /begin FUNCTION_LIST /end FUNCTION_LIST /end MEASUREMENT
/begin MEASUREMENT vDID1508_R#2 "After LSB conversion for the DID$1508 monitor, data" UBYTE COMP_0068 1 100 0 255 ECU_ADDRESS 0xFFFF3B45 /begin FUNCTION_LIST /end FUNCTION_LIST /end MEASUREMENT
/begin MEASUREMENT vDID1509 "After LSB conversion for the DID$1509 monitor, data" UBYTE COMP_0068 1 100 0 255 ECU_ADDRESS 0xFFFF3B46 /begin FUNCTION_LIST /end FUNCTION_LIST /end MEASUREMENT
/begin MEASUREMENT vDID1509_R#1 "After LSB conversion for the DID$1509 monitor, data" UBYTE COMP_0068 1 100 0 255 ECU_ADDRESS 0xFFFF3B46 /begin FUNCTION_LIST /end FUNCTION_LIST /end MEASUREMENT
/begin MEASUREMENT vDID1509_R#2 "After LSB conversion for the DID$1509 monitor, data" UBYTE COMP_0068 1 100 0 255 ECU_ADDRESS 0xFFFF3B47 /begin FUNCTION_LIST /end FUNCTION_LIST /end MEASUREMENT
/begin MEASUREMENT vDID150A "After LSB conversion for the DID$150A monitor, data" UBYTE COMP_0068 1 100 0 255 ECU_ADDRESS 0xFFFF3B48 /begin FUNCTION_LIST /end FUNCTION_LIST /end MEASUREMENT
/begin MEASUREMENT vDID150A_R#1 "After LSB conversion for the DID$150A monitor, data" UBYTE COMP_0068 1 100 0 255 ECU_ADDRESS 0xFFFF3B48 /begin FUNCTION_LIST /end FUNCTION_LIST /end MEASUREMENT
/begin MEASUREMENT vDID150A_R#2 "After LSB conversion for the DID$150A monitor, data" UBYTE COMP_0068 1 100 0 255 ECU_ADDRESS 0xFFFF3B49 /begin FUNCTION_LIST /end FUNCTION_LIST /end MEASUREMENT
/begin MEASUREMENT vDID150B "After LSB conversion for the DID$150B monitor, data" UBYTE COMP_0068 1 100 0 255 ECU_ADDRESS 0xFFFF3B4A /begin FUNCTION_LIST /end FUNCTION_LIST /end MEASUREMENT
/begin MEASUREMENT vDID150B_R#1 "After LSB conversion for the DID$150B monitor, data" UBYTE COMP_0068 1 100 0 255 ECU_ADDRESS 0xFFFF3B4A /begin FUNCTION_LIST /end FUNCTION_LIST /end MEASUREMENT
/begin MEASUREMENT vDID150B_R#2 "After LSB conversion for the DID$150B monitor, data" UBYTE COMP_0068 1 100 0 255 ECU_ADDRESS 0xFFFF3B4B /begin FUNCTION_LIST /end FUNCTION_LIST /end MEASUREMENT
/begin MEASUREMENT vDID150C "After LSB conversion for the DID$150C monitor, data" UBYTE COMP_0068 1 100 0 255 ECU_ADDRESS 0xFFFF3B4C /begin FUNCTION_LIST /end FUNCTION_LIST /end MEASUREMENT
/begin MEASUREMENT vDID150C_R#1 "After LSB conversion for the DID$150C monitor, data" UBYTE COMP_0068 1 100 0 255 ECU_ADDRESS 0xFFFF3B4C /begin FUNCTION_LIST /end FUNCTION_LIST /end MEASUREMENT
/begin MEASUREMENT vDID150C_R#2 "After LSB conversion for the DID$150C monitor, data" UBYTE COMP_0068 1 100 0 255 ECU_ADDRESS 0xFFFF3B4D /begin FUNCTION_LIST /end FUNCTION_LIST /end MEASUREMENT
/begin MEASUREMENT vDID150D "After LSB conversion for the DID$150D monitor, data" UBYTE COMP_0068 1 100 0 255 ECU_ADDRESS 0xFFFF3B4E /begin FUNCTION_LIST /end FUNCTION_LIST /end MEASUREMENT
/begin MEASUREMENT vDID150D_R#1 "After LSB conversion for the DID$150D monitor, data" UBYTE COMP_0068 1 100 0 255 ECU_ADDRESS 0xFFFF3B4E /begin FUNCTION_LIST /end FUNCTION_LIST /end MEASUREMENT
/begin MEASUREMENT vDID150D_R#2 "After LSB conversion for the DID$150D monitor, data" UBYTE COMP_0068 1 100 0 255 ECU_ADDRESS 0xFFFF3B4F /begin FUNCTION_LIST /end FUNCTION_LIST /end MEASUREMENT
/begin MEASUREMENT vDID150E "After LSB conversion for the DID$150E monitor, data" UBYTE COMP_0068 1 100 0 255 ECU_ADDRESS 0xFFFF3B50 /begin FUNCTION_LIST /end FUNCTION_LIST /end MEASUREMENT
/begin MEASUREMENT vDID150E_R#1 "After LSB conversion for the DID$150E monitor, data" UBYTE COMP_0068 1 100 0 255 ECU_ADDRESS 0xFFFF3B50 /begin FUNCTION_LIST /end FUNCTION_LIST /end MEASUREMENT
/begin MEASUREMENT vDID150E_R#2 "After LSB conversion for the DID$150E monitor, data" UBYTE COMP_0068 1 100 0 255 ECU_ADDRESS 0xFFFF3B51 /begin FUNCTION_LIST /end FUNCTION_LIST /end MEASUREMENT
/begin MEASUREMENT vDID150F "After LSB conversion for the DID$150F monitor, data" UBYTE COMP_0068 1 100 0 255 ECU_ADDRESS 0xFFFF3B52 /begin FUNCTION_LIST /end FUNCTION_LIST /end MEASUREMENT
/begin MEASUREMENT vDID150F_R#1 "After LSB conversion for the DID$150F monitor, data" UBYTE COMP_0068 1 100 0 255 ECU_ADDRESS 0xFFFF3B52 /begin FUNCTION_LIST /end FUNCTION_LIST /end MEASUREMENT
/begin MEASUREMENT vDID150F_R#2 "After LSB conversion for the DID$150F monitor, data" UBYTE COMP_0068 1 100 0 255 ECU_ADDRESS 0xFFFF3B53 /begin FUNCTION_LIST /end FUNCTION_LIST /end MEASUREMENT
/begin MEASUREMENT vDID1510 "After LSB conversion for the DID$1510 monitor, data" UBYTE COMP_0068 1 100 0 255 ECU_ADDRESS 0xFFFF3B54 /begin FUNCTION_LIST /end FUNCTION_LIST /end MEASUREMENT
/begin MEASUREMENT vDID1510_R#1 "After LSB conversion for the DID$1510 monitor, data" UBYTE COMP_0068 1 100 0 255 ECU_ADDRESS 0xFFFF3B54 /begin FUNCTION_LIST /end FUNCTION_LIST /end MEASUREMENT
/begin MEASUREMENT vDID1510_R#2 "After LSB conversion for the DID$1510 monitor, data" UBYTE COMP_0068 1 100 0 255 ECU_ADDRESS 0xFFFF3B55 /begin FUNCTION_LIST /end FUNCTION_LIST /end MEASUREMENT
/begin MEASUREMENT vDID1511 "After LSB conversion for the DID$1511 monitor, data" UBYTE COMP_0068 1 100 0 255 ECU_ADDRESS 0xFFFF3B56 /begin FUNCTION_LIST /end FUNCTION_LIST /end MEASUREMENT
/begin MEASUREMENT vDID1511_R#1 "After LSB conversion for the DID$1511 monitor, data" UBYTE COMP_0068 1 100 0 255 ECU_ADDRESS 0xFFFF3B56 /begin FUNCTION_LIST /end FUNCTION_LIST /end MEASUREMENT
/begin MEASUREMENT vDID1511_R#2 "After LSB conversion for the DID$1511 monitor, data" UBYTE COMP_0068 1 100 0 255 ECU_ADDRESS 0xFFFF3B57 /begin FUNCTION_LIST /end FUNCTION_LIST /end MEASUREMENT
/begin MEASUREMENT vDID1512 "After LSB conversion for the DID$1512 monitor, data" UBYTE COMP_0068 1 100 0 255 ECU_ADDRESS 0xFFFF3B58 /begin FUNCTION_LIST /end FUNCTION_LIST /end MEASUREMENT
/begin MEASUREMENT vDID1512_R#1 "After LSB conversion for the DID$1512 monitor, data" UBYTE COMP_0068 1 100 0 255 ECU_ADDRESS 0xFFFF3B58 /begin FUNCTION_LIST /end FUNCTION_LIST /end MEASUREMENT
/begin MEASUREMENT vDID1512_R#2 "After LSB conversion for the DID$1512 monitor, data" UBYTE COMP_0068 1 100 0 255 ECU_ADDRESS 0xFFFF3B59 /begin FUNCTION_LIST /end FUNCTION_LIST /end MEASUREMENT
/begin MEASUREMENT vDID1513 "After LSB conversion for the DID$1513 monitor, data" UBYTE COMP_0068 1 100 0 255 ECU_ADDRESS 0xFFFF3B5A /begin FUNCTION_LIST /end FUNCTION_LIST /end MEASUREMENT
/begin MEASUREMENT vDID1513_R#1 "After LSB conversion for the DID$1513 monitor, data" UBYTE COMP_0068 1 100 0 255 ECU_ADDRESS 0xFFFF3B5A /begin FUNCTION_LIST /end FUNCTION_LIST /end MEASUREMENT
/begin MEASUREMENT vDID1513_R#2 "After LSB conversion for the DID$1513 monitor, data" UBYTE COMP_0068 1 100 0 255 ECU_ADDRESS 0xFFFF3B5B /begin FUNCTION_LIST /end FUNCTION_LIST /end MEASUREMENT
/begin MEASUREMENT vDID2001 "After LSB conversion for the DID$2001 monitor, data" UWORD COMP_0573_S 1 100 -273 6280.5 ECU_ADDRESS 0xFFFF3B5C /begin FUNCTION_LIST /end FUNCTION_LIST /end MEASUREMENT
/begin MEASUREMENT vDID2002 "After LSB conversion for the DID$2002 monitor, data" UWORD COMP_0427 1 100 0 16383.75 ECU_ADDRESS 0xFFFF3B5E /begin FUNCTION_LIST /end FUNCTION_LIST /end MEASUREMENT
/begin MEASUREMENT vDID2004 "After LSB conversion for the DID$2004 monitor, data" UWORD COMP_0345_S 1 100 -400 1647.96875 ECU_ADDRESS 0xFFFF3B60 /begin FUNCTION_LIST /end FUNCTION_LIST /end MEASUREMENT
/begin MEASUREMENT vDID2005 "After LSB conversion for the DID$2005 monitor, data" UWORD COMP_0537_S 1 100 0 65.535 ECU_ADDRESS 0xFFFF3B62 /begin FUNCTION_LIST /end FUNCTION_LIST /end MEASUREMENT
/begin MEASUREMENT vDID2006 "After LSB conversion for the DID$2006 monitor, data" ULONG COMP_0470 1 100 0 4294967295 ECU_ADDRESS 0xFFFFB5E8 /begin FUNCTION_LIST /end FUNCTION_LIST /end MEASUREMENT
/begin MEASUREMENT vDID2008 "After LSB conversion for the DID$2008 monitor, data" UWORD COMP_0573_S 1 100 -273 6280.5 ECU_ADDRESS 0xFFFF3B64 /begin FUNCTION_LIST /end FUNCTION_LIST /end MEASUREMENT
/begin MEASUREMENT vDID2009 "After LSB conversion for the DID$2009 monitor, data" UWORD COMP_0491_S 1 100 0 65535 ECU_ADDRESS 0xFFFF3B66 /begin FUNCTION_LIST /end FUNCTION_LIST /end MEASUREMENT
/begin MEASUREMENT vDID200A "After LSB conversion for the DID$200A monitor, data" UWORD COMP_0537_S 1 100 0 65.535 ECU_ADDRESS 0xFFFF3B68 /begin FUNCTION_LIST /end FUNCTION_LIST /end MEASUREMENT
/begin MEASUREMENT vDID200B "After LSB conversion for the DID$200B monitor, data" UWORD COMP_0537_S 1 100 0 65.535 ECU_ADDRESS 0xFFFF3B6A /begin FUNCTION_LIST /end FUNCTION_LIST /end MEASUREMENT
/begin MEASUREMENT vDID200C "After LSB conversion for the DID$200C monitor, data" UWORD COMP_0537_S 1 100 0 65.535 ECU_ADDRESS 0xFFFF3B6C /begin FUNCTION_LIST /end FUNCTION_LIST /end MEASUREMENT
/begin MEASUREMENT vDID200D "After LSB conversion for the DID$200D monitor, data" UWORD COMP_0537_S 1 100 0 65.535 ECU_ADDRESS 0xFFFF3B6E /begin FUNCTION_LIST /end FUNCTION_LIST /end MEASUREMENT
/begin MEASUREMENT vDID200E "After LSB conversion for the DID$200E monitor, data" UBYTE COMP_0572_S 1 100 0 255 ECU_ADDRESS 0xFFFF3B70 /begin FUNCTION_LIST /end FUNCTION_LIST /end MEASUREMENT
/begin MEASUREMENT vDID200F "After LSB conversion for the DID$200F monitor, data" UBYTE COMP_0572_S 1 100 0 255 ECU_ADDRESS 0xFFFF3B71 /begin FUNCTION_LIST /end FUNCTION_LIST /end MEASUREMENT
/begin MEASUREMENT vDID2012 "After LSB conversion for the DID$2012 monitor, data" UWORD COMP_0537_S 1 100 0 65.535 ECU_ADDRESS 0xFFFF3B72 /begin FUNCTION_LIST /end FUNCTION_LIST /end MEASUREMENT
/begin MEASUREMENT vDID2013 "After LSB conversion for the DID$2013 monitor, data" UWORD COMP_0537_S 1 100 0 65.535 ECU_ADDRESS 0xFFFF3B74 /begin FUNCTION_LIST /end FUNCTION_LIST /end MEASUREMENT
/begin MEASUREMENT vDID2018 "After LSB conversion for the DID$2018 monitor, data" UBYTE COMP_0572_S 1 100 0 255 ECU_ADDRESS 0xFFFF3B76 /begin FUNCTION_LIST /end FUNCTION_LIST /end MEASUREMENT
/begin MEASUREMENT vDID2019 "After LSB conversion for the DID$2019 monitor, data" UBYTE COMP_0572_S 1 100 0 255 ECU_ADDRESS 0xFFFF3B77 /begin FUNCTION_LIST /end FUNCTION_LIST /end MEASUREMENT
/begin MEASUREMENT vDID201E "After LSB conversion for the DID$201E monitor, data" UBYTE COMP_0572_S 1 100 0 255 ECU_ADDRESS 0xFFFF3B78 /begin FUNCTION_LIST /end FUNCTION_LIST /end MEASUREMENT
/begin MEASUREMENT vDID201F "After LSB conversion for the DID$201F monitor, data" UBYTE COMP_0572_S 1 100 0 255 ECU_ADDRESS 0xFFFF3B79 /begin FUNCTION_LIST /end FUNCTION_LIST /end MEASUREMENT
/begin MEASUREMENT vDID2021 "After LSB conversion for the DID$2021 monitor, data" UWORD COMP_0537_S 1 100 0 65.535 ECU_ADDRESS 0xFFFF3B7A /begin FUNCTION_LIST /end FUNCTION_LIST /end MEASUREMENT
/begin MEASUREMENT vDID2024 "After LSB conversion for the DID$2024 monitor, data" UWORD COMP_0427 1 100 0 16383.75 ECU_ADDRESS 0xFFFF3B7C /begin FUNCTION_LIST /end FUNCTION_LIST /end MEASUREMENT
/begin MEASUREMENT vDID2025 "After LSB conversion for the DID$2025 monitor, data" UBYTE COMP_0574_S 1 100 0 255 ECU_ADDRESS 0xFFFF3B7E /begin FUNCTION_LIST /end FUNCTION_LIST /end MEASUREMENT
/begin MEASUREMENT vDID2026 "After LSB conversion for the DID$2026 monitor, data" UBYTE COMP_0572_S 1 100 0 255 ECU_ADDRESS 0xFFFF3B7F /begin FUNCTION_LIST /end FUNCTION_LIST /end MEASUREMENT
/begin MEASUREMENT vDID202D "After LSB conversion for the DID$202D monitor, data" UBYTE COMP_0572_S 1 100 0 255 ECU_ADDRESS 0xFFFF3B80 /begin FUNCTION_LIST /end FUNCTION_LIST /end MEASUREMENT
/begin MEASUREMENT vDID202E "After LSB conversion for the DID$202E monitor, data" UWORD COMP_0575_S 1 100 -327.67 327.68 ECU_ADDRESS 0xFFFF3B82 /begin FUNCTION_LIST /end FUNCTION_LIST /end MEASUREMENT
/begin MEASUREMENT vDID2030 "After LSB conversion for the DID$2030 monitor, data" UWORD COMP_0576_S 1 100 -655.34 655.36 ECU_ADDRESS 0xFFFF3B84 /begin FUNCTION_LIST /end FUNCTION_LIST /end MEASUREMENT
/begin MEASUREMENT vDID2031 "After LSB conversion for the DID$2031 monitor, data" UWORD COMP_0576_S 1 100 -655.34 655.36 ECU_ADDRESS 0xFFFF3B86 /begin FUNCTION_LIST /end FUNCTION_LIST /end MEASUREMENT
/begin MEASUREMENT vDID2032 "After LSB conversion for the DID$2032 monitor, data" UWORD COMP_0576_S 1 100 -655.34 655.36 ECU_ADDRESS 0xFFFF3B88 /begin FUNCTION_LIST /end FUNCTION_LIST /end MEASUREMENT
/begin MEASUREMENT vDID2033 "After LSB conversion for the DID$2033 monitor, data" UWORD COMP_0575_S 1 100 -327.67 327.68 ECU_ADDRESS 0xFFFF3B8A /begin FUNCTION_LIST /end FUNCTION_LIST /end MEASUREMENT
/begin MEASUREMENT vDID2034 "After LSB conversion for the DID$2034 monitor, data" UWORD COMP_0575_S 1 100 -327.67 327.68 ECU_ADDRESS 0xFFFF3B8C /begin FUNCTION_LIST /end FUNCTION_LIST /end MEASUREMENT
/begin MEASUREMENT vDID2035 "After LSB conversion for the DID$2035 monitor, data" UWORD COMP_0375_S 1 100 0 655.35 ECU_ADDRESS 0xFFFF3B8E /begin FUNCTION_LIST /end FUNCTION_LIST /end MEASUREMENT
/begin MEASUREMENT vDID2039 "After LSB conversion for the DID$2039 monitor, data" UWORD COMP_0492 1 100 0 65535 ECU_ADDRESS 0xFFFF3B90 /begin FUNCTION_LIST /end FUNCTION_LIST /end MEASUREMENT
/begin MEASUREMENT vDID203A "After LSB conversion for the DID$203A monitor, data" UBYTE COMP_0572_S 1 100 0 255 ECU_ADDRESS 0xFFFF3B92 /begin FUNCTION_LIST /end FUNCTION_LIST /end MEASUREMENT
/begin MEASUREMENT vDID203B "After LSB conversion for the DID$203B monitor, data" UBYTE COMP_0572_S 1 100 0 255 ECU_ADDRESS 0xFFFF3B93 /begin FUNCTION_LIST /end FUNCTION_LIST /end MEASUREMENT
/begin MEASUREMENT vDID203C "After LSB conversion for the DID$203C monitor, data" UBYTE COMP_0572_S 1 100 0 255 ECU_ADDRESS 0xFFFF3B94 /begin FUNCTION_LIST /end FUNCTION_LIST /end MEASUREMENT
/begin MEASUREMENT vDID203D "After LSB conversion for the DID$203D monitor, data" UBYTE COMP_0572_S 1 100 0 255 ECU_ADDRESS 0xFFFF3B95 /begin FUNCTION_LIST /end FUNCTION_LIST /end MEASUREMENT
/begin MEASUREMENT vDID203E "After LSB conversion for the DID$203E monitor, data" UBYTE COMP_0572_S 1 100 0 255 ECU_ADDRESS 0xFFFF3B96 /begin FUNCTION_LIST /end FUNCTION_LIST /end MEASUREMENT
/begin MEASUREMENT vDID203F "After LSB conversion for the DID$203F monitor, data" UBYTE COMP_0572_S 1 100 0 255 ECU_ADDRESS 0xFFFF3B97 /begin FUNCTION_LIST /end FUNCTION_LIST /end MEASUREMENT
/begin MEASUREMENT vDID2041 "After LSB conversion for the DID$2041 monitor, data" UBYTE COMP_0572_S 1 100 0 255 ECU_ADDRESS 0xFFFF3B98 /begin FUNCTION_LIST /end FUNCTION_LIST /end MEASUREMENT
/begin MEASUREMENT vDID2042 "After LSB conversion for the DID$2042 monitor, data" UBYTE COMP_0572_S 1 100 0 255 ECU_ADDRESS 0xFFFF3B99 /begin FUNCTION_LIST /end FUNCTION_LIST /end MEASUREMENT
/begin MEASUREMENT vDID2043 "After LSB conversion for the DID$2043 monitor, data" UBYTE COMP_0572_S 1 100 0 255 ECU_ADDRESS 0xFFFF3B9A /begin FUNCTION_LIST /end FUNCTION_LIST /end MEASUREMENT
/begin MEASUREMENT vDID2044 "After LSB conversion for the DID$2044 monitor, data" UWORD COMP_0575_S 1 100 -327.67 327.68 ECU_ADDRESS 0xFFFF3B9C /begin FUNCTION_LIST /end FUNCTION_LIST /end MEASUREMENT
/begin MEASUREMENT vDID2047 "After LSB conversion for the DID$2047 monitor, data" UBYTE COMP_0572_S 1 100 0 255 ECU_ADDRESS 0xFFFF3B9E /begin FUNCTION_LIST /end FUNCTION_LIST /end MEASUREMENT
/begin MEASUREMENT vDID2049 "After LSB conversion for the DID$2049 monitor, data" UBYTE COMP_0572_S 1 100 0 255 ECU_ADDRESS 0xFFFF3B9F /begin FUNCTION_LIST /end FUNCTION_LIST /end MEASUREMENT
/begin MEASUREMENT vDID204A "After LSB conversion for the DID$204A monitor, data" UBYTE COMP_0572_S 1 100 0 255 ECU_ADDRESS 0xFFFF3BA0 /begin FUNCTION_LIST /end FUNCTION_LIST /end MEASUREMENT
/begin MEASUREMENT vDID2050 "After LSB conversion for the DID$2050 monitor, data" UBYTE COMP_0068 1 100 0 255 ECU_ADDRESS 0xFFFF3BA1 /begin FUNCTION_LIST /end FUNCTION_LIST /end MEASUREMENT
/begin MEASUREMENT vDID2051 "After LSB conversion for the DID$2051 monitor, data" UBYTE COMP_0572_S 1 100 0 255 ECU_ADDRESS 0xFFFF3BA2 /begin FUNCTION_LIST /end FUNCTION_LIST /end MEASUREMENT
/begin MEASUREMENT vDID2059 "After LSB conversion for the DID$2059 monitor, data" UBYTE COMP_0572_S 1 100 0 255 ECU_ADDRESS 0xFFFF3BA3 /begin FUNCTION_LIST /end FUNCTION_LIST /end MEASUREMENT
/begin MEASUREMENT vDID205B "After LSB conversion for the DID$205B monitor, data" UBYTE COMP_0572_S 1 100 0 255 ECU_ADDRESS 0xFFFF3BA4 /begin FUNCTION_LIST /end FUNCTION_LIST /end MEASUREMENT
/begin MEASUREMENT vDID2066 "After LSB conversion for the DID$2066 monitor, data" UWORD COMP_0470_S 1 100 0 2047.96875 ECU_ADDRESS 0xFFFF3BA6 /begin FUNCTION_LIST /end FUNCTION_LIST /end MEASUREMENT
/begin MEASUREMENT vDID2067 "After LSB conversion for the DID$2067 monitor, data" UWORD COMP_0470_S 1 100 0 2047.96875 ECU_ADDRESS 0xFFFF3BA8 /begin FUNCTION_LIST /end FUNCTION_LIST /end MEASUREMENT
/begin MEASUREMENT vDID2068 "After LSB conversion for the DID$2068 monitor, data" UWORD COMP_0470_S 1 100 0 2047.96875 ECU_ADDRESS 0xFFFF3BAA /begin FUNCTION_LIST /end FUNCTION_LIST /end MEASUREMENT
/begin MEASUREMENT vDID2069 "After LSB conversion for the DID$2069 monitor, data" UWORD COMP_0470_S 1 100 0 2047.96875 ECU_ADDRESS 0xFFFF3BAC /begin FUNCTION_LIST /end FUNCTION_LIST /end MEASUREMENT
/begin MEASUREMENT vDID240C "After LSB conversion for the DID$240C monitor, data" UWORD COMP_0537_S 1 100 0 65.535 ECU_ADDRESS 0xFFFF3BAE /begin FUNCTION_LIST /end FUNCTION_LIST /end MEASUREMENT
/begin MEASUREMENT vDID240D "After LSB conversion for the DID$240D monitor, data" UWORD COMP_0573_S 1 100 -273 6280.5 ECU_ADDRESS 0xFFFF3BB0 /begin FUNCTION_LIST /end FUNCTION_LIST /end MEASUREMENT
/begin MEASUREMENT vDID240E "After LSB conversion for the DID$240E monitor, data" UWORD COMP_0537_S 1 100 0 65.535 ECU_ADDRESS 0xFFFF3BB2 /begin FUNCTION_LIST /end FUNCTION_LIST /end MEASUREMENT
/begin MEASUREMENT vDID2414 "After LSB conversion for the DID$2414 monitor, data" UWORD COMP_0575_S 1 100 -327.67 327.68 ECU_ADDRESS 0xFFFF3BB4 /begin FUNCTION_LIST /end FUNCTION_LIST /end MEASUREMENT
/begin MEASUREMENT vDID2415 "After LSB conversion for the DID$2415 monitor, data" UWORD COMP_0575_S 1 100 -327.67 327.68 ECU_ADDRESS 0xFFFF3BB6 /begin FUNCTION_LIST /end FUNCTION_LIST /end MEASUREMENT
/begin MEASUREMENT vDID2416 "After LSB conversion for the DID$2416 monitor, data" UWORD COMP_0575_S 1 100 -327.67 327.68 ECU_ADDRESS 0xFFFF3BB8 /begin FUNCTION_LIST /end FUNCTION_LIST /end MEASUREMENT
/begin MEASUREMENT vDID2418 "After LSB conversion for the DID$2418 monitor, data" UWORD COMP_0537_S 1 100 0 65.535 ECU_ADDRESS 0xFFFF3BBA /begin FUNCTION_LIST /end FUNCTION_LIST /end MEASUREMENT
/begin MEASUREMENT vDID2419 "After LSB conversion for the DID$2419 monitor, data" UWORD COMP_0537_S 1 100 0 65.535 ECU_ADDRESS 0xFFFF3BBC /begin FUNCTION_LIST /end FUNCTION_LIST /end MEASUREMENT
/begin MEASUREMENT vDID241F "After LSB conversion for the DID$241F monitor, data" UWORD COMP_0575_S 1 100 -327.67 327.68 ECU_ADDRESS 0xFFFF3BBE /begin FUNCTION_LIST /end FUNCTION_LIST /end MEASUREMENT
/begin MEASUREMENT vDID2422 "After LSB conversion for the DID$2422 monitor, data" UWORD COMP_0577_S 1 100 0 3276.75 ECU_ADDRESS 0xFFFF3BC0 /begin FUNCTION_LIST /end FUNCTION_LIST /end MEASUREMENT
/begin MEASUREMENT vDID242F "After LSB conversion for the DID$242F monitor, data" UWORD COMP_0575_S 1 100 -327.67 327.68 ECU_ADDRESS 0xFFFF3BC2 /begin FUNCTION_LIST /end FUNCTION_LIST /end MEASUREMENT
/begin MEASUREMENT vDID2449 "After LSB conversion for the DID$2449 monitor, data" UWORD COMP_0492 1 100 0 65535 ECU_ADDRESS 0xFFFF3BC4 /begin FUNCTION_LIST /end FUNCTION_LIST /end MEASUREMENT
/begin MEASUREMENT vDID244A "After LSB conversion for the DID$244A monitor, data" UWORD COMP_0492 1 100 0 65535 ECU_ADDRESS 0xFFFF3BC6 /begin FUNCTION_LIST /end FUNCTION_LIST /end MEASUREMENT
/begin MEASUREMENT vDID244B "After LSB conversion for the DID$244B monitor, data" UWORD COMP_0575_S 1 100 -327.67 327.68 ECU_ADDRESS 0xFFFF3BC8 /begin FUNCTION_LIST /end FUNCTION_LIST /end MEASUREMENT
/begin MEASUREMENT vDID244C "After LSB conversion for the DID$244C monitor, data" UWORD COMP_0575_S 1 100 -327.67 327.68 ECU_ADDRESS 0xFFFF3BCA /begin FUNCTION_LIST /end FUNCTION_LIST /end MEASUREMENT
/begin MEASUREMENT vDID2450 "After LSB conversion for the DID$2450 monitor, data" UWORD COMP_0492 1 100 0 65535 ECU_ADDRESS 0xFFFF3BCC /begin FUNCTION_LIST /end FUNCTION_LIST /end MEASUREMENT
/begin MEASUREMENT vDID2451 "After LSB conversion for the DID$2451 monitor, data" UWORD COMP_0575_S 1 100 -327.67 327.68 ECU_ADDRESS 0xFFFF3BCE /begin FUNCTION_LIST /end FUNCTION_LIST /end MEASUREMENT
/begin MEASUREMENT vDID2452 "After LSB conversion for the DID$2452 monitor, data" UWORD COMP_0575_S 1 100 -327.67 327.68 ECU_ADDRESS 0xFFFF3BD0 /begin FUNCTION_LIST /end FUNCTION_LIST /end MEASUREMENT
/begin MEASUREMENT vDID2453 "After LSB conversion for the DID$2453 monitor, data" UWORD COMP_0492 1 100 0 65535 ECU_ADDRESS 0xFFFF3BD2 /begin FUNCTION_LIST /end FUNCTION_LIST /end MEASUREMENT
/begin MEASUREMENT vDID2455 "After LSB conversion for the DID$2455 monitor, data" UWORD COMP_0492 1 100 0 65535 ECU_ADDRESS 0xFFFF3BD4 /begin FUNCTION_LIST /end FUNCTION_LIST /end MEASUREMENT
/begin MEASUREMENT vDID2457 "After LSB conversion for the DID$2457 monitor, data" UWORD COMP_0575_S 1 100 -327.67 327.68 ECU_ADDRESS 0xFFFF3BD6 /begin FUNCTION_LIST /end FUNCTION_LIST /end MEASUREMENT
/begin MEASUREMENT vDID2458 "After LSB conversion for the DID$2458 monitor, data" UWORD COMP_0575_S 1 100 -327.67 327.68 ECU_ADDRESS 0xFFFF3BD8 /begin FUNCTION_LIST /end FUNCTION_LIST /end MEASUREMENT
/begin MEASUREMENT vDID245D "After LSB conversion for the DID$245D monitor, data" UBYTE COMP_0572_S 1 100 0 255 ECU_ADDRESS 0xFFFF3BDA /begin FUNCTION_LIST /end FUNCTION_LIST /end MEASUREMENT
/begin MEASUREMENT vDID245E "After LSB conversion for the DID$245E monitor, data" UWORD COMP_0217 1 100 0 3.999941832 ECU_ADDRESS 0xFFFF3BDC /begin FUNCTION_LIST /end FUNCTION_LIST /end MEASUREMENT
/begin MEASUREMENT vDID2804 "After LSB conversion for the DID$2804 monitor, data" UWORD COMP_0578_S 1 100 0 262140 ECU_ADDRESS 0xFFFF3BDE /begin FUNCTION_LIST /end FUNCTION_LIST /end MEASUREMENT
/begin MEASUREMENT vDID2806 "After LSB conversion for the DID$2806 monitor, data" UWORD COMP_0579_S 1 100 0 655.35 ECU_ADDRESS 0xFFFF3BE0 /begin FUNCTION_LIST /end FUNCTION_LIST /end MEASUREMENT
/begin MEASUREMENT vDID2807 "After LSB conversion for the DID$2807 monitor, data" UWORD COMP_0576_S 1 100 -655.34 655.36 ECU_ADDRESS 0xFFFF3BE2 /begin FUNCTION_LIST /end FUNCTION_LIST /end MEASUREMENT
/begin MEASUREMENT vDID2808 "After LSB conversion for the DID$2808 monitor, data" UWORD COMP_0576_S 1 100 -655.34 655.36 ECU_ADDRESS 0xFFFF3BE4 /begin FUNCTION_LIST /end FUNCTION_LIST /end MEASUREMENT
/begin MEASUREMENT vDID2812 "After LSB conversion for the DID$2812 monitor, data" UWORD COMP_0580_S 1 100 -32767 32768 ECU_ADDRESS 0xFFFF3BE6 /begin FUNCTION_LIST /end FUNCTION_LIST /end MEASUREMENT
/begin MEASUREMENT vDID281B "After LSB conversion for the DID$281B monitor, data" UBYTE COMP_0572_S 1 100 0 255 ECU_ADDRESS 0xFFFF3BE8 /begin FUNCTION_LIST /end FUNCTION_LIST /end MEASUREMENT
/begin MEASUREMENT vDID281C "After LSB conversion for the DID$281C monitor, data" UBYTE COMP_0572_S 1 100 0 255 ECU_ADDRESS 0xFFFF3BE9 /begin FUNCTION_LIST /end FUNCTION_LIST /end MEASUREMENT
/begin MEASUREMENT vDID2822 "After LSB conversion for the DID$2822 monitor, data" UWORD COMP_0575_S 1 100 -327.67 327.68 ECU_ADDRESS 0xFFFF3BEA /begin FUNCTION_LIST /end FUNCTION_LIST /end MEASUREMENT
/begin MEASUREMENT vDID283E "After LSB conversion for the DID$283E monitor, data" UWORD COMP_0581_S 1 100 -655.34 655.36 ECU_ADDRESS 0xFFFF3BEC /begin FUNCTION_LIST /end FUNCTION_LIST /end MEASUREMENT
/begin MEASUREMENT vDID2841 "After LSB conversion for the DID$2841 monitor, data" UWORD COMP_0016 1 100 0 65535 ECU_ADDRESS 0xFFFF3BEE /begin FUNCTION_LIST /end FUNCTION_LIST /end MEASUREMENT
/begin MEASUREMENT vDID2842 "After LSB conversion for the DID$2842 monitor, data" UWORD COMP_0016 1 100 0 65535 ECU_ADDRESS 0xFFFF3BF0 /begin FUNCTION_LIST /end FUNCTION_LIST /end MEASUREMENT
/begin MEASUREMENT vDID2843 "After LSB conversion for the DID$2843 monitor, data" UWORD COMP_0016 1 100 0 65535 ECU_ADDRESS 0xFFFF3BF2 /begin FUNCTION_LIST /end FUNCTION_LIST /end MEASUREMENT
/begin MEASUREMENT vDID2844 "After LSB conversion for the DID$2844 monitor, data" UWORD COMP_0016 1 100 0 65535 ECU_ADDRESS 0xFFFF3BF4 /begin FUNCTION_LIST /end FUNCTION_LIST /end MEASUREMENT
/begin MEASUREMENT vDID2845 "After LSB conversion for the DID$2845 monitor, data" UWORD COMP_0016 1 100 0 65535 ECU_ADDRESS 0xFFFF3BF6 /begin FUNCTION_LIST /end FUNCTION_LIST /end MEASUREMENT
/begin MEASUREMENT vDID2846 "After LSB conversion for the DID$2846 monitor, data" UWORD COMP_0016 1 100 0 65535 ECU_ADDRESS 0xFFFF3BF8 /begin FUNCTION_LIST /end FUNCTION_LIST /end MEASUREMENT
/begin MEASUREMENT vDID2C03 "RAM value vDID2C03" UBYTE COMP_0068 1 100 0 255 ECU_ADDRESS 0xFFFF3BFA /begin FUNCTION_LIST /end FUNCTION_LIST /end MEASUREMENT
/begin MEASUREMENT vDID2C04 "RAM value vDID2C04" UBYTE COMP_0068 1 100 0 255 ECU_ADDRESS 0xFFFF3BFB /begin FUNCTION_LIST /end FUNCTION_LIST /end MEASUREMENT
/begin MEASUREMENT vDID2C2C "After LSB conversion for the DID$2C2C monitor, data" UBYTE COMP_0572_S 1 100 0 255 ECU_ADDRESS 0xFFFF3BFC /begin FUNCTION_LIST /end FUNCTION_LIST /end MEASUREMENT
/begin MEASUREMENT vDID2E06 "After LSB conversion for the DID$2E06 monitor, data" UBYTE COMP_0021 1 100 0 99.609375 ECU_ADDRESS 0xFFFF3BFD /begin FUNCTION_LIST /end FUNCTION_LIST /end MEASUREMENT
/begin MEASUREMENT vDID2E07 "After LSB conversion for the DID$2E07 monitor, data" UBYTE COMP_0009 1 100 0 199.21875 ECU_ADDRESS 0xFFFF3BFE /begin FUNCTION_LIST /end FUNCTION_LIST /end MEASUREMENT
/begin MEASUREMENT vDID2E08 "After LSB conversion for the DID$2E08 monitor, data" UBYTE COMP_0009 1 100 0 199.21875 ECU_ADDRESS 0xFFFF3BFF /begin FUNCTION_LIST /end FUNCTION_LIST /end MEASUREMENT
/begin MEASUREMENT vDID2E09 "After LSB conversion for the DID$2E09 monitor, data" UBYTE COMP_0009 1 100 0 199.21875 ECU_ADDRESS 0xFFFF3C00 /begin FUNCTION_LIST /end FUNCTION_LIST /end MEASUREMENT
/begin MEASUREMENT vDID2E0A "After LSB conversion for the DID$2E0A monitor, data" UBYTE COMP_0009 1 100 0 199.21875 ECU_ADDRESS 0xFFFF3C01 /begin FUNCTION_LIST /end FUNCTION_LIST /end MEASUREMENT
/begin MEASUREMENT vDID2E61 "After LSB conversion for the DID$2E61 monitor, data" UBYTE COMP_0572_S 1 100 0 255 ECU_ADDRESS 0xFFFF3C02 /begin FUNCTION_LIST /end FUNCTION_LIST /end MEASUREMENT
/begin MEASUREMENT vDID2E62 "After LSB conversion for the DID$2E62 monitor, data" UBYTE COMP_0572_S 1 100 0 255 ECU_ADDRESS 0xFFFF3C03 /begin FUNCTION_LIST /end FUNCTION_LIST /end MEASUREMENT
/begin MEASUREMENT vDID2E64 "After LSB conversion for the DID$2E64 monitor, data" UBYTE COMP_0572_S 1 100 0 255 ECU_ADDRESS 0xFFFF3C04 /begin FUNCTION_LIST /end FUNCTION_LIST /end MEASUREMENT
/begin MEASUREMENT vDID2E65 "After LSB conversion for the DID$2E65 monitor, data" UBYTE COMP_0027 1 100 0 255 ECU_ADDRESS 0xFFFF3C05 /begin FUNCTION_LIST /end FUNCTION_LIST /end MEASUREMENT
/begin MEASUREMENT vDID2E69 "After LSB conversion for the DID$2E65 monitor, data" UWORD COMP_0578_S 1 100 0 262140 ECU_ADDRESS 0xFFFF3C06 /begin FUNCTION_LIST /end FUNCTION_LIST /end MEASUREMENT
/begin MEASUREMENT vDID2E70 "After LSB conversion for the DID$2E70 monitor, data" UBYTE COMP_0572_S 1 100 0 255 ECU_ADDRESS 0xFFFF3C08 /begin FUNCTION_LIST /end FUNCTION_LIST /end MEASUREMENT
/begin MEASUREMENT vDLEPX1 "The amount of change of EVPRES of the 1 s front" UBYTE COMP_0102 1 100 0 5100 ECU_ADDRESS 0xFFFF1274 /begin FUNCTION_LIST /end FUNCTION_LIST /end MEASUREMENT
/begin MEASUREMENT vDLMDTBL "mDLMD1,2,3 storage table" UBYTE COMP_0027 1 100 0 255 ECU_ADDRESS 0xFFFF2A51 /begin FUNCTION_LIST /end FUNCTION_LIST /end MEASUREMENT
/begin MEASUREMENT vDLMDTBL_R#1 "mDLMD1,2,3 storage table" UBYTE COMP_0027 1 100 0 255 ECU_ADDRESS 0xFFFF2A51 /begin FUNCTION_LIST /end FUNCTION_LIST /end MEASUREMENT
/begin MEASUREMENT vDLMDTBL_R#2 "mDLMD1,2,3 storage table" UBYTE COMP_0027 1 100 0 255 ECU_ADDRESS 0xFFFF2A52 /begin FUNCTION_LIST /end FUNCTION_LIST /end MEASUREMENT
/begin MEASUREMENT vDLMDTBL_R#3 "mDLMD1,2,3 storage table" UBYTE COMP_0027 1 100 0 255 ECU_ADDRESS 0xFFFF2A53 /begin FUNCTION_LIST /end FUNCTION_LIST /end MEASUREMENT
/begin MEASUREMENT vDLTDEGI "The amount of operation corner deviation" UBYTE COMP_0256 1 100 -64 63.5 ECU_ADDRESS 0xFFFF1018 /begin FUNCTION_LIST /end FUNCTION_LIST /end MEASUREMENT
/begin MEASUREMENT vDLTDEGI_R#1 "The amount of operation corner deviation" UBYTE COMP_0256 1 100 -64 63.5 ECU_ADDRESS 0xFFFF1018 /begin FUNCTION_LIST /end FUNCTION_LIST /end MEASUREMENT
/begin MEASUREMENT vDLTDEGI_R#2 "The amount of operation corner deviation" UBYTE COMP_0256 1 100 -64 63.5 ECU_ADDRESS 0xFFFF1019 /begin FUNCTION_LIST /end FUNCTION_LIST /end MEASUREMENT
/begin MEASUREMENT vDLTDEGI0f "Operation corner deviation quantity change judgement flag" UBYTE COMP_0004 1 100 0 255 ECU_ADDRESS 0xFFFF1275 /begin FUNCTION_LIST /end FUNCTION_LIST /end MEASUREMENT
/begin MEASUREMENT vDLTEAC "ACC Torque order value un-adjustment deviation" UWORD COMP_0196 1 100 0 6553.5 ECU_ADDRESS 0xFFFF3C0A /begin FUNCTION_LIST /end FUNCTION_LIST /end MEASUREMENT
/begin MEASUREMENT vDLTEGR "The amount of a change in EGR temperature" UBYTE COMP_0035 1 100 -50 205 ECU_ADDRESS 0xFFFF2A62 /begin FUNCTION_LIST /end FUNCTION_LIST /end MEASUREMENT
/begin MEASUREMENT vDLTMN "A MNRPM change (rise side) before 100mS" UBYTE COMP_0000 1 100 0 6375 ECU_ADDRESS 0xFFFF8A39 /begin FUNCTION_LIST /end FUNCTION_LIST /end MEASUREMENT
/begin MEASUREMENT vDLTMNRR "A change in MNRPM before 100mS" UBYTE COMP_0000 1 100 0 6375 ECU_ADDRESS 0xFFFF2A68 /begin FUNCTION_LIST /end FUNCTION_LIST /end MEASUREMENT
/begin COMPU_METHOD COMP_0068 "1-" RAT_FUNC "%8.2" "-" COEFFS 0 1 0 0 0 1 /end COMPU_METHOD
/begin COMPU_METHOD COMP_0004 "1Å|" RAT_FUNC "%8.2" "Å|" COEFFS 0 1 0 0 0 1 /end COMPU_METHOD
/begin COMPU_METHOD COMP_0023 "5mV" RAT_FUNC "%8.2" "mV" COEFFS 0 1 0 0 0 5 /end COMPU_METHOD
/begin COMPU_METHOD COMP_0020 "50rpm" RAT_FUNC "%8.2" "rpm" COEFFS 0 1 0 0 0 50 /end COMPU_METHOD
/begin COMPU_METHOD COMP_0002 "0.35deg" RAT_FUNC "%8.2" "deg" COEFFS 0 1 0 0 0 0.35 /end COMPU_METHOD
/begin COMPU_METHOD COMP_0453 "0.002-" RAT_FUNC "%8.4" "-" COEFFS 0 1 0 0 0 0.002 /end COMPU_METHOD
/begin COMPU_METHOD COMP_0014 "10ms" RAT_FUNC "%8.2" "ms" COEFFS 0 1 0 0 0 10 /end COMPU_METHOD
/begin COMPU_METHOD COMP_0008 "100ms" RAT_FUNC "%8.2" "ms" COEFFS 0 1 0 0 0 100 /end COMPU_METHOD
/begin COMPU_METHOD COMP_0196 "0.1Nm" RAT_FUNC "%8.2" "Nm" COEFFS 0 1 0 0 0 0.1 /end COMPU_METHOD
/begin COMPU_METHOD COMP_0009 "100/128%" RAT_FUNC "%8.2" "%" COEFFS 0 1 0 0 0 0.78125 /end COMPU_METHOD
/begin COMPU_METHOD COMP_0013 "1s" RAT_FUNC "%8.2" "s" COEFFS 0 1 0 0 0 1 /end COMPU_METHOD
/begin COMPU_METHOD COMP_0000 "25rpm" RAT_FUNC "%8.2" "rpm" COEFFS 0 1 0 0 0 25 /end COMPU_METHOD
/begin COMPU_METHOD COMP_0047 "0.5%" RAT_FUNC "%8.2" "%" COEFFS 0 1 0 0 0 0.5 /end COMPU_METHOD
/begin COMPU_METHOD COMP_0436 "0.1km/h" RAT_FUNC "%8.2" "km/h" COEFFS 0 1 0 0 0 0.1 /end COMPU_METHOD
/begin COMPU_METHOD COMP_0021 "100/256%" RAT_FUNC "%8.2" "%" COEFFS 0 1 0 0 0 0.390625 /end COMPU_METHOD
/begin COMPU_METHOD COMP_0217 "1/16384-" RAT_FUNC "%8.6" "-" COEFFS 0 1 0 0 0 0.0000610352 /end COMPU_METHOD
/begin COMPU_METHOD COMP_0250 "4ms" RAT_FUNC "%8.2" "ms" COEFFS 0 1 0 0 0 4 /end COMPU_METHOD
/begin COMPU_METHOD COMP_0033 "80mV" RAT_FUNC "%8.2" "mV" COEFFS 0 1 0 0 0 80 /end COMPU_METHOD
/begin COMPU_METHOD COMP_0027 "1%" RAT_FUNC "%8.2" "%" COEFFS 0 1 0 0 0 1 /end COMPU_METHOD
/begin COMPU_METHOD COMP_0024 "50ms" RAT_FUNC "%8.2" "ms" COEFFS 0 1 0 0 0 50 /end COMPU_METHOD
/begin COMPU_METHOD COMP_0030 "1âÒ" RAT_FUNC "%8.2" "âÒ" COEFFS 0 1 0 0 0 1 /end COMPU_METHOD
/begin COMPU_METHOD COMP_0345_S "1/32Nm" RAT_FUNC "%8.3" "Nm" COEFFS 0 1 400 0 0 0.03125 /end COMPU_METHOD
/begin COMPU_METHOD COMP_0031 "1/256%" RAT_FUNC "%8.4" "%" COEFFS 0 1 0 0 0 0.00390625 /end COMPU_METHOD
/begin COMPU_METHOD COMP_0005 "0.11deg" RAT_FUNC "%8.2" "deg" COEFFS 0 1 0 0 0 0.11 /end COMPU_METHOD
/begin COMPU_METHOD COMP_0362_S "0.125%" RAT_FUNC "%8.2" "%" COEFFS 0 1 0 0 0 0.125 /end COMPU_METHOD
/begin COMPU_METHOD COMP_0048 "64/128degCA" RAT_FUNC "%8.2" "degCA" COEFFS 0 1 0 0 0 0.5 /end COMPU_METHOD
/begin COMPU_METHOD COMP_0016 "1count" RAT_FUNC "%8.2" "count" COEFFS 0 1 0 0 0 1 /end COMPU_METHOD
/begin COMPU_METHOD COMP_0054 "20mV" RAT_FUNC "%8.2" "mV" COEFFS 0 1 0 0 0 20 /end COMPU_METHOD
/begin COMPU_METHOD COMP_0373 "1/100-" RAT_FUNC "%8.3" "-" COEFFS 0 1 0 0 0 0.01 /end COMPU_METHOD
/begin COMPU_METHOD COMP_0059 "0.5%/s" RAT_FUNC "%8.2" "%/s" COEFFS 0 1 0 0 0 0.5 /end COMPU_METHOD
/begin COMPU_METHOD COMP_0050 "5/64mV" RAT_FUNC "%8.3" "mV" COEFFS 0 1 0 0 0 0.078125 /end COMPU_METHOD
/begin COMPU_METHOD COMP_0035 "X-50Åé" RAT_FUNC "%8.2" "Åé" COEFFS 0 1 50 0 0 1 /end COMPU_METHOD
/begin COMPU_METHOD COMP_0375_S "0.01km/h" RAT_FUNC "%8.3" "km/h" COEFFS 0 1 0 0 0 0.01 /end COMPU_METHOD
/begin COMPU_METHOD COMP_0078 "1/256deg" RAT_FUNC "%8.4" "deg" COEFFS 0 1 0 0 0 0.00390625 /end COMPU_METHOD
/begin COMPU_METHOD COMP_0256 "64/128degCA" RAT_FUNC "%8.2" "degCA" COEFFS 0 1 64 0 0 0.5 /end COMPU_METHOD
/begin COMPU_METHOD COMP_0150 "0.5L" RAT_FUNC "%8.2" "L" COEFFS 0 1 0 0 0 0.5 /end COMPU_METHOD
/begin COMPU_METHOD COMP_0191 "1REV" RAT_FUNC "%8.2" "REV" COEFFS 0 1 0 0 0 1 /end COMPU_METHOD
/begin COMPU_METHOD COMP_0232 "1/128mm^2" RAT_FUNC "%8.4" "mm^2" COEFFS 0 1 0 0 0 0.0078125 /end COMPU_METHOD
/begin COMPU_METHOD COMP_0492 "20/256mV" RAT_FUNC "%8.2" "mV" COEFFS 0 1 0 0 0 1 /end COMPU_METHOD
/begin COMPU_METHOD COMP_0193 "0.1Nm/10ms" RAT_FUNC "%8.2" "Nm/10ms" COEFFS 0 1 0 0 0 0.1 /end COMPU_METHOD
/begin COMPU_METHOD COMP_0092 "1bit" RAT_FUNC "%8.2" "bit" COEFFS 0 1 0 0 0 1 /end COMPU_METHOD
/begin COMPU_METHOD COMP_0030_S "NN" RAT_FUNC "%8.2" "N" COEFFS 0 1 0 0 0 1 /end COMPU_METHOD
/begin COMPU_METHOD COMP_0470_S "1/32Nm" RAT_FUNC "%8.3" "Nm" COEFFS 0 1 0 0 0 0.03125 /end COMPU_METHOD
/begin COMPU_METHOD COMP_0053 "1ms" RAT_FUNC "%8.2" "ms" COEFFS 0 1 0 0 0 1 /end COMPU_METHOD
/begin COMPU_METHOD COMP_0491_S "1mbar" RAT_FUNC "%8.2" "mbar" COEFFS 0 1 0 0 0 1 /end COMPU_METHOD
/begin COMPU_METHOD COMP_0497_S "1/256deg" RAT_FUNC "%8.4" "deg" COEFFS 0 1 128 0 0 0.00390625 /end COMPU_METHOD
/begin COMPU_METHOD COMP_0516_S "0.125%/sec" RAT_FUNC "%8.2" "%/sec" COEFFS 0 1 0 0 0 0.125 /end COMPU_METHOD
/begin COMPU_METHOD COMP_0283 "1flag" RAT_FUNC "%8.2" "flag" COEFFS 0 1 0 0 0 1 /end COMPU_METHOD
/begin COMPU_METHOD COMP_0287 "1REF" RAT_FUNC "%8.2" "REF" COEFFS 0 1 0 0 0 1 /end COMPU_METHOD
/begin COMPU_METHOD COMP_0531_S "m/s^2m/s^2" RAT_FUNC "%8.2" "m/s^2" COEFFS 0 1 0 0 0 0.1 /end COMPU_METHOD
/begin COMPU_METHOD COMP_0470 "1km" RAT_FUNC "%8.2" "km" COEFFS 0 1 0 0 0 1 /end COMPU_METHOD
/begin COMPU_METHOD COMP_0427 "0.25rpm" RAT_FUNC "%8.2" "rpm" COEFFS 0 1 0 0 0 0.25 /end COMPU_METHOD
/begin COMPU_METHOD COMP_0537_S "VV" RAT_FUNC "%8.4" "V" COEFFS 0 1 0 0 0 0.001 /end COMPU_METHOD
/begin COMPU_METHOD COMP_0140 "0.5STEP" RAT_FUNC "%8.2" "STEP" COEFFS 0 1 0 0 0 0.5 /end COMPU_METHOD
/begin COMPU_METHOD COMP_0141 "50/256%" RAT_FUNC "%8.2" "%" COEFFS 0 1 0 0 0 0.1953125 /end COMPU_METHOD
/begin COMPU_METHOD COMP_0550_S "mm^2mm^2" RAT_FUNC "%8.6" "mm^2" COEFFS 0 1 0 0 0 0.0000305176 /end COMPU_METHOD
/begin COMPU_METHOD COMP_0371 "2cc" RAT_FUNC "%8.2" "cc" COEFFS 0 1 0 0 0 2 /end COMPU_METHOD
/begin COMPU_METHOD COMP_0491 "20/256mV" RAT_FUNC "%8.3" "mV" COEFFS 0 1 0 0 0 0.078125 /end COMPU_METHOD
/begin COMPU_METHOD COMP_0017_S "mmHgmmHg" RAT_FUNC "%8.3" "mmHg" COEFFS 0 1 0 0 0 0.03125 /end COMPU_METHOD
/begin COMPU_METHOD COMP_0359 "0.5%" RAT_FUNC "%8.2" "%" COEFFS 0 1 64 0 0 0.5 /end COMPU_METHOD
/begin COMPU_METHOD COMP_0269 "0.5/256%" RAT_FUNC "%8.4" "%" COEFFS 0 1 0 0 0 0.001953125 /end COMPU_METHOD
/begin COMPU_METHOD COMP_0554_S "É SÉ S" RAT_FUNC "%8.2" "É S" COEFFS 0 1 0 0 0 209715.2 /end COMPU_METHOD
/begin COMPU_METHOD COMP_0376 "0.1É S" RAT_FUNC "%8.2" "É S" COEFFS 0 1 0 0 0 0.1 /end COMPU_METHOD
/begin COMPU_METHOD COMP_0021_S "NmNm" RAT_FUNC "%8.2" "Nm" COEFFS 0 1 100 0 0 2 /end COMPU_METHOD
/begin COMPU_METHOD COMP_0022_S "--" RAT_FUNC "%8.4" "-" COEFFS 0 1 0 0 0 0.003921568 /end COMPU_METHOD
/begin COMPU_METHOD COMP_0379 "8/10000cm**2" RAT_FUNC "%8.5" "cm**2" COEFFS 0 1 0 0 0 0.0008 /end COMPU_METHOD
/begin COMPU_METHOD COMP_0118 "40mV" RAT_FUNC "%8.2" "mV" COEFFS 0 1 0 0 0 40 /end COMPU_METHOD
/begin COMPU_METHOD COMP_0164 "0.000305MPa" RAT_FUNC "%8.5" "MPa" COEFFS 0 1 0 0 0 0.000305 /end COMPU_METHOD
/begin COMPU_METHOD COMP_0380 "1/16count" RAT_FUNC "%8.3" "count" COEFFS 0 1 0 0 0 0.0625 /end COMPU_METHOD
/begin COMPU_METHOD COMP_0381 "1/8192-" RAT_FUNC "%8.5" "-" COEFFS 0 1 0 0 0 0.0001221 /end COMPU_METHOD
/begin COMPU_METHOD COMP_0257 "128/128degCA" RAT_FUNC "%8.2" "degCA" COEFFS 0 1 128 0 0 1 /end COMPU_METHOD
/begin COMPU_METHOD COMP_0189 "3.2É S" RAT_FUNC "%8.2" "É S" COEFFS 0 1 0 0 0 3.2 /end COMPU_METHOD
/begin COMPU_METHOD COMP_0072 "1/16%" RAT_FUNC "%8.3" "%" COEFFS 0 1 8 0 0 0.0625 /end COMPU_METHOD
/begin COMPU_METHOD COMP_0384 "1/128-" RAT_FUNC "%8.4" "-" COEFFS 0 1 0 0 0 0.007813 /end COMPU_METHOD
/begin COMPU_METHOD COMP_0062_S "AA" RAT_FUNC "%8.2" "A" COEFFS 0 1 0 0 0 1 /end COMPU_METHOD
/begin COMPU_METHOD COMP_0385 "1.608km" RAT_FUNC "%8.2" "km" COEFFS 0 1 0 0 0 1.608 /end COMPU_METHOD
/begin COMPU_METHOD COMP_0562_S "AA" RAT_FUNC "%8.2" "A" COEFFS 0 1 0 0 0 0.125 /end COMPU_METHOD
/begin COMPU_METHOD COMP_0563_S "A/ÅéA/Åé" RAT_FUNC "%8.3" "A/Åé" COEFFS 0 1 0 0 0 0.01 /end COMPU_METHOD
/begin COMPU_METHOD COMP_0029_S "É ÇìÉ Çì" RAT_FUNC "%8.2" "É Çì" COEFFS 0 1 0 0 0 3.2 /end COMPU_METHOD
/begin COMPU_METHOD COMP_0389 "1/2548km" RAT_FUNC "%8.5" "km" COEFFS 0 1 0 0 0 0.000392465 /end COMPU_METHOD
/begin COMPU_METHOD COMP_0564_S "--" RAT_FUNC "%8.6" "-" COEFFS 0 1 0 0 0 0.00000392157 /end COMPU_METHOD
/begin COMPU_METHOD COMP_0033_S "mAmA" RAT_FUNC "%8.2" "mA" COEFFS 0 1 0 0 0 0.5 /end COMPU_METHOD
/begin COMPU_METHOD COMP_0390 "10deg" RAT_FUNC "%8.2" "deg" COEFFS 0 1 0 0 0 10 /end COMPU_METHOD
/begin COMPU_METHOD COMP_0391 "100/256%" RAT_FUNC "%8.2" "%" COEFFS 0 1 0 0 0 0.391 /end COMPU_METHOD
/begin COMPU_METHOD COMP_0567_S "cyl(BITà íu)cyl(BIT" RAT_FUNC "%8.2" "cyl(BIT" COEFFS 0 1 0 0 0 1 /end COMPU_METHOD
/begin COMPU_METHOD COMP_0038_S "%%" RAT_FUNC "%8.3" "%" COEFFS 0 1 3200 0 0 0.09765625 /end COMPU_METHOD
/begin COMPU_METHOD COMP_0394 "12.8É S" RAT_FUNC "%8.2" "É S" COEFFS 0 1 0 0 0 12.8 /end COMPU_METHOD
/begin COMPU_METHOD COMP_0040_S "Nm/secNm/sec" RAT_FUNC "%8.2" "Nm/sec" COEFFS 0 1 0 0 0 20 /end COMPU_METHOD
/begin COMPU_METHOD COMP_0397 "20mV" RAT_FUNC "%8.2" "mV" COEFFS 0 1 0 0 0 20 /end COMPU_METHOD
/begin COMPU_METHOD COMP_0572_S "FlagFlag" RAT_FUNC "%8.2" "Flag" COEFFS 0 1 0 0 0 1 /end COMPU_METHOD
/begin COMPU_METHOD COMP_0573_S "ÅéÅé" RAT_FUNC "%8.2" "Åé" COEFFS 0 1 273 0 0 0.1 /end COMPU_METHOD
/begin COMPU_METHOD COMP_0574_S "statusstatus" RAT_FUNC "%8.2" "status" COEFFS 0 1 0 0 0 1 /end COMPU_METHOD
/begin COMPU_METHOD COMP_0575_S "%%" RAT_FUNC "%8.3" "%" COEFFS 0 1 327.67 0 0 0.01 /end COMPU_METHOD
/begin COMPU_METHOD COMP_0576_S "degCAdegCA" RAT_FUNC "%8.3" "degCA" COEFFS 0 1 655.34 0 0 0.02 /end COMPU_METHOD
/begin COMPU_METHOD COMP_0577_S "kg/hkg/h" RAT_FUNC "%8.3" "kg/h" COEFFS 0 1 0 0 0 0.05 /end COMPU_METHOD
/begin COMPU_METHOD COMP_0578_S "É sÉ s" RAT_FUNC "%8.2" "É s" COEFFS 0 1 0 0 0 4 /end COMPU_METHOD
/begin COMPU_METHOD COMP_0579_S "mg/strkmg/strk" RAT_FUNC "%8.3" "mg/strk" COEFFS 0 1 0 0 0 0.01 /end COMPU_METHOD
/begin COMPU_METHOD COMP_0580_S "É sÉ s" RAT_FUNC "%8.2" "É s" COEFFS 0 1 32767 0 0 1 /end COMPU_METHOD
/begin COMPU_METHOD COMP_0581_S "degCrSdegCrS" RAT_FUNC "%8.3" "degCrS" COEFFS 0 1 655.34 0 0 0.02 /end COMPU_METHOD
/begin COMPU_METHOD COMP_0102 "20mV/s" RAT_FUNC "%8.2" "mV/s" COEFFS 0 1 0 0 0 20 /end COMPU_METHOD
/end MODULE
/end PROJECT
