ASAP2_VERSION 1 3_BETA
/begin PROJECT TK_X91_EUR_VC ""
/begin HEADER "" /* key HEADER ++ "comment" Ç… Par.scomment */ PROJECT_NO TK_X91_EUR_VC /* key PROJECT_NO ++ project number Ç… car_eng_desti_lot */ VERSION "7V4YHZEB2" /* key VERSION ++ version number Ç… mProgver */ /end HEADER
/begin MODULE DIM ""
/begin MOD_COMMON "" DEPOSIT ABSOLUTE BYTE_ORDER MSB_FIRST /* ﬁ≤ƒµ∞¿ﬁ∞Ç™ÿÃﬂ⁄∞ΩÇ≥ÇÍÇÈ */ /end MOD_COMMON
/begin MEASUREMENT tTMSLP1EX "STAGE#1 diagnosis experience judgement timer" UBYTE COMP_0202_S 1 100 0 255 ECU_ADDRESS 0xFFFF4532 /begin FUNCTION_LIST /end FUNCTION_LIST /end MEASUREMENT
/begin MEASUREMENT tTMSLP1NG "STAGE#1 diagnosis NG judgement timer" UBYTE COMP_0202_S 1 100 0 255 ECU_ADDRESS 0xFFFF4533 /begin FUNCTION_LIST /end FUNCTION_LIST /end MEASUREMENT
/begin MEASUREMENT tTMSLP2NG "STAGE#2 diagnosis NG judgement timer" UBYTE COMP_0202_S 1 100 0 255 ECU_ADDRESS 0xFFFF4534 /begin FUNCTION_LIST /end FUNCTION_LIST /end MEASUREMENT
/begin MEASUREMENT tTMSLP2OK "STAGE#2 diagnosis OK judgement timer" UBYTE COMP_0202_S 1 100 0 255 ECU_ADDRESS 0xFFFF4535 /begin FUNCTION_LIST /end FUNCTION_LIST /end MEASUREMENT
/begin MEASUREMENT tTMSLSH02 "Leak-down time for the 0.02inch diagnosis slosh judgement" UBYTE COMP_0202_S 1 100 0 255 ECU_ADDRESS 0xFFFF4536 /begin FUNCTION_LIST /end FUNCTION_LIST /end MEASUREMENT
/begin MEASUREMENT tTMSLSH04 "Leak-down time for 0.04-inch judgement slosh judgement" UBYTE COMP_0202_S 1 100 0 255 ECU_ADDRESS 0xFFFF4537 /begin FUNCTION_LIST /end FUNCTION_LIST /end MEASUREMENT
/begin MEASUREMENT tTMVASCD "Vehicle speed diagnosis judgement time" UBYTE COMP_0202_S 1 100 0 255 ECU_ADDRESS 0xFFFF4538 /begin FUNCTION_LIST /end FUNCTION_LIST /end MEASUREMENT
/begin MEASUREMENT tTMVBNG "A/F F/B circuit power supply off timer" UBYTE COMP_0202_S 1 100 0 255 ECU_ADDRESS 0xFFFF4539 /begin FUNCTION_LIST /end FUNCTION_LIST /end MEASUREMENT
/begin MEASUREMENT tTMVPNG "VP Unusual judgement" UBYTE COMP_0202_S 1 100 0 255 ECU_ADDRESS 0xFFFF453A /begin FUNCTION_LIST /end FUNCTION_LIST /end MEASUREMENT
/begin MEASUREMENT tTMVPOK "VP Unusual judgement" UBYTE COMP_0202_S 1 100 0 255 ECU_ADDRESS 0xFFFF453B /begin FUNCTION_LIST /end FUNCTION_LIST /end MEASUREMENT
/begin MEASUREMENT tTMZKFAIL "NAVI- communication fail judgement time" UBYTE COMP_0202_S 1 100 0 255 ECU_ADDRESS 0xFFFF453C /begin FUNCTION_LIST /end FUNCTION_LIST /end MEASUREMENT
/begin MEASUREMENT tTMZKFL "NAVI- communication fail judgement time" UBYTE COMP_0202_S 1 100 0 255 ECU_ADDRESS 0xFFFF453D /begin FUNCTION_LIST /end FUNCTION_LIST /end MEASUREMENT
/begin MEASUREMENT tTNGSLSH "Fuel level gauge slosh diagnosis slosh judgement delay" UBYTE COMP_0202_S 1 100 0 255 ECU_ADDRESS 0xFFFF453E /begin FUNCTION_LIST /end FUNCTION_LIST /end MEASUREMENT
/begin MEASUREMENT tTO2HF1NG "O2HF1 breakage NG judgement delay time" UBYTE COMP_0202_S 1 100 0 255 ECU_ADDRESS 0xFFFF4540 /begin FUNCTION_LIST /end FUNCTION_LIST /end MEASUREMENT
/begin MEASUREMENT tTO2HF2NG "O2HF2 breakage NG judgement delay time" UBYTE COMP_0202_S 1 100 0 255 ECU_ADDRESS 0xFFFF4541 /begin FUNCTION_LIST /end FUNCTION_LIST /end MEASUREMENT
/begin MEASUREMENT tTO2HR1NG "O2HR1 breakage NG judgement delay time" UBYTE COMP_0202_S 1 100 0 255 ECU_ADDRESS 0xFFFF4542 /begin FUNCTION_LIST /end FUNCTION_LIST /end MEASUREMENT
/begin MEASUREMENT tTO2HR2NG "O2HR2 breakage NG judgement delay time" UBYTE COMP_0202_S 1 100 0 255 ECU_ADDRESS 0xFFFF4543 /begin FUNCTION_LIST /end FUNCTION_LIST /end MEASUREMENT
/begin MEASUREMENT tTPEVCCL "CVBV OPEN timing" UBYTE COMP_0202_S 1 100 0 255 ECU_ADDRESS 0xFFFF4544 /begin FUNCTION_LIST /end FUNCTION_LIST /end MEASUREMENT
/begin MEASUREMENT tTPEVSTD "ÉvÉãÉvÉåÉbÉVÉÉÅ[É`ÉFÉbÉN start delay" UBYTE COMP_0202_S 1 100 0 255 ECU_ADDRESS 0xFFFF4545 /begin FUNCTION_LIST /end FUNCTION_LIST /end MEASUREMENT
/begin MEASUREMENT tTPHANGD "PHASE breakage diagnosis NG judgement delay" UBYTE COMP_0202_S 1 100 0 255 ECU_ADDRESS 0xFFFF4546 /begin FUNCTION_LIST /end FUNCTION_LIST /end MEASUREMENT
/begin MEASUREMENT tTPOSNGD "POS breakage diagnosis NG judgement delay" UBYTE COMP_0202_S 1 100 0 255 ECU_ADDRESS 0xFFFF4548 /begin FUNCTION_LIST /end FUNCTION_LIST /end MEASUREMENT
/begin MEASUREMENT tTSCSNG "SCV solenoid valve NG judgement timer" UBYTE COMP_0202_S 1 100 0 255 ECU_ADDRESS 0xFFFF4549 /begin FUNCTION_LIST /end FUNCTION_LIST /end MEASUREMENT
/begin MEASUREMENT tTSCSNG21 "SCV solenoid valve NG judgement timer 1 (for the BTYPE hardware)" UBYTE COMP_0202_S 1 100 0 255 ECU_ADDRESS 0xFFFF454A /begin FUNCTION_LIST /end FUNCTION_LIST /end MEASUREMENT
/begin MEASUREMENT tTSCSNG22 "SCV solenoid valve NG judgement timer 2 (for the BTYPE hardware)" UBYTE COMP_0202_S 1 100 0 255 ECU_ADDRESS 0xFFFF454B /begin FUNCTION_LIST /end FUNCTION_LIST /end MEASUREMENT
/begin MEASUREMENT tTTANG "Intake air temperature sensor diagnosis delay" UBYTE COMP_0202_S 1 100 0 255 ECU_ADDRESS 0xFFFF454C /begin FUNCTION_LIST /end FUNCTION_LIST /end MEASUREMENT
/begin MEASUREMENT tTTANG1 "Intake air temperature sensor diagnosis delay" UBYTE COMP_0202_S 1 100 0 255 ECU_ADDRESS 0xFFFF454D /begin FUNCTION_LIST /end FUNCTION_LIST /end MEASUREMENT
/begin MEASUREMENT tTTANGO "Intake air temperature sensor diagnosis delay" UBYTE COMP_0202_S 1 100 0 255 ECU_ADDRESS 0xFFFF454E /begin FUNCTION_LIST /end FUNCTION_LIST /end MEASUREMENT
/begin MEASUREMENT tTTANGR "Intake air temperature sensor diagnosis delay" UBYTE COMP_0202_S 1 100 0 255 ECU_ADDRESS 0xFFFF454F /begin FUNCTION_LIST /end FUNCTION_LIST /end MEASUREMENT
/begin MEASUREMENT tTTANGR2 "Intake air temperature sensor diagnosis delay (RATE law)" UBYTE COMP_0202_S 1 100 0 255 ECU_ADDRESS 0xFFFF4550 /begin FUNCTION_LIST /end FUNCTION_LIST /end MEASUREMENT
/begin MEASUREMENT tTTANGS "Intake air temperature sensor diagnosis delay" UBYTE COMP_0202_S 1 100 0 255 ECU_ADDRESS 0xFFFF4551 /begin FUNCTION_LIST /end FUNCTION_LIST /end MEASUREMENT
/begin MEASUREMENT tTTEVDY41 "Leak-down start delay" UBYTE COMP_0202_S 1 100 0 255 ECU_ADDRESS 0xFFFF4552 /begin FUNCTION_LIST /end FUNCTION_LIST /end MEASUREMENT
/begin MEASUREMENT tTTEVDY42 "Leak-down start delay" UBYTE COMP_0202_S 1 100 0 255 ECU_ADDRESS 0xFFFF4553 /begin FUNCTION_LIST /end FUNCTION_LIST /end MEASUREMENT
/begin MEASUREMENT tTTFNG "Fuel temperature sensor judgement delay" UBYTE COMP_0202_S 1 100 0 255 ECU_ADDRESS 0xFFFF4554 /begin FUNCTION_LIST /end FUNCTION_LIST /end MEASUREMENT
/begin MEASUREMENT tTTFNGO "Fuel temperature sensor Low Input judgement delay" UBYTE COMP_0202_S 1 100 0 255 ECU_ADDRESS 0xFFFF4555 /begin FUNCTION_LIST /end FUNCTION_LIST /end MEASUREMENT
/begin MEASUREMENT tTTFNGS "Fuel temperature sensor High Input judgement delay" UBYTE COMP_0202_S 1 100 0 255 ECU_ADDRESS 0xFFFF4556 /begin FUNCTION_LIST /end FUNCTION_LIST /end MEASUREMENT
/begin MEASUREMENT tTTMEVC4 "A timer for the DPAMB renewal" UBYTE COMP_0202_S 1 100 0 255 ECU_ADDRESS 0xFFFF4557 /begin FUNCTION_LIST /end FUNCTION_LIST /end MEASUREMENT
/begin MEASUREMENT tTTOHI "Oil temperature sensor voltage HIGH INPUT diagnosis NG judgement delay timer" UBYTE COMP_0202_S 1 100 0 255 ECU_ADDRESS 0xFFFF4558 /begin FUNCTION_LIST /end FUNCTION_LIST /end MEASUREMENT
/begin MEASUREMENT tTTOLO "Oil temperature sensor voltage LOW INPUT diagnosis NG judgement delay timer" UBYTE COMP_0202_S 1 100 0 255 ECU_ADDRESS 0xFFFF4559 /begin FUNCTION_LIST /end FUNCTION_LIST /end MEASUREMENT
/begin MEASUREMENT tTTPDIVL "A timer for the TPUL2 decrement interval" UBYTE COMP_0202_S 1 100 0 255 ECU_ADDRESS 0xFFFF455A /begin FUNCTION_LIST /end FUNCTION_LIST /end MEASUREMENT
/begin MEASUREMENT tTTPFS1 "TCS communication unusual time timer" UBYTE COMP_0202_S 1 100 0 255 ECU_ADDRESS 0xFFFF455B /begin FUNCTION_LIST /end FUNCTION_LIST /end MEASUREMENT
/begin MEASUREMENT tTTW1 "Coolant temperature sensor diagnosis NG delay timer" UBYTE COMP_0202_S 1 100 0 255 ECU_ADDRESS 0xFFFF455C /begin FUNCTION_LIST /end FUNCTION_LIST /end MEASUREMENT
/begin MEASUREMENT tTTW1O "Coolant temperature sensor Low Input diagnosis NG delay timer" UBYTE COMP_0202_S 1 100 0 255 ECU_ADDRESS 0xFFFF455D /begin FUNCTION_LIST /end FUNCTION_LIST /end MEASUREMENT
/begin MEASUREMENT tTTW1S "Coolant temperature sensor High Input diagnosis NG delay timer" UBYTE COMP_0202_S 1 100 0 255 ECU_ADDRESS 0xFFFF455E /begin FUNCTION_LIST /end FUNCTION_LIST /end MEASUREMENT
/begin MEASUREMENT tTVC1NG "VTC solenoid 1NG judgement timer" UBYTE COMP_0202_S 1 100 0 255 ECU_ADDRESS 0xFFFF455F /begin FUNCTION_LIST /end FUNCTION_LIST /end MEASUREMENT
/begin MEASUREMENT tTVC2NG "VTC solenoid 2NG judgement timer" UBYTE COMP_0202_S 1 100 0 255 ECU_ADDRESS 0xFFFF4560 /begin FUNCTION_LIST /end FUNCTION_LIST /end MEASUREMENT
/begin MEASUREMENT tTVSP5S "IGN After on, more than a condition 5-second continuation timer of VSP>= 4km /h" UBYTE COMP_0202_S 1 100 0 255 ECU_ADDRESS 0xFFFF4561 /begin FUNCTION_LIST /end FUNCTION_LIST /end MEASUREMENT
/begin MEASUREMENT tTVSPNG2 "PTD vehicle speed sensor NG judgement delay timer" UBYTE COMP_0202_S 1 100 0 255 ECU_ADDRESS 0xFFFF4562 /begin FUNCTION_LIST /end FUNCTION_LIST /end MEASUREMENT
/begin MEASUREMENT tTXACDY "TCS air-conditioning control delay timer" UBYTE COMP_0202_S 1 100 0 255 ECU_ADDRESS 0xFFFF4565 /begin FUNCTION_LIST /end FUNCTION_LIST /end MEASUREMENT
/begin MEASUREMENT tTZKFLTIM "NAVI- communication fail judgement time" UBYTE COMP_0202_S 1 100 0 255 ECU_ADDRESS 0xFFFF4566 /begin FUNCTION_LIST /end FUNCTION_LIST /end MEASUREMENT
/begin MEASUREMENT tVICSNG "VIAS solenoid NG judgement timer" UBYTE COMP_0202_S 1 100 0 255 ECU_ADDRESS 0xFFFF4568 /begin FUNCTION_LIST /end FUNCTION_LIST /end MEASUREMENT
/begin MEASUREMENT tVICSNG2 "VIAS solenoid NG judgement timer 2" UBYTE COMP_0202_S 1 100 0 255 ECU_ADDRESS 0xFFFF4569 /begin FUNCTION_LIST /end FUNCTION_LIST /end MEASUREMENT
/begin MEASUREMENT tVICSNG21 "VIAS solenoid NG judgement timer (ST micro-business)" UBYTE COMP_0202_S 1 100 0 255 ECU_ADDRESS 0xFFFF456A /begin FUNCTION_LIST /end FUNCTION_LIST /end MEASUREMENT
/begin MEASUREMENT tVICSNG22 "VIAS solenoid NG judgement timer (ST micro-business)" UBYTE COMP_0202_S 1 100 0 255 ECU_ADDRESS 0xFFFF456B /begin FUNCTION_LIST /end FUNCTION_LIST /end MEASUREMENT
/begin MEASUREMENT tVPNGTIM "Intake pressure sensor voltage NG judgement delay" UBYTE COMP_0202_S 1 100 0 255 ECU_ADDRESS 0xFFFF456C /begin FUNCTION_LIST /end FUNCTION_LIST /end MEASUREMENT
/begin MEASUREMENT tVPNGTM2 "Intake pressure sensor NG judgement delay (High)" UBYTE COMP_0202_S 1 100 0 255 ECU_ADDRESS 0xFFFF456D /begin FUNCTION_LIST /end FUNCTION_LIST /end MEASUREMENT
/begin MEASUREMENT tVTCDY1 "VTC At the time of on, monitor start delay timer" UBYTE COMP_0202_S 1 100 0 255 ECU_ADDRESS 0xFFFF4573 /begin FUNCTION_LIST /end FUNCTION_LIST /end MEASUREMENT
/begin MEASUREMENT tVTCDY2 "VTC At the time of off, monitor start delay timer" UBYTE COMP_0202_S 1 100 0 255 ECU_ADDRESS 0xFFFF4574 /begin FUNCTION_LIST /end FUNCTION_LIST /end MEASUREMENT
/begin MEASUREMENT tVTCMLDLGL "A NG judgement delay timer (PhaseLH) for rationalization crank angle sensor Phase offset diagnosis MIL lighting" UBYTE COMP_0202_S 1 100 0 255 ECU_ADDRESS 0xFFFF4575 /begin FUNCTION_LIST /end FUNCTION_LIST /end MEASUREMENT
/begin MEASUREMENT tVTCMLDLYG "A NG judgement delay timer for rationalization crank angle sensor alignment check diagnosis MIL lighting" UBYTE COMP_0202_S 1 100 0 255 ECU_ADDRESS 0xFFFF4578 /begin FUNCTION_LIST /end FUNCTION_LIST /end MEASUREMENT
/begin MEASUREMENT tVTCNGDL3 "NG judgement delay timer" UBYTE COMP_0202_S 1 100 0 255 ECU_ADDRESS 0xFFFF4579 /begin FUNCTION_LIST /end FUNCTION_LIST /end MEASUREMENT
/begin MEASUREMENT tVTCNGDL4 "NG judgement delay timer" UBYTE COMP_0202_S 1 100 0 255 ECU_ADDRESS 0xFFFF457B /begin FUNCTION_LIST /end FUNCTION_LIST /end MEASUREMENT
/begin MEASUREMENT tVTCNGDLGL "Rationalization crank angle sensor Phase offset diagnosis NG judgement delay (PhaseLH)" UBYTE COMP_0202_S 1 100 0 255 ECU_ADDRESS 0xFFFF457D /begin FUNCTION_LIST /end FUNCTION_LIST /end MEASUREMENT
/begin MEASUREMENT tVTCNGDLYG "Rationalization crank angle sensor alignment check diagnosis NG judgement delay" UBYTE COMP_0202_S 1 100 0 255 ECU_ADDRESS 0xFFFF4580 /begin FUNCTION_LIST /end FUNCTION_LIST /end MEASUREMENT
/begin MEASUREMENT tVTCODLY "After the start, diagnosis start delay timer (for the idle)" UBYTE COMP_0202_S 1 100 0 255 ECU_ADDRESS 0xFFFF4581 /begin FUNCTION_LIST /end FUNCTION_LIST /end MEASUREMENT
/begin MEASUREMENT tVTCOPT "Electromagnetism VTC breakage diagnosis judgement delay timer" UBYTE COMP_0202_S 1 100 0 255 ECU_ADDRESS 0xFFFF4582 /begin FUNCTION_LIST /end FUNCTION_LIST /end MEASUREMENT
/begin MEASUREMENT tVTCSDLYG "After a rationalization crank angle sensor alignment check diagnosis starts, diagnosis permission start delay" UBYTE COMP_0202_S 1 100 0 255 ECU_ADDRESS 0xFFFF4585 /begin FUNCTION_LIST /end FUNCTION_LIST /end MEASUREMENT
/begin MEASUREMENT tVTCSDLYIG "After a rationalization crank angle sensor alignment check diagnosis starts, diagnosis permission start delay (for idle éû)" UBYTE COMP_0202_S 1 100 0 255 ECU_ADDRESS 0xFFFF4586 /begin FUNCTION_LIST /end FUNCTION_LIST /end MEASUREMENT
/begin MEASUREMENT tVTIMLDLE "VTC NG judgement delay timer" UBYTE COMP_0202_S 1 100 0 255 ECU_ADDRESS 0xFFFF4588 /begin FUNCTION_LIST /end FUNCTION_LIST /end MEASUREMENT
/begin MEASUREMENT tVTIMLDLI "VTC NG judgement delay timer" UBYTE COMP_0202_S 1 100 0 255 ECU_ADDRESS 0xFFFF458A /begin FUNCTION_LIST /end FUNCTION_LIST /end MEASUREMENT
/begin MEASUREMENT tVTIMLDLY "A NG judgement delay timer (for the idle) for MIL lighting" UBYTE COMP_0202_S 1 100 0 255 ECU_ADDRESS 0xFFFF458C /begin FUNCTION_LIST /end FUNCTION_LIST /end MEASUREMENT
/begin MEASUREMENT tVTINGDL3 "NG judgement delay timer (for the idle)" UBYTE COMP_0202_S 1 100 0 255 ECU_ADDRESS 0xFFFF458E /begin FUNCTION_LIST /end FUNCTION_LIST /end MEASUREMENT
/begin MEASUREMENT tVTINGDLE "VTC trouble tense judgement delay timer" UBYTE COMP_0202_S 1 100 0 255 ECU_ADDRESS 0xFFFF4590 /begin FUNCTION_LIST /end FUNCTION_LIST /end MEASUREMENT
/begin MEASUREMENT tVTINGDLI "VTC trouble tense judgement delay timer" UBYTE COMP_0202_S 1 100 0 255 ECU_ADDRESS 0xFFFF4592 /begin FUNCTION_LIST /end FUNCTION_LIST /end MEASUREMENT
/begin MEASUREMENT tVTMLDLYE "VTC NG judgement delay timer" UBYTE COMP_0202_S 1 100 0 255 ECU_ADDRESS 0xFFFF4594 /begin FUNCTION_LIST /end FUNCTION_LIST /end MEASUREMENT
/begin MEASUREMENT tVTMLDLYI "VTC NG judgement delay timer" UBYTE COMP_0202_S 1 100 0 255 ECU_ADDRESS 0xFFFF4596 /begin FUNCTION_LIST /end FUNCTION_LIST /end MEASUREMENT
/begin MEASUREMENT tVTNEDME2 "A delay timer for the VTC momentary-disconnection, noise diagnosis NG judgement" UBYTE COMP_0202_S 1 100 0 255 ECU_ADDRESS 0xFFFF4598 /begin FUNCTION_LIST /end FUNCTION_LIST /end MEASUREMENT
/begin MEASUREMENT tVTNEDMI2 "A delay timer (intake side) for the VTC momentary-disconnection, noise diagnosis NG judgement" UBYTE COMP_0202_S 1 100 0 255 ECU_ADDRESS 0xFFFF459A /begin FUNCTION_LIST /end FUNCTION_LIST /end MEASUREMENT
/begin MEASUREMENT tVTNEDML2 "A delay timer for VTC momentary-disconnection, noise diagnosis MIL lighting" UBYTE COMP_0202_S 1 100 0 255 ECU_ADDRESS 0xFFFF459E /begin FUNCTION_LIST /end FUNCTION_LIST /end MEASUREMENT
/begin MEASUREMENT tVTNEDMLE "A delay timer (exhaust side) for the VTC breakage trouble diagnosis NG judgement" UBYTE COMP_0202_S 1 100 0 255 ECU_ADDRESS 0xFFFF45A0 /begin FUNCTION_LIST /end FUNCTION_LIST /end MEASUREMENT
/begin MEASUREMENT tVTNEDMLI "A delay timer (intake side) for the VTC breakage trouble diagnosis NG judgement" UBYTE COMP_0202_S 1 100 0 255 ECU_ADDRESS 0xFFFF45A2 /begin FUNCTION_LIST /end FUNCTION_LIST /end MEASUREMENT
/begin MEASUREMENT tVTNGDLYE "VTC trouble tense judgement delay timer" UBYTE COMP_0202_S 1 100 0 255 ECU_ADDRESS 0xFFFF45A4 /begin FUNCTION_LIST /end FUNCTION_LIST /end MEASUREMENT
/begin MEASUREMENT tVTNGDLYI "VTC trouble tense judgement delay timer" UBYTE COMP_0202_S 1 100 0 255 ECU_ADDRESS 0xFFFF45A6 /begin FUNCTION_LIST /end FUNCTION_LIST /end MEASUREMENT
/begin MEASUREMENT tVTODLYE "After the start, diagnosis start delay timer" UBYTE COMP_0202_S 1 100 0 255 ECU_ADDRESS 0xFFFF45A8 /begin FUNCTION_LIST /end FUNCTION_LIST /end MEASUREMENT
/begin MEASUREMENT tVTODLYI "After the start, diagnosis start delay timer" UBYTE COMP_0202_S 1 100 0 255 ECU_ADDRESS 0xFFFF45A9 /begin FUNCTION_LIST /end FUNCTION_LIST /end MEASUREMENT
/begin MEASUREMENT tVTSDLYE "After the start, diagnosis start delay timer" UBYTE COMP_0202_S 1 100 0 255 ECU_ADDRESS 0xFFFF45AA /begin FUNCTION_LIST /end FUNCTION_LIST /end MEASUREMENT
/begin MEASUREMENT tVTSDLYI "After the start, diagnosis start delay timer" UBYTE COMP_0202_S 1 100 0 255 ECU_ADDRESS 0xFFFF45AB /begin FUNCTION_LIST /end FUNCTION_LIST /end MEASUREMENT
/begin MEASUREMENT tVTTMEVC4 "Imaginary pull-down region condition judgement timer" UBYTE COMP_0202_S 1 100 0 255 ECU_ADDRESS 0xFFFF45AC /begin FUNCTION_LIST /end FUNCTION_LIST /end MEASUREMENT
/begin MEASUREMENT tVTTPDIVL "A timer for the TPULM decrement interval" UBYTE COMP_0202_S 1 100 0 255 ECU_ADDRESS 0xFFFF45AD /begin FUNCTION_LIST /end FUNCTION_LIST /end MEASUREMENT
/begin MEASUREMENT tEGRSNG2_S "EGR diagnosis delay timer 2" UBYTE COMP_0202_S 1 100 0 255 ECU_ADDRESS 0xFFFF45AE /begin FUNCTION_LIST /end FUNCTION_LIST /end MEASUREMENT
/begin MEASUREMENT tEGRTX_S "TEGR arrangement operation interval counter" UBYTE COMP_0202_S 1 100 0 255 ECU_ADDRESS 0xFFFF45AF /begin FUNCTION_LIST /end FUNCTION_LIST /end MEASUREMENT
/begin MEASUREMENT tSADT_S "FLASH seed requirement delay" UBYTE COMP_0202_S 1 100 0 255 ECU_ADDRESS 0xFFFF45B0 /begin FUNCTION_LIST /end FUNCTION_LIST /end MEASUREMENT
/begin MEASUREMENT tTEGRA_S "EGR diagnosis region formation time" UBYTE COMP_0202_S 1 100 0 255 ECU_ADDRESS 0xFFFF45B1 /begin FUNCTION_LIST /end FUNCTION_LIST /end MEASUREMENT
/begin MEASUREMENT tTVSP5S_S "IGN After on, more than a condition 5-second continuation timer of VSP>= 4km /h" UBYTE COMP_0202_S 1 100 0 255 ECU_ADDRESS 0xFFFF45B2 /begin FUNCTION_LIST /end FUNCTION_LIST /end MEASUREMENT
/begin MEASUREMENT tACMAINGT "ACC main thing SW diagnosis time" UBYTE COMP_0203_S 1 100 0 255 ECU_ADDRESS 0xFFFF45B3 /begin FUNCTION_LIST /end FUNCTION_LIST /end MEASUREMENT
/begin MEASUREMENT tADJTMR "EEPROM writing timer" UBYTE COMP_0203_S 1 100 0 255 ECU_ADDRESS 0xFFFF45B4 /begin FUNCTION_LIST /end FUNCTION_LIST /end MEASUREMENT
/begin MEASUREMENT tAFONOK "AFM breakage OK timer" UBYTE COMP_0203_S 1 100 0 255 ECU_ADDRESS 0xFFFF45B6 /begin FUNCTION_LIST /end FUNCTION_LIST /end MEASUREMENT
/begin MEASUREMENT tAFTHNG "Inhalation air quantity calculation condition delay" UBYTE COMP_0203_S 1 100 0 255 ECU_ADDRESS 0xFFFF45B7 /begin FUNCTION_LIST /end FUNCTION_LIST /end MEASUREMENT
/begin MEASUREMENT tAGBRTDNG "AGB requirement retard limit timer" UBYTE COMP_0203_S 1 100 0 255 ECU_ADDRESS 0xFFFF45B8 /begin FUNCTION_LIST /end FUNCTION_LIST /end MEASUREMENT
/begin MEASUREMENT tAPODDLY "The second-fold NG judgement time (APS)" UBYTE COMP_0203_S 1 100 0 255 ECU_ADDRESS 0xFFFF45B9 /begin FUNCTION_LIST /end FUNCTION_LIST /end MEASUREMENT
/begin MEASUREMENT tAPS1HI "Accelerator pedal 1 full-close position downward renewal delay timer" UBYTE COMP_0203_S 1 100 0 255 ECU_ADDRESS 0xFFFF45BA /begin FUNCTION_LIST /end FUNCTION_LIST /end MEASUREMENT
/begin MEASUREMENT tAPS1LOW "Accelerator pedal 1 full-close position upward renewal delay timer" UBYTE COMP_0203_S 1 100 0 255 ECU_ADDRESS 0xFFFF45BB /begin FUNCTION_LIST /end FUNCTION_LIST /end MEASUREMENT
/begin MEASUREMENT tAPS2HI "Accelerator pedal 2 full-close position downward renewal delay timer" UBYTE COMP_0203_S 1 100 0 255 ECU_ADDRESS 0xFFFF45BC /begin FUNCTION_LIST /end FUNCTION_LIST /end MEASUREMENT
/begin MEASUREMENT tAPS2LOW "Accelerator pedal 2 full-close position upward renewal delay timer" UBYTE COMP_0203_S 1 100 0 255 ECU_ADDRESS 0xFFFF45BD /begin FUNCTION_LIST /end FUNCTION_LIST /end MEASUREMENT
/begin MEASUREMENT tAPSDBLT2 "APS the second-fold CA release time" UBYTE COMP_0203_S 1 100 0 255 ECU_ADDRESS 0xFFFF45BE /begin FUNCTION_LIST /end FUNCTION_LIST /end MEASUREMENT
/begin MEASUREMENT tASCCLDG "fASCCLDG Measuring timer" UBYTE COMP_0203_S 1 100 0 255 ECU_ADDRESS 0xFFFF45BF /begin FUNCTION_LIST /end FUNCTION_LIST /end MEASUREMENT
/begin MEASUREMENT tASCDCTNG1 "ASCD order value abnormality diagnosis time" UBYTE COMP_0203_S 1 100 0 255 ECU_ADDRESS 0xFFFF45C0 /begin FUNCTION_LIST /end FUNCTION_LIST /end MEASUREMENT
/begin MEASUREMENT tASCDCTNG2 "ASCD order value abnormality diagnosis time" UBYTE COMP_0203_S 1 100 0 255 ECU_ADDRESS 0xFFFF45C1 /begin FUNCTION_LIST /end FUNCTION_LIST /end MEASUREMENT
/begin MEASUREMENT tASCDCTNG3 "ASCD order value abnormality diagnosis time" UBYTE COMP_0203_S 1 100 0 255 ECU_ADDRESS 0xFFFF45C2 /begin FUNCTION_LIST /end FUNCTION_LIST /end MEASUREMENT
/begin MEASUREMENT tASCDCTNG4 "ASCD order value abnormality diagnosis time" UBYTE COMP_0203_S 1 100 0 255 ECU_ADDRESS 0xFFFF45C3 /begin FUNCTION_LIST /end FUNCTION_LIST /end MEASUREMENT
/begin MEASUREMENT tASCDCTNG5 "ASCD order value abnormality diagnosis time" UBYTE COMP_0203_S 1 100 0 255 ECU_ADDRESS 0xFFFF45C4 /begin FUNCTION_LIST /end FUNCTION_LIST /end MEASUREMENT
/begin MEASUREMENT tASCDCTNG6 "ASCD order value abnormality diagnosis time" UBYTE COMP_0203_S 1 100 0 255 ECU_ADDRESS 0xFFFF45C5 /begin FUNCTION_LIST /end FUNCTION_LIST /end MEASUREMENT
/begin MEASUREMENT tASCDCTNG7 "ASCD order value abnormality diagnosis time" UBYTE COMP_0203_S 1 100 0 255 ECU_ADDRESS 0xFFFF45C6 /begin FUNCTION_LIST /end FUNCTION_LIST /end MEASUREMENT
/begin MEASUREMENT tASCDDTNG "The judgement timer which unusually continues an AT signal line" UBYTE COMP_0203_S 1 100 0 255 ECU_ADDRESS 0xFFFF45C7 /begin FUNCTION_LIST /end FUNCTION_LIST /end MEASUREMENT
/begin MEASUREMENT tASCDXNG1 "ASCD un-adjustment diagnosis time" UBYTE COMP_0203_S 1 100 0 255 ECU_ADDRESS 0xFFFF45C8 /begin FUNCTION_LIST /end FUNCTION_LIST /end MEASUREMENT
/begin MEASUREMENT tASCDXNG2 "ASCD un-adjustment diagnosis time" UBYTE COMP_0203_S 1 100 0 255 ECU_ADDRESS 0xFFFF45C9 /begin FUNCTION_LIST /end FUNCTION_LIST /end MEASUREMENT
/begin MEASUREMENT tBNCPOFF "BNC SW pulse stop timer" UBYTE COMP_0203_S 1 100 0 255 ECU_ADDRESS 0xFFFF45CA /begin FUNCTION_LIST /end FUNCTION_LIST /end MEASUREMENT
/begin MEASUREMENT tBRKCHKT1 "Brake SWON progress judgement time" UBYTE COMP_0203_S 1 100 0 255 ECU_ADDRESS 0xFFFF45CB /begin FUNCTION_LIST /end FUNCTION_LIST /end MEASUREMENT
/begin MEASUREMENT tCENST15 "REF15 signal delay timer" UBYTE COMP_0203_S 1 100 0 255 ECU_ADDRESS 0xFFFF45CC /begin FUNCTION_LIST /end FUNCTION_LIST /end MEASUREMENT
/begin MEASUREMENT tCHGRAPO "CHGRAPO timer" UBYTE COMP_0203_S 1 100 0 255 ECU_ADDRESS 0xFFFF45CD /begin FUNCTION_LIST /end FUNCTION_LIST /end MEASUREMENT
/begin MEASUREMENT tCLRDIAG "fCLRDIAG Measuring timer" UBYTE COMP_0203_S 1 100 0 255 ECU_ADDRESS 0xFFFF45CE /begin FUNCTION_LIST /end FUNCTION_LIST /end MEASUREMENT
/begin MEASUREMENT tCLROBDDI "fCLROBDDI Measuring timer" UBYTE COMP_0203_S 1 100 0 255 ECU_ADDRESS 0xFFFF45CF /begin FUNCTION_LIST /end FUNCTION_LIST /end MEASUREMENT
/begin MEASUREMENT tCRULMPTM "Cruise lamp operation delay time" UBYTE COMP_0203_S 1 100 0 255 ECU_ADDRESS 0xFFFF45D0 /begin FUNCTION_LIST /end FUNCTION_LIST /end MEASUREMENT
/begin MEASUREMENT tCSNGDCL "CAM breakage diagnosis NG judgement timer (PhaseLH)" UBYTE COMP_0203_S 1 100 0 255 ECU_ADDRESS 0xFFFF45D2 /begin FUNCTION_LIST /end FUNCTION_LIST /end MEASUREMENT
/begin MEASUREMENT tCSNGSTCL "At the time of the start, CAM breakage judgement timer (PhaseLH)" UBYTE COMP_0203_S 1 100 0 255 ECU_ADDRESS 0xFFFF45D5 /begin FUNCTION_LIST /end FUNCTION_LIST /end MEASUREMENT
/begin MEASUREMENT tCSPDLY "A POS10 signal momentary-disconnection noise tooth breaks off, judgement delay" UBYTE COMP_0203_S 1 100 0 255 ECU_ADDRESS 0xFFFF45D7 /begin FUNCTION_LIST /end FUNCTION_LIST /end MEASUREMENT
/begin MEASUREMENT tCSPOKD "A POS10 signal momentary-disconnection noise tooth breaks off, diagnosis OK judgement delay" UBYTE COMP_0203_S 1 100 0 255 ECU_ADDRESS 0xFFFF45D8 /begin FUNCTION_LIST /end FUNCTION_LIST /end MEASUREMENT
/begin MEASUREMENT tCTCNCT "SCI waiting time timer" UBYTE COMP_0203_S 1 100 0 255 ECU_ADDRESS 0xFFFF45D9 /begin FUNCTION_LIST /end FUNCTION_LIST /end MEASUREMENT
/begin MEASUREMENT tCVCFLS "A CVT diagnosis NG judgement timer for ASCD" UBYTE COMP_0203_S 1 100 0 255 ECU_ADDRESS 0xFFFF45DA /begin FUNCTION_LIST /end FUNCTION_LIST /end MEASUREMENT
/begin MEASUREMENT tCVCUOK "A CVT diagnosis OK judgement timer for ASCD" UBYTE COMP_0203_S 1 100 0 255 ECU_ADDRESS 0xFFFF45DB /begin FUNCTION_LIST /end FUNCTION_LIST /end MEASUREMENT
/begin MEASUREMENT tDBLDLY "The second-fold NG judgement time (TPS)" UBYTE COMP_0203_S 1 100 0 255 ECU_ADDRESS 0xFFFF45DC /begin FUNCTION_LIST /end FUNCTION_LIST /end MEASUREMENT
/begin MEASUREMENT tDINRLMDLY "Inertia compensation permission time (at the time of a change in gear ratio, limiter upper limit)" UBYTE COMP_0203_S 1 100 0 255 ECU_ADDRESS 0xFFFF45DE /begin FUNCTION_LIST /end FUNCTION_LIST /end MEASUREMENT
/begin MEASUREMENT tDLATGPNG "Gear position signal un-adjustment diagnosis timer" UBYTE COMP_0203_S 1 100 0 255 ECU_ADDRESS 0xFFFF45DF /begin FUNCTION_LIST /end FUNCTION_LIST /end MEASUREMENT
/begin MEASUREMENT tDLATSFNG "During gear shift, signal un-adjustment diagnosis time" UBYTE COMP_0203_S 1 100 0 255 ECU_ADDRESS 0xFFFF45E0 /begin FUNCTION_LIST /end FUNCTION_LIST /end MEASUREMENT
/begin MEASUREMENT tDLSRVONG "Servo diagnosis prohibition TGTVO change quantity time measuring timer" UBYTE COMP_0203_S 1 100 0 255 ECU_ADDRESS 0xFFFF45E1 /begin FUNCTION_LIST /end FUNCTION_LIST /end MEASUREMENT
/begin MEASUREMENT tDTEGR2S "DTEGR computed delay" UBYTE COMP_0203_S 1 100 0 255 ECU_ADDRESS 0xFFFF45E2 /begin FUNCTION_LIST /end FUNCTION_LIST /end MEASUREMENT
/begin MEASUREMENT tDTEPNG2 "TTEP un-adjustment diagnosis judgement timer 2" UBYTE COMP_0203_S 1 100 0 255 ECU_ADDRESS 0xFFFF45E4 /begin FUNCTION_LIST /end FUNCTION_LIST /end MEASUREMENT
/begin MEASUREMENT tEPWWAIT "Learning value EEPROM write delay timer" UBYTE COMP_0203_S 1 100 0 255 ECU_ADDRESS 0xFFFF45E6 /begin FUNCTION_LIST /end FUNCTION_LIST /end MEASUREMENT
/begin MEASUREMENT tESPCLKNG "ESP clock NG judgement timer" UBYTE COMP_0203_S 1 100 0 255 ECU_ADDRESS 0xFFFF45E7 /begin FUNCTION_LIST /end FUNCTION_LIST /end MEASUREMENT
/begin MEASUREMENT tETSCLKNG "ETS clock NG judgement timer" UBYTE COMP_0203_S 1 100 0 255 ECU_ADDRESS 0xFFFF45E9 /begin FUNCTION_LIST /end FUNCTION_LIST /end MEASUREMENT
/begin MEASUREMENT tETSF1 "A timer 1 for the fail treatment judgement" UBYTE COMP_0203_S 1 100 0 255 ECU_ADDRESS 0xFFFF45EA /begin FUNCTION_LIST /end FUNCTION_LIST /end MEASUREMENT
/begin MEASUREMENT tETSF2 "A timer 2 for the fail treatment judgement" UBYTE COMP_0203_S 1 100 0 255 ECU_ADDRESS 0xFFFF45EB /begin FUNCTION_LIST /end FUNCTION_LIST /end MEASUREMENT
/begin MEASUREMENT tETSIVDNG "ETSInvalid torque requirement NG judgement timer" UBYTE COMP_0203_S 1 100 0 255 ECU_ADDRESS 0xFFFF45EC /begin FUNCTION_LIST /end FUNCTION_LIST /end MEASUREMENT
/begin MEASUREMENT tETSLNKNG "ETS link check NG judgement timer" UBYTE COMP_0203_S 1 100 0 255 ECU_ADDRESS 0xFFFF45ED /begin FUNCTION_LIST /end FUNCTION_LIST /end MEASUREMENT
/begin MEASUREMENT tFPTMOFF "Fuel pump relay off delay timer" UBYTE COMP_0203_S 1 100 0 255 ECU_ADDRESS 0xFFFF45EE /begin FUNCTION_LIST /end FUNCTION_LIST /end MEASUREMENT
/begin MEASUREMENT tFPTMON "Fuel pump relay on delay timer" UBYTE COMP_0203_S 1 100 0 255 ECU_ADDRESS 0xFFFF45EF /begin FUNCTION_LIST /end FUNCTION_LIST /end MEASUREMENT
/begin MEASUREMENT tFSAFM "AF/M failsafe condition continuation timer" UBYTE COMP_0203_S 1 100 0 255 ECU_ADDRESS 0xFFFF45F0 /begin FUNCTION_LIST /end FUNCTION_LIST /end MEASUREMENT
/begin MEASUREMENT tFSCNT1 "Throttle SW on time" UBYTE COMP_0203_S 1 100 0 255 ECU_ADDRESS 0xFFFF45F1 /begin FUNCTION_LIST /end FUNCTION_LIST /end MEASUREMENT
/begin MEASUREMENT tIC3NGD "Diagnosis prohibition time" UBYTE COMP_0203_S 1 100 0 255 ECU_ADDRESS 0xFFFF45F2 /begin FUNCTION_LIST /end FUNCTION_LIST /end MEASUREMENT
/begin MEASUREMENT tIC3TIM "Time not to input an IC3 output clock" UBYTE COMP_0203_S 1 100 0 255 ECU_ADDRESS 0xFFFF45F3 /begin FUNCTION_LIST /end FUNCTION_LIST /end MEASUREMENT
/begin MEASUREMENT tIMMERDLY "At the time of the immobilizer irregular, communication mode transition executive timer" UBYTE COMP_0203_S 1 100 0 255 ECU_ADDRESS 0xFFFF45F4 /begin FUNCTION_LIST /end FUNCTION_LIST /end MEASUREMENT
/begin MEASUREMENT tIMMLODLY "A timer for the immobilizer breakage detection" UBYTE COMP_0203_S 1 100 0 255 ECU_ADDRESS 0xFFFF45F5 /begin FUNCTION_LIST /end FUNCTION_LIST /end MEASUREMENT
/begin MEASUREMENT tIMMMDDLY "Immobilizer communication mode transition executive timer" UBYTE COMP_0203_S 1 100 0 255 ECU_ADDRESS 0xFFFF45F6 /begin FUNCTION_LIST /end FUNCTION_LIST /end MEASUREMENT
/begin MEASUREMENT tIMMRXDLY "Immobilizer receiving data watch timer" UBYTE COMP_0203_S 1 100 0 255 ECU_ADDRESS 0xFFFF45F7 /begin FUNCTION_LIST /end FUNCTION_LIST /end MEASUREMENT
/begin MEASUREMENT tITSMDLY "Smoke countermeasure IT retard requirement delay time" UBYTE COMP_0203_S 1 100 0 255 ECU_ADDRESS 0xFFFF45F8 /begin FUNCTION_LIST /end FUNCTION_LIST /end MEASUREMENT
/begin MEASUREMENT tMSGCTACC "At the time of the ACC message counter un-renewal, timer" UBYTE COMP_0203_S 1 100 0 255 ECU_ADDRESS 0xFFFF45F9 /begin FUNCTION_LIST /end FUNCTION_LIST /end MEASUREMENT
/begin MEASUREMENT tMSRTCNT "MSRTCNT>=mMSRTNG" UBYTE COMP_0203_S 1 100 0 255 ECU_ADDRESS 0xFFFF45FA /begin FUNCTION_LIST /end FUNCTION_LIST /end MEASUREMENT
/begin MEASUREMENT tNSCVCG "Learning formation delay timer" UBYTE COMP_0203_S 1 100 0 255 ECU_ADDRESS 0xFFFF45FB /begin FUNCTION_LIST /end FUNCTION_LIST /end MEASUREMENT
/begin MEASUREMENT tOWCOFDL "#FOWOFDL clear delay" UBYTE COMP_0203_S 1 100 0 255 ECU_ADDRESS 0xFFFF45FC /begin FUNCTION_LIST /end FUNCTION_LIST /end MEASUREMENT
/begin MEASUREMENT tPBDLY "Throttle open-degree value judgement delay" UBYTE COMP_0203_S 1 100 0 255 ECU_ADDRESS 0xFFFF45FD /begin FUNCTION_LIST /end FUNCTION_LIST /end MEASUREMENT
/begin MEASUREMENT tPTIME "A timer for the DPAMB renewal" UBYTE COMP_0203_S 1 100 0 255 ECU_ADDRESS 0xFFFF45FE /begin FUNCTION_LIST /end FUNCTION_LIST /end MEASUREMENT
/begin MEASUREMENT tPWTDLY "At the time of the power transistor off, delay time" UBYTE COMP_0203_S 1 100 0 255 ECU_ADDRESS 0xFFFF45FF /begin FUNCTION_LIST /end FUNCTION_LIST /end MEASUREMENT
/begin MEASUREMENT tRSTEPRM "fCLRDIAG Measuring timer" UBYTE COMP_0203_S 1 100 0 255 ECU_ADDRESS 0xFFFF4601 /begin FUNCTION_LIST /end FUNCTION_LIST /end MEASUREMENT
/begin MEASUREMENT tSETLMPTM "Cruise, set lamp operation delay time" UBYTE COMP_0203_S 1 100 0 255 ECU_ADDRESS 0xFFFF4604 /begin FUNCTION_LIST /end FUNCTION_LIST /end MEASUREMENT
/begin MEASUREMENT tSTFPROF "Fuel pump relay off cycle time count to Active test" UBYTE COMP_0203_S 1 100 0 255 ECU_ADDRESS 0xFFFF4606 /begin FUNCTION_LIST /end FUNCTION_LIST /end MEASUREMENT
/begin MEASUREMENT tSTFPRON "Fuel pump relay on cycle time count to Active test" UBYTE COMP_0203_S 1 100 0 255 ECU_ADDRESS 0xFFFF4607 /begin FUNCTION_LIST /end FUNCTION_LIST /end MEASUREMENT
/begin MEASUREMENT tTABVSNG "ABV control solenoid diagnosis NG delay timer" UBYTE COMP_0203_S 1 100 0 255 ECU_ADDRESS 0xFFFF4608 /begin FUNCTION_LIST /end FUNCTION_LIST /end MEASUREMENT
/begin MEASUREMENT tTACCMAIN "ACC ECM The main thing SW un-adjustment judgement timer" UBYTE COMP_0203_S 1 100 0 255 ECU_ADDRESS 0xFFFF4609 /begin FUNCTION_LIST /end FUNCTION_LIST /end MEASUREMENT
/begin MEASUREMENT tTAF1FS "AFM breakage trouble diagnosis failsafe timer" UBYTE COMP_0203_S 1 100 0 255 ECU_ADDRESS 0xFFFF460A /begin FUNCTION_LIST /end FUNCTION_LIST /end MEASUREMENT
/begin MEASUREMENT tTAF3OK "AFM middle delay OK timer" UBYTE COMP_0203_S 1 100 0 255 ECU_ADDRESS 0xFFFF460C /begin FUNCTION_LIST /end FUNCTION_LIST /end MEASUREMENT
/begin MEASUREMENT tTAFSFS "AFM short trouble diagnosis failsafe timer" UBYTE COMP_0203_S 1 100 0 255 ECU_ADDRESS 0xFFFF460D /begin FUNCTION_LIST /end FUNCTION_LIST /end MEASUREMENT
/begin MEASUREMENT tTAFSOK1 "At the time of the AFM engine stop, OK timer" UBYTE COMP_0203_S 1 100 0 255 ECU_ADDRESS 0xFFFF460F /begin FUNCTION_LIST /end FUNCTION_LIST /end MEASUREMENT
/begin MEASUREMENT tTAOKTIM "Intake air temperature sensor voltage OK judgement delay" UBYTE COMP_0203_S 1 100 0 255 ECU_ADDRESS 0xFFFF4610 /begin FUNCTION_LIST /end FUNCTION_LIST /end MEASUREMENT
/begin MEASUREMENT tTAOKTM2 "Intake air temperature sensor OK judgement delay (High)" UBYTE COMP_0203_S 1 100 0 255 ECU_ADDRESS 0xFFFF4611 /begin FUNCTION_LIST /end FUNCTION_LIST /end MEASUREMENT
/begin MEASUREMENT tTAPOINCH "Inching permission timer" UBYTE COMP_0203_S 1 100 0 255 ECU_ADDRESS 0xFFFF4612 /begin FUNCTION_LIST /end FUNCTION_LIST /end MEASUREMENT
/begin MEASUREMENT tTAPSNG "APS open trouble diagnosis delay timer" UBYTE COMP_0203_S 1 100 0 255 ECU_ADDRESS 0xFFFF4613 /begin FUNCTION_LIST /end FUNCTION_LIST /end MEASUREMENT
/begin MEASUREMENT tTASTRNG "APOSTR un-adjustment judgement delay time" UBYTE COMP_0203_S 1 100 0 255 ECU_ADDRESS 0xFFFF4614 /begin FUNCTION_LIST /end FUNCTION_LIST /end MEASUREMENT
/begin MEASUREMENT tTCSDT "The delay which unusually judges ETC" UBYTE COMP_0203_S 1 100 0 255 ECU_ADDRESS 0xFFFF4616 /begin FUNCTION_LIST /end FUNCTION_LIST /end MEASUREMENT
/begin MEASUREMENT tTCSRCV "TCS recover" UBYTE COMP_0203_S 1 100 0 255 ECU_ADDRESS 0xFFFF4617 /begin FUNCTION_LIST /end FUNCTION_LIST /end MEASUREMENT
/begin MEASUREMENT tTDAFSES "An AFS condition delay for the A/F sensor activated judgement" UBYTE COMP_0203_S 1 100 0 255 ECU_ADDRESS 0xFFFF4618 /begin FUNCTION_LIST /end FUNCTION_LIST /end MEASUREMENT
/begin MEASUREMENT tTDAFST "A START SW ONOFF rest delay for the A/F sensor activated judgement" UBYTE COMP_0203_S 1 100 0 255 ECU_ADDRESS 0xFFFF461A /begin FUNCTION_LIST /end FUNCTION_LIST /end MEASUREMENT
/begin MEASUREMENT tTDEVPS "DEVPS is calculated in every 1 s." UBYTE COMP_0203_S 1 100 0 255 ECU_ADDRESS 0xFFFF461C /begin FUNCTION_LIST /end FUNCTION_LIST /end MEASUREMENT
/begin MEASUREMENT tTDRECS "1st torque going down control recover timer" UBYTE COMP_0203_S 1 100 0 255 ECU_ADDRESS 0xFFFF461E /begin FUNCTION_LIST /end FUNCTION_LIST /end MEASUREMENT
/begin MEASUREMENT tTDRECS2 "The whole area torque going down control recover timer" UBYTE COMP_0203_S 1 100 0 255 ECU_ADDRESS 0xFFFF461F /begin FUNCTION_LIST /end FUNCTION_LIST /end MEASUREMENT
/begin MEASUREMENT tTDRECS3 "1st stall torque going down control recover timer" UBYTE COMP_0203_S 1 100 0 255 ECU_ADDRESS 0xFFFF4620 /begin FUNCTION_LIST /end FUNCTION_LIST /end MEASUREMENT
/begin MEASUREMENT tTDRECS4 "Reverse stall torque going down control recover timer" UBYTE COMP_0203_S 1 100 0 255 ECU_ADDRESS 0xFFFF4621 /begin FUNCTION_LIST /end FUNCTION_LIST /end MEASUREMENT
/begin MEASUREMENT tTDTSPNG "DRTQSP un-adjustment judgement delay time" UBYTE COMP_0203_S 1 100 0 255 ECU_ADDRESS 0xFFFF4622 /begin FUNCTION_LIST /end FUNCTION_LIST /end MEASUREMENT
/begin MEASUREMENT tTETCNG "Time to judge ETC unusually" UBYTE COMP_0203_S 1 100 0 255 ECU_ADDRESS 0xFFFF4623 /begin FUNCTION_LIST /end FUNCTION_LIST /end MEASUREMENT
/begin MEASUREMENT tTFGN100 "FGN computed interval 100mS delay" UBYTE COMP_0203_S 1 100 0 255 ECU_ADDRESS 0xFFFF4625 /begin FUNCTION_LIST /end FUNCTION_LIST /end MEASUREMENT
/begin MEASUREMENT tTGKEND "GKTVO origin learning completion judgement delay timer" UBYTE COMP_0203_S 1 100 0 255 ECU_ADDRESS 0xFFFF4626 /begin FUNCTION_LIST /end FUNCTION_LIST /end MEASUREMENT
/begin MEASUREMENT tTGM8VB "After starter SW off, time" UBYTE COMP_0203_S 1 100 0 255 ECU_ADDRESS 0xFFFF4627 /begin FUNCTION_LIST /end FUNCTION_LIST /end MEASUREMENT
/begin MEASUREMENT tTIGNG2 "The ignition the first diagnosis NG mask judgement delay timer" UBYTE COMP_0203_S 1 100 0 255 ECU_ADDRESS 0xFFFF4628 /begin FUNCTION_LIST /end FUNCTION_LIST /end MEASUREMENT
/begin MEASUREMENT tTIGON1 "ISC IGN SW Off tense IGN ONOFF delay" UBYTE COMP_0203_S 1 100 0 255 ECU_ADDRESS 0xFFFF4629 /begin FUNCTION_LIST /end FUNCTION_LIST /end MEASUREMENT
/begin MEASUREMENT tTIGON2 "ISC IGN SW After off tense IGN off, engine stall judgement delay" UBYTE COMP_0203_S 1 100 0 255 ECU_ADDRESS 0xFFFF462A /begin FUNCTION_LIST /end FUNCTION_LIST /end MEASUREMENT
/begin MEASUREMENT tTM100MS "100mS measuring timer" UBYTE COMP_0203_S 1 100 0 255 ECU_ADDRESS 0xFFFF462B /begin FUNCTION_LIST /end FUNCTION_LIST /end MEASUREMENT
/begin MEASUREMENT tTM1100MS "1100mS measuring timer" UBYTE COMP_0203_S 1 100 0 255 ECU_ADDRESS 0xFFFF462C /begin FUNCTION_LIST /end FUNCTION_LIST /end MEASUREMENT
/begin MEASUREMENT tTM1200MS "1200mS measuring timer" UBYTE COMP_0203_S 1 100 0 255 ECU_ADDRESS 0xFFFF462D /begin FUNCTION_LIST /end FUNCTION_LIST /end MEASUREMENT
/begin MEASUREMENT tTM200MS "200mS measuring timer" UBYTE COMP_0203_S 1 100 0 255 ECU_ADDRESS 0xFFFF462E /begin FUNCTION_LIST /end FUNCTION_LIST /end MEASUREMENT
/begin MEASUREMENT tTM83CN "Single cylinder misfire judgement cancellation monitor delay" UBYTE COMP_0203_S 1 100 0 255 ECU_ADDRESS 0xFFFF462F /begin FUNCTION_LIST /end FUNCTION_LIST /end MEASUREMENT
/begin MEASUREMENT tTMADJ190 "VAFSTIK measuring delay" UBYTE COMP_0203_S 1 100 0 255 ECU_ADDRESS 0xFFFF4631 /begin FUNCTION_LIST /end FUNCTION_LIST /end MEASUREMENT
/begin MEASUREMENT tTMBRKER "timer for countdown" UBYTE COMP_0203_S 1 100 0 255 ECU_ADDRESS 0xFFFF4636 /begin FUNCTION_LIST /end FUNCTION_LIST /end MEASUREMENT
/begin MEASUREMENT tTMCHASCD "At the time of a change in a control mode, judgement time" UBYTE COMP_0203_S 1 100 0 255 ECU_ADDRESS 0xFFFF4637 /begin FUNCTION_LIST /end FUNCTION_LIST /end MEASUREMENT
/begin MEASUREMENT tTMCLNG "The judgement timer whose TCS communication is unusual" UBYTE COMP_0203_S 1 100 0 255 ECU_ADDRESS 0xFFFF4638 /begin FUNCTION_LIST /end FUNCTION_LIST /end MEASUREMENT
/begin MEASUREMENT tTMDTOK "At the time of the A/T signal line normality judgement, output switching" UBYTE COMP_0203_S 1 100 0 255 ECU_ADDRESS 0xFFFF463A /begin FUNCTION_LIST /end FUNCTION_LIST /end MEASUREMENT
/begin MEASUREMENT tTMEGR "Steady state judgement delay timer" UBYTE COMP_0203_S 1 100 0 255 ECU_ADDRESS 0xFFFF463B /begin FUNCTION_LIST /end FUNCTION_LIST /end MEASUREMENT
/begin MEASUREMENT tTMEGR2 "After the EGR cut, delay timer" UBYTE COMP_0203_S 1 100 0 255 ECU_ADDRESS 0xFFFF463C /begin FUNCTION_LIST /end FUNCTION_LIST /end MEASUREMENT
/begin MEASUREMENT tTMEGST "Stall detect timer" UBYTE COMP_0203_S 1 100 0 255 ECU_ADDRESS 0xFFFF463D /begin FUNCTION_LIST /end FUNCTION_LIST /end MEASUREMENT
/begin MEASUREMENT tTMGASCD "At the time of the acceleration watch, steady state judgement time" UBYTE COMP_0203_S 1 100 0 255 ECU_ADDRESS 0xFFFF463E /begin FUNCTION_LIST /end FUNCTION_LIST /end MEASUREMENT
/begin MEASUREMENT tTMLRFC "TCS F/C Bank switching timer" UBYTE COMP_0203_S 1 100 0 255 ECU_ADDRESS 0xFFFF4640 /begin FUNCTION_LIST /end FUNCTION_LIST /end MEASUREMENT
/begin MEASUREMENT tTMLRN "The continuation time of fTPSLRN==1" UBYTE COMP_0203_S 1 100 0 255 ECU_ADDRESS 0xFFFF4641 /begin FUNCTION_LIST /end FUNCTION_LIST /end MEASUREMENT
/begin MEASUREMENT tTMLRN1 "Full-close learning mask time" UBYTE COMP_0203_S 1 100 0 255 ECU_ADDRESS 0xFFFF4642 /begin FUNCTION_LIST /end FUNCTION_LIST /end MEASUREMENT
/begin MEASUREMENT tTMMFCN "All the region misfire judgement cancellation delays" UBYTE COMP_0203_S 1 100 0 255 ECU_ADDRESS 0xFFFF4643 /begin FUNCTION_LIST /end FUNCTION_LIST /end MEASUREMENT
/begin MEASUREMENT tTMMFE3 "Single cylinder misfire judgement cancellation delay (3/8)" UBYTE COMP_0203_S 1 100 0 255 ECU_ADDRESS 0xFFFF4644 /begin FUNCTION_LIST /end FUNCTION_LIST /end MEASUREMENT
/begin MEASUREMENT tTMMFEA "Multiple cylinder misfire judgement cancellation delay" UBYTE COMP_0203_S 1 100 0 255 ECU_ADDRESS 0xFFFF4645 /begin FUNCTION_LIST /end FUNCTION_LIST /end MEASUREMENT
/begin MEASUREMENT tTMMFEM "Single cylinder misfire judgement cancellation delay" UBYTE COMP_0203_S 1 100 0 255 ECU_ADDRESS 0xFFFF4646 /begin FUNCTION_LIST /end FUNCTION_LIST /end MEASUREMENT
/begin MEASUREMENT tTMMFENW "Misfire judgement cancellation delay (for the monitor)" UBYTE COMP_0203_S 1 100 0 255 ECU_ADDRESS 0xFFFF4647 /begin FUNCTION_LIST /end FUNCTION_LIST /end MEASUREMENT
/begin MEASUREMENT tTMPATUCH "response to the challeng" UBYTE COMP_0203_S 1 100 0 255 ECU_ADDRESS 0xFFFF464A /begin FUNCTION_LIST /end FUNCTION_LIST /end MEASUREMENT
/begin MEASUREMENT tTMPATVSC "Timer for VSC" UBYTE COMP_0203_S 1 100 0 255 ECU_ADDRESS 0xFFFF464B /begin FUNCTION_LIST /end FUNCTION_LIST /end MEASUREMENT
/begin MEASUREMENT tTMPMYVSC "Mean engine speed timer" UBYTE COMP_0203_S 1 100 0 255 ECU_ADDRESS 0xFFFF464C /begin FUNCTION_LIST /end FUNCTION_LIST /end MEASUREMENT
/begin MEASUREMENT tTMPOTPRO "timer for temporarily allowing the engine to run" UBYTE COMP_0203_S 1 100 0 255 ECU_ADDRESS 0xFFFF464D /begin FUNCTION_LIST /end FUNCTION_LIST /end MEASUREMENT
/begin MEASUREMENT tTMPROT "Immobilizer time-out time" UBYTE COMP_0203_S 1 100 0 255 ECU_ADDRESS 0xFFFF464E /begin FUNCTION_LIST /end FUNCTION_LIST /end MEASUREMENT
/begin MEASUREMENT tTMPSRABS "Freins Base Rapide input surveillance timer" UBYTE COMP_0203_S 1 100 0 255 ECU_ADDRESS 0xFFFF464F /begin FUNCTION_LIST /end FUNCTION_LIST /end MEASUREMENT
/begin MEASUREMENT tTMPSRACC "ACC Base input monitoring timer" UBYTE COMP_0203_S 1 100 0 255 ECU_ADDRESS 0xFFFF4650 /begin FUNCTION_LIST /end FUNCTION_LIST /end MEASUREMENT
/begin MEASUREMENT tTMPSRAT "AT control unit input surveillance timer" UBYTE COMP_0203_S 1 100 0 255 ECU_ADDRESS 0xFFFF4651 /begin FUNCTION_LIST /end FUNCTION_LIST /end MEASUREMENT
/begin MEASUREMENT tTMPSRBRA "Brake control unit input surveillance timer" UBYTE COMP_0203_S 1 100 0 255 ECU_ADDRESS 0xFFFF4652 /begin FUNCTION_LIST /end FUNCTION_LIST /end MEASUREMENT
/begin MEASUREMENT tTMPSRBV "BVA Base input surveillance timer" UBYTE COMP_0203_S 1 100 0 255 ECU_ADDRESS 0xFFFF4653 /begin FUNCTION_LIST /end FUNCTION_LIST /end MEASUREMENT
/begin MEASUREMENT tTMPSRBVA "-" UBYTE COMP_0203_S 1 100 0 255 ECU_ADDRESS 0xFFFF4654 /begin FUNCTION_LIST /end FUNCTION_LIST /end MEASUREMENT
/begin MEASUREMENT tTMPSRCLI "Clim Base input surveillance timer" UBYTE COMP_0203_S 1 100 0 255 ECU_ADDRESS 0xFFFF4655 /begin FUNCTION_LIST /end FUNCTION_LIST /end MEASUREMENT
/begin MEASUREMENT tTMPSRCLM "-" UBYTE COMP_0203_S 1 100 0 255 ECU_ADDRESS 0xFFFF4656 /begin FUNCTION_LIST /end FUNCTION_LIST /end MEASUREMENT
/begin MEASUREMENT tTMPSRCLU "Cluster input surveillance timer" UBYTE COMP_0203_S 1 100 0 255 ECU_ADDRESS 0xFFFF4657 /begin FUNCTION_LIST /end FUNCTION_LIST /end MEASUREMENT
/begin MEASUREMENT tTMPSRGCU "Gas control unit input surveillance timer" UBYTE COMP_0203_S 1 100 0 255 ECU_ADDRESS 0xFFFF4658 /begin FUNCTION_LIST /end FUNCTION_LIST /end MEASUREMENT
/begin MEASUREMENT tTMPSRSWA "-" UBYTE COMP_0203_S 1 100 0 255 ECU_ADDRESS 0xFFFF4659 /begin FUNCTION_LIST /end FUNCTION_LIST /end MEASUREMENT
/begin MEASUREMENT tTMPSRTDB "TDB Base input surveillance timer" UBYTE COMP_0203_S 1 100 0 255 ECU_ADDRESS 0xFFFF465A /begin FUNCTION_LIST /end FUNCTION_LIST /end MEASUREMENT
/begin MEASUREMENT tTMPSRUCH "UCH vers INJ input Monitoring timer" UBYTE COMP_0203_S 1 100 0 255 ECU_ADDRESS 0xFFFF465B /begin FUNCTION_LIST /end FUNCTION_LIST /end MEASUREMENT
/begin MEASUREMENT tTMPSRUPC "UPC control unit input surveillance timer" UBYTE COMP_0203_S 1 100 0 255 ECU_ADDRESS 0xFFFF465C /begin FUNCTION_LIST /end FUNCTION_LIST /end MEASUREMENT
/begin MEASUREMENT tTMRUCHK1 "Revolution-unit NG judgement time 1" UBYTE COMP_0203_S 1 100 0 255 ECU_ADDRESS 0xFFFF465E /begin FUNCTION_LIST /end FUNCTION_LIST /end MEASUREMENT
/begin MEASUREMENT tTMSRVACC "Automatic Cruise Control Unit absence detection time-out" UBYTE COMP_0203_S 1 100 0 255 ECU_ADDRESS 0xFFFF465F /begin FUNCTION_LIST /end FUNCTION_LIST /end MEASUREMENT
/begin MEASUREMENT tTMSRVBUS "BusOffTimer" UBYTE COMP_0203_S 1 100 0 255 ECU_ADDRESS 0xFFFF4660 /begin FUNCTION_LIST /end FUNCTION_LIST /end MEASUREMENT
/begin MEASUREMENT tTMSRVDDC "DDCM Control Unit absence detection time-out" UBYTE COMP_0203_S 1 100 0 255 ECU_ADDRESS 0xFFFF4661 /begin FUNCTION_LIST /end FUNCTION_LIST /end MEASUREMENT
/begin MEASUREMENT tTMSRVGCU "Gaz Control Unit absence detection time-out" UBYTE COMP_0203_S 1 100 0 255 ECU_ADDRESS 0xFFFF4662 /begin FUNCTION_LIST /end FUNCTION_LIST /end MEASUREMENT
/begin MEASUREMENT tTMSRVINJ "Mute (transmission failure) detection time-out" UBYTE COMP_0203_S 1 100 0 255 ECU_ADDRESS 0xFFFF4663 /begin FUNCTION_LIST /end FUNCTION_LIST /end MEASUREMENT
/begin MEASUREMENT tTMSTVSC "Timer for starter switch" UBYTE COMP_0203_S 1 100 0 255 ECU_ADDRESS 0xFFFF4664 /begin FUNCTION_LIST /end FUNCTION_LIST /end MEASUREMENT
/begin MEASUREMENT tTMTEGR "IGN SW On delay" UBYTE COMP_0203_S 1 100 0 255 ECU_ADDRESS 0xFFFF4666 /begin FUNCTION_LIST /end FUNCTION_LIST /end MEASUREMENT
/begin MEASUREMENT tTMTLG "Condition stable waiting time timer" UBYTE COMP_0203_S 1 100 0 255 ECU_ADDRESS 0xFFFF4669 /begin FUNCTION_LIST /end FUNCTION_LIST /end MEASUREMENT
/begin MEASUREMENT tTMVPBNG "Supercharge pressure sensor diagnosis NG judgement timer" UBYTE COMP_0203_S 1 100 0 255 ECU_ADDRESS 0xFFFF466A /begin FUNCTION_LIST /end FUNCTION_LIST /end MEASUREMENT
/begin MEASUREMENT tTMVPBOK "Supercharge pressure sensor diagnosis OK judgement timer" UBYTE COMP_0203_S 1 100 0 255 ECU_ADDRESS 0xFFFF466B /begin FUNCTION_LIST /end FUNCTION_LIST /end MEASUREMENT
/begin MEASUREMENT tTNZERO2 "To become KNRPMQ=0 under the condition of #STSW=1 progress time" UBYTE COMP_0203_S 1 100 0 255 ECU_ADDRESS 0xFFFF466D /begin FUNCTION_LIST /end FUNCTION_LIST /end MEASUREMENT
/begin MEASUREMENT tTO2HNG "O2HNG judgement delay time" UBYTE COMP_0203_S 1 100 0 255 ECU_ADDRESS 0xFFFF466F /begin FUNCTION_LIST /end FUNCTION_LIST /end MEASUREMENT
/begin MEASUREMENT tTOCNT "Time overcoat timer" UBYTE COMP_0203_S 1 100 0 255 ECU_ADDRESS 0xFFFF4671 /begin FUNCTION_LIST /end FUNCTION_LIST /end MEASUREMENT
/begin MEASUREMENT tTP2_10MS "Stage 5 30mS timer" UBYTE COMP_0203_S 1 100 0 255 ECU_ADDRESS 0xFFFF4672 /begin FUNCTION_LIST /end FUNCTION_LIST /end MEASUREMENT
/begin MEASUREMENT tTPRCVT "TCS recover timer" UBYTE COMP_0203_S 1 100 0 255 ECU_ADDRESS 0xFFFF4673 /begin FUNCTION_LIST /end FUNCTION_LIST /end MEASUREMENT
/begin MEASUREMENT tTPTDCNG "PTDCAN fail timer" UBYTE COMP_0203_S 1 100 0 255 ECU_ADDRESS 0xFFFF4674 /begin FUNCTION_LIST /end FUNCTION_LIST /end MEASUREMENT
/begin MEASUREMENT tTQDYNHTM "T/M excessive torque going down timer" UBYTE COMP_0203_S 1 100 0 255 ECU_ADDRESS 0xFFFF4676 /begin FUNCTION_LIST /end FUNCTION_LIST /end MEASUREMENT
/begin MEASUREMENT tTST200 "START SW After on, progress timer" UBYTE COMP_0203_S 1 100 0 255 ECU_ADDRESS 0xFFFF4678 /begin FUNCTION_LIST /end FUNCTION_LIST /end MEASUREMENT
/begin MEASUREMENT tTTCLNG1 "The judgement time 1 whose TCS communication is unusual" UBYTE COMP_0203_S 1 100 0 255 ECU_ADDRESS 0xFFFF467A /begin FUNCTION_LIST /end FUNCTION_LIST /end MEASUREMENT
/begin MEASUREMENT tTTOILST "TOILST fixed delay timer" UBYTE COMP_0203_S 1 100 0 255 ECU_ADDRESS 0xFFFF467B /begin FUNCTION_LIST /end FUNCTION_LIST /end MEASUREMENT
/begin MEASUREMENT tTTXLNG "The delay which unusually judges TCS-C/U communication" UBYTE COMP_0203_S 1 100 0 255 ECU_ADDRESS 0xFFFF467D /begin FUNCTION_LIST /end FUNCTION_LIST /end MEASUREMENT
/begin MEASUREMENT tTVANG2 "VAPO un-adjustment judgement delay time 2" UBYTE COMP_0203_S 1 100 0 255 ECU_ADDRESS 0xFFFF467E /begin FUNCTION_LIST /end FUNCTION_LIST /end MEASUREMENT
/begin MEASUREMENT tTVFNG1 "Fuel pressure sensor diagnosis trouble tense judgement timer 1" UBYTE COMP_0203_S 1 100 0 255 ECU_ADDRESS 0xFFFF4680 /begin FUNCTION_LIST /end FUNCTION_LIST /end MEASUREMENT
/begin MEASUREMENT tTVFNG2 "Fuel pressure sensor diagnosis trouble tense judgement timer 2" UBYTE COMP_0203_S 1 100 0 255 ECU_ADDRESS 0xFFFF4681 /begin FUNCTION_LIST /end FUNCTION_LIST /end MEASUREMENT
/begin MEASUREMENT tTVSPPLS "Vehicle speed pulse non-input time measuring timer" UBYTE COMP_0203_S 1 100 0 255 ECU_ADDRESS 0xFFFF4682 /begin FUNCTION_LIST /end FUNCTION_LIST /end MEASUREMENT
/begin MEASUREMENT tTXFS1NG "TXFS1 NG judgement flag" UBYTE COMP_0203_S 1 100 0 255 ECU_ADDRESS 0xFFFF4683 /begin FUNCTION_LIST /end FUNCTION_LIST /end MEASUREMENT
/begin MEASUREMENT tTXFS2NG "TXFS2 NG judgement flag" UBYTE COMP_0203_S 1 100 0 255 ECU_ADDRESS 0xFFFF4684 /begin FUNCTION_LIST /end FUNCTION_LIST /end MEASUREMENT
/begin MEASUREMENT tUINRLMDLY "Inertia compensation permission time (at the time of a change in gear ratio, limiter upper limit)" UBYTE COMP_0203_S 1 100 0 255 ECU_ADDRESS 0xFFFF4685 /begin FUNCTION_LIST /end FUNCTION_LIST /end MEASUREMENT
/begin MEASUREMENT tVBJGDLY "Starter SWOFF rest 1 s delay time for the VB condition" UBYTE COMP_0203_S 1 100 0 255 ECU_ADDRESS 0xFFFF4686 /begin FUNCTION_LIST /end FUNCTION_LIST /end MEASUREMENT
/begin MEASUREMENT tVITESTM "Timer for vehicle speed invalid detection" UBYTE COMP_0203_S 1 100 0 255 ECU_ADDRESS 0xFFFF4687 /begin FUNCTION_LIST /end FUNCTION_LIST /end MEASUREMENT
/begin MEASUREMENT tVPFSTIM "Intake pressure sensor voltage failsafe judgement delay" UBYTE COMP_0203_S 1 100 0 255 ECU_ADDRESS 0xFFFF4688 /begin FUNCTION_LIST /end FUNCTION_LIST /end MEASUREMENT
/begin MEASUREMENT tVPFSTM2 "Intake pressure sensor failsafe judgement delay (High)" UBYTE COMP_0203_S 1 100 0 255 ECU_ADDRESS 0xFFFF4689 /begin FUNCTION_LIST /end FUNCTION_LIST /end MEASUREMENT
/begin MEASUREMENT tVPOKTIM "Intake pressure sensor voltage OK judgement delay" UBYTE COMP_0203_S 1 100 0 255 ECU_ADDRESS 0xFFFF468A /begin FUNCTION_LIST /end FUNCTION_LIST /end MEASUREMENT
/begin MEASUREMENT tVPOKTM2 "Intake pressure sensor OK judgement delay (High)" UBYTE COMP_0203_S 1 100 0 255 ECU_ADDRESS 0xFFFF468B /begin FUNCTION_LIST /end FUNCTION_LIST /end MEASUREMENT
/begin MEASUREMENT tVTCTM "Control TVO, TP condition delay" UBYTE COMP_0203_S 1 100 0 255 ECU_ADDRESS 0xFFFF468C /begin FUNCTION_LIST /end FUNCTION_LIST /end MEASUREMENT
/begin MEASUREMENT tWDTDLY "WDT diagnosis delay" UBYTE COMP_0203_S 1 100 0 255 ECU_ADDRESS 0xFFFF468D /begin FUNCTION_LIST /end FUNCTION_LIST /end MEASUREMENT
/begin MEASUREMENT tAPS1CA_S "-" UBYTE COMP_0203_S 1 100 0 255 ECU_ADDRESS 0xFFFF468E /begin FUNCTION_LIST /end FUNCTION_LIST /end MEASUREMENT
/begin MEASUREMENT tAPS2CA_S "-" UBYTE COMP_0203_S 1 100 0 255 ECU_ADDRESS 0xFFFF468F /begin FUNCTION_LIST /end FUNCTION_LIST /end MEASUREMENT
/begin MEASUREMENT tAPSXCA_S "-" UBYTE COMP_0203_S 1 100 0 255 ECU_ADDRESS 0xFFFF4690 /begin FUNCTION_LIST /end FUNCTION_LIST /end MEASUREMENT
/begin MEASUREMENT tDELIN_S "Negative pressure deficiency time" UBYTE COMP_0203_S 1 100 0 255 ECU_ADDRESS 0xFFFF4691 /begin FUNCTION_LIST /end FUNCTION_LIST /end MEASUREMENT
/begin MEASUREMENT tTMTEGR_S "IGN SW On delay" UBYTE COMP_0203_S 1 100 0 255 ECU_ADDRESS 0xFFFF4692 /begin FUNCTION_LIST /end FUNCTION_LIST /end MEASUREMENT
/begin MEASUREMENT tTPS1CA_S "-" UBYTE COMP_0203_S 1 100 0 255 ECU_ADDRESS 0xFFFF4693 /begin FUNCTION_LIST /end FUNCTION_LIST /end MEASUREMENT
/begin MEASUREMENT tTPS2CA_S "-" UBYTE COMP_0203_S 1 100 0 255 ECU_ADDRESS 0xFFFF4694 /begin FUNCTION_LIST /end FUNCTION_LIST /end MEASUREMENT
/begin MEASUREMENT tTPSXCA_S "-" UBYTE COMP_0203_S 1 100 0 255 ECU_ADDRESS 0xFFFF4695 /begin FUNCTION_LIST /end FUNCTION_LIST /end MEASUREMENT
/begin MEASUREMENT tTVANG2_S "Un-adjustment judgement delay time 2" UBYTE COMP_0203_S 1 100 0 255 ECU_ADDRESS 0xFFFF4696 /begin FUNCTION_LIST /end FUNCTION_LIST /end MEASUREMENT
/begin MEASUREMENT tTVAPNG_S "Un-adjustment judgement delay time" UBYTE COMP_0203_S 1 100 0 255 ECU_ADDRESS 0xFFFF4697 /begin FUNCTION_LIST /end FUNCTION_LIST /end MEASUREMENT
/begin MEASUREMENT tBNCADOFF "Wire connection : opened brake switch input OFF-Timer" UBYTE COMP_0204_S 1 100 0 255 ECU_ADDRESS 0xFFFF4698 /begin FUNCTION_LIST /end FUNCTION_LIST /end MEASUREMENT
/begin MEASUREMENT tBNCADON "Wire connection : opened brake switch input ON-Timer" UBYTE COMP_0204_S 1 100 0 255 ECU_ADDRESS 0xFFFF4699 /begin FUNCTION_LIST /end FUNCTION_LIST /end MEASUREMENT
/begin MEASUREMENT tP2TIME "Reception-transmitting interval timer" UBYTE COMP_0204_S 1 100 0 255 ECU_ADDRESS 0xFFFF469A /begin FUNCTION_LIST /end FUNCTION_LIST /end MEASUREMENT
/begin MEASUREMENT tP4TIME "Receiving byte interval timer" UBYTE COMP_0204_S 1 100 0 255 ECU_ADDRESS 0xFFFF469B /begin FUNCTION_LIST /end FUNCTION_LIST /end MEASUREMENT
/begin MEASUREMENT tTP1 "Between the stage 3 requirement datas, timer (22mS)" UBYTE COMP_0204_S 1 100 0 255 ECU_ADDRESS 0xFFFF469C /begin FUNCTION_LIST /end FUNCTION_LIST /end MEASUREMENT
/begin MEASUREMENT tTP2 "Stage 5 30mS timer" UBYTE COMP_0204_S 1 100 0 255 ECU_ADDRESS 0xFFFF469D /begin FUNCTION_LIST /end FUNCTION_LIST /end MEASUREMENT
/begin MEASUREMENT tTP3S "Stage 3 52mS timer" UBYTE COMP_0204_S 1 100 0 255 ECU_ADDRESS 0xFFFF469E /begin FUNCTION_LIST /end FUNCTION_LIST /end MEASUREMENT
/begin MEASUREMENT tTWupCON1 "From under LowB óß, to the first command transmission, for the CONSULT 1" UBYTE COMP_0204_S 1 100 0 255 ECU_ADDRESS 0xFFFF469F /begin FUNCTION_LIST /end FUNCTION_LIST /end MEASUREMENT
/begin MEASUREMENT tTWupCON2 "From under LowB óß, to the first command transmission, for the CONSULT 2" UBYTE COMP_0204_S 1 100 0 255 ECU_ADDRESS 0xFFFF46A0 /begin FUNCTION_LIST /end FUNCTION_LIST /end MEASUREMENT
/begin MEASUREMENT tTWupDBM "From under LowB óß, to the first command transmission, for the new monitor" UBYTE COMP_0204_S 1 100 0 255 ECU_ADDRESS 0xFFFF46A1 /begin FUNCTION_LIST /end FUNCTION_LIST /end MEASUREMENT
/begin MEASUREMENT tTWW2 "W2 waiting time" UBYTE COMP_0204_S 1 100 0 255 ECU_ADDRESS 0xFFFF46A2 /begin FUNCTION_LIST /end FUNCTION_LIST /end MEASUREMENT
/begin MEASUREMENT tTWW3 "W3 waiting time" UBYTE COMP_0204_S 1 100 0 255 ECU_ADDRESS 0xFFFF46A3 /begin FUNCTION_LIST /end FUNCTION_LIST /end MEASUREMENT
/begin MEASUREMENT tTWW4 "W4 waiting time" UBYTE COMP_0204_S 1 100 0 255 ECU_ADDRESS 0xFFFF46A4 /begin FUNCTION_LIST /end FUNCTION_LIST /end MEASUREMENT
/begin MEASUREMENT cCRGNG "R/G After the breakage, speed" UBYTE COMP_0191 1 100 0 255 ECU_ADDRESS 0xFFFF46A5 /begin FUNCTION_LIST /end FUNCTION_LIST /end MEASUREMENT
/begin MEASUREMENT cELNALP "A rotation counter for the ALP computation" UBYTE COMP_0191 1 100 0 255 ECU_ADDRESS 0xFFFF46A6 /begin FUNCTION_LIST /end FUNCTION_LIST /end MEASUREMENT
/begin MEASUREMENT cKBLBLN "A rotation counter for the whole area learning" UBYTE COMP_0191 1 100 0 255 ECU_ADDRESS 0xFFFF46A8 /begin FUNCTION_LIST /end FUNCTION_LIST /end MEASUREMENT
/begin MEASUREMENT tCLONDLY "After the relay compulsory off start, delay timer" UWORD COMP_0201_S 1 100 0 65535 ECU_ADDRESS 0xFFFF46AA /begin FUNCTION_LIST /end FUNCTION_LIST /end MEASUREMENT
/begin MEASUREMENT tHCSNGTM "A high oil temperature failsafe NG delay timer" UWORD COMP_0201_S 1 100 0 65535 ECU_ADDRESS 0xFFFF46AC /begin FUNCTION_LIST /end FUNCTION_LIST /end MEASUREMENT
/begin MEASUREMENT tHCSOKTM "A high oil temperature failsafe re-entrance delay timer" UWORD COMP_0201_S 1 100 0 65535 ECU_ADDRESS 0xFFFF46AE /begin FUNCTION_LIST /end FUNCTION_LIST /end MEASUREMENT
/begin MEASUREMENT tLENDLY2 "Lean operation permission delay timer" UWORD COMP_0201_S 1 100 0 65535 ECU_ADDRESS 0xFFFF46B0 /begin FUNCTION_LIST /end FUNCTION_LIST /end MEASUREMENT
/begin MEASUREMENT tTBATSCC "At the time of the clamp voltage, battery electric current sensor middle trouble diagnosis judgement time timer" UWORD COMP_0201_S 1 100 0 65535 ECU_ADDRESS 0xFFFF46B2 /begin FUNCTION_LIST /end FUNCTION_LIST /end MEASUREMENT
/begin MEASUREMENT tTDIRE17 "Pull-down switchover cancellation time" UWORD COMP_0201_S 1 100 0 65535 ECU_ADDRESS 0xFFFF46B4 /begin FUNCTION_LIST /end FUNCTION_LIST /end MEASUREMENT
/begin MEASUREMENT tTMIDCP "Idle clamp continuation time timer" UWORD COMP_0201_S 1 100 0 65535 ECU_ADDRESS 0xFFFF46B6 /begin FUNCTION_LIST /end FUNCTION_LIST /end MEASUREMENT
/begin MEASUREMENT tTMPCRASH "Timeout after crash to avoid engine running" UWORD COMP_0201_S 1 100 0 65535 ECU_ADDRESS 0xFFFF46B8 /begin FUNCTION_LIST /end FUNCTION_LIST /end MEASUREMENT
/begin MEASUREMENT tTUSAD "CAT diagnosis routine executive time" UWORD COMP_0201_S 1 100 0 65535 ECU_ADDRESS 0xFFFF46BE /begin FUNCTION_LIST /end FUNCTION_LIST /end MEASUREMENT
/begin MEASUREMENT tASCSWNGT "ASCD SW signal diagnosis (ASSWNG) NG judgement timer" UWORD COMP_0202_S 1 100 0 65535 ECU_ADDRESS 0xFFFF46C0 /begin FUNCTION_LIST /end FUNCTION_LIST /end MEASUREMENT
/begin MEASUREMENT tDLTWCVT "CVT oil temperature rise delay time" UWORD COMP_0202_S 1 100 0 65535 ECU_ADDRESS 0xFFFF46C2 /begin FUNCTION_LIST /end FUNCTION_LIST /end MEASUREMENT
/begin MEASUREMENT tFCSTART "Fuel cut inhibition delay after start timer" UWORD COMP_0202_S 1 100 0 65535 ECU_ADDRESS 0xFFFF46C4 /begin FUNCTION_LIST /end FUNCTION_LIST /end MEASUREMENT
/begin MEASUREMENT tMCLMOIM2 "MIL lights-out (b) condition formation continuation time (for LEAN)" UWORD COMP_0202_S 1 100 0 65535 ECU_ADDRESS 0xFFFF46C6 /begin FUNCTION_LIST /end FUNCTION_LIST /end MEASUREMENT
/begin MEASUREMENT tMCLMOIM3 "MIL lights-out (b) condition formation continuation time (for RICH)" UWORD COMP_0202_S 1 100 0 65535 ECU_ADDRESS 0xFFFF46C8 /begin FUNCTION_LIST /end FUNCTION_LIST /end MEASUREMENT
/begin MEASUREMENT tTDIRE12 "BSVP12 measuring delay" UWORD COMP_0202_S 1 100 0 65535 ECU_ADDRESS 0xFFFF46CA /begin FUNCTION_LIST /end FUNCTION_LIST /end MEASUREMENT
/begin MEASUREMENT tTDIRE13 "DVP8 measuring delay" UWORD COMP_0202_S 1 100 0 65535 ECU_ADDRESS 0xFFFF46CC /begin FUNCTION_LIST /end FUNCTION_LIST /end MEASUREMENT
/begin MEASUREMENT tTDIRE19H "DVP4 re-calculation delay timer (a high vehicle speed region)" UWORD COMP_0202_S 1 100 0 65535 ECU_ADDRESS 0xFFFF46CE /begin FUNCTION_LIST /end FUNCTION_LIST /end MEASUREMENT
/begin MEASUREMENT tTDIRE19K "DVP4 re-calculation delay timer (at the time of the leak-down)" UWORD COMP_0202_S 1 100 0 65535 ECU_ADDRESS 0xFFFF46D0 /begin FUNCTION_LIST /end FUNCTION_LIST /end MEASUREMENT
/begin MEASUREMENT tTDIRE19L "DVP4 re-calculation delay timer (a low vehicle speed region)" UWORD COMP_0202_S 1 100 0 65535 ECU_ADDRESS 0xFFFF46D2 /begin FUNCTION_LIST /end FUNCTION_LIST /end MEASUREMENT
/begin MEASUREMENT tTDIREI9 "BSVP12 measuring delay" UWORD COMP_0202_S 1 100 0 65535 ECU_ADDRESS 0xFFFF46D4 /begin FUNCTION_LIST /end FUNCTION_LIST /end MEASUREMENT
/begin MEASUREMENT tTFGTP2 "Slosh judgement release delay" UWORD COMP_0202_S 1 100 0 65535 ECU_ADDRESS 0xFFFF46D6 /begin FUNCTION_LIST /end FUNCTION_LIST /end MEASUREMENT
/begin MEASUREMENT tTMACIS "Timer for AC idle up request" UWORD COMP_0202_S 1 100 0 65535 ECU_ADDRESS 0xFFFF46D8 /begin FUNCTION_LIST /end FUNCTION_LIST /end MEASUREMENT
/begin MEASUREMENT tDAPXLH "At the time of the APS un-adjustment, limphome start delay" UWORD COMP_0203_S 1 100 0 65535 ECU_ADDRESS 0xFFFF46DA /begin FUNCTION_LIST /end FUNCTION_LIST /end MEASUREMENT
/begin MEASUREMENT tDFKPASKP "-" UWORD COMP_0203_S 1 100 0 65535 ECU_ADDRESS 0xFFFF46DC /begin FUNCTION_LIST /end FUNCTION_LIST /end MEASUREMENT
/begin MEASUREMENT tDFKPBSKP "-" UWORD COMP_0203_S 1 100 0 65535 ECU_ADDRESS 0xFFFF46DE /begin FUNCTION_LIST /end FUNCTION_LIST /end MEASUREMENT
/begin MEASUREMENT tDLMPCH5 "Map switching judgement delay 5" UWORD COMP_0203_S 1 100 0 65535 ECU_ADDRESS 0xFFFF46E2 /begin FUNCTION_LIST /end FUNCTION_LIST /end MEASUREMENT
/begin MEASUREMENT tDTPXLH "At the time of the TPS un-adjustment, limphome start delay" UWORD COMP_0203_S 1 100 0 65535 ECU_ADDRESS 0xFFFF46E6 /begin FUNCTION_LIST /end FUNCTION_LIST /end MEASUREMENT
/begin MEASUREMENT tFDTRGPB_M "EEPROM trigger prohibition timer" UWORD COMP_0203_S 1 100 0 65535 ECU_ADDRESS 0xFFFF46E8 /begin FUNCTION_LIST /end FUNCTION_LIST /end MEASUREMENT
/begin MEASUREMENT tISWONNG1 "Accelerator SWON trouble diagnosis judgement time" UWORD COMP_0203_S 1 100 0 65535 ECU_ADDRESS 0xFFFF46EA /begin FUNCTION_LIST /end FUNCTION_LIST /end MEASUREMENT
/begin MEASUREMENT tPRTIME "Public relations subtraction delay timer" UWORD COMP_0203_S 1 100 0 65535 ECU_ADDRESS 0xFFFF46EC /begin FUNCTION_LIST /end FUNCTION_LIST /end MEASUREMENT
/begin MEASUREMENT tRCRRPIV "Response The response interval timer which Pending is negative toward" UWORD COMP_0203_S 1 100 0 65535 ECU_ADDRESS 0xFFFF46F0 /begin FUNCTION_LIST /end FUNCTION_LIST /end MEASUREMENT
/begin MEASUREMENT tROTTWNG "Radiator exit coolant temperature sensor breakage/short diagnosis NG delay timer" UWORD COMP_0203_S 1 100 0 65535 ECU_ADDRESS 0xFFFF46F2 /begin FUNCTION_LIST /end FUNCTION_LIST /end MEASUREMENT
/begin MEASUREMENT tROTTWOK "Radiator exit coolant temperature sensor breakage/short diagnosis OK delay timer" UWORD COMP_0203_S 1 100 0 65535 ECU_ADDRESS 0xFFFF46F4 /begin FUNCTION_LIST /end FUNCTION_LIST /end MEASUREMENT
/begin MEASUREMENT tSTEGWND1 "EGR#1 window timer (for the ST, driver)" UWORD COMP_0203_S 1 100 0 65535 ECU_ADDRESS 0xFFFF46F6 /begin FUNCTION_LIST /end FUNCTION_LIST /end MEASUREMENT
/begin MEASUREMENT tSTEGWND2 "EGR#2 window timer (for the ST, driver)" UWORD COMP_0203_S 1 100 0 65535 ECU_ADDRESS 0xFFFF46F8 /begin FUNCTION_LIST /end FUNCTION_LIST /end MEASUREMENT
/begin MEASUREMENT tSTEGWND3 "EGR#3 window timer (for the ST, driver)" UWORD COMP_0203_S 1 100 0 65535 ECU_ADDRESS 0xFFFF46FA /begin FUNCTION_LIST /end FUNCTION_LIST /end MEASUREMENT
/begin MEASUREMENT tSTEGWND4 "EGR#4 window timer (for the ST, driver)" UWORD COMP_0203_S 1 100 0 65535 ECU_ADDRESS 0xFFFF46FC /begin FUNCTION_LIST /end FUNCTION_LIST /end MEASUREMENT
/begin MEASUREMENT tSTSCWND1 "SCV#1 window timer (for the ST, driver)" UWORD COMP_0203_S 1 100 0 65535 ECU_ADDRESS 0xFFFF46FE /begin FUNCTION_LIST /end FUNCTION_LIST /end MEASUREMENT
/begin MEASUREMENT tSTSCWND2 "SCV#2 window timer (for the ST, driver)" UWORD COMP_0203_S 1 100 0 65535 ECU_ADDRESS 0xFFFF4700 /begin FUNCTION_LIST /end FUNCTION_LIST /end MEASUREMENT
/begin MEASUREMENT tSTSCWND3 "SCV#3 window timer (for the ST, driver)" UWORD COMP_0203_S 1 100 0 65535 ECU_ADDRESS 0xFFFF4702 /begin FUNCTION_LIST /end FUNCTION_LIST /end MEASUREMENT
/begin MEASUREMENT tSTSCWND4 "SCV#4 window timer (for the ST, driver)" UWORD COMP_0203_S 1 100 0 65535 ECU_ADDRESS 0xFFFF4704 /begin FUNCTION_LIST /end FUNCTION_LIST /end MEASUREMENT
/begin MEASUREMENT tTABVSNG2 "ABV control solenoid diagnosis NG delay timer 2" UWORD COMP_0203_S 1 100 0 65535 ECU_ADDRESS 0xFFFF4706 /begin FUNCTION_LIST /end FUNCTION_LIST /end MEASUREMENT
/begin MEASUREMENT tTAFTNG "AFM function diagnosis timer" UWORD COMP_0203_S 1 100 0 65535 ECU_ADDRESS 0xFFFF4708 /begin FUNCTION_LIST /end FUNCTION_LIST /end MEASUREMENT
/begin MEASUREMENT tTMACCLU "Timer for AC vehicle speed inhibition" UWORD COMP_0203_S 1 100 0 65535 ECU_ADDRESS 0xFFFF470A /begin FUNCTION_LIST /end FUNCTION_LIST /end MEASUREMENT
/begin MEASUREMENT tTMACLK "fCNXAC check timer" UWORD COMP_0203_S 1 100 0 65535 ECU_ADDRESS 0xFFFF470C /begin FUNCTION_LIST /end FUNCTION_LIST /end MEASUREMENT
/begin MEASUREMENT tTMACRQ "Timer for AC request" UWORD COMP_0203_S 1 100 0 65535 ECU_ADDRESS 0xFFFF470E /begin FUNCTION_LIST /end FUNCTION_LIST /end MEASUREMENT
/begin MEASUREMENT tTMACVS "Timer for AC vehicle speed inhibition" UWORD COMP_0203_S 1 100 0 65535 ECU_ADDRESS 0xFFFF4710 /begin FUNCTION_LIST /end FUNCTION_LIST /end MEASUREMENT
/begin MEASUREMENT tTMDEFD1 "Default mechanism diagnosis delay" UWORD COMP_0203_S 1 100 0 65535 ECU_ADDRESS 0xFFFF4712 /begin FUNCTION_LIST /end FUNCTION_LIST /end MEASUREMENT
/begin MEASUREMENT tTMPMONAT "AT reception supervisory timeout when diag CAN is off" UWORD COMP_0203_S 1 100 0 65535 ECU_ADDRESS 0xFFFF4716 /begin FUNCTION_LIST /end FUNCTION_LIST /end MEASUREMENT
/begin MEASUREMENT tTMRUCHK2 "Revolution-unit NG judgement time 2" UWORD COMP_0203_S 1 100 0 65535 ECU_ADDRESS 0xFFFF4718 /begin FUNCTION_LIST /end FUNCTION_LIST /end MEASUREMENT
/begin MEASUREMENT tTMSRVONG "Servo diagnosis timer" UWORD COMP_0203_S 1 100 0 65535 ECU_ADDRESS 0xFFFF471E /begin FUNCTION_LIST /end FUNCTION_LIST /end MEASUREMENT
/begin MEASUREMENT tTMTPOF "TCS Timer for off judgement" UWORD COMP_0203_S 1 100 0 65535 ECU_ADDRESS 0xFFFF4720 /begin FUNCTION_LIST /end FUNCTION_LIST /end MEASUREMENT
/begin MEASUREMENT tTMTVOSPR1 "Return spring abnormality diagnosis start throttle open-degree judgement time" UWORD COMP_0203_S 1 100 0 65535 ECU_ADDRESS 0xFFFF4722 /begin FUNCTION_LIST /end FUNCTION_LIST /end MEASUREMENT
/begin MEASUREMENT tTPSFSDL2S "TPS At the time of the single trouble, failsafe delay (for the TTAAPO_S operation)" UWORD COMP_0203_S 1 100 0 65535 ECU_ADDRESS 0xFFFF4728 /begin FUNCTION_LIST /end FUNCTION_LIST /end MEASUREMENT
/begin MEASUREMENT tTPSX4NG1 "Four times input NG judgement time" UWORD COMP_0203_S 1 100 0 65535 ECU_ADDRESS 0xFFFF472E /begin FUNCTION_LIST /end FUNCTION_LIST /end MEASUREMENT
/begin MEASUREMENT tVSABDLY "Filtering timer for vehicle speed received on the CAN network not present" UWORD COMP_0203_S 1 100 0 65535 ECU_ADDRESS 0xFFFF4732 /begin FUNCTION_LIST /end FUNCTION_LIST /end MEASUREMENT
/begin MEASUREMENT tVSINVDL "Vehicle speed invalid delay timer" UWORD COMP_0203_S 1 100 0 65535 ECU_ADDRESS 0xFFFF4734 /begin FUNCTION_LIST /end FUNCTION_LIST /end MEASUREMENT
/begin MEASUREMENT tVSNKDLY "Filtering timer for vehicle speed received on the CAN network not available" UWORD COMP_0203_S 1 100 0 65535 ECU_ADDRESS 0xFFFF4736 /begin FUNCTION_LIST /end FUNCTION_LIST /end MEASUREMENT
/begin MEASUREMENT tDELOUT_S "Negative pressure securing time" UWORD COMP_0203_S 1 100 0 65535 ECU_ADDRESS 0xFFFF4738 /begin FUNCTION_LIST /end FUNCTION_LIST /end MEASUREMENT
/begin MEASUREMENT tFDTRGPB_S "EEPROM trigger prohibition timer" UWORD COMP_0203_S 1 100 0 65535 ECU_ADDRESS 0xFFFF473A /begin FUNCTION_LIST /end FUNCTION_LIST /end MEASUREMENT
/begin MEASUREMENT tTMBLIM_S "At the time of the start, negative pressure securing time" UWORD COMP_0203_S 1 100 0 65535 ECU_ADDRESS 0xFFFF473C /begin FUNCTION_LIST /end FUNCTION_LIST /end MEASUREMENT
/begin MEASUREMENT tP3TIME "Transmission-receiving interval timer" UWORD COMP_0204_S 1 100 0 65535 ECU_ADDRESS 0xFFFF473E /begin FUNCTION_LIST /end FUNCTION_LIST /end MEASUREMENT
/begin MEASUREMENT tTMERRTV1 "The continuation time of the judgement deviation 1 and under" UWORD COMP_0204_S 1 100 0 65535 ECU_ADDRESS 0xFFFF4740 /begin FUNCTION_LIST /end FUNCTION_LIST /end MEASUREMENT
/begin MEASUREMENT tTMERRTV2 "The continuation time of the judgement deviation 2 and under" UWORD COMP_0204_S 1 100 0 65535 ECU_ADDRESS 0xFFFF4742 /begin FUNCTION_LIST /end FUNCTION_LIST /end MEASUREMENT
/begin MEASUREMENT tTP3 "Stage 3 6sec timer" UWORD COMP_0204_S 1 100 0 65535 ECU_ADDRESS 0xFFFF4744 /begin FUNCTION_LIST /end FUNCTION_LIST /end MEASUREMENT
/begin MEASUREMENT tTWW1 "From under LowB óß, to the first command transmission, for GST" UWORD COMP_0204_S 1 100 0 65535 ECU_ADDRESS 0xFFFF4746 /begin FUNCTION_LIST /end FUNCTION_LIST /end MEASUREMENT
/begin MEASUREMENT tBCTMR "After the start, BOSCH cut speed table switching timer" UBYTE COMP_0201_S 1 100 0 255 ECU_ADDRESS 0xFFFF24DC /begin FUNCTION_LIST /end FUNCTION_LIST /end MEASUREMENT
/begin MEASUREMENT tCKDWTM "After the start, progress time" UBYTE COMP_0201_S 1 100 0 255 ECU_ADDRESS 0xFFFF24DD /begin FUNCTION_LIST /end FUNCTION_LIST /end MEASUREMENT
/begin MEASUREMENT tDOSRHD "After PHOS operation Rr.O2/H on, delay timer" UBYTE COMP_0201_S 1 100 0 255 ECU_ADDRESS 0xFFFF24E3 /begin FUNCTION_LIST /end FUNCTION_LIST /end MEASUREMENT
/begin MEASUREMENT tDOSTCD "PHOS operation catalyst estimated temperature delay timer" UBYTE COMP_0201_S 1 100 0 255 ECU_ADDRESS 0xFFFF24E5 /begin FUNCTION_LIST /end FUNCTION_LIST /end MEASUREMENT
/begin MEASUREMENT tDTCST1 "The delay 1 which unusually detects an AT signal line" UBYTE COMP_0201_S 1 100 0 255 ECU_ADDRESS 0xFFFF24E6 /begin FUNCTION_LIST /end FUNCTION_LIST /end MEASUREMENT
/begin MEASUREMENT tEVCLDD "KDUTY UP EVPTR    condition 1,2 timer" UBYTE COMP_0201_S 1 100 0 255 ECU_ADDRESS 0xFFFF24E9 /begin FUNCTION_LIST /end FUNCTION_LIST /end MEASUREMENT
/begin MEASUREMENT tIDLETRP "Idle condition, more than a continuous 30 seconds" UBYTE COMP_0201_S 1 100 0 255 ECU_ADDRESS 0xFFFF24EA /begin FUNCTION_LIST /end FUNCTION_LIST /end MEASUREMENT
/begin MEASUREMENT tISCID "QFBI computed judgement time" UBYTE COMP_0201_S 1 100 0 255 ECU_ADDRESS 0xFFFF24ED /begin FUNCTION_LIST /end FUNCTION_LIST /end MEASUREMENT
/begin MEASUREMENT tLMDETM "Condition (a) - (g), completely, formation time count" UBYTE COMP_0201_S 1 100 0 255 ECU_ADDRESS 0xFFFF24EF /begin FUNCTION_LIST /end FUNCTION_LIST /end MEASUREMENT
/begin MEASUREMENT tMPNGT1 "Intake manifold absolute pressure sensor lower limit value error judgement timer" UBYTE COMP_0201_S 1 100 0 255 ECU_ADDRESS 0xFFFF24F1 /begin FUNCTION_LIST /end FUNCTION_LIST /end MEASUREMENT
/begin MEASUREMENT tMPNGT2 "Intake manifold absolute pressure sensor upper limit value error judgement timer" UBYTE COMP_0201_S 1 100 0 255 ECU_ADDRESS 0xFFFF24F2 /begin FUNCTION_LIST /end FUNCTION_LIST /end MEASUREMENT
/begin MEASUREMENT tOBDFCTM "The delay timer for an ACC  diagnostic NG judging" UBYTE COMP_0201_S 1 100 0 255 ECU_ADDRESS 0xFFFF24F3 /begin FUNCTION_LIST /end FUNCTION_LIST /end MEASUREMENT
/begin MEASUREMENT tPH1DL1 "PHOS1 operation condition CLOSED LOOP time" UBYTE COMP_0201_S 1 100 0 255 ECU_ADDRESS 0xFFFF24F4 /begin FUNCTION_LIST /end FUNCTION_LIST /end MEASUREMENT
/begin MEASUREMENT tPH1DL2 "After the PHOS1 operation condition lean, time" UBYTE COMP_0201_S 1 100 0 255 ECU_ADDRESS 0xFFFF24F6 /begin FUNCTION_LIST /end FUNCTION_LIST /end MEASUREMENT
/begin MEASUREMENT tRNLRC1 "PHOS operation CLOSE condition time timer" UBYTE COMP_0201_S 1 100 0 255 ECU_ADDRESS 0xFFFF24F8 /begin FUNCTION_LIST /end FUNCTION_LIST /end MEASUREMENT
/begin MEASUREMENT tRNLRC2 "After PHOS operation IDLE off, time timer" UBYTE COMP_0201_S 1 100 0 255 ECU_ADDRESS 0xFFFF24FA /begin FUNCTION_LIST /end FUNCTION_LIST /end MEASUREMENT
/begin MEASUREMENT tSCDWTM "After the start, progress time" UBYTE COMP_0201_S 1 100 0 255 ECU_ADDRESS 0xFFFF24FB /begin FUNCTION_LIST /end FUNCTION_LIST /end MEASUREMENT
/begin MEASUREMENT tTBBDEC "Gasoline mixing quantity decrease rate judgement timer" UBYTE COMP_0201_S 1 100 0 255 ECU_ADDRESS 0xFFFF24FD /begin FUNCTION_LIST /end FUNCTION_LIST /end MEASUREMENT
/begin MEASUREMENT tTBBHOT "KHOT increase period timer" UBYTE COMP_0201_S 1 100 0 255 ECU_ADDRESS 0xFFFF24FE /begin FUNCTION_LIST /end FUNCTION_LIST /end MEASUREMENT
/begin MEASUREMENT tTBBKMR "STFBYA increase period timer" UBYTE COMP_0201_S 1 100 0 255 ECU_ADDRESS 0xFFFF24FF /begin FUNCTION_LIST /end FUNCTION_LIST /end MEASUREMENT
/begin MEASUREMENT tTDLUC1 "At the time of lockup, NG judgement delay time counter" UBYTE COMP_0201_S 1 100 0 255 ECU_ADDRESS 0xFFFF2500 /begin FUNCTION_LIST /end FUNCTION_LIST /end MEASUREMENT
/begin MEASUREMENT tTDLUC3 "Region, formation time OK judgement criteria" UBYTE COMP_0201_S 1 100 0 255 ECU_ADDRESS 0xFFFF2501 /begin FUNCTION_LIST /end FUNCTION_LIST /end MEASUREMENT
/begin MEASUREMENT tTDSTCL "At the time of the start, CLOSE control start timer" UBYTE COMP_0201_S 1 100 0 255 ECU_ADDRESS 0xFFFF2502 /begin FUNCTION_LIST /end FUNCTION_LIST /end MEASUREMENT
/begin MEASUREMENT tTFCVO2 "A former O2/s deterioration judgement periodic measuring time timer" UBYTE COMP_0201_S 1 100 0 255 ECU_ADDRESS 0xFFFF2503 /begin FUNCTION_LIST /end FUNCTION_LIST /end MEASUREMENT
/begin MEASUREMENT tTM10S "The delay which unusually detects an A/T signal line" UBYTE COMP_0201_S 1 100 0 255 ECU_ADDRESS 0xFFFF2507 /begin FUNCTION_LIST /end FUNCTION_LIST /end MEASUREMENT
/begin MEASUREMENT tTMEVPC "Purge stop condition time" UBYTE COMP_0201_S 1 100 0 255 ECU_ADDRESS 0xFFFF250A /begin FUNCTION_LIST /end FUNCTION_LIST /end MEASUREMENT
/begin MEASUREMENT tTMEVPC1 "Canister purge check timer" UBYTE COMP_0201_S 1 100 0 255 ECU_ADDRESS 0xFFFF250B /begin FUNCTION_LIST /end FUNCTION_LIST /end MEASUREMENT
/begin MEASUREMENT tTMFPSTM "After the high coolant temperature initial judgement, delay timer" UBYTE COMP_0201_S 1 100 0 255 ECU_ADDRESS 0xFFFF250C /begin FUNCTION_LIST /end FUNCTION_LIST /end MEASUREMENT
/begin MEASUREMENT tTMPRH "For the high temperature tense time count" UBYTE COMP_0201_S 1 100 0 255 ECU_ADDRESS 0xFFFF250D /begin FUNCTION_LIST /end FUNCTION_LIST /end MEASUREMENT
/begin MEASUREMENT tTMRNID "Stage purge initialization idle time" UBYTE COMP_0201_S 1 100 0 255 ECU_ADDRESS 0xFFFF250E /begin FUNCTION_LIST /end FUNCTION_LIST /end MEASUREMENT
/begin MEASUREMENT tTMTRP1 "Trip 1 rush time measuring timer" UBYTE COMP_0201_S 1 100 0 255 ECU_ADDRESS 0xFFFF250F /begin FUNCTION_LIST /end FUNCTION_LIST /end MEASUREMENT
/begin MEASUREMENT tTMTRP2 "Trip 2 rush time measuring timer" UBYTE COMP_0201_S 1 100 0 255 ECU_ADDRESS 0xFFFF2510 /begin FUNCTION_LIST /end FUNCTION_LIST /end MEASUREMENT
/begin MEASUREMENT tTMTRP3 "Trip 3 rush time measuring timer" UBYTE COMP_0201_S 1 100 0 255 ECU_ADDRESS 0xFFFF2511 /begin FUNCTION_LIST /end FUNCTION_LIST /end MEASUREMENT
/begin MEASUREMENT tTMTRP4 "Trip 4 rush time measuring timer" UBYTE COMP_0201_S 1 100 0 255 ECU_ADDRESS 0xFFFF2512 /begin FUNCTION_LIST /end FUNCTION_LIST /end MEASUREMENT
/begin MEASUREMENT tTMTVIN "Learning renewal permission coolant temperature delay timer" UBYTE COMP_0201_S 1 100 0 255 ECU_ADDRESS 0xFFFF2513 /begin FUNCTION_LIST /end FUNCTION_LIST /end MEASUREMENT
/begin MEASUREMENT tTPGCK "Purge check continuation time timer" UBYTE COMP_0201_S 1 100 0 255 ECU_ADDRESS 0xFFFF2515 /begin FUNCTION_LIST /end FUNCTION_LIST /end MEASUREMENT
/begin MEASUREMENT tTPGCK3 "Empty purge judgement continuation time timer" UBYTE COMP_0201_S 1 100 0 255 ECU_ADDRESS 0xFFFF2516 /begin FUNCTION_LIST /end FUNCTION_LIST /end MEASUREMENT
/begin MEASUREMENT tTWNBUK "At the time of the backup, coolant temperature rise timer" UBYTE COMP_0201_S 1 100 0 255 ECU_ADDRESS 0xFFFF251C /begin FUNCTION_LIST /end FUNCTION_LIST /end MEASUREMENT
/begin MEASUREMENT tWIPDLY "Wiper off delay" UBYTE COMP_0201_S 1 100 0 255 ECU_ADDRESS 0xFFFF251D /begin FUNCTION_LIST /end FUNCTION_LIST /end MEASUREMENT
/begin MEASUREMENT tADVDLY1 "BETA computed delay 1" UBYTE COMP_0202_S 1 100 0 255 ECU_ADDRESS 0xFFFF2524 /begin FUNCTION_LIST /end FUNCTION_LIST /end MEASUREMENT
/begin MEASUREMENT tADVDLY2 "BETA computed delay 2" UBYTE COMP_0202_S 1 100 0 255 ECU_ADDRESS 0xFFFF2525 /begin FUNCTION_LIST /end FUNCTION_LIST /end MEASUREMENT
/begin MEASUREMENT tAPCLD "CLOSED switchover delay time" UBYTE COMP_0202_S 1 100 0 255 ECU_ADDRESS 0xFFFF2527 /begin FUNCTION_LIST /end FUNCTION_LIST /end MEASUREMENT
/begin MEASUREMENT tCHGOKTM "Battery charging complete continuation time" UBYTE COMP_0202_S 1 100 0 255 ECU_ADDRESS 0xFFFF252D /begin FUNCTION_LIST /end FUNCTION_LIST /end MEASUREMENT
/begin MEASUREMENT tDDTCST2 "The delay 2 (down-shift torque going down control) which unusually detects an AT signal line" UBYTE COMP_0202_S 1 100 0 255 ECU_ADDRESS 0xFFFF2533 /begin FUNCTION_LIST /end FUNCTION_LIST /end MEASUREMENT
/begin MEASUREMENT tDLYACT "The exhaust the second air cut solenoid delay timer" UBYTE COMP_0202_S 1 100 0 255 ECU_ADDRESS 0xFFFF2534 /begin FUNCTION_LIST /end FUNCTION_LIST /end MEASUREMENT
/begin MEASUREMENT tDLYEGR "EGR cut switchover prohibition time" UBYTE COMP_0202_S 1 100 0 255 ECU_ADDRESS 0xFFFF2535 /begin FUNCTION_LIST /end FUNCTION_LIST /end MEASUREMENT
/begin MEASUREMENT tDLYLOND "Lockup continuation time (for the DUETTE control) for the lean judgement" UBYTE COMP_0202_S 1 100 0 255 ECU_ADDRESS 0xFFFF2538 /begin FUNCTION_LIST /end FUNCTION_LIST /end MEASUREMENT
/begin MEASUREMENT tDLYNIDL2 "N range lean prohibition judgement timer 2" UBYTE COMP_0202_S 1 100 0 255 ECU_ADDRESS 0xFFFF2539 /begin FUNCTION_LIST /end FUNCTION_LIST /end MEASUREMENT
/begin MEASUREMENT tDLYPAOF "After FABCSOLOF, timer" UBYTE COMP_0202_S 1 100 0 255 ECU_ADDRESS 0xFFFF253A /begin FUNCTION_LIST /end FUNCTION_LIST /end MEASUREMENT
/begin MEASUREMENT tDLYPAON "After FABCSOLON, timer" UBYTE COMP_0202_S 1 100 0 255 ECU_ADDRESS 0xFFFF253B /begin FUNCTION_LIST /end FUNCTION_LIST /end MEASUREMENT
/begin MEASUREMENT tDTDOST "PHOSA operation condition delta-TVO condition delay" UBYTE COMP_0202_S 1 100 0 255 ECU_ADDRESS 0xFFFF253D /begin FUNCTION_LIST /end FUNCTION_LIST /end MEASUREMENT
/begin MEASUREMENT tDTSDT "An urgent slowdown signal delay" UBYTE COMP_0202_S 1 100 0 255 ECU_ADDRESS 0xFFFF253E /begin FUNCTION_LIST /end FUNCTION_LIST /end MEASUREMENT
/begin MEASUREMENT tEVPCTT "Purge cut Éømin time" UBYTE COMP_0202_S 1 100 0 255 ECU_ADDRESS 0xFFFF2541 /begin FUNCTION_LIST /end FUNCTION_LIST /end MEASUREMENT
/begin MEASUREMENT tEVPCTT3 "Purge cut Éømin time" UBYTE COMP_0202_S 1 100 0 255 ECU_ADDRESS 0xFFFF2542 /begin FUNCTION_LIST /end FUNCTION_LIST /end MEASUREMENT
/begin MEASUREMENT tEVPDLY "EVPDLY timer" UBYTE COMP_0202_S 1 100 0 255 ECU_ADDRESS 0xFFFF2544 /begin FUNCTION_LIST /end FUNCTION_LIST /end MEASUREMENT
/begin MEASUREMENT tFCTIM1 "A high air fuel cut judgement delay" UBYTE COMP_0202_S 1 100 0 255 ECU_ADDRESS 0xFFFF254E /begin FUNCTION_LIST /end FUNCTION_LIST /end MEASUREMENT
/begin MEASUREMENT tFO2HCTD "A former O2 heater off delay timer" UBYTE COMP_0202_S 1 100 0 255 ECU_ADDRESS 0xFFFF254F /begin FUNCTION_LIST /end FUNCTION_LIST /end MEASUREMENT
/begin MEASUREMENT tFSVO2NG "O2 sensor unusual time" UBYTE COMP_0202_S 1 100 0 255 ECU_ADDRESS 0xFFFF2552 /begin FUNCTION_LIST /end FUNCTION_LIST /end MEASUREMENT
/begin MEASUREMENT tIDELAYC "Step load switchover timer" UBYTE COMP_0202_S 1 100 0 255 ECU_ADDRESS 0xFFFF2556 /begin FUNCTION_LIST /end FUNCTION_LIST /end MEASUREMENT
/begin MEASUREMENT tIDLTM "Idle lambda control delay" UBYTE COMP_0202_S 1 100 0 255 ECU_ADDRESS 0xFFFF2557 /begin FUNCTION_LIST /end FUNCTION_LIST /end MEASUREMENT
/begin MEASUREMENT tIDLTM2 "After the start, rich-shift delay" UBYTE COMP_0202_S 1 100 0 255 ECU_ADDRESS 0xFFFF2558 /begin FUNCTION_LIST /end FUNCTION_LIST /end MEASUREMENT
/begin MEASUREMENT tIDLYAD "DADVI control start delay timer" UBYTE COMP_0202_S 1 100 0 255 ECU_ADDRESS 0xFFFF2559 /begin FUNCTION_LIST /end FUNCTION_LIST /end MEASUREMENT
/begin MEASUREMENT tISCBCDLY "After the fuel cut recover, at the time of the slowdown, a negative pressure compensation time limit timer" UBYTE COMP_0202_S 1 100 0 255 ECU_ADDRESS 0xFFFF255A /begin FUNCTION_LIST /end FUNCTION_LIST /end MEASUREMENT
/begin MEASUREMENT tKAIVFT "VO2 compensation release delay timer" UBYTE COMP_0202_S 1 100 0 255 ECU_ADDRESS 0xFFFF255F /begin FUNCTION_LIST /end FUNCTION_LIST /end MEASUREMENT
/begin MEASUREMENT tKAIVRTAF "ADO2R compensation release delay timer" UBYTE COMP_0202_S 1 100 0 255 ECU_ADDRESS 0xFFFF2563 /begin FUNCTION_LIST /end FUNCTION_LIST /end MEASUREMENT
/begin MEASUREMENT tKMRDTM "KMR delay timer (gear change)" UBYTE COMP_0202_S 1 100 0 255 ECU_ADDRESS 0xFFFF2565 /begin FUNCTION_LIST /end FUNCTION_LIST /end MEASUREMENT
/begin MEASUREMENT tLRNTIM2E "VTC reference angle learning permission delay timer" UBYTE COMP_0202_S 1 100 0 255 ECU_ADDRESS 0xFFFF256A /begin FUNCTION_LIST /end FUNCTION_LIST /end MEASUREMENT
/begin MEASUREMENT tLRNTIM2I "VTC reference angle learning permission delay timer" UBYTE COMP_0202_S 1 100 0 255 ECU_ADDRESS 0xFFFF256B /begin FUNCTION_LIST /end FUNCTION_LIST /end MEASUREMENT
/begin MEASUREMENT tLRNTIME "VTC maximum-retard degree position learning prohibition delay timer" UBYTE COMP_0202_S 1 100 0 255 ECU_ADDRESS 0xFFFF256C /begin FUNCTION_LIST /end FUNCTION_LIST /end MEASUREMENT
/begin MEASUREMENT tLRNTIMI "VTC maximum-retard degree position learning prohibition delay timer" UBYTE COMP_0202_S 1 100 0 255 ECU_ADDRESS 0xFFFF256D /begin FUNCTION_LIST /end FUNCTION_LIST /end MEASUREMENT
/begin MEASUREMENT tMPNGT3 "Intake manifold absolute pressure sensor breakage error judgement timer" UBYTE COMP_0202_S 1 100 0 255 ECU_ADDRESS 0xFFFF256E /begin FUNCTION_LIST /end FUNCTION_LIST /end MEASUREMENT
/begin MEASUREMENT tNGTIMI "The judgement delay whose VTC maximum-retard degree diagnosis reference position is unusual" UBYTE COMP_0202_S 1 100 0 255 ECU_ADDRESS 0xFFFF2573 /begin FUNCTION_LIST /end FUNCTION_LIST /end MEASUREMENT
/begin MEASUREMENT tO2HCTD "A former O2 heater off delay" UBYTE COMP_0202_S 1 100 0 255 ECU_ADDRESS 0xFFFF2576 /begin FUNCTION_LIST /end FUNCTION_LIST /end MEASUREMENT
/begin MEASUREMENT tO2TMHMX1 "O2 sensor heater duty upper limit value maintenance time" UBYTE COMP_0202_S 1 100 0 255 ECU_ADDRESS 0xFFFF2577 /begin FUNCTION_LIST /end FUNCTION_LIST /end MEASUREMENT
/begin MEASUREMENT tPDFL2 "control permission judgement time related to the Pd pressure sensor" UBYTE COMP_0202_S 1 100 0 255 ECU_ADDRESS 0xFFFF2579 /begin FUNCTION_LIST /end FUNCTION_LIST /end MEASUREMENT
/begin MEASUREMENT tPH1DL3 "After the PHOS1 operation condition idle, time" UBYTE COMP_0202_S 1 100 0 255 ECU_ADDRESS 0xFFFF257B /begin FUNCTION_LIST /end FUNCTION_LIST /end MEASUREMENT
/begin MEASUREMENT tPHKFOT "Fr.O2/S output reversal judgement time for the PHOSA operation prohibition judgement" UBYTE COMP_0202_S 1 100 0 255 ECU_ADDRESS 0xFFFF257D /begin FUNCTION_LIST /end FUNCTION_LIST /end MEASUREMENT
/begin MEASUREMENT tRFMTIM "At the time of the acceleration, FAN control judgement timer" UBYTE COMP_0202_S 1 100 0 255 ECU_ADDRESS 0xFFFF2582 /begin FUNCTION_LIST /end FUNCTION_LIST /end MEASUREMENT
/begin MEASUREMENT tSCVDTM "SCV control condition (1) - (6) formation delay" UBYTE COMP_0202_S 1 100 0 255 ECU_ADDRESS 0xFFFF2585 /begin FUNCTION_LIST /end FUNCTION_LIST /end MEASUREMENT
/begin MEASUREMENT tSMTTM "At the time of the engine start, shake mode continuous time timer" UBYTE COMP_0202_S 1 100 0 255 ECU_ADDRESS 0xFFFF2586 /begin FUNCTION_LIST /end FUNCTION_LIST /end MEASUREMENT
/begin MEASUREMENT tSTEXCS "After the start, a control prohibition delay timer by the cylinder" UBYTE COMP_0202_S 1 100 0 255 ECU_ADDRESS 0xFFFF2587 /begin FUNCTION_LIST /end FUNCTION_LIST /end MEASUREMENT
/begin MEASUREMENT tSTOKTM "A continuation time timer for the battery charging complete judgement" UBYTE COMP_0202_S 1 100 0 255 ECU_ADDRESS 0xFFFF2588 /begin FUNCTION_LIST /end FUNCTION_LIST /end MEASUREMENT
/begin MEASUREMENT tTALREG "After the control start start, prohibition time" UBYTE COMP_0202_S 1 100 0 255 ECU_ADDRESS 0xFFFF258E /begin FUNCTION_LIST /end FUNCTION_LIST /end MEASUREMENT
/begin MEASUREMENT tTALTVBHH "DUTYF/B operation High side judgement delay timer" UBYTE COMP_0202_S 1 100 0 255 ECU_ADDRESS 0xFFFF258F /begin FUNCTION_LIST /end FUNCTION_LIST /end MEASUREMENT
/begin MEASUREMENT tTALTVBHL "DUTYF/B operation Low side judgement delay timer" UBYTE COMP_0202_S 1 100 0 255 ECU_ADDRESS 0xFFFF2590 /begin FUNCTION_LIST /end FUNCTION_LIST /end MEASUREMENT
/begin MEASUREMENT tTASLRDQ "Learning operation start delay (for TAS learning)" UBYTE COMP_0202_S 1 100 0 255 ECU_ADDRESS 0xFFFF2591 /begin FUNCTION_LIST /end FUNCTION_LIST /end MEASUREMENT
/begin MEASUREMENT tTDLYAB "ABV control switchover prohibition time" UBYTE COMP_0202_S 1 100 0 255 ECU_ADDRESS 0xFFFF2596 /begin FUNCTION_LIST /end FUNCTION_LIST /end MEASUREMENT
/begin MEASUREMENT tTDLYPA "Pressure measuring delay timer" UBYTE COMP_0202_S 1 100 0 255 ECU_ADDRESS 0xFFFF2597 /begin FUNCTION_LIST /end FUNCTION_LIST /end MEASUREMENT
/begin MEASUREMENT tTHETEVP "A timer for the heat resisting purge judgement condition" UBYTE COMP_0202_S 1 100 0 255 ECU_ADDRESS 0xFFFF259A /begin FUNCTION_LIST /end FUNCTION_LIST /end MEASUREMENT
/begin MEASUREMENT tTIMERD "N -> D At the time of the select, lower limit conditional delay time timer" UBYTE COMP_0202_S 1 100 0 255 ECU_ADDRESS 0xFFFF259B /begin FUNCTION_LIST /end FUNCTION_LIST /end MEASUREMENT
/begin MEASUREMENT tTIMERR "N -> At the time of the R select, lower limit conditional delay time timer" UBYTE COMP_0202_S 1 100 0 255 ECU_ADDRESS 0xFFFF259C /begin FUNCTION_LIST /end FUNCTION_LIST /end MEASUREMENT
/begin MEASUREMENT tTLUCSD "Lockup release solenoid diagnosis permission delay time" UBYTE COMP_0202_S 1 100 0 255 ECU_ADDRESS 0xFFFF25A2 /begin FUNCTION_LIST /end FUNCTION_LIST /end MEASUREMENT
/begin MEASUREMENT tTMALDC "Slowdown tense slowdown judgement continuation time" UBYTE COMP_0202_S 1 100 0 255 ECU_ADDRESS 0xFFFF25A4 /begin FUNCTION_LIST /end FUNCTION_LIST /end MEASUREMENT
/begin MEASUREMENT tTMAPNE "Rotation rise judgement timer" UBYTE COMP_0202_S 1 100 0 255 ECU_ADDRESS 0xFFFF25A5 /begin FUNCTION_LIST /end FUNCTION_LIST /end MEASUREMENT
/begin MEASUREMENT tTMAPTP "TP increased judgement timer" UBYTE COMP_0202_S 1 100 0 255 ECU_ADDRESS 0xFFFF25A6 /begin FUNCTION_LIST /end FUNCTION_LIST /end MEASUREMENT
/begin MEASUREMENT tTMAPVD "Battery voltage decline judgement timer" UBYTE COMP_0202_S 1 100 0 255 ECU_ADDRESS 0xFFFF25A7 /begin FUNCTION_LIST /end FUNCTION_LIST /end MEASUREMENT
/begin MEASUREMENT tTMEVPN "EVPNTM timer" UBYTE COMP_0202_S 1 100 0 255 ECU_ADDRESS 0xFFFF25AA /begin FUNCTION_LIST /end FUNCTION_LIST /end MEASUREMENT
/begin MEASUREMENT tTMFPOFDY "Hi flow-quantity judgement delay timer" UBYTE COMP_0202_S 1 100 0 255 ECU_ADDRESS 0xFFFF25AB /begin FUNCTION_LIST /end FUNCTION_LIST /end MEASUREMENT
/begin MEASUREMENT tTMLN2S "LNRPM>=400rpm" UBYTE COMP_0202_S 1 100 0 255 ECU_ADDRESS 0xFFFF25AD /begin FUNCTION_LIST /end FUNCTION_LIST /end MEASUREMENT
/begin MEASUREMENT tTMNINJ "A sequential switchover delay" UBYTE COMP_0202_S 1 100 0 255 ECU_ADDRESS 0xFFFF25AE /begin FUNCTION_LIST /end FUNCTION_LIST /end MEASUREMENT
/begin MEASUREMENT tTMPRES "FABCSOL first on time timer" UBYTE COMP_0202_S 1 100 0 255 ECU_ADDRESS 0xFFFF25AF /begin FUNCTION_LIST /end FUNCTION_LIST /end MEASUREMENT
/begin MEASUREMENT tTMSCC "SCV Timer for off prohibition release delay measuring" UBYTE COMP_0202_S 1 100 0 255 ECU_ADDRESS 0xFFFF25B1 /begin FUNCTION_LIST /end FUNCTION_LIST /end MEASUREMENT
/begin MEASUREMENT tTMSCVC "At the time of the start, a timer for delay measuring" UBYTE COMP_0202_S 1 100 0 255 ECU_ADDRESS 0xFFFF25B2 /begin FUNCTION_LIST /end FUNCTION_LIST /end MEASUREMENT
/begin MEASUREMENT tTNLALT "Control continuation time upper limit" UBYTE COMP_0202_S 1 100 0 255 ECU_ADDRESS 0xFFFF25B3 /begin FUNCTION_LIST /end FUNCTION_LIST /end MEASUREMENT
/begin MEASUREMENT tTPPSNG1 "P/S oil pressure sensor diagnosis NG judgement timer 1" UBYTE COMP_0202_S 1 100 0 255 ECU_ADDRESS 0xFFFF25B5 /begin FUNCTION_LIST /end FUNCTION_LIST /end MEASUREMENT
/begin MEASUREMENT tTVBMAX "Control prohibition voltage judgement timer" UBYTE COMP_0202_S 1 100 0 255 ECU_ADDRESS 0xFFFF25B7 /begin FUNCTION_LIST /end FUNCTION_LIST /end MEASUREMENT
/begin MEASUREMENT tUDTCST2 "The delay 2 (up-shift torque going down control) which unusually detects an AT signal line" UBYTE COMP_0202_S 1 100 0 255 ECU_ADDRESS 0xFFFF25B8 /begin FUNCTION_LIST /end FUNCTION_LIST /end MEASUREMENT
/begin MEASUREMENT tUTDTMR "DTDTMR judgement timer" UBYTE COMP_0202_S 1 100 0 255 ECU_ADDRESS 0xFFFF25B9 /begin FUNCTION_LIST /end FUNCTION_LIST /end MEASUREMENT
/begin MEASUREMENT tVSCNGT "Open-degree sensor NG judgement delay timer" UBYTE COMP_0202_S 1 100 0 255 ECU_ADDRESS 0xFFFF25BA /begin FUNCTION_LIST /end FUNCTION_LIST /end MEASUREMENT
/begin MEASUREMENT tVTCOEDLY "VTC reference position deviation parameter measuring delay timer" UBYTE COMP_0202_S 1 100 0 255 ECU_ADDRESS 0xFFFF25BB /begin FUNCTION_LIST /end FUNCTION_LIST /end MEASUREMENT
/begin MEASUREMENT tVTLRDLY "VTC maximum-retard degree diagnosis reference learning prohibition time timer" UBYTE COMP_0202_S 1 100 0 255 ECU_ADDRESS 0xFFFF25BD /begin FUNCTION_LIST /end FUNCTION_LIST /end MEASUREMENT
/begin MEASUREMENT tVTLRDLYE "VTC maximum-retard degree diagnosis reference learning prohibition time timer" UBYTE COMP_0202_S 1 100 0 255 ECU_ADDRESS 0xFFFF25BF /begin FUNCTION_LIST /end FUNCTION_LIST /end MEASUREMENT
/begin MEASUREMENT tYRTIME4 "Roll-back release time" UBYTE COMP_0202_S 1 100 0 255 ECU_ADDRESS 0xFFFF25C2 /begin FUNCTION_LIST /end FUNCTION_LIST /end MEASUREMENT
/begin MEASUREMENT tYRTIME5 "Roll-back release time" UBYTE COMP_0202_S 1 100 0 255 ECU_ADDRESS 0xFFFF25C3 /begin FUNCTION_LIST /end FUNCTION_LIST /end MEASUREMENT
/begin MEASUREMENT tYRTIME6 "Roll-back release time" UBYTE COMP_0202_S 1 100 0 255 ECU_ADDRESS 0xFFFF25C4 /begin FUNCTION_LIST /end FUNCTION_LIST /end MEASUREMENT
/begin MEASUREMENT tAGBCD1 "calibrable delay:off => on shift" UBYTE COMP_0203_S 1 100 0 255 ECU_ADDRESS 0xFFFF25CB /begin FUNCTION_LIST /end FUNCTION_LIST /end MEASUREMENT
/begin MEASUREMENT tAGBCD2 "calibrable delay:on => off shift" UBYTE COMP_0203_S 1 100 0 255 ECU_ADDRESS 0xFFFF25CC /begin FUNCTION_LIST /end FUNCTION_LIST /end MEASUREMENT
/begin MEASUREMENT tALTWORK "For the ALTF increase speed regulation" UBYTE COMP_0203_S 1 100 0 255 ECU_ADDRESS 0xFFFF25CD /begin FUNCTION_LIST /end FUNCTION_LIST /end MEASUREMENT
/begin MEASUREMENT tCATSTRG "Catalyst diagnosis operation period" UBYTE COMP_0203_S 1 100 0 255 ECU_ADDRESS 0xFFFF25D1 /begin FUNCTION_LIST /end FUNCTION_LIST /end MEASUREMENT
/begin MEASUREMENT tCFRD "Half-cylinder recover delay timer" UBYTE COMP_0203_S 1 100 0 255 ECU_ADDRESS 0xFFFF25D5 /begin FUNCTION_LIST /end FUNCTION_LIST /end MEASUREMENT
/begin MEASUREMENT tCHK80CVT "CVT input pulse input judgement-less timer" UBYTE COMP_0203_S 1 100 0 255 ECU_ADDRESS 0xFFFF25D6 /begin FUNCTION_LIST /end FUNCTION_LIST /end MEASUREMENT
/begin MEASUREMENT tCHK80VSP "A high precision vehicle speed pulse input judgement-less timer" UBYTE COMP_0203_S 1 100 0 255 ECU_ADDRESS 0xFFFF25D7 /begin FUNCTION_LIST /end FUNCTION_LIST /end MEASUREMENT
/begin MEASUREMENT tCHRCNT "Generating electricity -less judgement timer" UBYTE COMP_0203_S 1 100 0 255 ECU_ADDRESS 0xFFFF25D8 /begin FUNCTION_LIST /end FUNCTION_LIST /end MEASUREMENT
/begin MEASUREMENT tCKTDREC "Torque limiter reversion ë™ occasion addition timer" UBYTE COMP_0203_S 1 100 0 255 ECU_ADDRESS 0xFFFF25D9 /begin FUNCTION_LIST /end FUNCTION_LIST /end MEASUREMENT
/begin MEASUREMENT tCNSDLYI "Retard side response time measuring delay" UBYTE COMP_0203_S 1 100 0 255 ECU_ADDRESS 0xFFFF25DA /begin FUNCTION_LIST /end FUNCTION_LIST /end MEASUREMENT
/begin MEASUREMENT tCRENST "An engine stall judgement delay timer for the hard cranking" UBYTE COMP_0203_S 1 100 0 255 ECU_ADDRESS 0xFFFF25DD /begin FUNCTION_LIST /end FUNCTION_LIST /end MEASUREMENT
/begin MEASUREMENT tCSALP "50mS counter for LTVOS" UBYTE COMP_0203_S 1 100 0 255 ECU_ADDRESS 0xFFFF25DE /begin FUNCTION_LIST /end FUNCTION_LIST /end MEASUREMENT
/begin MEASUREMENT tDJFN2 "An unusual judgement delay at the time of the idle" UBYTE COMP_0203_S 1 100 0 255 ECU_ADDRESS 0xFFFF25E1 /begin FUNCTION_LIST /end FUNCTION_LIST /end MEASUREMENT
/begin MEASUREMENT tDLPTDLU "L/U At the time of ON/ off, delay" UBYTE COMP_0203_S 1 100 0 255 ECU_ADDRESS 0xFFFF25E3 /begin FUNCTION_LIST /end FUNCTION_LIST /end MEASUREMENT
/begin MEASUREMENT tDQAC2 "QLDAC slowdown rate timer" UBYTE COMP_0203_S 1 100 0 255 ECU_ADDRESS 0xFFFF25EF /begin FUNCTION_LIST /end FUNCTION_LIST /end MEASUREMENT
/begin MEASUREMENT tDQCI1 "QFBI change rate timer (When it is added.)" UBYTE COMP_0203_S 1 100 0 255 ECU_ADDRESS 0xFFFF25F1 /begin FUNCTION_LIST /end FUNCTION_LIST /end MEASUREMENT
/begin MEASUREMENT tDQCI2 "QFBI change rate timer (When it is subtracted.)" UBYTE COMP_0203_S 1 100 0 255 ECU_ADDRESS 0xFFFF25F2 /begin FUNCTION_LIST /end FUNCTION_LIST /end MEASUREMENT
/begin MEASUREMENT tDQCIMAXH "At the time of the homogeneous, QFBI MAX value change rate timer" UBYTE COMP_0203_S 1 100 0 255 ECU_ADDRESS 0xFFFF25F3 /begin FUNCTION_LIST /end FUNCTION_LIST /end MEASUREMENT
/begin MEASUREMENT tDQCIMAXS "At the time of the stratified, QFBI MAX change rate timer" UBYTE COMP_0203_S 1 100 0 255 ECU_ADDRESS 0xFFFF25F4 /begin FUNCTION_LIST /end FUNCTION_LIST /end MEASUREMENT
/begin MEASUREMENT tDQCIMINH "At the time of the homogeneous, QFBI MIN value change rate timer" UBYTE COMP_0203_S 1 100 0 255 ECU_ADDRESS 0xFFFF25F5 /begin FUNCTION_LIST /end FUNCTION_LIST /end MEASUREMENT
/begin MEASUREMENT tDQCIMINS "At the time of the stratified, QFBI MIN value change rate timer" UBYTE COMP_0203_S 1 100 0 255 ECU_ADDRESS 0xFFFF25F6 /begin FUNCTION_LIST /end FUNCTION_LIST /end MEASUREMENT
/begin MEASUREMENT tDRAGFT1 "Time constant for drag switch filtering (on)" UBYTE COMP_0203_S 1 100 0 255 ECU_ADDRESS 0xFFFF25F7 /begin FUNCTION_LIST /end FUNCTION_LIST /end MEASUREMENT
/begin MEASUREMENT tDRAGFT2 "Time constant for drag switch filtering (off)" UBYTE COMP_0203_S 1 100 0 255 ECU_ADDRESS 0xFFFF25F8 /begin FUNCTION_LIST /end FUNCTION_LIST /end MEASUREMENT
/begin MEASUREMENT tDTLOAD3 "After electric load SW off, idle rise release delay 3" UBYTE COMP_0203_S 1 100 0 255 ECU_ADDRESS 0xFFFF25FC /begin FUNCTION_LIST /end FUNCTION_LIST /end MEASUREMENT
/begin MEASUREMENT tEGENTM "A delay timer for 2 times ignition judgement" UBYTE COMP_0203_S 1 100 0 255 ECU_ADDRESS 0xFFFF25FE /begin FUNCTION_LIST /end FUNCTION_LIST /end MEASUREMENT
/begin MEASUREMENT tFSTRDL "After switching, progress time" UBYTE COMP_0203_S 1 100 0 255 ECU_ADDRESS 0xFFFF2600 /begin FUNCTION_LIST /end FUNCTION_LIST /end MEASUREMENT
/begin MEASUREMENT tIDLETIM "IDLESW, progress time after off" UBYTE COMP_0203_S 1 100 0 255 ECU_ADDRESS 0xFFFF2603 /begin FUNCTION_LIST /end FUNCTION_LIST /end MEASUREMENT
/begin MEASUREMENT tIMNISC1S "1-second timer for the ISC function diagnosis" UBYTE COMP_0203_S 1 100 0 255 ECU_ADDRESS 0xFFFF2604 /begin FUNCTION_LIST /end FUNCTION_LIST /end MEASUREMENT
/begin MEASUREMENT tJUGASOL "AT shift ASOL flag switching judgement timer" UBYTE COMP_0203_S 1 100 0 255 ECU_ADDRESS 0xFFFF2607 /begin FUNCTION_LIST /end FUNCTION_LIST /end MEASUREMENT
/begin MEASUREMENT tJUGVB "Output off release condition timer" UBYTE COMP_0203_S 1 100 0 255 ECU_ADDRESS 0xFFFF2608 /begin FUNCTION_LIST /end FUNCTION_LIST /end MEASUREMENT
/begin MEASUREMENT tMAXKNX "A timer for the KRPM10 un-adjustment diagnosis parameter maximum value setup" UBYTE COMP_0203_S 1 100 0 255 ECU_ADDRESS 0xFFFF260D /begin FUNCTION_LIST /end FUNCTION_LIST /end MEASUREMENT
/begin MEASUREMENT tMAXPNX "A timer for the vMAXPNX setup" UBYTE COMP_0203_S 1 100 0 255 ECU_ADDRESS 0xFFFF260E /begin FUNCTION_LIST /end FUNCTION_LIST /end MEASUREMENT
/begin MEASUREMENT tMFRFDLY1 "MFDTY operation (i) continuation counter" UBYTE COMP_0203_S 1 100 0 255 ECU_ADDRESS 0xFFFF260F /begin FUNCTION_LIST /end FUNCTION_LIST /end MEASUREMENT
/begin MEASUREMENT tMFRFDLY2 "MFDTY operation (ii) continuation counter" UBYTE COMP_0203_S 1 100 0 255 ECU_ADDRESS 0xFFFF2610 /begin FUNCTION_LIST /end FUNCTION_LIST /end MEASUREMENT
/begin MEASUREMENT tMILEAGE "Mileage integration treatment interval time" UBYTE COMP_0203_S 1 100 0 255 ECU_ADDRESS 0xFFFF2611 /begin FUNCTION_LIST /end FUNCTION_LIST /end MEASUREMENT
/begin MEASUREMENT tNEUTFT1 "Time constant for neutral switch filtering (on)" UBYTE COMP_0203_S 1 100 0 255 ECU_ADDRESS 0xFFFF2613 /begin FUNCTION_LIST /end FUNCTION_LIST /end MEASUREMENT
/begin MEASUREMENT tNEUTFT2 "Time constant for neutral switch filtering (off)" UBYTE COMP_0203_S 1 100 0 255 ECU_ADDRESS 0xFFFF2614 /begin FUNCTION_LIST /end FUNCTION_LIST /end MEASUREMENT
/begin MEASUREMENT tNGDCAM2L "POS10 diagnosis permission CAM signal input period (PhaseLH)" UBYTE COMP_0203_S 1 100 0 255 ECU_ADDRESS 0xFFFF2617 /begin FUNCTION_LIST /end FUNCTION_LIST /end MEASUREMENT
/begin MEASUREMENT tNGDCAML "CAM signal breakage judgement timer (PhaseLH)" UBYTE COMP_0203_S 1 100 0 255 ECU_ADDRESS 0xFFFF2618 /begin FUNCTION_LIST /end FUNCTION_LIST /end MEASUREMENT
/begin MEASUREMENT tNSETVB1 "At the time of the battery voltage descent, timer 1" UBYTE COMP_0203_S 1 100 0 255 ECU_ADDRESS 0xFFFF261A /begin FUNCTION_LIST /end FUNCTION_LIST /end MEASUREMENT
/begin MEASUREMENT tOVCNT1 "Over charge judgement timer 1" UBYTE COMP_0203_S 1 100 0 255 ECU_ADDRESS 0xFFFF261B /begin FUNCTION_LIST /end FUNCTION_LIST /end MEASUREMENT
/begin MEASUREMENT tOVCNT2 "Over charge judgement timer 2" UBYTE COMP_0203_S 1 100 0 255 ECU_ADDRESS 0xFFFF261C /begin FUNCTION_LIST /end FUNCTION_LIST /end MEASUREMENT
/begin MEASUREMENT tQCK1 "QCK1 renewal timer" UBYTE COMP_0203_S 1 100 0 255 ECU_ADDRESS 0xFFFF2620 /begin FUNCTION_LIST /end FUNCTION_LIST /end MEASUREMENT
/begin MEASUREMENT tQCK2 "QCK2 renewal timer" UBYTE COMP_0203_S 1 100 0 255 ECU_ADDRESS 0xFFFF2621 /begin FUNCTION_LIST /end FUNCTION_LIST /end MEASUREMENT
/begin MEASUREMENT tQTASINV "80mS judgement timer" UBYTE COMP_0203_S 1 100 0 255 ECU_ADDRESS 0xFFFF2622 /begin FUNCTION_LIST /end FUNCTION_LIST /end MEASUREMENT
/begin MEASUREMENT tREFARI "Progress time from REF profit çûÇ›" UBYTE COMP_0203_S 1 100 0 255 ECU_ADDRESS 0xFFFF2623 /begin FUNCTION_LIST /end FUNCTION_LIST /end MEASUREMENT
/begin MEASUREMENT tREFCNTI "ê†ìÆ engine rotation number of times operation interval time" UBYTE COMP_0203_S 1 100 0 255 ECU_ADDRESS 0xFFFF2624 /begin FUNCTION_LIST /end FUNCTION_LIST /end MEASUREMENT
/begin MEASUREMENT tRESDLYI "Advance side response time measuring delay" UBYTE COMP_0203_S 1 100 0 255 ECU_ADDRESS 0xFFFF2626 /begin FUNCTION_LIST /end FUNCTION_LIST /end MEASUREMENT
/begin MEASUREMENT tRINLDS "The rest O2 initialization start delay" UBYTE COMP_0203_S 1 100 0 255 ECU_ADDRESS 0xFFFF262D /begin FUNCTION_LIST /end FUNCTION_LIST /end MEASUREMENT
/begin MEASUREMENT tRINLDST "3rdVRO2 compensation release delay timer" UBYTE COMP_0203_S 1 100 0 255 ECU_ADDRESS 0xFFFF262F /begin FUNCTION_LIST /end FUNCTION_LIST /end MEASUREMENT
/begin MEASUREMENT tSCVDL2 "A timer for SCV ignition timing compensation off delay measuring" UBYTE COMP_0203_S 1 100 0 255 ECU_ADDRESS 0xFFFF2633 /begin FUNCTION_LIST /end FUNCTION_LIST /end MEASUREMENT
/begin MEASUREMENT tSCVDLY "A timer for SCV ignition timing compensation on delay measuring" UBYTE COMP_0203_S 1 100 0 255 ECU_ADDRESS 0xFFFF2634 /begin FUNCTION_LIST /end FUNCTION_LIST /end MEASUREMENT
/begin MEASUREMENT tSCVOFTM "SCV Off time delay timer" UBYTE COMP_0203_S 1 100 0 255 ECU_ADDRESS 0xFFFF2635 /begin FUNCTION_LIST /end FUNCTION_LIST /end MEASUREMENT
/begin MEASUREMENT tSCVONTM "SCV On time delay timer" UBYTE COMP_0203_S 1 100 0 255 ECU_ADDRESS 0xFFFF2636 /begin FUNCTION_LIST /end FUNCTION_LIST /end MEASUREMENT
/begin MEASUREMENT tSHIFTE "VTC fixed condition judgement timer" UBYTE COMP_0203_S 1 100 0 255 ECU_ADDRESS 0xFFFF2637 /begin FUNCTION_LIST /end FUNCTION_LIST /end MEASUREMENT
/begin MEASUREMENT tSHIFTI "VTC fixed condition judgement timer" UBYTE COMP_0203_S 1 100 0 255 ECU_ADDRESS 0xFFFF2639 /begin FUNCTION_LIST /end FUNCTION_LIST /end MEASUREMENT
/begin MEASUREMENT tSTARTE "F/B condition judgement timer" UBYTE COMP_0203_S 1 100 0 255 ECU_ADDRESS 0xFFFF263C /begin FUNCTION_LIST /end FUNCTION_LIST /end MEASUREMENT
/begin MEASUREMENT tSTARTI "F/B condition judgement timer" UBYTE COMP_0203_S 1 100 0 255 ECU_ADDRESS 0xFFFF263E /begin FUNCTION_LIST /end FUNCTION_LIST /end MEASUREMENT
/begin MEASUREMENT tSTDLY "FNRPM<NSTOFFC# timer" UBYTE COMP_0203_S 1 100 0 255 ECU_ADDRESS 0xFFFF2640 /begin FUNCTION_LIST /end FUNCTION_LIST /end MEASUREMENT
/begin MEASUREMENT tTAFPOS2 "AFM middle electric potential fixed trouble diagnosis POS detection timer" UBYTE COMP_0203_S 1 100 0 255 ECU_ADDRESS 0xFFFF2643 /begin FUNCTION_LIST /end FUNCTION_LIST /end MEASUREMENT
/begin MEASUREMENT tTAGBCD1 "Time constant for reverse switch filtering (on)" UBYTE COMP_0203_S 1 100 0 255 ECU_ADDRESS 0xFFFF2644 /begin FUNCTION_LIST /end FUNCTION_LIST /end MEASUREMENT
/begin MEASUREMENT tTAGBCD2 "Time constant for reverse switch filtering (on)" UBYTE COMP_0203_S 1 100 0 255 ECU_ADDRESS 0xFFFF2645 /begin FUNCTION_LIST /end FUNCTION_LIST /end MEASUREMENT
/begin MEASUREMENT tTCPUBKUP "A timer for the hard check" UBYTE COMP_0203_S 1 100 0 255 ECU_ADDRESS 0xFFFF264A /begin FUNCTION_LIST /end FUNCTION_LIST /end MEASUREMENT
/begin MEASUREMENT tTFEINTD "ST SW ONOFF The rest 1S delay" UBYTE COMP_0203_S 1 100 0 255 ECU_ADDRESS 0xFFFF264B /begin FUNCTION_LIST /end FUNCTION_LIST /end MEASUREMENT
/begin MEASUREMENT tTKT100M "KT low oil temperature tense 100mS judgement 1" UBYTE COMP_0203_S 1 100 0 255 ECU_ADDRESS 0xFFFF264E /begin FUNCTION_LIST /end FUNCTION_LIST /end MEASUREMENT
/begin MEASUREMENT tTKT100M2 "KT low oil temperature tense 100mS judgement 2" UBYTE COMP_0203_S 1 100 0 255 ECU_ADDRESS 0xFFFF264F /begin FUNCTION_LIST /end FUNCTION_LIST /end MEASUREMENT
/begin MEASUREMENT tTKT100M3 "KT low oil temperature tense 100mS judgement 3" UBYTE COMP_0203_S 1 100 0 255 ECU_ADDRESS 0xFFFF2650 /begin FUNCTION_LIST /end FUNCTION_LIST /end MEASUREMENT
/begin MEASUREMENT tTKT100M4 "KT low oil temperature tense 100mS judgement 4" UBYTE COMP_0203_S 1 100 0 255 ECU_ADDRESS 0xFFFF2651 /begin FUNCTION_LIST /end FUNCTION_LIST /end MEASUREMENT
/begin MEASUREMENT tTKT100M5 "KT low oil temperature tense 100mS judgement 5" UBYTE COMP_0203_S 1 100 0 255 ECU_ADDRESS 0xFFFF2652 /begin FUNCTION_LIST /end FUNCTION_LIST /end MEASUREMENT
/begin MEASUREMENT tTMACDEAC "timer for countdown" UBYTE COMP_0203_S 1 100 0 255 ECU_ADDRESS 0xFFFF2653 /begin FUNCTION_LIST /end FUNCTION_LIST /end MEASUREMENT
/begin MEASUREMENT tTMALCT "Control time" UBYTE COMP_0203_S 1 100 0 255 ECU_ADDRESS 0xFFFF2654 /begin FUNCTION_LIST /end FUNCTION_LIST /end MEASUREMENT
/begin MEASUREMENT tTMALP "Transient state judgement delay" UBYTE COMP_0203_S 1 100 0 255 ECU_ADDRESS 0xFFFF2655 /begin FUNCTION_LIST /end FUNCTION_LIST /end MEASUREMENT
/begin MEASUREMENT tTMDTD "Timer for toque down" UBYTE COMP_0203_S 1 100 0 255 ECU_ADDRESS 0xFFFF2658 /begin FUNCTION_LIST /end FUNCTION_LIST /end MEASUREMENT
/begin MEASUREMENT tTMGKTVO "50mS counter for LTVOS" UBYTE COMP_0203_S 1 100 0 255 ECU_ADDRESS 0xFFFF2659 /begin FUNCTION_LIST /end FUNCTION_LIST /end MEASUREMENT
/begin MEASUREMENT tTMIGSW "IGSW Off delay timer" UBYTE COMP_0203_S 1 100 0 255 ECU_ADDRESS 0xFFFF265B /begin FUNCTION_LIST /end FUNCTION_LIST /end MEASUREMENT
/begin MEASUREMENT tTMISC "ISC breakage diagnosis timer" UBYTE COMP_0203_S 1 100 0 255 ECU_ADDRESS 0xFFFF265D /begin FUNCTION_LIST /end FUNCTION_LIST /end MEASUREMENT
/begin MEASUREMENT tTMNEMT "A timer for the engine speed un-adjustment diagnosis" UBYTE COMP_0203_S 1 100 0 255 ECU_ADDRESS 0xFFFF2662 /begin FUNCTION_LIST /end FUNCTION_LIST /end MEASUREMENT
/begin MEASUREMENT tTMSTON "START SW After on, timer" UBYTE COMP_0203_S 1 100 0 255 ECU_ADDRESS 0xFFFF2664 /begin FUNCTION_LIST /end FUNCTION_LIST /end MEASUREMENT
/begin MEASUREMENT tTMTVO "TVOMIN renewal delay time" UBYTE COMP_0203_S 1 100 0 255 ECU_ADDRESS 0xFFFF2665 /begin FUNCTION_LIST /end FUNCTION_LIST /end MEASUREMENT
/begin MEASUREMENT tTMTVOI "TH/S After a F/S release, delay timer" UBYTE COMP_0203_S 1 100 0 255 ECU_ADDRESS 0xFFFF2666 /begin FUNCTION_LIST /end FUNCTION_LIST /end MEASUREMENT
/begin MEASUREMENT tTMUAFS "Intake failsafe switchover judgement delay" UBYTE COMP_0203_S 1 100 0 255 ECU_ADDRESS 0xFFFF2667 /begin FUNCTION_LIST /end FUNCTION_LIST /end MEASUREMENT
/begin MEASUREMENT tTMVBL "VB decline tense completion judgement delay" UBYTE COMP_0203_S 1 100 0 255 ECU_ADDRESS 0xFFFF2668 /begin FUNCTION_LIST /end FUNCTION_LIST /end MEASUREMENT
/begin MEASUREMENT tTO2HF1OK "O2HF1 breakage OK judgement delay time" UBYTE COMP_0203_S 1 100 0 255 ECU_ADDRESS 0xFFFF2669 /begin FUNCTION_LIST /end FUNCTION_LIST /end MEASUREMENT
/begin MEASUREMENT tTO2HF2OK "O2HF2 breakage OK judgement delay time" UBYTE COMP_0203_S 1 100 0 255 ECU_ADDRESS 0xFFFF266A /begin FUNCTION_LIST /end FUNCTION_LIST /end MEASUREMENT
/begin MEASUREMENT tTO2HFOK "FO2 heater OK judgement 100mS measuring timer" UBYTE COMP_0203_S 1 100 0 255 ECU_ADDRESS 0xFFFF266B /begin FUNCTION_LIST /end FUNCTION_LIST /end MEASUREMENT
/begin MEASUREMENT tTO2HR1OK "O2HR1 breakage OK judgement delay time" UBYTE COMP_0203_S 1 100 0 255 ECU_ADDRESS 0xFFFF266D /begin FUNCTION_LIST /end FUNCTION_LIST /end MEASUREMENT
/begin MEASUREMENT tTO2HR2OK "O2HR2 breakage OK judgement delay time" UBYTE COMP_0203_S 1 100 0 255 ECU_ADDRESS 0xFFFF266E /begin FUNCTION_LIST /end FUNCTION_LIST /end MEASUREMENT
/begin MEASUREMENT tTO2HROK "Rear O2 heater OK judgement 100mS measuring timer" UBYTE COMP_0203_S 1 100 0 255 ECU_ADDRESS 0xFFFF266F /begin FUNCTION_LIST /end FUNCTION_LIST /end MEASUREMENT
/begin MEASUREMENT tTPPSFNG1 "At the time of the P/S oil pressure sensor trouble, judgement timer 1" UBYTE COMP_0203_S 1 100 0 255 ECU_ADDRESS 0xFFFF2671 /begin FUNCTION_LIST /end FUNCTION_LIST /end MEASUREMENT
/begin MEASUREMENT tTPPSFNG2 "At the time of the P/S oil pressure sensor trouble, judgement timer 2" UBYTE COMP_0203_S 1 100 0 255 ECU_ADDRESS 0xFFFF2672 /begin FUNCTION_LIST /end FUNCTION_LIST /end MEASUREMENT
/begin MEASUREMENT tTSCVDV "Correlation diagnosis NG judgement delay timer" UBYTE COMP_0203_S 1 100 0 255 ECU_ADDRESS 0xFFFF2677 /begin FUNCTION_LIST /end FUNCTION_LIST /end MEASUREMENT
/begin MEASUREMENT tTSCVDV1 "Correlation diagnosis NG judgement delay timer" UBYTE COMP_0203_S 1 100 0 255 ECU_ADDRESS 0xFFFF2678 /begin FUNCTION_LIST /end FUNCTION_LIST /end MEASUREMENT
/begin MEASUREMENT tTSCVDV2 "Correlation diagnosis OK judgement delay timer" UBYTE COMP_0203_S 1 100 0 255 ECU_ADDRESS 0xFFFF2679 /begin FUNCTION_LIST /end FUNCTION_LIST /end MEASUREMENT
/begin MEASUREMENT tTTPFS "At the time of the TP start, failsafe release delay" UBYTE COMP_0203_S 1 100 0 255 ECU_ADDRESS 0xFFFF267A /begin FUNCTION_LIST /end FUNCTION_LIST /end MEASUREMENT
/begin MEASUREMENT tTUNLOCKT "Actual lockup release delay time" UBYTE COMP_0203_S 1 100 0 255 ECU_ADDRESS 0xFFFF267B /begin FUNCTION_LIST /end FUNCTION_LIST /end MEASUREMENT
/begin MEASUREMENT tTVBALR "VB decline tense completion judgement delay" UBYTE COMP_0203_S 1 100 0 255 ECU_ADDRESS 0xFFFF267C /begin FUNCTION_LIST /end FUNCTION_LIST /end MEASUREMENT
/begin MEASUREMENT tTVTERE "A stable experience flag set judgement time timer" UBYTE COMP_0203_S 1 100 0 255 ECU_ADDRESS 0xFFFF267D /begin FUNCTION_LIST /end FUNCTION_LIST /end MEASUREMENT
/begin MEASUREMENT tTVTERI "A stable experience flag set judgement time timer" UBYTE COMP_0203_S 1 100 0 255 ECU_ADDRESS 0xFFFF267E /begin FUNCTION_LIST /end FUNCTION_LIST /end MEASUREMENT
/begin MEASUREMENT tVBEGOF "EGR cut condition (7) judgement timer" UBYTE COMP_0203_S 1 100 0 255 ECU_ADDRESS 0xFFFF2680 /begin FUNCTION_LIST /end FUNCTION_LIST /end MEASUREMENT
/begin MEASUREMENT tVTCDLYE "VTC target angle switching delay" UBYTE COMP_0203_S 1 100 0 255 ECU_ADDRESS 0xFFFF2682 /begin FUNCTION_LIST /end FUNCTION_LIST /end MEASUREMENT
/begin MEASUREMENT tVTCDLYI "VTC target angle switching delay" UBYTE COMP_0203_S 1 100 0 255 ECU_ADDRESS 0xFFFF2683 /begin FUNCTION_LIST /end FUNCTION_LIST /end MEASUREMENT
/begin MEASUREMENT tVTCHTIME "I-gain prohibition time timer" UBYTE COMP_0203_S 1 100 0 255 ECU_ADDRESS 0xFFFF2684 /begin FUNCTION_LIST /end FUNCTION_LIST /end MEASUREMENT
/begin MEASUREMENT tVTCPOT1 "VTC Unusual position diagnosis VTC stop delay" UBYTE COMP_0203_S 1 100 0 255 ECU_ADDRESS 0xFFFF2686 /begin FUNCTION_LIST /end FUNCTION_LIST /end MEASUREMENT
/begin MEASUREMENT tVTCPOT2 "VTC Unusual position diagnosis judgement delay" UBYTE COMP_0203_S 1 100 0 255 ECU_ADDRESS 0xFFFF2688 /begin FUNCTION_LIST /end FUNCTION_LIST /end MEASUREMENT
/begin MEASUREMENT tVTPOTE1 "VTC Unusual position diagnosis VTC stop delay" UBYTE COMP_0203_S 1 100 0 255 ECU_ADDRESS 0xFFFF268A /begin FUNCTION_LIST /end FUNCTION_LIST /end MEASUREMENT
/begin MEASUREMENT tVTPOTE2 "VTC Unusual position diagnosis judgement delay" UBYTE COMP_0203_S 1 100 0 255 ECU_ADDRESS 0xFFFF268C /begin FUNCTION_LIST /end FUNCTION_LIST /end MEASUREMENT
/begin MEASUREMENT tSTTMOK_S "At the time of the extreme low temperature, engine initial judgement completion timer" UBYTE COMP_0203_S 1 100 0 255 ECU_ADDRESS 0xFFFF2690 /begin FUNCTION_LIST /end FUNCTION_LIST /end MEASUREMENT
/begin MEASUREMENT tTMTATE_S "Un-adjustment diagnosis delay timer" UBYTE COMP_0203_S 1 100 0 255 ECU_ADDRESS 0xFFFF2691 /begin FUNCTION_LIST /end FUNCTION_LIST /end MEASUREMENT
/begin MEASUREMENT tFSAF30M "After the mass airflow meter OK judgement, 30mS ec measuring timer" UBYTE COMP_0204_S 1 100 0 255 ECU_ADDRESS 0xFFFF2692 /begin FUNCTION_LIST /end FUNCTION_LIST /end MEASUREMENT
/begin MEASUREMENT tTMRMN10 "At the time of the vDLTMN operation, 10mS progress judgement timer" UBYTE COMP_0204_S 1 100 0 255 ECU_ADDRESS 0xFFFF2693 /begin FUNCTION_LIST /end FUNCTION_LIST /end MEASUREMENT
/begin MEASUREMENT tTMRN10 "At the time of the vNRPMz5 operation, 10mS progress judgement timer" UBYTE COMP_0204_S 1 100 0 255 ECU_ADDRESS 0xFFFF2694 /begin FUNCTION_LIST /end FUNCTION_LIST /end MEASUREMENT
/begin MEASUREMENT tTMRNE "At the time of the vDLTNE operation, 10mS progress judgement timer" UBYTE COMP_0204_S 1 100 0 255 ECU_ADDRESS 0xFFFF2695 /begin FUNCTION_LIST /end FUNCTION_LIST /end MEASUREMENT
/begin MEASUREMENT tTVOOK "A timer for the throttle sensor OK judgement" UBYTE COMP_0204_S 1 100 0 255 ECU_ADDRESS 0xFFFF2696 /begin FUNCTION_LIST /end FUNCTION_LIST /end MEASUREMENT
/begin MEASUREMENT tVSPCKCNT "176.5mS progress check" UBYTE COMP_0204_S 1 100 0 255 ECU_ADDRESS 0xFFFF2697 /begin FUNCTION_LIST /end FUNCTION_LIST /end MEASUREMENT
/begin MEASUREMENT cCRO2H "The rest O2/S RICH side initialization counter" UBYTE COMP_0191 1 100 0 255 ECU_ADDRESS 0xFFFF269C /begin FUNCTION_LIST /end FUNCTION_LIST /end MEASUREMENT
/begin MEASUREMENT cCRO2L "The rest O2/S LEAN side initialization counter" UBYTE COMP_0191 1 100 0 255 ECU_ADDRESS 0xFFFF269E /begin FUNCTION_LIST /end FUNCTION_LIST /end MEASUREMENT
/begin MEASUREMENT cECTTM "ALPHA switchover delay rotation" UBYTE COMP_0191 1 100 0 255 ECU_ADDRESS 0xFFFF26A0 /begin FUNCTION_LIST /end FUNCTION_LIST /end MEASUREMENT
/begin MEASUREMENT cINLDL "O2 sensor activated judgment rotation (lean)" UBYTE COMP_0191 1 100 0 255 ECU_ADDRESS 0xFFFF26A1 /begin FUNCTION_LIST /end FUNCTION_LIST /end MEASUREMENT
/begin MEASUREMENT cINLDR "O2 sensor activated judgment rotation (rich)" UBYTE COMP_0191 1 100 0 255 ECU_ADDRESS 0xFFFF26A3 /begin FUNCTION_LIST /end FUNCTION_LIST /end MEASUREMENT
/begin MEASUREMENT cACREF "REF Counter" UBYTE COMP_0287 1 100 0 255 ECU_ADDRESS 0xFFFF26A6 /begin FUNCTION_LIST /end FUNCTION_LIST /end MEASUREMENT
/begin MEASUREMENT cAFSAMPLE "A/F sensor voltage sampling counter" UBYTE COMP_0287 1 100 0 255 ECU_ADDRESS 0xFFFF26A8 /begin FUNCTION_LIST /end FUNCTION_LIST /end MEASUREMENT
/begin MEASUREMENT cCTSPIG "A REF counter for the sampling judgement" UBYTE COMP_0287 1 100 0 255 ECU_ADDRESS 0xFFFF26A9 /begin FUNCTION_LIST /end FUNCTION_LIST /end MEASUREMENT
/begin MEASUREMENT cO2SAMPLE "VO2 sampling counter" UBYTE COMP_0287 1 100 0 255 ECU_ADDRESS 0xFFFF26AB /begin FUNCTION_LIST /end FUNCTION_LIST /end MEASUREMENT
/begin MEASUREMENT cQTRREF "QTRREF switching ÇË counter" UBYTE COMP_0287 1 100 0 255 ECU_ADDRESS 0xFFFF26AC /begin FUNCTION_LIST /end FUNCTION_LIST /end MEASUREMENT
/begin MEASUREMENT cRFNREF "REF Counter" UBYTE COMP_0287 1 100 0 255 ECU_ADDRESS 0xFFFF26AD /begin FUNCTION_LIST /end FUNCTION_LIST /end MEASUREMENT
/begin MEASUREMENT cRSEDRF "After the lean, rich-shift control completion delay counter" UBYTE COMP_0287 1 100 0 255 ECU_ADDRESS 0xFFFF26AE /begin FUNCTION_LIST /end FUNCTION_LIST /end MEASUREMENT
/begin MEASUREMENT cTEGRDLY "Target EGR rate switching delay counter" UBYTE COMP_0287 1 100 0 255 ECU_ADDRESS 0xFFFF26B0 /begin FUNCTION_LIST /end FUNCTION_LIST /end MEASUREMENT
/begin MEASUREMENT cTREFINT "REFJOB executive number of times timer" UBYTE COMP_0287 1 100 0 255 ECU_ADDRESS 0xFFFF26B1 /begin FUNCTION_LIST /end FUNCTION_LIST /end MEASUREMENT
/begin MEASUREMENT cVTCFBTME "Switchover condition judgement delay counter" UBYTE COMP_0287 1 100 0 255 ECU_ADDRESS 0xFFFF26B2 /begin FUNCTION_LIST /end FUNCTION_LIST /end MEASUREMENT
/begin MEASUREMENT cVTCFBTMI "Switchover condition judgement delay counter" UBYTE COMP_0287 1 100 0 255 ECU_ADDRESS 0xFFFF26B4 /begin FUNCTION_LIST /end FUNCTION_LIST /end MEASUREMENT
/begin MEASUREMENT tSTSWTR2 "After STSWONOFF, more than 600 seconds" UWORD COMP_0201_S 1 100 0 65535 ECU_ADDRESS 0xFFFF26B6 /begin FUNCTION_LIST /end FUNCTION_LIST /end MEASUREMENT
/begin MEASUREMENT tSTSWTRP "After STSWONOFF, more than 600 seconds" UWORD COMP_0201_S 1 100 0 65535 ECU_ADDRESS 0xFFFF26B8 /begin FUNCTION_LIST /end FUNCTION_LIST /end MEASUREMENT
/begin MEASUREMENT tTMEVC2 "Re-purge check prohibition time timer" UWORD COMP_0201_S 1 100 0 65535 ECU_ADDRESS 0xFFFF26BC /begin FUNCTION_LIST /end FUNCTION_LIST /end MEASUREMENT
/begin MEASUREMENT tTMOBEV "After the heat resisting purge cut, time" UWORD COMP_0201_S 1 100 0 65535 ECU_ADDRESS 0xFFFF26BE /begin FUNCTION_LIST /end FUNCTION_LIST /end MEASUREMENT
/begin MEASUREMENT tTTOQFG "Lean operation permission delay timer" UWORD COMP_0201_S 1 100 0 65535 ECU_ADDRESS 0xFFFF26C0 /begin FUNCTION_LIST /end FUNCTION_LIST /end MEASUREMENT
/begin MEASUREMENT tIDTPST "Start SW ONOFF rest timer" UWORD COMP_0202_S 1 100 0 65535 ECU_ADDRESS 0xFFFF26C2 /begin FUNCTION_LIST /end FUNCTION_LIST /end MEASUREMENT
/begin MEASUREMENT tDASTDL "Delay for DLTADV from transient to steady state timer" UWORD COMP_0203_S 1 100 0 65535 ECU_ADDRESS 0xFFFF26C4 /begin FUNCTION_LIST /end FUNCTION_LIST /end MEASUREMENT
/begin MEASUREMENT tFCD "Time for ÉvÉäÉgÉãÉN compensation start time judgement" UWORD COMP_0203_S 1 100 0 65535 ECU_ADDRESS 0xFFFF26C8 /begin FUNCTION_LIST /end FUNCTION_LIST /end MEASUREMENT
/begin MEASUREMENT tFCRADVT "FCRADV set duration" UWORD COMP_0203_S 1 100 0 65535 ECU_ADDRESS 0xFFFF26CA /begin FUNCTION_LIST /end FUNCTION_LIST /end MEASUREMENT
/begin MEASUREMENT tNSETVB2 "At the time of the battery voltage descent, timer 2" UWORD COMP_0203_S 1 100 0 65535 ECU_ADDRESS 0xFFFF26CE /begin FUNCTION_LIST /end FUNCTION_LIST /end MEASUREMENT
/begin MEASUREMENT tTMBRKFL2 "Fuel cut start time condition measuring timer" UWORD COMP_0203_S 1 100 0 65535 ECU_ADDRESS 0xFFFF26D8 /begin FUNCTION_LIST /end FUNCTION_LIST /end MEASUREMENT
/begin MEASUREMENT tTMUADJ "The delay which unusually judges an intake" UWORD COMP_0203_S 1 100 0 65535 ECU_ADDRESS 0xFFFF26DA /begin FUNCTION_LIST /end FUNCTION_LIST /end MEASUREMENT
/begin MEASUREMENT tTMUAOK "Intake abnormality diagnosis OK judgement delay" UWORD COMP_0203_S 1 100 0 65535 ECU_ADDRESS 0xFFFF26DC /begin FUNCTION_LIST /end FUNCTION_LIST /end MEASUREMENT
/begin MEASUREMENT tVSPCNT "706mS progress check" UWORD COMP_0204_S 1 100 0 65535 ECU_ADDRESS 0xFFFF26DE /begin FUNCTION_LIST /end FUNCTION_LIST /end MEASUREMENT
/begin MEASUREMENT tVSPCNTS "176.5mS progress check" UWORD COMP_0204_S 1 100 0 65535 ECU_ADDRESS 0xFFFF26E0 /begin FUNCTION_LIST /end FUNCTION_LIST /end MEASUREMENT
/begin MEASUREMENT cRINT1 "After PHOS operation starts, engine rotation counter" UWORD COMP_0191 1 100 0 65535 ECU_ADDRESS 0xFFFF26E2 /begin FUNCTION_LIST /end FUNCTION_LIST /end MEASUREMENT
/begin MEASUREMENT avADJDDL "DDL2 response code" UBYTE COMP_0004 1 100 0 255 ECU_ADDRESS 0xFFFF40F4 /begin FUNCTION_LIST /end FUNCTION_LIST /end MEASUREMENT
/begin MEASUREMENT avAFFRVMX "Cruise control and speed limiter status : parameter sent to the cluster by CAN for display" UBYTE COMP_0068 1 100 0 255 ECU_ADDRESS 0xFFFF40F5 /begin FUNCTION_LIST /end FUNCTION_LIST /end MEASUREMENT
/begin MEASUREMENT avALTFPW "Filtered alternator mechanical power (W) ." UWORD COMP_0365_S 1 100 0 655350 ECU_ADDRESS 0xFFFF22FC /begin FUNCTION_LIST /end FUNCTION_LIST /end MEASUREMENT
/begin MEASUREMENT avALTMX "Output DUTY upper limit value" UBYTE COMP_0047 1 100 0 127.5 ECU_ADDRESS 0xFFFF22FE /begin FUNCTION_LIST /end FUNCTION_LIST /end MEASUREMENT
/begin MEASUREMENT avAPOFORCE "The accelerator pedal drive power" SWORD COMP_0030_S 1 100 -32768 32767 ECU_ADDRESS 0xFFFF40F8 /begin FUNCTION_LIST /end FUNCTION_LIST /end MEASUREMENT
/begin MEASUREMENT avAPSCCTR "Counter of accelerator pedal safety case detected failure N Åã 1 (memorized)" UBYTE COMP_0068 1 100 0 255 ECU_ADDRESS 0xFFFFB681 /begin FUNCTION_LIST /end FUNCTION_LIST /end MEASUREMENT
/begin MEASUREMENT avBBLKCTRM "Maximum value of counter for detection of blocked button. Saved in EEPROM" UBYTE COMP_0068 1 100 0 255 ECU_ADDRESS 0xFFFFB682 /begin FUNCTION_LIST /end FUNCTION_LIST /end MEASUREMENT
/begin MEASUREMENT avCCFAL "Carrier of all the failures which cause CC failure" UBYTE COMP_0068 1 100 0 255 ECU_ADDRESS 0xFFFFB68A /begin FUNCTION_LIST /end FUNCTION_LIST /end MEASUREMENT
/begin MEASUREMENT avCCSLDACN "Compilation of all the cru/sl normal causes of deactivation." UBYTE COMP_0068 1 100 0 255 ECU_ADDRESS 0xFFFF40FA /begin FUNCTION_LIST /end FUNCTION_LIST /end MEASUREMENT
/begin MEASUREMENT avCCSLDSYS "Compilation of all the cru/sl normal deactivations due to system causes. Saved in E? PROM." UBYTE COMP_0068 1 100 0 255 ECU_ADDRESS 0xFFFFB68B /begin FUNCTION_LIST /end FUNCTION_LIST /end MEASUREMENT
/begin MEASUREMENT avCCSLFAL "Carrier of all the failures which cause CC/SL failure" UBYTE COMP_0068 1 100 0 255 ECU_ADDRESS 0xFFFFB68C /begin FUNCTION_LIST /end FUNCTION_LIST /end MEASUREMENT
/begin MEASUREMENT avCCSLFREF "Force request delivered by the control loop of the cruise control and speed limiter strategy" SWORD COMP_0030_S 1 100 -32768 32767 ECU_ADDRESS 0xFFFF40FC /begin FUNCTION_LIST /end FUNCTION_LIST /end MEASUREMENT
/begin MEASUREMENT avCCSLG "Filtered vehicle acceleration for cruise control    and speed limiter" SWORD COMP_0531_S 1 100 -3276.8 3276.7 ECU_ADDRESS 0xFFFF40FE /begin FUNCTION_LIST /end FUNCTION_LIST /end MEASUREMENT
/begin MEASUREMENT avCCSLVREF "Filtered speed at the corrector input" UWORD COMP_0375_S 1 100 0 655.35 ECU_ADDRESS 0xFFFF4100 /begin FUNCTION_LIST /end FUNCTION_LIST /end MEASUREMENT
/begin MEASUREMENT avCCSLVRO "Reference speed increment" UWORD COMP_0532_S 1 100 0 655.35 ECU_ADDRESS 0xFFFF4102 /begin FUNCTION_LIST /end FUNCTION_LIST /end MEASUREMENT
/begin MEASUREMENT avCCSLVSP "Vehicle speed filtered by the cruise control/speed limiter strategy" UWORD COMP_0375_S 1 100 0 655.35 ECU_ADDRESS 0xFFFF4104 /begin FUNCTION_LIST /end FUNCTION_LIST /end MEASUREMENT
/begin MEASUREMENT avCCSNAPST "Snapshot data of root cause when CC shut-off occurs" UBYTE COMP_0068 1 100 0 255 ECU_ADDRESS 0xFFFF4106 /begin FUNCTION_LIST /end FUNCTION_LIST /end MEASUREMENT
/begin MEASUREMENT avCCSNAPST_C#1_R#1 "Snapshot data of root cause when CC shut-off occurs" UBYTE COMP_0068 1 100 0 255 ECU_ADDRESS 0xFFFF4106 /begin FUNCTION_LIST /end FUNCTION_LIST /end MEASUREMENT
/begin MEASUREMENT avCCSNAPST_C#2_R#1 "Snapshot data of root cause when CC shut-off occurs" UBYTE COMP_0068 1 100 0 255 ECU_ADDRESS 0xFFFF4107 /begin FUNCTION_LIST /end FUNCTION_LIST /end MEASUREMENT
/begin MEASUREMENT avCCSNAPST_C#3_R#1 "Snapshot data of root cause when CC shut-off occurs" UBYTE COMP_0068 1 100 0 255 ECU_ADDRESS 0xFFFF4108 /begin FUNCTION_LIST /end FUNCTION_LIST /end MEASUREMENT
/begin MEASUREMENT avCCSNAPST_C#4_R#1 "Snapshot data of root cause when CC shut-off occurs" UBYTE COMP_0068 1 100 0 255 ECU_ADDRESS 0xFFFF4109 /begin FUNCTION_LIST /end FUNCTION_LIST /end MEASUREMENT
/begin MEASUREMENT avCCSNAPST_C#5_R#1 "Snapshot data of root cause when CC shut-off occurs" UBYTE COMP_0068 1 100 0 255 ECU_ADDRESS 0xFFFF410A /begin FUNCTION_LIST /end FUNCTION_LIST /end MEASUREMENT
/begin MEASUREMENT avCCSNAPST_C#6_R#1 "Snapshot data of root cause when CC shut-off occurs" UBYTE COMP_0068 1 100 0 255 ECU_ADDRESS 0xFFFF410B /begin FUNCTION_LIST /end FUNCTION_LIST /end MEASUREMENT
/begin MEASUREMENT avCCSNAPST_C#7_R#1 "Snapshot data of root cause when CC shut-off occurs" UBYTE COMP_0068 1 100 0 255 ECU_ADDRESS 0xFFFF410C /begin FUNCTION_LIST /end FUNCTION_LIST /end MEASUREMENT
/begin MEASUREMENT avCCSNAPST_C#8_R#1 "Snapshot data of root cause when CC shut-off occurs" UBYTE COMP_0068 1 100 0 255 ECU_ADDRESS 0xFFFF410D /begin FUNCTION_LIST /end FUNCTION_LIST /end MEASUREMENT
/begin MEASUREMENT avCCSNAPST_C#9_R#1 "Snapshot data of root cause when CC shut-off occurs" UBYTE COMP_0068 1 100 0 255 ECU_ADDRESS 0xFFFF410E /begin FUNCTION_LIST /end FUNCTION_LIST /end MEASUREMENT
/begin MEASUREMENT avCCSNAPST_C#10_R#1 "Snapshot data of root cause when CC shut-off occurs" UBYTE COMP_0068 1 100 0 255 ECU_ADDRESS 0xFFFF410F /begin FUNCTION_LIST /end FUNCTION_LIST /end MEASUREMENT
/begin MEASUREMENT avCCSNAPST_C#11_R#1 "Snapshot data of root cause when CC shut-off occurs" UBYTE COMP_0068 1 100 0 255 ECU_ADDRESS 0xFFFF4110 /begin FUNCTION_LIST /end FUNCTION_LIST /end MEASUREMENT
/begin MEASUREMENT avCCSNAPST_C#12_R#1 "Snapshot data of root cause when CC shut-off occurs" UBYTE COMP_0068 1 100 0 255 ECU_ADDRESS 0xFFFF4111 /begin FUNCTION_LIST /end FUNCTION_LIST /end MEASUREMENT
/begin MEASUREMENT avCCSNAPST_C#13_R#1 "Snapshot data of root cause when CC shut-off occurs" UBYTE COMP_0068 1 100 0 255 ECU_ADDRESS 0xFFFF4112 /begin FUNCTION_LIST /end FUNCTION_LIST /end MEASUREMENT
/begin MEASUREMENT avCCSNAPST_C#14_R#1 "Snapshot data of root cause when CC shut-off occurs" UBYTE COMP_0068 1 100 0 255 ECU_ADDRESS 0xFFFF4113 /begin FUNCTION_LIST /end FUNCTION_LIST /end MEASUREMENT
/begin MEASUREMENT avCCSNAPST_C#15_R#1 "Snapshot data of root cause when CC shut-off occurs" UBYTE COMP_0068 1 100 0 255 ECU_ADDRESS 0xFFFF4114 /begin FUNCTION_LIST /end FUNCTION_LIST /end MEASUREMENT
/begin MEASUREMENT avCCSNAPST_C#16_R#1 "Snapshot data of root cause when CC shut-off occurs" UBYTE COMP_0068 1 100 0 255 ECU_ADDRESS 0xFFFF4115 /begin FUNCTION_LIST /end FUNCTION_LIST /end MEASUREMENT
/begin MEASUREMENT avCCSNAPST_C#17_R#1 "Snapshot data of root cause when CC shut-off occurs" UBYTE COMP_0068 1 100 0 255 ECU_ADDRESS 0xFFFF4116 /begin FUNCTION_LIST /end FUNCTION_LIST /end MEASUREMENT
/begin MEASUREMENT avCCSNAPST_C#18_R#1 "Snapshot data of root cause when CC shut-off occurs" UBYTE COMP_0068 1 100 0 255 ECU_ADDRESS 0xFFFF4117 /begin FUNCTION_LIST /end FUNCTION_LIST /end MEASUREMENT
/begin MEASUREMENT avCCSNAPST_C#19_R#1 "Snapshot data of root cause when CC shut-off occurs" UBYTE COMP_0068 1 100 0 255 ECU_ADDRESS 0xFFFF4118 /begin FUNCTION_LIST /end FUNCTION_LIST /end MEASUREMENT
/begin MEASUREMENT avCCSNAPST_C#20_R#1 "Snapshot data of root cause when CC shut-off occurs" UBYTE COMP_0068 1 100 0 255 ECU_ADDRESS 0xFFFF4119 /begin FUNCTION_LIST /end FUNCTION_LIST /end MEASUREMENT
/begin MEASUREMENT avCCSNAPST_C#21_R#1 "Snapshot data of root cause when CC shut-off occurs" UBYTE COMP_0068 1 100 0 255 ECU_ADDRESS 0xFFFF411A /begin FUNCTION_LIST /end FUNCTION_LIST /end MEASUREMENT
/begin MEASUREMENT avCCSNAPST_C#22_R#1 "Snapshot data of root cause when CC shut-off occurs" UBYTE COMP_0068 1 100 0 255 ECU_ADDRESS 0xFFFF411B /begin FUNCTION_LIST /end FUNCTION_LIST /end MEASUREMENT
/begin MEASUREMENT avCCSNAPST_C#23_R#1 "Snapshot data of root cause when CC shut-off occurs" UBYTE COMP_0068 1 100 0 255 ECU_ADDRESS 0xFFFF411C /begin FUNCTION_LIST /end FUNCTION_LIST /end MEASUREMENT
/begin MEASUREMENT avCCSNAPST_C#24_R#1 "Snapshot data of root cause when CC shut-off occurs" UBYTE COMP_0068 1 100 0 255 ECU_ADDRESS 0xFFFF411D /begin FUNCTION_LIST /end FUNCTION_LIST /end MEASUREMENT
/begin MEASUREMENT avCCSNAPST_C#25_R#1 "Snapshot data of root cause when CC shut-off occurs" UBYTE COMP_0068 1 100 0 255 ECU_ADDRESS 0xFFFF411E /begin FUNCTION_LIST /end FUNCTION_LIST /end MEASUREMENT
/begin MEASUREMENT avCCSNAPST_C#26_R#1 "Snapshot data of root cause when CC shut-off occurs" UBYTE COMP_0068 1 100 0 255 ECU_ADDRESS 0xFFFF411F /begin FUNCTION_LIST /end FUNCTION_LIST /end MEASUREMENT
/begin MEASUREMENT avCCSNAPST_C#27_R#1 "Snapshot data of root cause when CC shut-off occurs" UBYTE COMP_0068 1 100 0 255 ECU_ADDRESS 0xFFFF4120 /begin FUNCTION_LIST /end FUNCTION_LIST /end MEASUREMENT
/begin MEASUREMENT avCCSNAPST_C#28_R#1 "Snapshot data of root cause when CC shut-off occurs" UBYTE COMP_0068 1 100 0 255 ECU_ADDRESS 0xFFFF4121 /begin FUNCTION_LIST /end FUNCTION_LIST /end MEASUREMENT
/begin MEASUREMENT avCCSNAPST_C#29_R#1 "Snapshot data of root cause when CC shut-off occurs" UBYTE COMP_0068 1 100 0 255 ECU_ADDRESS 0xFFFF4122 /begin FUNCTION_LIST /end FUNCTION_LIST /end MEASUREMENT
/begin MEASUREMENT avCCSNAPST_C#30_R#1 "Snapshot data of root cause when CC shut-off occurs" UBYTE COMP_0068 1 100 0 255 ECU_ADDRESS 0xFFFF4123 /begin FUNCTION_LIST /end FUNCTION_LIST /end MEASUREMENT
/begin MEASUREMENT avCCSNAPST_C#31_R#1 "Snapshot data of root cause when CC shut-off occurs" UBYTE COMP_0068 1 100 0 255 ECU_ADDRESS 0xFFFF4124 /begin FUNCTION_LIST /end FUNCTION_LIST /end MEASUREMENT
/begin MEASUREMENT avCCSNAPST_C#32_R#1 "Snapshot data of root cause when CC shut-off occurs" UBYTE COMP_0068 1 100 0 255 ECU_ADDRESS 0xFFFF4125 /begin FUNCTION_LIST /end FUNCTION_LIST /end MEASUREMENT
/begin MEASUREMENT avCCSNAPST_C#33_R#1 "Snapshot data of root cause when CC shut-off occurs" UBYTE COMP_0068 1 100 0 255 ECU_ADDRESS 0xFFFF4126 /begin FUNCTION_LIST /end FUNCTION_LIST /end MEASUREMENT
/begin MEASUREMENT avCCSNAPST_C#34_R#1 "Snapshot data of root cause when CC shut-off occurs" UBYTE COMP_0068 1 100 0 255 ECU_ADDRESS 0xFFFF4127 /begin FUNCTION_LIST /end FUNCTION_LIST /end MEASUREMENT
/begin MEASUREMENT avCNSMCNT "IT MASTER is turned, integration fuel consumption quantity counter" UBYTE COMP_0068 1 100 0 255 ECU_ADDRESS 0xFFFF2304 /begin FUNCTION_LIST /end FUNCTION_LIST /end MEASUREMENT
/begin MEASUREMENT avCNTCAT "Catalyst diagnosis completion number of times counter" UBYTE COMP_0016 1 100 0 255 ECU_ADDRESS 0xFFFFB690 /begin FUNCTION_LIST /end FUNCTION_LIST /end MEASUREMENT
/begin MEASUREMENT avCOMDRACC "ACC steering wheel commands transmitted to ACC ECU" UBYTE COMP_0068 1 100 0 255 ECU_ADDRESS 0xFFFF4128 /begin FUNCTION_LIST /end FUNCTION_LIST /end MEASUREMENT
/begin MEASUREMENT avCOMDTMP "State of the steering wheel buttons : not filtered" UBYTE COMP_0068 1 100 0 255 ECU_ADDRESS 0xFFFF4129 /begin FUNCTION_LIST /end FUNCTION_LIST /end MEASUREMENT
/begin MEASUREMENT avCRUCMPDG "Carrier for safety failure diagnosis" UBYTE COMP_0068 1 100 0 255 ECU_ADDRESS 0xFFFFB692 /begin FUNCTION_LIST /end FUNCTION_LIST /end MEASUREMENT
/begin MEASUREMENT avCRUCON "Cruise control state" UBYTE COMP_0068 1 100 0 255 ECU_ADDRESS 0xFFFF40E2 /begin FUNCTION_LIST /end FUNCTION_LIST /end MEASUREMENT
/begin MEASUREMENT avCSACMXDS "Maximum duration of SET+ button press" UBYTE COMP_0013 1 100 0 255 ECU_ADDRESS 0xFFFFB693 /begin FUNCTION_LIST /end FUNCTION_LIST /end MEASUREMENT
/begin MEASUREMENT avCSDEMXDS "Maximum duration of SET- button press" UBYTE COMP_0013 1 100 0 255 ECU_ADDRESS 0xFFFFB694 /begin FUNCTION_LIST /end FUNCTION_LIST /end MEASUREMENT
/begin MEASUREMENT avCSRSMXDS "Maximum duration of RESUME button press" UBYTE COMP_0013 1 100 0 255 ECU_ADDRESS 0xFFFFB695 /begin FUNCTION_LIST /end FUNCTION_LIST /end MEASUREMENT
/begin MEASUREMENT avCSSUMXDS "Maximum duration of SUSPEND button press" UBYTE COMP_0013 1 100 0 255 ECU_ADDRESS 0xFFFFB696 /begin FUNCTION_LIST /end FUNCTION_LIST /end MEASUREMENT
/begin MEASUREMENT avCTEMBMX "Multiplexed state of the clutch pedal switch (1=pressed clutch pedal or not connected)" UBYTE COMP_0068 1 100 0 255 ECU_ADDRESS 0xFFFF412A /begin FUNCTION_LIST /end FUNCTION_LIST /end MEASUREMENT
/begin MEASUREMENT avDLINCONF "State data of driveline configuration (Transmission type)." UBYTE COMP_0068 1 100 0 255 ECU_ADDRESS 0xFFFF412B /begin FUNCTION_LIST /end FUNCTION_LIST /end MEASUREMENT
/begin MEASUREMENT avDRPWTSP "Driver powertrain setpoint" UWORD COMP_0362_S 1 100 0 8191.875 ECU_ADDRESS 0xFFFF412C /begin FUNCTION_LIST /end FUNCTION_LIST /end MEASUREMENT
/begin MEASUREMENT avDRVMDFAC "Driving mode factor" UBYTE COMP_0425 1 100 0 99.99999981 ECU_ADDRESS 0xFFFF412E /begin FUNCTION_LIST /end FUNCTION_LIST /end MEASUREMENT
/begin MEASUREMENT avECMSUM "ECM SUM value" UBYTE COMP_0068 1 100 0 255 ECU_ADDRESS 0xFFFFB69E /begin FUNCTION_LIST /end FUNCTION_LIST /end MEASUREMENT
/begin MEASUREMENT avECMSUM_R#1 "ECM SUM value" UBYTE COMP_0068 1 100 0 255 ECU_ADDRESS 0xFFFFB69E /begin FUNCTION_LIST /end FUNCTION_LIST /end MEASUREMENT
/begin MEASUREMENT avECMSUM_R#2 "ECM SUM value" UBYTE COMP_0068 1 100 0 255 ECU_ADDRESS 0xFFFFB69F /begin FUNCTION_LIST /end FUNCTION_LIST /end MEASUREMENT
/begin MEASUREMENT avECMSUM_R#3 "ECM SUM value" UBYTE COMP_0068 1 100 0 255 ECU_ADDRESS 0xFFFFB6A0 /begin FUNCTION_LIST /end FUNCTION_LIST /end MEASUREMENT
/begin MEASUREMENT avECMSUM_R#4 "ECM SUM value" UBYTE COMP_0068 1 100 0 255 ECU_ADDRESS 0xFFFFB6A1 /begin FUNCTION_LIST /end FUNCTION_LIST /end MEASUREMENT
/begin MEASUREMENT avETADGCY "CAT Diagnosis Status (for Start Routine By Local Identifier)" UBYTE COMP_0004 1 100 0 255 ECU_ADDRESS 0xFFFF412F /begin FUNCTION_LIST /end FUNCTION_LIST /end MEASUREMENT
/begin MEASUREMENT avETARVMX "Engine states" UBYTE COMP_0068 1 100 0 255 ECU_ADDRESS 0xFFFF4130 /begin FUNCTION_LIST /end FUNCTION_LIST /end MEASUREMENT
/begin MEASUREMENT avFINLISS "Final idle speed setpoint" UWORD COMP_0337_S 1 100 0 65535 ECU_ADDRESS 0xFFFF4132 /begin FUNCTION_LIST /end FUNCTION_LIST /end MEASUREMENT
/begin MEASUREMENT avFINLISSF "Final idle speed setpoint with Diag offset" UWORD COMP_0337_S 1 100 0 65535 ECU_ADDRESS 0xFFFF4134 /begin FUNCTION_LIST /end FUNCTION_LIST /end MEASUREMENT
/begin MEASUREMENT avFO2HDONf "O2 heater duty output flag" UBYTE COMP_0004 1 100 0 255 ECU_ADDRESS 0xFFFF2328 /begin FUNCTION_LIST /end FUNCTION_LIST /end MEASUREMENT
/begin MEASUREMENT avFO2HONf "FrO2 heater" UBYTE COMP_0004 1 100 0 255 ECU_ADDRESS 0xFFFF2329 /begin FUNCTION_LIST /end FUNCTION_LIST /end MEASUREMENT
/begin MEASUREMENT avGEARMT "Transmission ratio for manual gearbox calculated by the engine control unit via Vitrap" UBYTE COMP_0068 1 100 0 255 ECU_ADDRESS 0xFFFF413A /begin FUNCTION_LIST /end FUNCTION_LIST /end MEASUREMENT
/begin MEASUREMENT avGFO2N "Former O2 sensor unusual voltage diagnosis voltage minimum value for GST" UBYTE COMP_0104 1 100 0 2550 ECU_ADDRESS 0xFFFFB6E5 /begin FUNCTION_LIST /end FUNCTION_LIST /end MEASUREMENT
/begin MEASUREMENT avGFO2X "Former O2 sensor unusual voltage diagnosis voltage maximum value for GST" UBYTE COMP_0104 1 100 0 2550 ECU_ADDRESS 0xFFFFB6E7 /begin FUNCTION_LIST /end FUNCTION_LIST /end MEASUREMENT
/begin MEASUREMENT avIVSPCOMN "Vehicle speed order value mirror value" SLONG COMP_0001_S 1 100 -1842.540969984 1842.540969126 ECU_ADDRESS 0xFFFF413C /begin FUNCTION_LIST /end FUNCTION_LIST /end MEASUREMENT
/begin MEASUREMENT avLANTPO "Engine torque equivalent signal" UBYTE COMP_0001 1 100 0 31.875 ECU_ADDRESS 0xFFFF4140 /begin FUNCTION_LIST /end FUNCTION_LIST /end MEASUREMENT
/begin MEASUREMENT avMAXAVTQ "The torque maximum value that engine output is possible" SWORD COMP_0228 1 100 -3276.8 3276.7 ECU_ADDRESS 0xFFFF4142 /begin FUNCTION_LIST /end FUNCTION_LIST /end MEASUREMENT
/begin MEASUREMENT avMAXDAVTQ "Maximum available torque with dynamic limitation" UWORD COMP_0345_S 1 100 -400 1647.96875 ECU_ADDRESS 0xFFFF4144 /begin FUNCTION_LIST /end FUNCTION_LIST /end MEASUREMENT
/begin MEASUREMENT avMAXSAVTQ "Maximum absolute effective torque" UWORD COMP_0345_S 1 100 -400 1647.96875 ECU_ADDRESS 0xFFFF4146 /begin FUNCTION_LIST /end FUNCTION_LIST /end MEASUREMENT
/begin MEASUREMENT avMILOUTMX "MILLlamp" UBYTE COMP_0068 1 100 0 255 ECU_ADDRESS 0xFFFF4148 /begin FUNCTION_LIST /end FUNCTION_LIST /end MEASUREMENT
/begin MEASUREMENT avMILREQ1 "MIL ignition state requested by MUX encoding" UBYTE COMP_0068 1 100 0 255 ECU_ADDRESS 0xFFFF4149 /begin FUNCTION_LIST /end FUNCTION_LIST /end MEASUREMENT
/begin MEASUREMENT avMILREQ2 "Readiness state indication by MIL" UBYTE COMP_0068 1 100 0 255 ECU_ADDRESS 0xFFFF414A /begin FUNCTION_LIST /end FUNCTION_LIST /end MEASUREMENT
/begin MEASUREMENT avMINAVTQ "The torque minimum value that engine output is possible" SWORD COMP_0228 1 100 -3276.8 3276.7 ECU_ADDRESS 0xFFFF414C /begin FUNCTION_LIST /end FUNCTION_LIST /end MEASUREMENT
/begin MEASUREMENT avNOAGBTRQ "torque request without agb request sent for AGB on CAN" UWORD COMP_0345_S 1 100 -400 1647.96875 ECU_ADDRESS 0xFFFF414E /begin FUNCTION_LIST /end FUNCTION_LIST /end MEASUREMENT
/begin MEASUREMENT avNOAGBTRR "target torque request without agb request sent for AGB on CAN" UWORD COMP_0345_S 1 100 -400 1647.96875 ECU_ADDRESS 0xFFFF4150 /begin FUNCTION_LIST /end FUNCTION_LIST /end MEASUREMENT
/begin MEASUREMENT avO2HDTY "O2 sensor heater duty" UWORD COMP_0133_S 1 100 0 2559.9609375 ECU_ADDRESS 0xFFFF233C /begin FUNCTION_LIST /end FUNCTION_LIST /end MEASUREMENT
/begin MEASUREMENT avPENDPR9 "A service 09hPR transmitting requirement for Pending" UBYTE COMP_0068 1 100 0 255 ECU_ADDRESS 0xFFFF4152 /begin FUNCTION_LIST /end FUNCTION_LIST /end MEASUREMENT
/begin MEASUREMENT avPMAXALT "MaximumMechanicalPowerAllowed" UBYTE COMP_0360_S 1 100 0 10200 ECU_ADDRESS 0xFFFF4153 /begin FUNCTION_LIST /end FUNCTION_LIST /end MEASUREMENT
/begin MEASUREMENT avPMAXCTP "AlternatorMaximumPower" UBYTE COMP_0439_S 1 100 0 5100 ECU_ADDRESS 0xFFFF4154 /begin FUNCTION_LIST /end FUNCTION_LIST /end MEASUREMENT
/begin MEASUREMENT avPRSCLIM "Relative AC pressure for diagnosis" UWORD COMP_0420_S 1 100 0 6553.5 ECU_ADDRESS 0xFFFF2346 /begin FUNCTION_LIST /end FUNCTION_LIST /end MEASUREMENT
/begin MEASUREMENT avPSLPALT "AllowedPowerGradient" UBYTE COMP_0463_S 1 100 0 10200 ECU_ADDRESS 0xFFFF4155 /begin FUNCTION_LIST /end FUNCTION_LIST /end MEASUREMENT
/begin MEASUREMENT avPVSTAT "Mailbox ventilation status" UBYTE COMP_0068 1 100 0 255 ECU_ADDRESS 0xFFFF40E3 /begin FUNCTION_LIST /end FUNCTION_LIST /end MEASUREMENT
/begin MEASUREMENT avRDRPWTSP "Powertrain setpoint (per cent) requested by real (pedal) and virtual (ACC/CC/SL) drivers" UWORD COMP_0451_S 1 100 0 81.91875 ECU_ADDRESS 0xFFFF4156 /begin FUNCTION_LIST /end FUNCTION_LIST /end MEASUREMENT
/begin MEASUREMENT avRFFNGC "F.F. data buffer NG code (an edition for a DTC 3 bytes-ization)" ULONG COMP_0426 1 100 0 4294967295 ECU_ADDRESS 0xFFFFB718 /begin FUNCTION_LIST /end FUNCTION_LIST /end MEASUREMENT
/begin MEASUREMENT avRMAXAVTQ "Maximum effective engine torque" UWORD COMP_0345_S 1 100 -400 1647.96875 ECU_ADDRESS 0xFFFF415A /begin FUNCTION_LIST /end FUNCTION_LIST /end MEASUREMENT
/begin MEASUREMENT avRMINAVTQ "minimum available engine torque" UWORD COMP_0345_S 1 100 -400 1647.96875 ECU_ADDRESS 0xFFFF415C /begin FUNCTION_LIST /end FUNCTION_LIST /end MEASUREMENT
/begin MEASUREMENT avRO2HDONf "Rear O2 heater duty output flag" UBYTE COMP_0004 1 100 0 255 ECU_ADDRESS 0xFFFF2352 /begin FUNCTION_LIST /end FUNCTION_LIST /end MEASUREMENT
/begin MEASUREMENT avRO2HONf "Rest O2 heater ON/ off" UBYTE COMP_0004 1 100 0 255 ECU_ADDRESS 0xFFFF2358 /begin FUNCTION_LIST /end FUNCTION_LIST /end MEASUREMENT
/begin MEASUREMENT avRTENG "Estimated effective engine torque" UWORD COMP_0345_S 1 100 -400 1647.96875 ECU_ADDRESS 0xFFFF4160 /begin FUNCTION_LIST /end FUNCTION_LIST /end MEASUREMENT
/begin MEASUREMENT avRTFRIC "engine torque losses" UWORD COMP_0345_S 1 100 -400 1647.96875 ECU_ADDRESS 0xFFFF4162 /begin FUNCTION_LIST /end FUNCTION_LIST /end MEASUREMENT
/begin MEASUREMENT avRTTEP "Torque Target (SLOW torque)" UWORD COMP_0345_S 1 100 -400 1647.96875 ECU_ADDRESS 0xFFFF4166 /begin FUNCTION_LIST /end FUNCTION_LIST /end MEASUREMENT
/begin MEASUREMENT avRTTEPFST "Torque Setpoint (FAST torque)" UWORD COMP_0345_S 1 100 -400 1647.96875 ECU_ADDRESS 0xFFFF4168 /begin FUNCTION_LIST /end FUNCTION_LIST /end MEASUREMENT
/begin MEASUREMENT avRTTEPRAW "Slow torque without AT request and without anti-jerk." UWORD COMP_0345_S 1 100 -400 1647.96875 ECU_ADDRESS 0xFFFF416A /begin FUNCTION_LIST /end FUNCTION_LIST /end MEASUREMENT
/begin MEASUREMENT avSTSTRSW "State of the steering wheel push buttons" UBYTE COMP_0068 1 100 0 255 ECU_ADDRESS 0xFFFF4181 /begin FUNCTION_LIST /end FUNCTION_LIST /end MEASUREMENT
/begin MEASUREMENT avSVCLAREF "Acceleration command delivered by the control loop" SWORD COMP_0428_S 1 100 -62.5000448 62.49813745 ECU_ADDRESS 0xFFFF4182 /begin FUNCTION_LIST /end FUNCTION_LIST /end MEASUREMENT
/begin MEASUREMENT avSWMANACC "ACC/speed limiter main switch position transmitted to ACC ECU" UBYTE COMP_0068 1 100 0 255 ECU_ADDRESS 0xFFFF4184 /begin FUNCTION_LIST /end FUNCTION_LIST /end MEASUREMENT
/begin MEASUREMENT avTFDCC "ASCD drive power order value" SWORD COMP_0030_S 1 100 -32768 32767 ECU_ADDRESS 0xFFFF4188 /begin FUNCTION_LIST /end FUNCTION_LIST /end MEASUREMENT
/begin MEASUREMENT avTFDSL "Speed limiter drive power order value" SWORD COMP_0030_S 1 100 -32768 32767 ECU_ADDRESS 0xFFFF418A /begin FUNCTION_LIST /end FUNCTION_LIST /end MEASUREMENT
/begin MEASUREMENT avTIST5 "At the time of the initial injection, output pulse width #5" UWORD COMP_0192 1 100 0 655350 ECU_ADDRESS 0xFFFF2378 /begin FUNCTION_LIST /end FUNCTION_LIST /end MEASUREMENT
/begin MEASUREMENT avTISTF5 "After initial injection ZD-ization compensation, pulse width #5" UWORD COMP_0192 1 100 0 655350 ECU_ADDRESS 0xFFFF2384 /begin FUNCTION_LIST /end FUNCTION_LIST /end MEASUREMENT
/begin MEASUREMENT avTPFBAN "This time, at the time of the injection, use TPÅ~TFBYA" UWORD COMP_0166_S 1 100 0 63.999056205 ECU_ADDRESS 0xFFFF2386 /begin FUNCTION_LIST /end FUNCTION_LIST /end MEASUREMENT
/begin MEASUREMENT avTQREQSF "Torque request status" UBYTE COMP_0068 1 100 0 255 ECU_ADDRESS 0xFFFF4190 /begin FUNCTION_LIST /end FUNCTION_LIST /end MEASUREMENT
/begin MEASUREMENT avTQWOAGB "AGB A former torque to require" SWORD COMP_0228 1 100 -3276.8 3276.7 ECU_ADDRESS 0xFFFF4192 /begin FUNCTION_LIST /end FUNCTION_LIST /end MEASUREMENT
/begin MEASUREMENT avTQWOARBT "ARBIT A former torque to deal with" SWORD COMP_0228 1 100 -3276.8 3276.7 ECU_ADDRESS 0xFFFF4194 /begin FUNCTION_LIST /end FUNCTION_LIST /end MEASUREMENT
/begin MEASUREMENT avTTEPDIFF "Effective engine torque setpoint requested by real" UWORD COMP_0345_S 1 100 -400 1647.96875 ECU_ADDRESS 0xFFFF4196 /begin FUNCTION_LIST /end FUNCTION_LIST /end MEASUREMENT
/begin MEASUREMENT avTTEPDIFS "Effective engine torque target requested by real (pedal) and virtual (ACC/CC/SL) drivers" UWORD COMP_0345_S 1 100 -400 1647.96875 ECU_ADDRESS 0xFFFF4198 /begin FUNCTION_LIST /end FUNCTION_LIST /end MEASUREMENT
/begin MEASUREMENT avVBSET "Target generating electricity voltage" UWORD COMP_0054 1 100 0 1310700 ECU_ADDRESS 0xFFFF239E /begin FUNCTION_LIST /end FUNCTION_LIST /end MEASUREMENT
/begin MEASUREMENT avVINDDL "DDL2 response code" UBYTE COMP_0004 1 100 0 255 ECU_ADDRESS 0xFFFF419B /begin FUNCTION_LIST /end FUNCTION_LIST /end MEASUREMENT
/begin MEASUREMENT avVITCONMX "Requested speed selected by the driver" UBYTE COMP_0068 1 100 0 255 ECU_ADDRESS 0xFFFF419C /begin FUNCTION_LIST /end FUNCTION_LIST /end MEASUREMENT
/begin MEASUREMENT avVITRVLVK "Requested speed selected by the driver (Cruise Control or Speed Limiter) in km/h" UBYTE COMP_0429 1 100 0 255 ECU_ADDRESS 0xFFFF419D /begin FUNCTION_LIST /end FUNCTION_LIST /end MEASUREMENT
/begin MEASUREMENT avVSPASCD "A vehicle speed for ASCD" SLONG COMP_0209_S 1 100 -1843.20024746394 1843.20024660563 ECU_ADDRESS 0xFFFF41A0 /begin FUNCTION_LIST /end FUNCTION_LIST /end MEASUREMENT
/begin MEASUREMENT avVSPCOMN "Vehicle speed order value (final value)" SLONG COMP_0001_S 1 100 -1842.540969984 1842.540969126 ECU_ADDRESS 0xFFFF41A8 /begin FUNCTION_LIST /end FUNCTION_LIST /end MEASUREMENT
/begin MEASUREMENT avVTCDGN1S_2 "RAM value avVTCDGN1S" UBYTE COMP_0004 1 100 0 255 ECU_ADDRESS 0xFFFF41AE /begin FUNCTION_LIST /end FUNCTION_LIST /end MEASUREMENT
/begin MEASUREMENT avVTCDGN1S_1 "RAM value avVTCDGN1S" UBYTE COMP_0004 1 100 0 255 ECU_ADDRESS 0xFFFF41AD /begin FUNCTION_LIST /end FUNCTION_LIST /end MEASUREMENT
/begin MEASUREMENT avVTCDGN2S_2 "RAM value avVTCDGN2S" UBYTE COMP_0004 1 100 0 255 ECU_ADDRESS 0xFFFF41AF /begin FUNCTION_LIST /end FUNCTION_LIST /end MEASUREMENT
/begin MEASUREMENT avVTCDGN2S_1 "RAM value avVTCDGN2S" UBYTE COMP_0004 1 100 0 255 ECU_ADDRESS 0xFFFF41B1 /begin FUNCTION_LIST /end FUNCTION_LIST /end MEASUREMENT
/begin MEASUREMENT avVTCSOLEf "Tooth solenoid output flag" UBYTE COMP_0004 1 100 0 255 ECU_ADDRESS 0xFFFF23A4 /begin FUNCTION_LIST /end FUNCTION_LIST /end MEASUREMENT
/begin MEASUREMENT avVTCSOLIf "Tooth solenoid output flag" UBYTE COMP_0004 1 100 0 255 ECU_ADDRESS 0xFFFF23A5 /begin FUNCTION_LIST /end FUNCTION_LIST /end MEASUREMENT
/begin MEASUREMENT avVXXGEAR "Transmission ratio    for manual gearbox calculated by the engine control unit" SBYTE COMP_0263 1 100 -128 127 ECU_ADDRESS 0xFFFF41B2 /begin FUNCTION_LIST /end FUNCTION_LIST /end MEASUREMENT
/begin MEASUREMENT bvALPCALf "ALPHA operation judgement" UBYTE COMP_0004 1 100 0 255 ECU_ADDRESS 0xFFFF22BD /begin FUNCTION_LIST /end FUNCTION_LIST /end MEASUREMENT
/begin MEASUREMENT bvBTXD "Transmitting data" UBYTE COMP_0004 1 100 0 255 ECU_ADDRESS 0xFFFF40B2 /begin FUNCTION_LIST /end FUNCTION_LIST /end MEASUREMENT
/begin MEASUREMENT bvCBUF "Command buffer" UBYTE COMP_0004 1 100 0 255 ECU_ADDRESS 0xFFFF40CA /begin FUNCTION_LIST /end FUNCTION_LIST /end MEASUREMENT
/begin MEASUREMENT bvCTX "Transfer buffer" UBYTE COMP_0004 1 100 0 255 ECU_ADDRESS 0xFFFF40CB /begin FUNCTION_LIST /end FUNCTION_LIST /end MEASUREMENT
/begin MEASUREMENT bvEVPCLRf "At the time of base re-learning, EVPCNT clear requirement flag" UBYTE COMP_0004 1 100 0 255 ECU_ADDRESS 0xFFFF22C1 /begin FUNCTION_LIST /end FUNCTION_LIST /end MEASUREMENT
/begin MEASUREMENT bvFBSLTDf "Base learning convergent judgement flag" UBYTE COMP_0004 1 100 0 255 ECU_ADDRESS 0xFFFF40AC /begin FUNCTION_LIST /end FUNCTION_LIST /end MEASUREMENT
/begin MEASUREMENT bvFBSRYOf "Base learning region judgement" UBYTE COMP_0004 1 100 0 255 ECU_ADDRESS 0xFFFF22C3 /begin FUNCTION_LIST /end FUNCTION_LIST /end MEASUREMENT
/begin MEASUREMENT bvFTCC "TCC condition buffer" UBYTE COMP_0004 1 100 0 255 ECU_ADDRESS 0xFFFF40D8 /begin FUNCTION_LIST /end FUNCTION_LIST /end MEASUREMENT
/begin MEASUREMENT bvLMCLSTf "Close control start flag" UBYTE COMP_0004 1 100 0 255 ECU_ADDRESS 0xFFFF22A5 /begin FUNCTION_LIST /end FUNCTION_LIST /end MEASUREMENT
/begin MEASUREMENT bvLMDCLSf "Lambda control open close judgement flag" UBYTE COMP_0004 1 100 0 255 ECU_ADDRESS 0xFFFF22A6 /begin FUNCTION_LIST /end FUNCTION_LIST /end MEASUREMENT
/begin MEASUREMENT bvLMDRCHf "Lambda control rich lean judgement flag" UBYTE COMP_0004 1 100 0 255 ECU_ADDRESS 0xFFFF22A7 /begin FUNCTION_LIST /end FUNCTION_LIST /end MEASUREMENT
/begin MEASUREMENT bvMCCDM "MC command buffer" UBYTE COMP_0004 1 100 0 255 ECU_ADDRESS 0xFFFF40D9 /begin FUNCTION_LIST /end FUNCTION_LIST /end MEASUREMENT
/begin MEASUREMENT bvMICB "MI command buffer" UBYTE COMP_0004 1 100 0 255 ECU_ADDRESS 0xFFFF40DA /begin FUNCTION_LIST /end FUNCTION_LIST /end MEASUREMENT
/begin MEASUREMENT bvMOPENf "Monitor clamp occurrence judgement" UBYTE COMP_0004 1 100 0 255 ECU_ADDRESS 0xFFFF22A8 /begin FUNCTION_LIST /end FUNCTION_LIST /end MEASUREMENT
/begin MEASUREMENT bvPGALPHAf "ALPHA switchover requirement" UBYTE COMP_0004 1 100 0 255 ECU_ADDRESS 0xFFFF22DB /begin FUNCTION_LIST /end FUNCTION_LIST /end MEASUREMENT
/begin MEASUREMENT bvSCSTPM "SCV output condition" UWORD COMP_0025 1 100 0 32767.5 ECU_ADDRESS 0xFFFFB67A /begin FUNCTION_LIST /end FUNCTION_LIST /end MEASUREMENT
/begin MEASUREMENT bvSCSTPML "SCV output condition" UWORD COMP_0025 1 100 0 32767.5 ECU_ADDRESS 0xFFFFB67C /begin FUNCTION_LIST /end FUNCTION_LIST /end MEASUREMENT
/begin MEASUREMENT bvSST "DDL1 sub-stage" UBYTE COMP_0004 1 100 0 255 ECU_ADDRESS 0xFFFF40DB /begin FUNCTION_LIST /end FUNCTION_LIST /end MEASUREMENT
/begin MEASUREMENT bvSYFLG "Transmitting condition registor" UBYTE COMP_0004 1 100 0 255 ECU_ADDRESS 0xFFFF40DD /begin FUNCTION_LIST /end FUNCTION_LIST /end MEASUREMENT
/begin MEASUREMENT vA2EFIM "AT to ECM flame" UBYTE COMP_0283 1 100 0 255 ECU_ADDRESS 0xFFFF3884 /begin FUNCTION_LIST /end FUNCTION_LIST /end MEASUREMENT
/begin MEASUREMENT vABFADJf "Lambda point compensation value computed treatment conditions" UBYTE COMP_0004 1 100 0 255 ECU_ADDRESS 0xFFFF3885 /begin FUNCTION_LIST /end FUNCTION_LIST /end MEASUREMENT
/begin MEASUREMENT vABFBFR "For 250mS of AFSAF for the É¢AFSAF computation, one's personal history" UWORD COMP_0453 1 100 0 131.07 ECU_ADDRESS 0xFFFF10C8 /begin FUNCTION_LIST /end FUNCTION_LIST /end MEASUREMENT
/begin MEASUREMENT vABFCMPf "Target A/F switching flag" UBYTE COMP_0004 1 100 0 255 ECU_ADDRESS 0xFFFF10DC /begin FUNCTION_LIST /end FUNCTION_LIST /end MEASUREMENT
/begin MEASUREMENT vABFFCZ "A previous value fuel cut cylinder for the A/F sensor diagnosis" UBYTE COMP_0421 1 100 0 255 ECU_ADDRESS 0xFFFF10E2 /begin FUNCTION_LIST /end FUNCTION_LIST /end MEASUREMENT
/begin MEASUREMENT vACCCLT "After the acceleration order value limiter treatment, value" SLONG COMP_0206_S 1 100 -512.000903872512 512.000903634093 ECU_ADDRESS 0xFFFF2704 /begin FUNCTION_LIST /end FUNCTION_LIST /end MEASUREMENT
/begin MEASUREMENT vACCCOM "The output value of the acceleration order value" SLONG COMP_0206_S 1 100 -512.000903872512 512.000903634093 ECU_ADDRESS 0xFFFF270C /begin FUNCTION_LIST /end FUNCTION_LIST /end MEASUREMENT
/begin MEASUREMENT vACCFBK "Robust compensator output for the vehicle speed servo" SLONG COMP_0206_S 1 100 -512.000903872512 512.000903634093 ECU_ADDRESS 0xFFFF2714 /begin FUNCTION_LIST /end FUNCTION_LIST /end MEASUREMENT
/begin MEASUREMENT vACCFKF "Acceleration estimated value LPF output value" SLONG COMP_0206_S 1 100 -512.000903872512 512.000903634093 ECU_ADDRESS 0xFFFF271C /begin FUNCTION_LIST /end FUNCTION_LIST /end MEASUREMENT
/begin MEASUREMENT vACCHILMT "At the time of the acceleration order value upper limit saturation judgement, value" SLONG COMP_0206_S 1 100 -512.000903872512 512.000903634093 ECU_ADDRESS 0xFFFF2720 /begin FUNCTION_LIST /end FUNCTION_LIST /end MEASUREMENT
/begin MEASUREMENT vACCLOLMT "At the time of the acceleration order value lower limit saturation judgement, value" SLONG COMP_0206_S 1 100 -512.000903872512 512.000903634093 ECU_ADDRESS 0xFFFF2724 /begin FUNCTION_LIST /end FUNCTION_LIST /end MEASUREMENT
/begin MEASUREMENT vACCMDL "Model matching compensation vessel output value for the vehicle speed servo" SLONG COMP_0206_S 1 100 -512.000903872512 512.000903634093 ECU_ADDRESS 0xFFFF2728 /begin FUNCTION_LIST /end FUNCTION_LIST /end MEASUREMENT
/begin MEASUREMENT vACCME1 "OD maximum drive power temporary learning value" SLONG COMP_0206_S 1 100 -512.000903872512 512.000903634093 ECU_ADDRESS 0xFFFF272C /begin FUNCTION_LIST /end FUNCTION_LIST /end MEASUREMENT
/begin MEASUREMENT vACCME2 "OD maximum drive power learning value" SLONG COMP_0206_S 1 100 -512.000903872512 512.000903634093 ECU_ADDRESS 0xFFFF2730 /begin FUNCTION_LIST /end FUNCTION_LIST /end MEASUREMENT
/begin MEASUREMENT vACCMSG1T "ACCMSG1 reception interval counter" UBYTE COMP_0014 1 100 0 2550 ECU_ADDRESS 0xFFFF3886 /begin FUNCTION_LIST /end FUNCTION_LIST /end MEASUREMENT
/begin MEASUREMENT vACCREF "Robust filter output value for the vehicle speed servo" SLONG COMP_0206_S 1 100 -512.000903872512 512.000903634093 ECU_ADDRESS 0xFFFF2734 /begin FUNCTION_LIST /end FUNCTION_LIST /end MEASUREMENT
/begin MEASUREMENT vACCREF_R#1 "Robust filter output value for the vehicle speed servo" SLONG COMP_0206_S 1 100 -512.000903872512 512.000903634093 ECU_ADDRESS 0xFFFF2734 /begin FUNCTION_LIST /end FUNCTION_LIST /end MEASUREMENT
/begin MEASUREMENT vACCREF_R#2 "Robust filter output value for the vehicle speed servo" SLONG COMP_0206_S 1 100 -512.000903872512 512.000903634093 ECU_ADDRESS 0xFFFF2738 /begin FUNCTION_LIST /end FUNCTION_LIST /end MEASUREMENT
/begin MEASUREMENT vACCREF_R#3 "Robust filter output value for the vehicle speed servo" SLONG COMP_0206_S 1 100 -512.000903872512 512.000903634093 ECU_ADDRESS 0xFFFF273C /begin FUNCTION_LIST /end FUNCTION_LIST /end MEASUREMENT
/begin MEASUREMENT vACCREF_R#4 "Robust filter output value for the vehicle speed servo" SLONG COMP_0206_S 1 100 -512.000903872512 512.000903634093 ECU_ADDRESS 0xFFFF2740 /begin FUNCTION_LIST /end FUNCTION_LIST /end MEASUREMENT
/begin MEASUREMENT vACCREF_R#5 "Robust filter output value for the vehicle speed servo" SLONG COMP_0206_S 1 100 -512.000903872512 512.000903634093 ECU_ADDRESS 0xFFFF2744 /begin FUNCTION_LIST /end FUNCTION_LIST /end MEASUREMENT
/begin MEASUREMENT vACCREF_R#6 "Robust filter output value for the vehicle speed servo" SLONG COMP_0206_S 1 100 -512.000903872512 512.000903634093 ECU_ADDRESS 0xFFFF2748 /begin FUNCTION_LIST /end FUNCTION_LIST /end MEASUREMENT
/begin MEASUREMENT vACCREF_R#7 "Robust filter output value for the vehicle speed servo" SLONG COMP_0206_S 1 100 -512.000903872512 512.000903634093 ECU_ADDRESS 0xFFFF274C /begin FUNCTION_LIST /end FUNCTION_LIST /end MEASUREMENT
/begin MEASUREMENT vACCREF_R#8 "Robust filter output value for the vehicle speed servo" SLONG COMP_0206_S 1 100 -512.000903872512 512.000903634093 ECU_ADDRESS 0xFFFF2750 /begin FUNCTION_LIST /end FUNCTION_LIST /end MEASUREMENT
/begin MEASUREMENT vACCREF_R#9 "Robust filter output value for the vehicle speed servo" SLONG COMP_0206_S 1 100 -512.000903872512 512.000903634093 ECU_ADDRESS 0xFFFF2754 /begin FUNCTION_LIST /end FUNCTION_LIST /end MEASUREMENT
/begin MEASUREMENT vACCREF_R#10 "Robust filter output value for the vehicle speed servo" SLONG COMP_0206_S 1 100 -512.000903872512 512.000903634093 ECU_ADDRESS 0xFFFF2758 /begin FUNCTION_LIST /end FUNCTION_LIST /end MEASUREMENT
/begin MEASUREMENT vACCREF_R#11 "Robust filter output value for the vehicle speed servo" SLONG COMP_0206_S 1 100 -512.000903872512 512.000903634093 ECU_ADDRESS 0xFFFF275C /begin FUNCTION_LIST /end FUNCTION_LIST /end MEASUREMENT
/begin MEASUREMENT vACCRTF "Resistance estimated value LPF output value" SLONG COMP_0206_S 1 100 -512.000903872512 512.000903634093 ECU_ADDRESS 0xFFFF2760 /begin FUNCTION_LIST /end FUNCTION_LIST /end MEASUREMENT
/begin MEASUREMENT vACCRTM "Running resistance estimated value" SLONG COMP_0206_S 1 100 -512.000903872512 512.000903634093 ECU_ADDRESS 0xFFFF2764 /begin FUNCTION_LIST /end FUNCTION_LIST /end MEASUREMENT
/begin MEASUREMENT vACCSB2 "The output value of the noise removal L.P.F. for the vehicle speed servo" SLONG COMP_0206_S 1 100 -512.000903872512 512.000903634093 ECU_ADDRESS 0xFFFF2768 /begin FUNCTION_LIST /end FUNCTION_LIST /end MEASUREMENT
/begin MEASUREMENT vACCSUB "The operation of the outside war estimated value" SLONG COMP_0206_S 1 100 -512.000903872512 512.000903634093 ECU_ADDRESS 0xFFFF2774 /begin FUNCTION_LIST /end FUNCTION_LIST /end MEASUREMENT
/begin MEASUREMENT vACLOAD "Air conditioning absorbed power (compressor)" UBYTE COMP_0439_S 1 100 0 5100 ECU_ADDRESS 0xFFFF2780 /begin FUNCTION_LIST /end FUNCTION_LIST /end MEASUREMENT
/begin MEASUREMENT vACONOFFf "An air-conditioning ONOFF judgement for the rich spike" UBYTE COMP_0004 1 100 0 255 ECU_ADDRESS 0xFFFF10EA /begin FUNCTION_LIST /end FUNCTION_LIST /end MEASUREMENT
/begin MEASUREMENT vACPSCT "The number of POS10 signal input" UBYTE COMP_0013_S 1 100 0 255 ECU_ADDRESS 0xFFFF1F8D /begin FUNCTION_LIST /end FUNCTION_LIST /end MEASUREMENT
/begin MEASUREMENT vACSEGR1 "ST drive output value for the diagnosis" UBYTE COMP_0068 1 100 0 255 ECU_ADDRESS 0xFFFF8962 /begin FUNCTION_LIST /end FUNCTION_LIST /end MEASUREMENT
/begin MEASUREMENT vACSEGR2 "ST drive output value for the diagnosis" UBYTE COMP_0068 1 100 0 255 ECU_ADDRESS 0xFFFF8963 /begin FUNCTION_LIST /end FUNCTION_LIST /end MEASUREMENT
/begin MEASUREMENT vACSEGR3 "ST drive output value for the diagnosis" UBYTE COMP_0068 1 100 0 255 ECU_ADDRESS 0xFFFF8964 /begin FUNCTION_LIST /end FUNCTION_LIST /end MEASUREMENT
/begin MEASUREMENT vACSEGR4 "ST drive output value for the diagnosis" UBYTE COMP_0068 1 100 0 255 ECU_ADDRESS 0xFFFF8965 /begin FUNCTION_LIST /end FUNCTION_LIST /end MEASUREMENT
/begin MEASUREMENT vACSIGN16 "ST drive output value for the diagnosis" UBYTE COMP_0068 1 100 0 255 ECU_ADDRESS 0xFFFF1DFC /begin FUNCTION_LIST /end FUNCTION_LIST /end MEASUREMENT
/begin MEASUREMENT vACSINJ2 "ST drive output value for the diagnosis" UBYTE COMP_0068 1 100 0 255 ECU_ADDRESS 0xFFFF1DFD /begin FUNCTION_LIST /end FUNCTION_LIST /end MEASUREMENT
/begin MEASUREMENT vACSINJ3 "ST drive output value for the diagnosis" UBYTE COMP_0068 1 100 0 255 ECU_ADDRESS 0xFFFF1DFE /begin FUNCTION_LIST /end FUNCTION_LIST /end MEASUREMENT
/begin MEASUREMENT vACTDLAS "Map ACTDTY, last time, reference point memory" UBYTE COMP_0068 1 100 0 255 ECU_ADDRESS 0xFFFF3888 /begin FUNCTION_LIST /end FUNCTION_LIST /end MEASUREMENT
/begin MEASUREMENT vACTDTY "After the activation, DUTY value" UBYTE COMP_0047 1 100 0 127.5 ECU_ADDRESS 0xFFFF388A /begin FUNCTION_LIST /end FUNCTION_LIST /end MEASUREMENT
/begin MEASUREMENT vADACS "Alternator voltage value" UWORD COMP_0023 1 100 0 327675 ECU_ADDRESS 0xFFFF1CB8 /begin FUNCTION_LIST /end FUNCTION_LIST /end MEASUREMENT
/begin MEASUREMENT vADAFHFOF "A/F-H At the time of off, Front-AD" UWORD COMP_0023 1 100 0 327675 ECU_ADDRESS 0xFFFF1CBE /begin FUNCTION_LIST /end FUNCTION_LIST /end MEASUREMENT
/begin MEASUREMENT vADAFHFOFL "A/F-H At the time of off, Front-AD (Left)" UWORD COMP_0023 1 100 0 327675 ECU_ADDRESS 0xFFFF1CC0 /begin FUNCTION_LIST /end FUNCTION_LIST /end MEASUREMENT
/begin MEASUREMENT vADAFHFON "A/F-H At the time of on, Front-AD" UWORD COMP_0023 1 100 0 327675 ECU_ADDRESS 0xFFFF1CC2 /begin FUNCTION_LIST /end FUNCTION_LIST /end MEASUREMENT
/begin MEASUREMENT vADAFHFONL "A/F-H At the time of on, Front-AD (Left)" UWORD COMP_0023 1 100 0 327675 ECU_ADDRESS 0xFFFF1CC4 /begin FUNCTION_LIST /end FUNCTION_LIST /end MEASUREMENT
/begin MEASUREMENT vADAFIOUT "A/F sensor IOUT" UWORD COMP_0023 1 100 0 327675 ECU_ADDRESS 0xFFFF1CC6 /begin FUNCTION_LIST /end FUNCTION_LIST /end MEASUREMENT
/begin MEASUREMENT vADAFIOUTL "A/F sensor IOUT (Left)" UWORD COMP_0023 1 100 0 327675 ECU_ADDRESS 0xFFFF1CC8 /begin FUNCTION_LIST /end FUNCTION_LIST /end MEASUREMENT
/begin MEASUREMENT vADALTP "Alternator" UWORD COMP_0061 1 100 0 327675 ECU_ADDRESS 0xFFFF1CCE /begin FUNCTION_LIST /end FUNCTION_LIST /end MEASUREMENT
/begin MEASUREMENT vADAPS1V "A/D input accelerator pedal 1" UWORD COMP_0023 1 100 0 327675 ECU_ADDRESS 0xFFFF3544 /begin FUNCTION_LIST /end FUNCTION_LIST /end MEASUREMENT
/begin MEASUREMENT vADAPS2V "A/D input accelerator pedal 2" UWORD COMP_0023 1 100 0 327675 ECU_ADDRESS 0xFFFF3546 /begin FUNCTION_LIST /end FUNCTION_LIST /end MEASUREMENT
/begin MEASUREMENT vADASCDSW "ASCDSW A/D input voltage" UWORD COMP_0023 1 100 0 327675 ECU_ADDRESS 0xFFFF3548 /begin FUNCTION_LIST /end FUNCTION_LIST /end MEASUREMENT
/begin MEASUREMENT vADATMP_I "A/D input atomospheric pressure sensor (building in)" UWORD COMP_0023 1 100 0 327675 ECU_ADDRESS 0xFFFF388C /begin FUNCTION_LIST /end FUNCTION_LIST /end MEASUREMENT
/begin MEASUREMENT vADATMP_O "A/D input atomospheric pressure sensor (with the outside)" UWORD COMP_0023 1 100 0 327675 ECU_ADDRESS 0xFFFF388E /begin FUNCTION_LIST /end FUNCTION_LIST /end MEASUREMENT
/begin MEASUREMENT vADAVCC "ADCC A/D conversion value" UWORD COMP_0023 1 100 0 327675 ECU_ADDRESS 0xFFFF354A /begin FUNCTION_LIST /end FUNCTION_LIST /end MEASUREMENT
/begin MEASUREMENT vADBATSEN "Battery electric current sensor output voltage AD value" UWORD COMP_0023 1 100 0 327675 ECU_ADDRESS 0xFFFF1CD0 /begin FUNCTION_LIST /end FUNCTION_LIST /end MEASUREMENT
/begin MEASUREMENT vADBNCSW "BNC SW A/D conversion voltage value" UWORD COMP_0023 1 100 0 327675 ECU_ADDRESS 0xFFFF354C /begin FUNCTION_LIST /end FUNCTION_LIST /end MEASUREMENT
/begin MEASUREMENT vADCOVR "CO adjustment value" UWORD COMP_0061 1 100 0 327675 ECU_ADDRESS 0xFFFF1CD2 /begin FUNCTION_LIST /end FUNCTION_LIST /end MEASUREMENT
/begin MEASUREMENT vADCVO2L "Twin O2 sensor left A/D data buffer" UWORD COMP_0023 1 100 0 327675 ECU_ADDRESS 0xFFFF1E04 /begin FUNCTION_LIST /end FUNCTION_LIST /end MEASUREMENT
/begin MEASUREMENT vADCVO2L_R#1 "Twin O2 sensor left A/D data buffer" UWORD COMP_0023 1 100 0 327675 ECU_ADDRESS 0xFFFF1E04 /begin FUNCTION_LIST /end FUNCTION_LIST /end MEASUREMENT
/begin MEASUREMENT vADCVO2L_R#2 "Twin O2 sensor left A/D data buffer" UWORD COMP_0023 1 100 0 327675 ECU_ADDRESS 0xFFFF1E06 /begin FUNCTION_LIST /end FUNCTION_LIST /end MEASUREMENT
/begin MEASUREMENT vADCVO2R "Twin O2 sensor right A/D data buffer" UWORD COMP_0023 1 100 0 327675 ECU_ADDRESS 0xFFFF1E08 /begin FUNCTION_LIST /end FUNCTION_LIST /end MEASUREMENT
/begin MEASUREMENT vADCVO2R_R#1 "Twin O2 sensor right A/D data buffer" UWORD COMP_0023 1 100 0 327675 ECU_ADDRESS 0xFFFF1E08 /begin FUNCTION_LIST /end FUNCTION_LIST /end MEASUREMENT
/begin MEASUREMENT vADCVO2R_R#2 "Twin O2 sensor right A/D data buffer" UWORD COMP_0023 1 100 0 327675 ECU_ADDRESS 0xFFFF1E0A /begin FUNCTION_LIST /end FUNCTION_LIST /end MEASUREMENT
/begin MEASUREMENT vADDADIN "A port input voltage for the AD diagnosis" UWORD COMP_0023 1 100 0 327675 ECU_ADDRESS 0xFFFF354E /begin FUNCTION_LIST /end FUNCTION_LIST /end MEASUREMENT
/begin MEASUREMENT vADDCUR "Battery balance electric current integration value" UWORD COMP_0544_S 1 100 -32768 32767 ECU_ADDRESS 0xFFFF10F2 /begin FUNCTION_LIST /end FUNCTION_LIST /end MEASUREMENT
/begin MEASUREMENT vADDCURZ "Battery balance electric current integration value, last time, (before 100mS) value" UWORD COMP_0544_S 1 100 -32768 32767 ECU_ADDRESS 0xFFFF10F4 /begin FUNCTION_LIST /end FUNCTION_LIST /end MEASUREMENT
/begin MEASUREMENT vADDRV "FRCM D/R voltage" UWORD COMP_0104 1 100 0 655350 ECU_ADDRESS 0xFFFF1CD4 /begin FUNCTION_LIST /end FUNCTION_LIST /end MEASUREMENT
/begin MEASUREMENT vADFHS1ON "Heater electric current value A/D value (at the time of DUTY on)" UWORD COMP_0023 1 100 0 327675 ECU_ADDRESS 0xFFFF3894 /begin FUNCTION_LIST /end FUNCTION_LIST /end MEASUREMENT
/begin MEASUREMENT vADFPPSH "Fuel pressure sensor (high pressure)" UWORD COMP_0061 1 100 0 327675 ECU_ADDRESS 0xFFFF3550 /begin FUNCTION_LIST /end FUNCTION_LIST /end MEASUREMENT
/begin MEASUREMENT vADFPPSL "Fuel pressure sensor (low pressure)" UWORD COMP_0061 1 100 0 327675 ECU_ADDRESS 0xFFFF3552 /begin FUNCTION_LIST /end FUNCTION_LIST /end MEASUREMENT
/begin MEASUREMENT vADFTPRS "In the fuel tank, sensor" UWORD COMP_0061 1 100 0 327675 ECU_ADDRESS 0xFFFF1CD6 /begin FUNCTION_LIST /end FUNCTION_LIST /end MEASUREMENT
/begin MEASUREMENT vADISCVR "ISC adjustment volume" UWORD COMP_0023 1 100 0 327675 ECU_ADDRESS 0xFFFF1CD8 /begin FUNCTION_LIST /end FUNCTION_LIST /end MEASUREMENT
/begin MEASUREMENT vADJCNT "A number of times counter in total" UBYTE COMP_0030 1 100 0 255 ECU_ADDRESS 0xFFFF2788 /begin FUNCTION_LIST /end FUNCTION_LIST /end MEASUREMENT
/begin MEASUREMENT vADJDDL "DDL2 response code" UBYTE COMP_0004 1 100 0 255 ECU_ADDRESS 0xFFFF41B4 /begin FUNCTION_LIST /end FUNCTION_LIST /end MEASUREMENT
/begin MEASUREMENT vADJDIAG "DiagOnCAN response code" UBYTE COMP_0004 1 100 0 255 ECU_ADDRESS 0xFFFF2789 /begin FUNCTION_LIST /end FUNCTION_LIST /end MEASUREMENT
/begin MEASUREMENT vADJSTG "A control stage for VCC adjustment-less-ization" UBYTE COMP_0004 1 100 0 255 ECU_ADDRESS 0xFFFF278A /begin FUNCTION_LIST /end FUNCTION_LIST /end MEASUREMENT
/begin MEASUREMENT vADKNFIL1 "Knock-fail voltage 1 raw-value" UWORD COMP_0023 1 100 0 327675 ECU_ADDRESS 0xFFFF4038 /begin FUNCTION_LIST /end FUNCTION_LIST /end MEASUREMENT
/begin MEASUREMENT vADKNFIL2 "Knock-fail voltage 2 raw-value" UWORD COMP_0023 1 100 0 327675 ECU_ADDRESS 0xFFFF403A /begin FUNCTION_LIST /end FUNCTION_LIST /end MEASUREMENT
/begin MEASUREMENT vADMPX1 "Data acquisition RAM from the A/D multiprex" UWORD COMP_0023 1 100 0 327675 ECU_ADDRESS 0xFFFF278C /begin FUNCTION_LIST /end FUNCTION_LIST /end MEASUREMENT
/begin MEASUREMENT vADMPX1_R#1 "Data acquisition RAM from the A/D multiprex" UWORD COMP_0023 1 100 0 327675 ECU_ADDRESS 0xFFFF278C /begin FUNCTION_LIST /end FUNCTION_LIST /end MEASUREMENT
/begin MEASUREMENT vADMPX1_R#2 "Data acquisition RAM from the A/D multiprex" UWORD COMP_0023 1 100 0 327675 ECU_ADDRESS 0xFFFF278E /begin FUNCTION_LIST /end FUNCTION_LIST /end MEASUREMENT
/begin MEASUREMENT vADMPX1_R#3 "Data acquisition RAM from the A/D multiprex" UWORD COMP_0023 1 100 0 327675 ECU_ADDRESS 0xFFFF2790 /begin FUNCTION_LIST /end FUNCTION_LIST /end MEASUREMENT
/begin MEASUREMENT vADMPX1_R#4 "Data acquisition RAM from the A/D multiprex" UWORD COMP_0023 1 100 0 327675 ECU_ADDRESS 0xFFFF2792 /begin FUNCTION_LIST /end FUNCTION_LIST /end MEASUREMENT
/begin MEASUREMENT vADMPX1_R#5 "Data acquisition RAM from the A/D multiprex" UWORD COMP_0023 1 100 0 327675 ECU_ADDRESS 0xFFFF2794 /begin FUNCTION_LIST /end FUNCTION_LIST /end MEASUREMENT
/begin MEASUREMENT vADMPX1_R#6 "Data acquisition RAM from the A/D multiprex" UWORD COMP_0023 1 100 0 327675 ECU_ADDRESS 0xFFFF2796 /begin FUNCTION_LIST /end FUNCTION_LIST /end MEASUREMENT
/begin MEASUREMENT vADMPX1_R#7 "Data acquisition RAM from the A/D multiprex" UWORD COMP_0023 1 100 0 327675 ECU_ADDRESS 0xFFFF2798 /begin FUNCTION_LIST /end FUNCTION_LIST /end MEASUREMENT
/begin MEASUREMENT vADMPX1_R#8 "Data acquisition RAM from the A/D multiprex" UWORD COMP_0023 1 100 0 327675 ECU_ADDRESS 0xFFFF279A /begin FUNCTION_LIST /end FUNCTION_LIST /end MEASUREMENT
/begin MEASUREMENT vADMPX2 "Data acquisition RAM from the A/D multiprex" UWORD COMP_0023 1 100 0 327675 ECU_ADDRESS 0xFFFF279C /begin FUNCTION_LIST /end FUNCTION_LIST /end MEASUREMENT
/begin MEASUREMENT vADMPX2_R#1 "Data acquisition RAM from the A/D multiprex" UWORD COMP_0023 1 100 0 327675 ECU_ADDRESS 0xFFFF279C /begin FUNCTION_LIST /end FUNCTION_LIST /end MEASUREMENT
/begin MEASUREMENT vADMPX2_R#2 "Data acquisition RAM from the A/D multiprex" UWORD COMP_0023 1 100 0 327675 ECU_ADDRESS 0xFFFF279E /begin FUNCTION_LIST /end FUNCTION_LIST /end MEASUREMENT
/begin MEASUREMENT vADMPX2_R#3 "Data acquisition RAM from the A/D multiprex" UWORD COMP_0023 1 100 0 327675 ECU_ADDRESS 0xFFFF27A0 /begin FUNCTION_LIST /end FUNCTION_LIST /end MEASUREMENT
/begin MEASUREMENT vADMPX2_R#4 "Data acquisition RAM from the A/D multiprex" UWORD COMP_0023 1 100 0 327675 ECU_ADDRESS 0xFFFF27A2 /begin FUNCTION_LIST /end FUNCTION_LIST /end MEASUREMENT
/begin MEASUREMENT vADMPX2_R#5 "Data acquisition RAM from the A/D multiprex" UWORD COMP_0023 1 100 0 327675 ECU_ADDRESS 0xFFFF27A4 /begin FUNCTION_LIST /end FUNCTION_LIST /end MEASUREMENT
/begin MEASUREMENT vADMPX2_R#6 "Data acquisition RAM from the A/D multiprex" UWORD COMP_0023 1 100 0 327675 ECU_ADDRESS 0xFFFF27A6 /begin FUNCTION_LIST /end FUNCTION_LIST /end MEASUREMENT
/begin MEASUREMENT vADMPX2_R#7 "Data acquisition RAM from the A/D multiprex" UWORD COMP_0023 1 100 0 327675 ECU_ADDRESS 0xFFFF27A8 /begin FUNCTION_LIST /end FUNCTION_LIST /end MEASUREMENT
/begin MEASUREMENT vADMPX2_R#8 "Data acquisition RAM from the A/D multiprex" UWORD COMP_0023 1 100 0 327675 ECU_ADDRESS 0xFFFF27AA /begin FUNCTION_LIST /end FUNCTION_LIST /end MEASUREMENT
/begin MEASUREMENT vADPMB "MB sensor AD conversion value" UWORD COMP_0023 1 100 0 327675 ECU_ADDRESS 0xFFFF3554 /begin FUNCTION_LIST /end FUNCTION_LIST /end MEASUREMENT
/begin MEASUREMENT vADPRES "Absolute pressure sensor voltage" UWORD COMP_0023 1 100 0 327675 ECU_ADDRESS 0xFFFF1CDA /begin FUNCTION_LIST /end FUNCTION_LIST /end MEASUREMENT
/begin MEASUREMENT vADTA "Intake air temperature sensor" UWORD COMP_0023 1 100 0 327675 ECU_ADDRESS 0xFFFF1CDC /begin FUNCTION_LIST /end FUNCTION_LIST /end MEASUREMENT
/begin MEASUREMENT vADTF "Fuel temperature sensor" UWORD COMP_0023 1 100 0 327675 ECU_ADDRESS 0xFFFF8846 /begin FUNCTION_LIST /end FUNCTION_LIST /end MEASUREMENT
/begin MEASUREMENT vADTO "Oil temperature sensor" UWORD COMP_0023 1 100 0 327675 ECU_ADDRESS 0xFFFF1CDE /begin FUNCTION_LIST /end FUNCTION_LIST /end MEASUREMENT
/begin MEASUREMENT vADTO2 "Oil temperature sensor (bank2)" UWORD COMP_0023 1 100 0 327675 ECU_ADDRESS 0xFFFF1CE0 /begin FUNCTION_LIST /end FUNCTION_LIST /end MEASUREMENT
/begin MEASUREMENT vADTPREST "Supercharge pressure sensor" UWORD COMP_0061 1 100 0 327675 ECU_ADDRESS 0xFFFF3556 /begin FUNCTION_LIST /end FUNCTION_LIST /end MEASUREMENT
/begin MEASUREMENT vADTPS1V "A/D input throttle sensor 1" UWORD COMP_0023 1 100 0 327675 ECU_ADDRESS 0xFFFF3558 /begin FUNCTION_LIST /end FUNCTION_LIST /end MEASUREMENT
/begin MEASUREMENT vADTPS2V "A/D input throttle sensor 2" UWORD COMP_0023 1 100 0 327675 ECU_ADDRESS 0xFFFF355A /begin FUNCTION_LIST /end FUNCTION_LIST /end MEASUREMENT
/begin MEASUREMENT vADTW "Coolant temperature sensor" UWORD COMP_0023 1 100 0 327675 ECU_ADDRESS 0xFFFF1CE2 /begin FUNCTION_LIST /end FUNCTION_LIST /end MEASUREMENT
/begin MEASUREMENT vADTW_S "Coolant temperature sensor" UWORD COMP_0023 1 100 0 327675 ECU_ADDRESS 0xFFFF1D22 /begin FUNCTION_LIST /end FUNCTION_LIST /end MEASUREMENT
/begin MEASUREMENT vADUS "Mass airflow meter" UWORD COMP_0023 1 100 0 327675 ECU_ADDRESS 0xFFFF1CE4 /begin FUNCTION_LIST /end FUNCTION_LIST /end MEASUREMENT
/begin MEASUREMENT vADVAFADJ "A/F sensor (+)" UWORD COMP_0023 1 100 0 327675 ECU_ADDRESS 0xFFFF1CE6 /begin FUNCTION_LIST /end FUNCTION_LIST /end MEASUREMENT
/begin MEASUREMENT vADVAFADJL "A/F sensor (+) (Left)" UWORD COMP_0023 1 100 0 327675 ECU_ADDRESS 0xFFFF1CE8 /begin FUNCTION_LIST /end FUNCTION_LIST /end MEASUREMENT
/begin MEASUREMENT vADVEGR "EGR temperature sensor" UWORD COMP_0023 1 100 0 327675 ECU_ADDRESS 0xFFFF1CEC /begin FUNCTION_LIST /end FUNCTION_LIST /end MEASUREMENT
/begin MEASUREMENT vADVHDI1 "At the time of the single injection, a final ignition timing" SBYTE COMP_0018 1 100 -128 127 ECU_ADDRESS 0xFFFF1F8F /begin FUNCTION_LIST /end FUNCTION_LIST /end MEASUREMENT
/begin MEASUREMENT vADVHDI2 "At the time of the twice injection, a final ignition timing" SBYTE COMP_0018 1 100 -128 127 ECU_ADDRESS 0xFFFF1F90 /begin FUNCTION_LIST /end FUNCTION_LIST /end MEASUREMENT
/begin MEASUREMENT vADVMOT "VMONT A/D conversion value" UWORD COMP_0054 1 100 0 1310700 ECU_ADDRESS 0xFFFF355C /begin FUNCTION_LIST /end FUNCTION_LIST /end MEASUREMENT
/begin MEASUREMENT vADVMV2 "Negative pressure sensor voltage sample value for the SW function" UWORD COMP_0023 1 100 0 327675 ECU_ADDRESS 0xFFFF355E /begin FUNCTION_LIST /end FUNCTION_LIST /end MEASUREMENT
/begin MEASUREMENT vADVO2F "The front of the O2 sensor" UWORD COMP_0023 1 100 0 327675 ECU_ADDRESS 0xFFFF1CEE /begin FUNCTION_LIST /end FUNCTION_LIST /end MEASUREMENT
/begin MEASUREMENT vADVO2FL "In front of the O2 sensor, the left bank voltage" UWORD COMP_0023 1 100 0 327675 ECU_ADDRESS 0xFFFF1CF0 /begin FUNCTION_LIST /end FUNCTION_LIST /end MEASUREMENT
/begin MEASUREMENT vADVO2HR "The rest of the O2 heaters" UWORD COMP_0023 1 100 0 327675 ECU_ADDRESS 0xFFFF1CF2 /begin FUNCTION_LIST /end FUNCTION_LIST /end MEASUREMENT
/begin MEASUREMENT vADVO2HRL "After the O2 heater, the left bank voltage" UWORD COMP_0023 1 100 0 327675 ECU_ADDRESS 0xFFFF1CF4 /begin FUNCTION_LIST /end FUNCTION_LIST /end MEASUREMENT
/begin MEASUREMENT vADVO2R "The rest of the O2 sensors" UWORD COMP_0023 1 100 0 327675 ECU_ADDRESS 0xFFFF1CF6 /begin FUNCTION_LIST /end FUNCTION_LIST /end MEASUREMENT
/begin MEASUREMENT vADVO2RL "After the O2 sensor, the left bank voltage" UWORD COMP_0023 1 100 0 327675 ECU_ADDRESS 0xFFFF1CF8 /begin FUNCTION_LIST /end FUNCTION_LIST /end MEASUREMENT
/begin MEASUREMENT vADVS "A/D input" UWORD COMP_0023 1 100 0 327675 ECU_ADDRESS 0xFFFF1CFA /begin FUNCTION_LIST /end FUNCTION_LIST /end MEASUREMENT
/begin MEASUREMENT vADVTMP "The work of TADVM+ADVHOS" SLONG COMP_0018 1 100 -2147483648 2147483647 ECU_ADDRESS 0xFFFF1F94 /begin FUNCTION_LIST /end FUNCTION_LIST /end MEASUREMENT
/begin MEASUREMENT vADVTRM0H "At the time of the SCV open, trimming-map compensation value high-octane" UBYTE COMP_0245 1 100 -64 191 ECU_ADDRESS 0xFFFF110B /begin FUNCTION_LIST /end FUNCTION_LIST /end MEASUREMENT
/begin MEASUREMENT vADVTRM1H "At the time of the SCV close, trimming-map compensation value high-octane" UBYTE COMP_0245 1 100 -64 191 ECU_ADDRESS 0xFFFF110D /begin FUNCTION_LIST /end FUNCTION_LIST /end MEASUREMENT
/begin MEASUREMENT vADVTRMPH "Trimming-map reference value high-octane" UBYTE COMP_0245 1 100 -64 191 ECU_ADDRESS 0xFFFF1111 /begin FUNCTION_LIST /end FUNCTION_LIST /end MEASUREMENT
/begin MEASUREMENT vAFAVCALf "Former A/F sensor middle electric potential trouble diagnosis permission condition" UBYTE COMP_0004 1 100 0 255 ECU_ADDRESS 0xFFFF1112 /begin FUNCTION_LIST /end FUNCTION_LIST /end MEASUREMENT
/begin MEASUREMENT vAFAVf "A former A/F sensor middle electric potential diagnosis diagnosis region condition fuel recover judgement flag" UBYTE COMP_0004 1 100 0 255 ECU_ADDRESS 0xFFFF1113 /begin FUNCTION_LIST /end FUNCTION_LIST /end MEASUREMENT
/begin MEASUREMENT vAFBINTf "For 250mS of AFSAF for the É¢AFSAF computation, one's personal history initialization" UBYTE COMP_0004 1 100 0 255 ECU_ADDRESS 0xFFFF1114 /begin FUNCTION_LIST /end FUNCTION_LIST /end MEASUREMENT
/begin MEASUREMENT vAFC10 "+ terminal voltage (before 0-90mS, value)" UWORD COMP_0023 1 100 0 327675 ECU_ADDRESS 0xFFFF389E /begin FUNCTION_LIST /end FUNCTION_LIST /end MEASUREMENT
/begin MEASUREMENT vAFC10_C#1_R#1 "+ terminal voltage (before 0-90mS, value)" UWORD COMP_0023 1 100 0 327675 ECU_ADDRESS 0xFFFF389E /begin FUNCTION_LIST /end FUNCTION_LIST /end MEASUREMENT
/begin MEASUREMENT vAFC10_C#1_R#2 "+ terminal voltage (before 0-90mS, value)" UWORD COMP_0023 1 100 0 327675 ECU_ADDRESS 0xFFFF38A0 /begin FUNCTION_LIST /end FUNCTION_LIST /end MEASUREMENT
/begin MEASUREMENT vAFC10_C#2_R#1 "+ terminal voltage (before 0-90mS, value)" UWORD COMP_0023 1 100 0 327675 ECU_ADDRESS 0xFFFF38A2 /begin FUNCTION_LIST /end FUNCTION_LIST /end MEASUREMENT
/begin MEASUREMENT vAFC10_C#2_R#2 "+ terminal voltage (before 0-90mS, value)" UWORD COMP_0023 1 100 0 327675 ECU_ADDRESS 0xFFFF38A4 /begin FUNCTION_LIST /end FUNCTION_LIST /end MEASUREMENT
/begin MEASUREMENT vAFC10_C#3_R#1 "+ terminal voltage (before 0-90mS, value)" UWORD COMP_0023 1 100 0 327675 ECU_ADDRESS 0xFFFF38A6 /begin FUNCTION_LIST /end FUNCTION_LIST /end MEASUREMENT
/begin MEASUREMENT vAFC10_C#3_R#2 "+ terminal voltage (before 0-90mS, value)" UWORD COMP_0023 1 100 0 327675 ECU_ADDRESS 0xFFFF38A8 /begin FUNCTION_LIST /end FUNCTION_LIST /end MEASUREMENT
/begin MEASUREMENT vAFC10_C#4_R#1 "+ terminal voltage (before 0-90mS, value)" UWORD COMP_0023 1 100 0 327675 ECU_ADDRESS 0xFFFF38AA /begin FUNCTION_LIST /end FUNCTION_LIST /end MEASUREMENT
/begin MEASUREMENT vAFC10_C#4_R#2 "+ terminal voltage (before 0-90mS, value)" UWORD COMP_0023 1 100 0 327675 ECU_ADDRESS 0xFFFF38AC /begin FUNCTION_LIST /end FUNCTION_LIST /end MEASUREMENT
/begin MEASUREMENT vAFC10_C#5_R#1 "+ terminal voltage (before 0-90mS, value)" UWORD COMP_0023 1 100 0 327675 ECU_ADDRESS 0xFFFF38AE /begin FUNCTION_LIST /end FUNCTION_LIST /end MEASUREMENT
/begin MEASUREMENT vAFC10_C#5_R#2 "+ terminal voltage (before 0-90mS, value)" UWORD COMP_0023 1 100 0 327675 ECU_ADDRESS 0xFFFF38B0 /begin FUNCTION_LIST /end FUNCTION_LIST /end MEASUREMENT
/begin MEASUREMENT vAFC10_C#6_R#1 "+ terminal voltage (before 0-90mS, value)" UWORD COMP_0023 1 100 0 327675 ECU_ADDRESS 0xFFFF38B2 /begin FUNCTION_LIST /end FUNCTION_LIST /end MEASUREMENT
/begin MEASUREMENT vAFC10_C#6_R#2 "+ terminal voltage (before 0-90mS, value)" UWORD COMP_0023 1 100 0 327675 ECU_ADDRESS 0xFFFF38B4 /begin FUNCTION_LIST /end FUNCTION_LIST /end MEASUREMENT
/begin MEASUREMENT vAFC10_C#7_R#1 "+ terminal voltage (before 0-90mS, value)" UWORD COMP_0023 1 100 0 327675 ECU_ADDRESS 0xFFFF38B6 /begin FUNCTION_LIST /end FUNCTION_LIST /end MEASUREMENT
/begin MEASUREMENT vAFC10_C#7_R#2 "+ terminal voltage (before 0-90mS, value)" UWORD COMP_0023 1 100 0 327675 ECU_ADDRESS 0xFFFF38B8 /begin FUNCTION_LIST /end FUNCTION_LIST /end MEASUREMENT
/begin MEASUREMENT vAFC10_C#8_R#1 "+ terminal voltage (before 0-90mS, value)" UWORD COMP_0023 1 100 0 327675 ECU_ADDRESS 0xFFFF38BA /begin FUNCTION_LIST /end FUNCTION_LIST /end MEASUREMENT
/begin MEASUREMENT vAFC10_C#8_R#2 "+ terminal voltage (before 0-90mS, value)" UWORD COMP_0023 1 100 0 327675 ECU_ADDRESS 0xFFFF38BC /begin FUNCTION_LIST /end FUNCTION_LIST /end MEASUREMENT
/begin MEASUREMENT vAFC10_C#9_R#1 "+ terminal voltage (before 0-90mS, value)" UWORD COMP_0023 1 100 0 327675 ECU_ADDRESS 0xFFFF38BE /begin FUNCTION_LIST /end FUNCTION_LIST /end MEASUREMENT
/begin MEASUREMENT vAFC10_C#9_R#2 "+ terminal voltage (before 0-90mS, value)" UWORD COMP_0023 1 100 0 327675 ECU_ADDRESS 0xFFFF38C0 /begin FUNCTION_LIST /end FUNCTION_LIST /end MEASUREMENT
/begin MEASUREMENT vAFC10_C#10_R#1 "+ terminal voltage (before 0-90mS, value)" UWORD COMP_0023 1 100 0 327675 ECU_ADDRESS 0xFFFF38C2 /begin FUNCTION_LIST /end FUNCTION_LIST /end MEASUREMENT
/begin MEASUREMENT vAFC10_C#10_R#2 "+ terminal voltage (before 0-90mS, value)" UWORD COMP_0023 1 100 0 327675 ECU_ADDRESS 0xFFFF38C4 /begin FUNCTION_LIST /end FUNCTION_LIST /end MEASUREMENT
/begin MEASUREMENT vAFC10CNT "A counter for the vAVAFC computation" UBYTE COMP_0014 1 100 0 2550 ECU_ADDRESS 0xFFFF38C6 /begin FUNCTION_LIST /end FUNCTION_LIST /end MEASUREMENT
/begin MEASUREMENT vAFCLT1A "Condition A delay timer" UBYTE COMP_0250 1 100 0 1020 ECU_ADDRESS 0xFFFF37C8 /begin FUNCTION_LIST /end FUNCTION_LIST /end MEASUREMENT
/begin MEASUREMENT vAFCLT1B "Condition B delay timer" UBYTE COMP_0250 1 100 0 1020 ECU_ADDRESS 0xFFFF37C9 /begin FUNCTION_LIST /end FUNCTION_LIST /end MEASUREMENT
/begin MEASUREMENT vAFHCAL10 "100mS measuring for the A/F sensor heater DUTY operation" UBYTE COMP_0014 1 100 0 2550 ECU_ADDRESS 0xFFFF38C9 /begin FUNCTION_LIST /end FUNCTION_LIST /end MEASUREMENT
/begin MEASUREMENT vAFHCONTf "A/F sensor heater-control control permission condition" UBYTE COMP_0004 1 100 0 255 ECU_ADDRESS 0xFFFF896A /begin FUNCTION_LIST /end FUNCTION_LIST /end MEASUREMENT
/begin MEASUREMENT vAFHDTY "A/F sensor heater duty output (a periodic counter)" UBYTE COMP_0027 1 100 0 255 ECU_ADDRESS 0xFFFF3560 /begin FUNCTION_LIST /end FUNCTION_LIST /end MEASUREMENT
/begin MEASUREMENT vAFHDTYS "A/F sensor heater duty output (the rest counter for the movement confirmation)" UBYTE COMP_0027 1 100 0 255 ECU_ADDRESS 0xFFFF3562 /begin FUNCTION_LIST /end FUNCTION_LIST /end MEASUREMENT
/begin MEASUREMENT vAFHMODEf "A/F sensor heater-control-in-progress flag" UBYTE COMP_0068 1 100 0 255 ECU_ADDRESS 0xFFFF38CB /begin FUNCTION_LIST /end FUNCTION_LIST /end MEASUREMENT
/begin MEASUREMENT vAFHONDTY "A/F sensor heater on duty output counter" UBYTE COMP_0027 1 100 0 255 ECU_ADDRESS 0xFFFF3564 /begin FUNCTION_LIST /end FUNCTION_LIST /end MEASUREMENT
/begin MEASUREMENT vAFHONf "A/F sensor heater on flag" UBYTE COMP_0068 1 100 0 255 ECU_ADDRESS 0xFFFF48AA /begin FUNCTION_LIST /end FUNCTION_LIST /end MEASUREMENT
/begin MEASUREMENT vAFHZCALf "Former A/F sensor rich lean response diagnosis permission condition" UBYTE COMP_0004 1 100 0 255 ECU_ADDRESS 0xFFFF1115 /begin FUNCTION_LIST /end FUNCTION_LIST /end MEASUREMENT
/begin MEASUREMENT vAFHZGOf "A former A/F sensor response deterioration/middle electric potential diagnosis diagnosis region condition" UBYTE COMP_0004 1 100 0 255 ECU_ADDRESS 0xFFFF27B3 /begin FUNCTION_LIST /end FUNCTION_LIST /end MEASUREMENT
/begin MEASUREMENT vAFHZLROKf "Rich lean response deterioration diagnosis OK judgement flag" UBYTE COMP_0004 1 100 0 255 ECU_ADDRESS 0xFFFF27B4 /begin FUNCTION_LIST /end FUNCTION_LIST /end MEASUREMENT
/begin MEASUREMENT vAFHZRCVf "Lean rich response deterioration diagnosis region condition judgement flag" UBYTE COMP_0004 1 100 0 255 ECU_ADDRESS 0xFFFF1117 /begin FUNCTION_LIST /end FUNCTION_LIST /end MEASUREMENT
/begin MEASUREMENT vAFHZRLOKf "Lean rich response deterioration diagnosis OK judgement flag" UBYTE COMP_0004 1 100 0 255 ECU_ADDRESS 0xFFFF27B5 /begin FUNCTION_LIST /end FUNCTION_LIST /end MEASUREMENT
/begin MEASUREMENT vAFHZf "A former A/F sensor response deterioration diagnosis region condition fuel recover judgement flag" UBYTE COMP_0004 1 100 0 255 ECU_ADDRESS 0xFFFF1116 /begin FUNCTION_LIST /end FUNCTION_LIST /end MEASUREMENT
/begin MEASUREMENT vAFLRACEND "RAM value vAFLRACEND" UBYTE COMP_0004 1 100 0 255 ECU_ADDRESS 0xFFFF27B6 /begin FUNCTION_LIST /end FUNCTION_LIST /end MEASUREMENT
/begin MEASUREMENT vAFLRENDf "Former A/F sensor response deterioration diagnosis completion (rich lean)" UBYTE COMP_0004 1 100 0 255 ECU_ADDRESS 0xFFFF27B7 /begin FUNCTION_LIST /end FUNCTION_LIST /end MEASUREMENT
/begin MEASUREMENT vAFLSTRPf "A/F sensor shift diagnosis lean-shift diagnosis TRIP judgement flag" UBYTE COMP_0004 1 100 0 255 ECU_ADDRESS 0xFFFF27B8 /begin FUNCTION_LIST /end FUNCTION_LIST /end MEASUREMENT
/begin MEASUREMENT vAFMCNT "AFM After they become NG and OK, a going down counter to the third TP calculation completion" UBYTE COMP_0030 1 100 0 255 ECU_ADDRESS 0xFFFF1D8E /begin FUNCTION_LIST /end FUNCTION_LIST /end MEASUREMENT
/begin MEASUREMENT vAFMODE "A/F sensor heater control mode" UBYTE COMP_0068 1 100 0 255 ECU_ADDRESS 0xFFFF38CC /begin FUNCTION_LIST /end FUNCTION_LIST /end MEASUREMENT
/begin MEASUREMENT vAFOFLGf "A/F sensor breakage diagnosis GST output data renewal flag" UBYTE COMP_0004 1 100 0 255 ECU_ADDRESS 0xFFFF27B9 /begin FUNCTION_LIST /end FUNCTION_LIST /end MEASUREMENT
/begin MEASUREMENT vAFOHONOf "A/F sensor shift learning region condition judgement flag" UBYTE COMP_0004 1 100 0 255 ECU_ADDRESS 0xFFFF27BA /begin FUNCTION_LIST /end FUNCTION_LIST /end MEASUREMENT
/begin MEASUREMENT vAFOKf "At the time of the A/F sensor breakage diagnosis normality, GST output data renewal flag" UBYTE COMP_0004 1 100 0 255 ECU_ADDRESS 0xFFFF27BB /begin FUNCTION_LIST /end FUNCTION_LIST /end MEASUREMENT
/begin MEASUREMENT vAFPRSTM "A former A/F sensor response deterioration diagnosis parameter backup acquisition timing counter" UBYTE COMP_0068 1 100 0 255 ECU_ADDRESS 0xFFFF27BC /begin FUNCTION_LIST /end FUNCTION_LIST /end MEASUREMENT
/begin MEASUREMENT vAFPRSTMf "After former A/F sensor rich lean response deterioration diagnosis idle SW on, time series data acquisition permission flag" UBYTE COMP_0004 1 100 0 255 ECU_ADDRESS 0xFFFF27BE /begin FUNCTION_LIST /end FUNCTION_LIST /end MEASUREMENT
/begin MEASUREMENT vAFRLACEND "RAM value vAFRLACEND" UBYTE COMP_0004 1 100 0 255 ECU_ADDRESS 0xFFFF27BF /begin FUNCTION_LIST /end FUNCTION_LIST /end MEASUREMENT
/begin MEASUREMENT vAFRLENDf "Former A/F sensor response deterioration diagnosis completion (lean rich)" UBYTE COMP_0004 1 100 0 255 ECU_ADDRESS 0xFFFF27C0 /begin FUNCTION_LIST /end FUNCTION_LIST /end MEASUREMENT
/begin MEASUREMENT vAFRO2INTf "A rear O2 voltage activated experience flag for the A/F sensor system" UBYTE COMP_0004 1 100 0 255 ECU_ADDRESS 0xFFFF111C /begin FUNCTION_LIST /end FUNCTION_LIST /end MEASUREMENT
/begin MEASUREMENT vAFRSTRPf "A/F sensor shift diagnosis rich-shift diagnosis TRIP judgement flag" UBYTE COMP_0004 1 100 0 255 ECU_ADDRESS 0xFFFF27C1 /begin FUNCTION_LIST /end FUNCTION_LIST /end MEASUREMENT
/begin MEASUREMENT vAFSACTMf "A/F sensor activated judgement experience flag" UBYTE COMP_0004 1 100 0 255 ECU_ADDRESS 0xFFFF27C2 /begin FUNCTION_LIST /end FUNCTION_LIST /end MEASUREMENT
/begin MEASUREMENT vAFSAVENDf "Former A/F sensor middle electric potential diagnosis completion" UBYTE COMP_0004 1 100 0 255 ECU_ADDRESS 0xFFFF27CC /begin FUNCTION_LIST /end FUNCTION_LIST /end MEASUREMENT
/begin MEASUREMENT vAFSCLPf "ALPHA transient state compensation prevention flag" UBYTE COMP_0004 1 100 0 255 ECU_ADDRESS 0xFFFF111D /begin FUNCTION_LIST /end FUNCTION_LIST /end MEASUREMENT
/begin MEASUREMENT vAFSFTC "AFSHOS renewal counter" UBYTE COMP_0016 1 100 0 255 ECU_ADDRESS 0xFFFF111E /begin FUNCTION_LIST /end FUNCTION_LIST /end MEASUREMENT
/begin MEASUREMENT vAFSTJf "A former A/F sensor lean rich response deterioration diagnosis region condition judgement flag" UBYTE COMP_0004 1 100 0 255 ECU_ADDRESS 0xFFFF1120 /begin FUNCTION_LIST /end FUNCTION_LIST /end MEASUREMENT
/begin MEASUREMENT vAFVNGBK "Former A/F sensor breakage diagnosis error information" UBYTE COMP_0016 1 100 0 255 ECU_ADDRESS 0xFFFF1121 /begin FUNCTION_LIST /end FUNCTION_LIST /end MEASUREMENT
/begin MEASUREMENT vAFVNGBKC "Former A/F sensor breakage diagnosis error information (for the diagnosis complete number of times count)" UBYTE COMP_0016 1 100 0 255 ECU_ADDRESS 0xFFFF1123 /begin FUNCTION_LIST /end FUNCTION_LIST /end MEASUREMENT
/begin MEASUREMENT vAGBCKCNT "AGB clock difference value unusual time" UBYTE COMP_0014 1 100 0 2550 ECU_ADDRESS 0xFFFF27E2 /begin FUNCTION_LIST /end FUNCTION_LIST /end MEASUREMENT
/begin MEASUREMENT vAGBDLCLK "AGB clock difference value" UBYTE COMP_0068 1 100 0 255 ECU_ADDRESS 0xFFFF48B4 /begin FUNCTION_LIST /end FUNCTION_LIST /end MEASUREMENT
/begin MEASUREMENT vAGBINTT "Delay between two consecutive calls to SDFTA" UBYTE COMP_0548_S 1 100 0 0.255 ECU_ADDRESS 0xFFFF38D4 DISPLAY_IDENTIFIER Vxx_agb_int_t /begin FUNCTION_LIST /end FUNCTION_LIST /end MEASUREMENT
/begin MEASUREMENT vAGBTUPNG "The former time integral value which raises an AGB torque" UWORD COMP_0196 1 100 0 6553.5 ECU_ADDRESS 0xFFFF27EE /begin FUNCTION_LIST /end FUNCTION_LIST /end MEASUREMENT
/begin MEASUREMENT vAHBCNT1 "A/F sensor parameter store counter (bank1)" UBYTE COMP_0016 1 100 0 255 ECU_ADDRESS 0xFFFFA0E6 /begin FUNCTION_LIST /end FUNCTION_LIST /end MEASUREMENT
/begin MEASUREMENT vAHBCNT2 "A/F sensor parameter store counter (bank2)" UBYTE COMP_0016 1 100 0 255 ECU_ADDRESS 0xFFFFA0E7 /begin FUNCTION_LIST /end FUNCTION_LIST /end MEASUREMENT
/begin MEASUREMENT vAHOSAV1 "Before 1 sample, AFSHOS mean" SWORD COMP_0341_S 1 100 -65.536 65.534 ECU_ADDRESS 0xFFFF27F4 /begin FUNCTION_LIST /end FUNCTION_LIST /end MEASUREMENT
/begin MEASUREMENT vAHOSINBLf "A/F sensor learning permission flag" UBYTE COMP_0004 1 100 0 255 ECU_ADDRESS 0xFFFF27FB /begin FUNCTION_LIST /end FUNCTION_LIST /end MEASUREMENT
/begin MEASUREMENT vAHTMRCNT1 "500mS counter (bank1) for the A/F sensor parameter backup" UBYTE COMP_0030 1 100 0 255 ECU_ADDRESS 0xFFFF2802 /begin FUNCTION_LIST /end FUNCTION_LIST /end MEASUREMENT
/begin MEASUREMENT vAHTMRCNT2 "500mS counter (bank2) for the A/F sensor parameter backup" UBYTE COMP_0030 1 100 0 255 ECU_ADDRESS 0xFFFF2803 /begin FUNCTION_LIST /end FUNCTION_LIST /end MEASUREMENT
/begin MEASUREMENT vAL1MN "LEKAL1 minimum value" UBYTE COMP_0232 1 100 0 1.9921875 ECU_ADDRESS 0xFFFFA192 /begin FUNCTION_LIST /end FUNCTION_LIST /end MEASUREMENT
/begin MEASUREMENT vAL2MN "LEKAL2 minimum value" UBYTE COMP_0232 1 100 0 1.9921875 ECU_ADDRESS 0xFFFFA193 /begin FUNCTION_LIST /end FUNCTION_LIST /end MEASUREMENT
/begin MEASUREMENT vAL3AV "Parameter mean" UBYTE COMP_0232 1 100 0 1.9921875 ECU_ADDRESS 0xFFFFA194 /begin FUNCTION_LIST /end FUNCTION_LIST /end MEASUREMENT
/begin MEASUREMENT vAL3AV_R#1 "Parameter mean" UBYTE COMP_0232 1 100 0 1.9921875 ECU_ADDRESS 0xFFFFA194 /begin FUNCTION_LIST /end FUNCTION_LIST /end MEASUREMENT
/begin MEASUREMENT vAL3AV_R#2 "Parameter mean" UBYTE COMP_0232 1 100 0 1.9921875 ECU_ADDRESS 0xFFFFA195 /begin FUNCTION_LIST /end FUNCTION_LIST /end MEASUREMENT
/begin MEASUREMENT vAL3AV_R#3 "Parameter mean" UBYTE COMP_0232 1 100 0 1.9921875 ECU_ADDRESS 0xFFFFA196 /begin FUNCTION_LIST /end FUNCTION_LIST /end MEASUREMENT
/begin MEASUREMENT vAL3AV_R#4 "Parameter mean" UBYTE COMP_0232 1 100 0 1.9921875 ECU_ADDRESS 0xFFFFA197 /begin FUNCTION_LIST /end FUNCTION_LIST /end MEASUREMENT
/begin MEASUREMENT vAL3AV_R#5 "Parameter mean" UBYTE COMP_0232 1 100 0 1.9921875 ECU_ADDRESS 0xFFFFA198 /begin FUNCTION_LIST /end FUNCTION_LIST /end MEASUREMENT
/begin MEASUREMENT vAL3AV_R#6 "Parameter mean" UBYTE COMP_0232 1 100 0 1.9921875 ECU_ADDRESS 0xFFFFA199 /begin FUNCTION_LIST /end FUNCTION_LIST /end MEASUREMENT
/begin MEASUREMENT vAL3AV_R#7 "Parameter mean" UBYTE COMP_0232 1 100 0 1.9921875 ECU_ADDRESS 0xFFFFA19A /begin FUNCTION_LIST /end FUNCTION_LIST /end MEASUREMENT
/begin MEASUREMENT vAL3AV_R#8 "Parameter mean" UBYTE COMP_0232 1 100 0 1.9921875 ECU_ADDRESS 0xFFFFA19B /begin FUNCTION_LIST /end FUNCTION_LIST /end MEASUREMENT
/begin MEASUREMENT vAL3BS1 "At the time of the LEAK3 operation, reference line pressure" UWORD COMP_0050 1 100 0 5119.921875 ECU_ADDRESS 0xFFFFA19C /begin FUNCTION_LIST /end FUNCTION_LIST /end MEASUREMENT
/begin MEASUREMENT vAL3BSP1 "At the time of the LEKAL3 operation, BASVP1" UWORD COMP_0050 1 100 0 5119.921875 ECU_ADDRESS 0xFFFFA19E /begin FUNCTION_LIST /end FUNCTION_LIST /end MEASUREMENT
/begin MEASUREMENT vAL3BSP2 "At the time of the LEKAL3 operation, BASVP2" UWORD COMP_0050 1 100 0 5119.921875 ECU_ADDRESS 0xFFFFA1A0 /begin FUNCTION_LIST /end FUNCTION_LIST /end MEASUREMENT
/begin MEASUREMENT vAL3DLY "At the time of the LEKAL3 operation, after the start, progress time" UBYTE COMP_0096 1 100 0 2550 ECU_ADDRESS 0xFFFFA1A2 /begin FUNCTION_LIST /end FUNCTION_LIST /end MEASUREMENT
/begin MEASUREMENT vAL3DTF "At the time of the LEKAL3 operation, É¢TFINT" UBYTE COMP_0003 1 100 0 255 ECU_ADDRESS 0xFFFFA1A3 /begin FUNCTION_LIST /end FUNCTION_LIST /end MEASUREMENT
/begin MEASUREMENT vAL3DTM "At the time of the LEKAL3 operation, DTIME" UWORD COMP_0008 1 100 0 6553500 ECU_ADDRESS 0xFFFFA1A4 /begin FUNCTION_LIST /end FUNCTION_LIST /end MEASUREMENT
/begin MEASUREMENT vAL3DV4 "At the time of the LEKAL3 operation, DVP4" UBYTE COMP_0054 1 100 0 5100 ECU_ADDRESS 0xFFFFA1A6 /begin FUNCTION_LIST /end FUNCTION_LIST /end MEASUREMENT
/begin MEASUREMENT vAL3DV5 "At the time of the LEKAL3 operation, DVP5" UBYTE COMP_0054 1 100 0 5100 ECU_ADDRESS 0xFFFFA1A7 /begin FUNCTION_LIST /end FUNCTION_LIST /end MEASUREMENT
/begin MEASUREMENT vAL3DV8 "At the time of the LEKAL3 operation, DVP8" UBYTE COMP_0054 1 100 0 5100 ECU_ADDRESS 0xFFFFA1A8 /begin FUNCTION_LIST /end FUNCTION_LIST /end MEASUREMENT
/begin MEASUREMENT vAL3FMX "LEKAL3 maximum value" UWORD COMP_0550_S 1 100 0 1.999970916 ECU_ADDRESS 0xFFFFA1AA /begin FUNCTION_LIST /end FUNCTION_LIST /end MEASUREMENT
/begin MEASUREMENT vAL3FMX_R#1 "LEKAL3 maximum value" UWORD COMP_0550_S 1 100 0 1.999970916 ECU_ADDRESS 0xFFFFA1AA /begin FUNCTION_LIST /end FUNCTION_LIST /end MEASUREMENT
/begin MEASUREMENT vAL3FMX_R#2 "LEKAL3 maximum value" UWORD COMP_0550_S 1 100 0 1.999970916 ECU_ADDRESS 0xFFFFA1AC /begin FUNCTION_LIST /end FUNCTION_LIST /end MEASUREMENT
/begin MEASUREMENT vAL3FMX_R#3 "LEKAL3 maximum value" UWORD COMP_0550_S 1 100 0 1.999970916 ECU_ADDRESS 0xFFFFA1AE /begin FUNCTION_LIST /end FUNCTION_LIST /end MEASUREMENT
/begin MEASUREMENT vAL3FMX_R#4 "LEKAL3 maximum value" UWORD COMP_0550_S 1 100 0 1.999970916 ECU_ADDRESS 0xFFFFA1B0 /begin FUNCTION_LIST /end FUNCTION_LIST /end MEASUREMENT
/begin MEASUREMENT vAL3FMX_R#5 "LEKAL3 maximum value" UWORD COMP_0550_S 1 100 0 1.999970916 ECU_ADDRESS 0xFFFFA1B2 /begin FUNCTION_LIST /end FUNCTION_LIST /end MEASUREMENT
/begin MEASUREMENT vAL3FMX_R#6 "LEKAL3 maximum value" UWORD COMP_0550_S 1 100 0 1.999970916 ECU_ADDRESS 0xFFFFA1B4 /begin FUNCTION_LIST /end FUNCTION_LIST /end MEASUREMENT
/begin MEASUREMENT vAL3FMX_R#7 "LEKAL3 maximum value" UWORD COMP_0550_S 1 100 0 1.999970916 ECU_ADDRESS 0xFFFFA1B6 /begin FUNCTION_LIST /end FUNCTION_LIST /end MEASUREMENT
/begin MEASUREMENT vAL3FMX_R#8 "LEKAL3 maximum value" UWORD COMP_0550_S 1 100 0 1.999970916 ECU_ADDRESS 0xFFFFA1B8 /begin FUNCTION_LIST /end FUNCTION_LIST /end MEASUREMENT
/begin MEASUREMENT vAL3FMX_R#9 "LEKAL3 maximum value" UWORD COMP_0550_S 1 100 0 1.999970916 ECU_ADDRESS 0xFFFFA1BA /begin FUNCTION_LIST /end FUNCTION_LIST /end MEASUREMENT
/begin MEASUREMENT vAL3FMX_R#10 "LEKAL3 maximum value" UWORD COMP_0550_S 1 100 0 1.999970916 ECU_ADDRESS 0xFFFFA1BC /begin FUNCTION_LIST /end FUNCTION_LIST /end MEASUREMENT
/begin MEASUREMENT vAL3FMX_R#11 "LEKAL3 maximum value" UWORD COMP_0550_S 1 100 0 1.999970916 ECU_ADDRESS 0xFFFFA1BE /begin FUNCTION_LIST /end FUNCTION_LIST /end MEASUREMENT
/begin MEASUREMENT vAL3FMX_R#12 "LEKAL3 maximum value" UWORD COMP_0550_S 1 100 0 1.999970916 ECU_ADDRESS 0xFFFFA1C0 /begin FUNCTION_LIST /end FUNCTION_LIST /end MEASUREMENT
/begin MEASUREMENT vAL3FMX_R#13 "LEKAL3 maximum value" UWORD COMP_0550_S 1 100 0 1.999970916 ECU_ADDRESS 0xFFFFA1C2 /begin FUNCTION_LIST /end FUNCTION_LIST /end MEASUREMENT
/begin MEASUREMENT vAL3FMX_R#14 "LEKAL3 maximum value" UWORD COMP_0550_S 1 100 0 1.999970916 ECU_ADDRESS 0xFFFFA1C4 /begin FUNCTION_LIST /end FUNCTION_LIST /end MEASUREMENT
/begin MEASUREMENT vAL3FMX_R#15 "LEKAL3 maximum value" UWORD COMP_0550_S 1 100 0 1.999970916 ECU_ADDRESS 0xFFFFA1C6 /begin FUNCTION_LIST /end FUNCTION_LIST /end MEASUREMENT
/begin MEASUREMENT vAL3FMX_R#16 "LEKAL3 maximum value" UWORD COMP_0550_S 1 100 0 1.999970916 ECU_ADDRESS 0xFFFFA1C8 /begin FUNCTION_LIST /end FUNCTION_LIST /end MEASUREMENT
/begin MEASUREMENT vAL3FNM "Parameter operation number of times" UWORD COMP_0016 1 100 0 65535 ECU_ADDRESS 0xFFFFA1CA /begin FUNCTION_LIST /end FUNCTION_LIST /end MEASUREMENT
/begin MEASUREMENT vAL3FNM_R#1 "Parameter operation number of times" UWORD COMP_0016 1 100 0 65535 ECU_ADDRESS 0xFFFFA1CA /begin FUNCTION_LIST /end FUNCTION_LIST /end MEASUREMENT
/begin MEASUREMENT vAL3FNM_R#2 "Parameter operation number of times" UWORD COMP_0016 1 100 0 65535 ECU_ADDRESS 0xFFFFA1CC /begin FUNCTION_LIST /end FUNCTION_LIST /end MEASUREMENT
/begin MEASUREMENT vAL3FNM_R#3 "Parameter operation number of times" UWORD COMP_0016 1 100 0 65535 ECU_ADDRESS 0xFFFFA1CE /begin FUNCTION_LIST /end FUNCTION_LIST /end MEASUREMENT
/begin MEASUREMENT vAL3FNM_R#4 "Parameter operation number of times" UWORD COMP_0016 1 100 0 65535 ECU_ADDRESS 0xFFFFA1D0 /begin FUNCTION_LIST /end FUNCTION_LIST /end MEASUREMENT
/begin MEASUREMENT vAL3FNM_R#5 "Parameter operation number of times" UWORD COMP_0016 1 100 0 65535 ECU_ADDRESS 0xFFFFA1D2 /begin FUNCTION_LIST /end FUNCTION_LIST /end MEASUREMENT
/begin MEASUREMENT vAL3FNM_R#6 "Parameter operation number of times" UWORD COMP_0016 1 100 0 65535 ECU_ADDRESS 0xFFFFA1D4 /begin FUNCTION_LIST /end FUNCTION_LIST /end MEASUREMENT
/begin MEASUREMENT vAL3FNM_R#7 "Parameter operation number of times" UWORD COMP_0016 1 100 0 65535 ECU_ADDRESS 0xFFFFA1D6 /begin FUNCTION_LIST /end FUNCTION_LIST /end MEASUREMENT
/begin MEASUREMENT vAL3FNM_R#8 "Parameter operation number of times" UWORD COMP_0016 1 100 0 65535 ECU_ADDRESS 0xFFFFA1D8 /begin FUNCTION_LIST /end FUNCTION_LIST /end MEASUREMENT
/begin MEASUREMENT vAL3FNM_R#9 "Parameter operation number of times" UWORD COMP_0016 1 100 0 65535 ECU_ADDRESS 0xFFFFA1DA /begin FUNCTION_LIST /end FUNCTION_LIST /end MEASUREMENT
/begin MEASUREMENT vAL3FNM_R#10 "Parameter operation number of times" UWORD COMP_0016 1 100 0 65535 ECU_ADDRESS 0xFFFFA1DC /begin FUNCTION_LIST /end FUNCTION_LIST /end MEASUREMENT
/begin MEASUREMENT vAL3FNM_R#11 "Parameter operation number of times" UWORD COMP_0016 1 100 0 65535 ECU_ADDRESS 0xFFFFA1DE /begin FUNCTION_LIST /end FUNCTION_LIST /end MEASUREMENT
/begin MEASUREMENT vAL3FNM_R#12 "Parameter operation number of times" UWORD COMP_0016 1 100 0 65535 ECU_ADDRESS 0xFFFFA1E0 /begin FUNCTION_LIST /end FUNCTION_LIST /end MEASUREMENT
/begin MEASUREMENT vAL3FNM_R#13 "Parameter operation number of times" UWORD COMP_0016 1 100 0 65535 ECU_ADDRESS 0xFFFFA1E2 /begin FUNCTION_LIST /end FUNCTION_LIST /end MEASUREMENT
/begin MEASUREMENT vAL3FNM_R#14 "Parameter operation number of times" UWORD COMP_0016 1 100 0 65535 ECU_ADDRESS 0xFFFFA1E4 /begin FUNCTION_LIST /end FUNCTION_LIST /end MEASUREMENT
/begin MEASUREMENT vAL3FNM_R#15 "Parameter operation number of times" UWORD COMP_0016 1 100 0 65535 ECU_ADDRESS 0xFFFFA1E6 /begin FUNCTION_LIST /end FUNCTION_LIST /end MEASUREMENT
/begin COMPU_METHOD COMP_0068 "1-" RAT_FUNC "%8.2" "-" COEFFS 0 1 0 0 0 1 /end COMPU_METHOD
/begin COMPU_METHOD COMP_0004 "1Å|" RAT_FUNC "%8.2" "Å|" COEFFS 0 1 0 0 0 1 /end COMPU_METHOD
/begin COMPU_METHOD COMP_0061 "5mv" RAT_FUNC "%8.2" "mv" COEFFS 0 1 0 0 0 5 /end COMPU_METHOD
/begin COMPU_METHOD COMP_0023 "5mV" RAT_FUNC "%8.2" "mV" COEFFS 0 1 0 0 0 5 /end COMPU_METHOD
/begin COMPU_METHOD COMP_0429 "1km/h" RAT_FUNC "%8.2" "km/h" COEFFS 0 1 0 0 0 1 /end COMPU_METHOD
/begin COMPU_METHOD COMP_0001 "1/8ms" RAT_FUNC "%8.2" "ms" COEFFS 0 1 0 0 0 0.125 /end COMPU_METHOD
/begin COMPU_METHOD COMP_0003 "1Åé" RAT_FUNC "%8.2" "Åé" COEFFS 0 1 0 0 0 1 /end COMPU_METHOD
/begin COMPU_METHOD COMP_0453 "0.002-" RAT_FUNC "%8.4" "-" COEFFS 0 1 0 0 0 0.002 /end COMPU_METHOD
/begin COMPU_METHOD COMP_0014 "10ms" RAT_FUNC "%8.2" "ms" COEFFS 0 1 0 0 0 10 /end COMPU_METHOD
/begin COMPU_METHOD COMP_0008 "100ms" RAT_FUNC "%8.2" "ms" COEFFS 0 1 0 0 0 100 /end COMPU_METHOD
/begin COMPU_METHOD COMP_0337_S "1r/min" RAT_FUNC "%8.2" "r/min" COEFFS 0 1 0 0 0 1 /end COMPU_METHOD
/begin COMPU_METHOD COMP_0196 "0.1Nm" RAT_FUNC "%8.2" "Nm" COEFFS 0 1 0 0 0 0.1 /end COMPU_METHOD
/begin COMPU_METHOD COMP_0013 "1s" RAT_FUNC "%8.2" "s" COEFFS 0 1 0 0 0 1 /end COMPU_METHOD
/begin COMPU_METHOD COMP_0047 "0.5%" RAT_FUNC "%8.2" "%" COEFFS 0 1 0 0 0 0.5 /end COMPU_METHOD
/begin COMPU_METHOD COMP_0018 "1deg" RAT_FUNC "%8.2" "deg" COEFFS 0 1 0 0 0 1 /end COMPU_METHOD
/begin COMPU_METHOD COMP_0250 "4ms" RAT_FUNC "%8.2" "ms" COEFFS 0 1 0 0 0 4 /end COMPU_METHOD
/begin COMPU_METHOD COMP_0027 "1%" RAT_FUNC "%8.2" "%" COEFFS 0 1 0 0 0 1 /end COMPU_METHOD
/begin COMPU_METHOD COMP_0030 "1âÒ" RAT_FUNC "%8.2" "âÒ" COEFFS 0 1 0 0 0 1 /end COMPU_METHOD
/begin COMPU_METHOD COMP_0341_S "0.002-" RAT_FUNC "%8.4" "-" COEFFS 0 1 0 0 0 0.002 /end COMPU_METHOD
/begin COMPU_METHOD COMP_0345_S "1/32Nm" RAT_FUNC "%8.3" "Nm" COEFFS 0 1 400 0 0 0.03125 /end COMPU_METHOD
/begin COMPU_METHOD COMP_0360_S "40W" RAT_FUNC "%8.2" "W" COEFFS 0 1 0 0 0 40 /end COMPU_METHOD
/begin COMPU_METHOD COMP_0362_S "0.125%" RAT_FUNC "%8.2" "%" COEFFS 0 1 0 0 0 0.125 /end COMPU_METHOD
/begin COMPU_METHOD COMP_0365_S "10W" RAT_FUNC "%8.2" "W" COEFFS 0 1 0 0 0 10 /end COMPU_METHOD
/begin COMPU_METHOD COMP_0016 "1count" RAT_FUNC "%8.2" "count" COEFFS 0 1 0 0 0 1 /end COMPU_METHOD
/begin COMPU_METHOD COMP_0054 "20mV" RAT_FUNC "%8.2" "mV" COEFFS 0 1 0 0 0 20 /end COMPU_METHOD
/begin COMPU_METHOD COMP_0050 "5/64mV" RAT_FUNC "%8.3" "mV" COEFFS 0 1 0 0 0 0.078125 /end COMPU_METHOD
/begin COMPU_METHOD COMP_0375_S "0.01km/h" RAT_FUNC "%8.3" "km/h" COEFFS 0 1 0 0 0 0.01 /end COMPU_METHOD
/begin COMPU_METHOD COMP_0228 "0.1Nm" RAT_FUNC "%8.2" "Nm" COEFFS 0 1 0 0 0 0.1 /end COMPU_METHOD
/begin COMPU_METHOD COMP_0096 "10s" RAT_FUNC "%8.2" "s" COEFFS 0 1 0 0 0 10 /end COMPU_METHOD
/begin COMPU_METHOD COMP_0425 "100/255%" RAT_FUNC "%8.2" "%" COEFFS 0 1 0 0 0 0.392156862 /end COMPU_METHOD
/begin COMPU_METHOD COMP_0104 "10mV" RAT_FUNC "%8.2" "mV" COEFFS 0 1 0 0 0 10 /end COMPU_METHOD
/begin COMPU_METHOD COMP_0420_S "0.1Bar" RAT_FUNC "%8.2" "Bar" COEFFS 0 1 0 0 0 0.1 /end COMPU_METHOD
/begin COMPU_METHOD COMP_0191 "1REV" RAT_FUNC "%8.2" "REV" COEFFS 0 1 0 0 0 1 /end COMPU_METHOD
/begin COMPU_METHOD COMP_0428_S "10^3/2^19km/h/s" RAT_FUNC "%8.4" "km/h/s" COEFFS 0 1 0 0 0 0.00190735 /end COMPU_METHOD
/begin COMPU_METHOD COMP_0025 "0.5step" RAT_FUNC "%8.2" "step" COEFFS 0 1 0 0 0 0.5 /end COMPU_METHOD
/begin COMPU_METHOD COMP_0133_S "%%" RAT_FUNC "%8.3" "%" COEFFS 0 1 0 0 0 0.0390625 /end COMPU_METHOD
/begin COMPU_METHOD COMP_0232 "1/128mm^2" RAT_FUNC "%8.4" "mm^2" COEFFS 0 1 0 0 0 0.0078125 /end COMPU_METHOD
/begin COMPU_METHOD COMP_0263 "1-" RAT_FUNC "%8.2" "-" COEFFS 0 1 0 0 0 1 /end COMPU_METHOD
/begin COMPU_METHOD COMP_0439_S "20W" RAT_FUNC "%8.2" "W" COEFFS 0 1 0 0 0 20 /end COMPU_METHOD
/begin COMPU_METHOD COMP_0451_S "0.00125ratio" RAT_FUNC "%8.4" "ratio" COEFFS 0 1 0 0 0 0.00125 /end COMPU_METHOD
/begin COMPU_METHOD COMP_0030_S "NN" RAT_FUNC "%8.2" "N" COEFFS 0 1 0 0 0 1 /end COMPU_METHOD
/begin COMPU_METHOD COMP_0463_S "40W/s" RAT_FUNC "%8.2" "W/s" COEFFS 0 1 0 0 0 40 /end COMPU_METHOD
/begin COMPU_METHOD COMP_0245 "X-64deg" RAT_FUNC "%8.2" "deg" COEFFS 0 1 64 0 0 1 /end COMPU_METHOD
/begin COMPU_METHOD COMP_0283 "1flag" RAT_FUNC "%8.2" "flag" COEFFS 0 1 0 0 0 1 /end COMPU_METHOD
/begin COMPU_METHOD COMP_0201_S "1s1s" RAT_FUNC "%8.2" "1s" COEFFS 0 1 0 0 0 1 /end COMPU_METHOD
/begin COMPU_METHOD COMP_0202_S "100ms100ms" RAT_FUNC "%8.2" "100ms" COEFFS 0 1 0 0 0 1 /end COMPU_METHOD
/begin COMPU_METHOD COMP_0203_S "10ms10ms" RAT_FUNC "%8.2" "10ms" COEFFS 0 1 0 0 0 1 /end COMPU_METHOD
/begin COMPU_METHOD COMP_0204_S "1ms1ms" RAT_FUNC "%8.2" "1ms" COEFFS 0 1 0 0 0 1 /end COMPU_METHOD
/begin COMPU_METHOD COMP_0287 "1REF" RAT_FUNC "%8.2" "REF" COEFFS 0 1 0 0 0 1 /end COMPU_METHOD
/begin COMPU_METHOD COMP_0531_S "m/s^2m/s^2" RAT_FUNC "%8.2" "m/s^2" COEFFS 0 1 0 0 0 0.1 /end COMPU_METHOD
/begin COMPU_METHOD COMP_0532_S "km/h/skm/h/s" RAT_FUNC "%8.3" "km/h/s" COEFFS 0 1 0 0 0 0.01 /end COMPU_METHOD
/begin COMPU_METHOD COMP_0192 "10É s" RAT_FUNC "%8.2" "É s" COEFFS 0 1 0 0 0 10 /end COMPU_METHOD
/begin COMPU_METHOD COMP_0426 "Å|code" RAT_FUNC "%8.2" "code" COEFFS 0 1 0 0 0 1 /end COMPU_METHOD
/begin COMPU_METHOD COMP_0001_S "km/hkm/h" RAT_FUNC "%8.6" "km/h" COEFFS 0 1 0 0 0 0.000000858 /end COMPU_METHOD
/begin COMPU_METHOD COMP_0166_S "msms" RAT_FUNC "%8.5" "ms" COEFFS 0 1 0 0 0 0.000976563 /end COMPU_METHOD
/begin COMPU_METHOD COMP_0209_S "3.6*2^-22km/h" RAT_FUNC "%8.6" "km/h" COEFFS 0 1 0 0 0 0.000000858307 /end COMPU_METHOD
/begin COMPU_METHOD COMP_0421 "1ãCìõ" RAT_FUNC "%8.2" "ãCìõ" COEFFS 0 1 0 0 0 1 /end COMPU_METHOD
/begin COMPU_METHOD COMP_0206_S "2^-22m/ss" RAT_FUNC "%8.6" "m/ss" COEFFS 0 1 0 0 0 0.000000238419 /end COMPU_METHOD
/begin COMPU_METHOD COMP_0013_S " ﬂŸΩ ﬂŸΩ" RAT_FUNC "%8.2" " ﬂŸΩ" COEFFS 0 1 0 0 0 1 /end COMPU_METHOD
/begin COMPU_METHOD COMP_0544_S "A100msA100ms" RAT_FUNC "%8.2" "A100ms" COEFFS 0 1 32768 0 0 1 /end COMPU_METHOD
/begin COMPU_METHOD COMP_0548_S "ss" RAT_FUNC "%8.4" "s" COEFFS 0 1 0 0 0 0.001 /end COMPU_METHOD
/begin COMPU_METHOD COMP_0550_S "mm^2mm^2" RAT_FUNC "%8.6" "mm^2" COEFFS 0 1 0 0 0 0.0000305176 /end COMPU_METHOD
/end MODULE
/end PROJECT
