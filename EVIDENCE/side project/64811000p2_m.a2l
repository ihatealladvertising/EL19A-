ASAP2_VERSION 1 3_BETA
/begin PROJECT TK_X91_EUR_VC ""
/begin HEADER "" /* key HEADER ++ "comment" Ç… Par.scomment */ PROJECT_NO TK_X91_EUR_VC /* key PROJECT_NO ++ project number Ç… car_eng_desti_lot */ VERSION "7V4YHZEB2" /* key VERSION ++ version number Ç… mProgver */ /end HEADER
/begin MODULE DIM ""
/begin MOD_COMMON "" DEPOSIT ABSOLUTE BYTE_ORDER MSB_FIRST /* ﬁ≤ƒµ∞¿ﬁ∞Ç™ÿÃﬂ⁄∞ΩÇ≥ÇÍÇÈ */ /end MOD_COMMON
/begin FUNCTION KF7-311.1A[21] "Fuel injection timing (for MPI)" /end FUNCTION
/begin FUNCTION KF7-312.1C[N] "Fuel injection pulse width characteristics formula (for MPI - deltaTP interruption injection control type)" /end FUNCTION
/begin FUNCTION KF7-312.2A[16] "Target equivalence ratio (for MPI) " /end FUNCTION
/begin FUNCTION KF7-312.3A[27] "Other target equivalence ratio (for MPI)" /end FUNCTION
/begin FUNCTION KF7-312.4A[6] "Transient correction (for MPI)" /end FUNCTION
/begin FUNCTION KF7-312.4C[4] "Transient correction (for MPI/ deltaTP method interruption injection control type))" /end FUNCTION
/begin FUNCTION KF7-312.5A[4] "Interruption injection at acceleration (for MPI)" /end FUNCTION
/begin FUNCTION KF7-312.5C[1] "Interruption injection at acceleration (for MPI)" /end FUNCTION
/begin FUNCTION KF7-312.6[34] "Fuel cut" /end FUNCTION
/begin FUNCTION KF7-313C.1[36] "Interface" /end FUNCTION
/begin CHARACTERISTIC mHOSQMAX "New article catalyst HSOSQ maximum value" CURVE 0x0000DE36 REC_SWORD_C 0 COMP_0334_S -83886.08 83883.52
 /begin AXIS_DESCR FIX_AXIS NO_INPUT_QUANTITY COMP_0205_S 2 0 1 FIX_AXIS_PAR_DIST 0 1 2 /end AXIS_DESCR
 /begin FUNCTION_LIST KF7-313C.1[36] /end FUNCTION_LIST
/end CHARACTERISTIC
/begin CHARACTERISTIC mHOSQMIN "HSOSQ minimum value" CURVE 0x0000DE3A REC_SWORD_C 0 COMP_0334_S -83886.08 83883.52
 /begin AXIS_DESCR FIX_AXIS NO_INPUT_QUANTITY COMP_0205_S 2 0 1 FIX_AXIS_PAR_DIST 0 1 2 /end AXIS_DESCR
 /begin FUNCTION_LIST KF7-313C.1[36] /end FUNCTION_LIST
/end CHARACTERISTIC
/begin CHARACTERISTIC mRHSOSQL "At the time of resetting, HSOSQ minimum value" CURVE 0x0000DE3E REC_SWORD_C 0 COMP_0334_S -83886.08 83883.52
 /begin AXIS_DESCR FIX_AXIS NO_INPUT_QUANTITY COMP_0205_S 2 0 1 FIX_AXIS_PAR_DIST 0 1 2 /end AXIS_DESCR
 /begin FUNCTION_LIST KF7-313C.1[36] /end FUNCTION_LIST
/end CHARACTERISTIC
/begin CHARACTERISTIC mRO2DTHS1 "RrO2 sensor slice setup hysteresis" CURVE 0x0000E416 REC_UWORD_C 0 COMP_0061 0 327675
 /begin AXIS_DESCR FIX_AXIS NO_INPUT_QUANTITY COMP_0205_S 2 0 1 FIX_AXIS_PAR_DIST 0 1 2 /end AXIS_DESCR
 /begin FUNCTION_LIST KF7-313C.1[36] /end FUNCTION_LIST
/end CHARACTERISTIC
/begin CHARACTERISTIC mRO2DTHS2 "Lean side RrO2 sensor the second slice setup hysteresis" CURVE 0x0000E41A REC_UWORD_C 0 COMP_0061 0 327675
 /begin AXIS_DESCR FIX_AXIS NO_INPUT_QUANTITY COMP_0205_S 2 0 1 FIX_AXIS_PAR_DIST 0 1 2 /end AXIS_DESCR
 /begin FUNCTION_LIST KF7-313C.1[36] /end FUNCTION_LIST
/end CHARACTERISTIC
/begin CHARACTERISTIC mRO2DTHS3 "Rich side RrO2 sensor the second slice setup hysteresis" CURVE 0x0000E41E REC_UWORD_C 0 COMP_0061 0 327675
 /begin AXIS_DESCR FIX_AXIS NO_INPUT_QUANTITY COMP_0205_S 2 0 1 FIX_AXIS_PAR_DIST 0 1 2 /end AXIS_DESCR
 /begin FUNCTION_LIST KF7-313C.1[36] /end FUNCTION_LIST
/end CHARACTERISTIC
/begin CHARACTERISTIC mRO2L1DT "Lean side RrO2 sensor slice" CURVE 0x0000E422 REC_UWORD_C 0 COMP_0061 0 327675
 /begin AXIS_DESCR FIX_AXIS NO_INPUT_QUANTITY COMP_0205_S 2 0 1 FIX_AXIS_PAR_DIST 0 1 2 /end AXIS_DESCR
 /begin FUNCTION_LIST KF7-313C.1[36] /end FUNCTION_LIST
/end CHARACTERISTIC
/begin CHARACTERISTIC mRO2L2DT "Lean side RrO2 sensor the second slice" CURVE 0x0000E426 REC_UWORD_C 0 COMP_0061 0 327675
 /begin AXIS_DESCR FIX_AXIS NO_INPUT_QUANTITY COMP_0205_S 2 0 1 FIX_AXIS_PAR_DIST 0 1 2 /end AXIS_DESCR
 /begin FUNCTION_LIST KF7-313C.1[36] /end FUNCTION_LIST
/end CHARACTERISTIC
/begin CHARACTERISTIC mRO2L3DT "Lean side RrO2 sensor the third slice" CURVE 0x0000E42A REC_UWORD_C 0 COMP_0023 0 327675
 /begin AXIS_DESCR FIX_AXIS NO_INPUT_QUANTITY COMP_0205_S 2 0 1 FIX_AXIS_PAR_DIST 0 1 2 /end AXIS_DESCR
 /begin FUNCTION_LIST KF7-313C.1[36] /end FUNCTION_LIST
/end CHARACTERISTIC
/begin CHARACTERISTIC mRO2R1DT "Rich side RrO2 sensor slice" CURVE 0x0000E42E REC_UWORD_C 0 COMP_0061 0 327675
 /begin AXIS_DESCR FIX_AXIS NO_INPUT_QUANTITY COMP_0205_S 2 0 1 FIX_AXIS_PAR_DIST 0 1 2 /end AXIS_DESCR
 /begin FUNCTION_LIST KF7-313C.1[36] /end FUNCTION_LIST
/end CHARACTERISTIC
/begin CHARACTERISTIC mRO2R2DT "Rich side RrO2 sensor the second slice" CURVE 0x0000E432 REC_UWORD_C 0 COMP_0061 0 327675
 /begin AXIS_DESCR FIX_AXIS NO_INPUT_QUANTITY COMP_0205_S 2 0 1 FIX_AXIS_PAR_DIST 0 1 2 /end AXIS_DESCR
 /begin FUNCTION_LIST KF7-313C.1[36] /end FUNCTION_LIST
/end CHARACTERISTIC
/begin CHARACTERISTIC mRO2R3DT "Rich side RrO2 sensor the third slice" CURVE 0x0000E436 REC_UWORD_C 0 COMP_0023 0 327675
 /begin AXIS_DESCR FIX_AXIS NO_INPUT_QUANTITY COMP_0205_S 2 0 1 FIX_AXIS_PAR_DIST 0 1 2 /end AXIS_DESCR
 /begin FUNCTION_LIST KF7-313C.1[36] /end FUNCTION_LIST
/end CHARACTERISTIC
/begin CHARACTERISTIC mSOSQMAX "LSOSQ maximum value" CURVE 0x0000DE42 REC_SWORD_C 0 COMP_0334_S -83886.08 83883.52
 /begin AXIS_DESCR FIX_AXIS NO_INPUT_QUANTITY COMP_0205_S 2 0 1 FIX_AXIS_PAR_DIST 0 1 2 /end AXIS_DESCR
 /begin FUNCTION_LIST KF7-313C.1[36] /end FUNCTION_LIST
/end CHARACTERISTIC
/begin CHARACTERISTIC mSOSQMIN "LSOSQ minimum value" CURVE 0x0000DE46 REC_SWORD_C 0 COMP_0334_S -83886.08 83883.52
 /begin AXIS_DESCR FIX_AXIS NO_INPUT_QUANTITY COMP_0205_S 2 0 1 FIX_AXIS_PAR_DIST 0 1 2 /end AXIS_DESCR
 /begin FUNCTION_LIST KF7-313C.1[36] /end FUNCTION_LIST
/end CHARACTERISTIC
/begin CHARACTERISTIC mTKGZR "KGZR table" CURVE 0x0000D3AE REC_UBYTE_C 0 COMP_0335_S -384 126
 /begin AXIS_DESCR FIX_AXIS NO_INPUT_QUANTITY COMP_0205_S 4 0 3 FIX_AXIS_PAR_DIST 0 1 4 /end AXIS_DESCR
 /begin FUNCTION_LIST KF7-312.4C[4] /end FUNCTION_LIST
/end CHARACTERISTIC
/begin CHARACTERISTIC mTRLCY2 "Compensation value table by the cylinder" CURVE 0x0000D850 REC_UBYTE_C 0 COMP_0045 0 1.9921875
 /begin AXIS_DESCR FIX_AXIS NO_INPUT_QUANTITY COMP_0205_S 6 0 5 FIX_AXIS_PAR_DIST 0 1 6 /end AXIS_DESCR
 /begin FUNCTION_LIST KF7-312.1C[N] /end FUNCTION_LIST
/end CHARACTERISTIC
/begin CHARACTERISTIC mTGZCLS "An interrupt injection injection time compensation rate (mild acceleration) by the cylinder" CURVE 0x0000D146 REC_UBYTE_C 0 COMP_0186 0 3.984375
 /begin AXIS_DESCR FIX_AXIS NO_INPUT_QUANTITY COMP_0205_S 8 0 7 FIX_AXIS_PAR_DIST 0 1 8 /end AXIS_DESCR
 /begin FUNCTION_LIST KF7-312.4C[4] KF7-312.5C[1] /end FUNCTION_LIST
/end CHARACTERISTIC
/begin CHARACTERISTIC mTGZCYL "An interrupt injection injection time compensation rate (urgent acceleration) by the cylinder" CURVE 0x0000D14E REC_UBYTE_C 0 COMP_0186 0 3.984375
 /begin AXIS_DESCR FIX_AXIS NO_INPUT_QUANTITY COMP_0205_S 8 0 7 FIX_AXIS_PAR_DIST 0 1 8 /end AXIS_DESCR
 /begin FUNCTION_LIST KF7-312.4C[4] KF7-312.5C[1] /end FUNCTION_LIST
/end CHARACTERISTIC
/begin CHARACTERISTIC mA0QA1 "Coefficient a0 (Qa region #1)" VALUE 0x00008EA4 REC_SWORD_C 0 COMP_0336_S -3.2768 3.2767 /begin FUNCTION_LIST KF7-313C.1[36] /end FUNCTION_LIST /end CHARACTERISTIC
/begin CHARACTERISTIC mA0QA12 "Coefficient a0 (Qa region #1) (bank 2)" VALUE 0x00008EA6 REC_SWORD_C 0 COMP_0336_S -3.2768 3.2767 /begin FUNCTION_LIST KF7-313C.1[36] /end FUNCTION_LIST /end CHARACTERISTIC
/begin CHARACTERISTIC mA0QA2 "Coefficient a0 (Qa region #2)" VALUE 0x00008EA8 REC_SWORD_C 0 COMP_0336_S -3.2768 3.2767 /begin FUNCTION_LIST KF7-313C.1[36] /end FUNCTION_LIST /end CHARACTERISTIC
/begin CHARACTERISTIC mA0QA3 "Coefficient a0 (Qa region #3)" VALUE 0x00008EAC REC_SWORD_C 0 COMP_0336_S -3.2768 3.2767 /begin FUNCTION_LIST KF7-313C.1[36] /end FUNCTION_LIST /end CHARACTERISTIC
/begin CHARACTERISTIC mA1QA1 "Coefficient a1 (Qa region #1)" VALUE 0x00008EB0 REC_SWORD_C 0 COMP_0336_S -3.2768 3.2767 /begin FUNCTION_LIST KF7-313C.1[36] /end FUNCTION_LIST /end CHARACTERISTIC
/begin CHARACTERISTIC mA1QA12 "Coefficient a1 (Qa region #1) (bank 2)" VALUE 0x00008EB2 REC_SWORD_C 0 COMP_0336_S -3.2768 3.2767 /begin FUNCTION_LIST KF7-313C.1[36] /end FUNCTION_LIST /end CHARACTERISTIC
/begin CHARACTERISTIC mA1QA2 "Coefficient a1 (Qa region #2)" VALUE 0x00008EB4 REC_SWORD_C 0 COMP_0336_S -3.2768 3.2767 /begin FUNCTION_LIST KF7-313C.1[36] /end FUNCTION_LIST /end CHARACTERISTIC
/begin CHARACTERISTIC mA1QA3 "Coefficient a1 (Qa region #3)" VALUE 0x00008EB8 REC_SWORD_C 0 COMP_0336_S -3.2768 3.2767 /begin FUNCTION_LIST KF7-313C.1[36] /end FUNCTION_LIST /end CHARACTERISTIC
/begin CHARACTERISTIC mABFAMPL "A/F amplitude (lean side)" VALUE 0x00008F8A REC_UWORD_C 0 COMP_0453 0 131.07 /begin FUNCTION_LIST KF7-313C.1[36] /end FUNCTION_LIST /end CHARACTERISTIC
/begin CHARACTERISTIC mABFAMPR "A/F amplitude (rich side)" VALUE 0x00008F8C REC_UWORD_C 0 COMP_0453 0 131.07 /begin FUNCTION_LIST KF7-313C.1[36] /end FUNCTION_LIST /end CHARACTERISTIC
/begin CHARACTERISTIC mABFAV "A/F weighted average value" VALUE 0x000081BF REC_UBYTE_C 0 COMP_0045 0 1.9921875 /begin FUNCTION_LIST KF7-313C.1[36] /end FUNCTION_LIST /end CHARACTERISTIC
/begin CHARACTERISTIC mABFCMPV "Target A/F clamp value" VALUE 0x00008F8E REC_UWORD_C 0 COMP_0453 0 131.07 /begin FUNCTION_LIST KF7-313C.1[36] KF7-313C.6[5] /end FUNCTION_LIST /end CHARACTERISTIC
/begin CHARACTERISTIC mACTMIN "At the time of use of RECAC2, TNC minimum limitation value" VALUE 0x000081E5 REC_UBYTE_C 0 COMP_0000 0 6375 /begin FUNCTION_LIST KF7-312.6[34] /end FUNCTION_LIST /end CHARACTERISTIC
/begin CHARACTERISTIC mAFDAFH "Diagnosis permission A/F upper limit" VALUE 0x00008FB2 REC_UWORD_C 0 COMP_0453 0 131.07 /begin FUNCTION_LIST KF7-313C.1[36] /end FUNCTION_LIST /end CHARACTERISTIC
/begin CHARACTERISTIC mAFDAFL "Diagnosis permission A/F lower limit" VALUE 0x00008FB4 REC_UWORD_C 0 COMP_0453 0 131.07 /begin FUNCTION_LIST KF7-313C.1[36] /end FUNCTION_LIST /end CHARACTERISTIC
/begin CHARACTERISTIC mAFDALPH "Diagnosis permission ALPHA upper limit" VALUE 0x0000820C REC_UBYTE_C 0 COMP_0027 0 255 /begin FUNCTION_LIST KF7-313C.1[36] /end FUNCTION_LIST /end CHARACTERISTIC
/begin CHARACTERISTIC mAFDALPL "Diagnosis permission ALPHA lower limit" VALUE 0x0000820D REC_UBYTE_C 0 COMP_0027 0 255 /begin FUNCTION_LIST KF7-313C.1[36] /end FUNCTION_LIST /end CHARACTERISTIC
/begin CHARACTERISTIC mAFDHDLY "Diagnosis permission heater delay" VALUE 0x00008210 REC_UBYTE_C 0 COMP_0267_S 0 25.5 /begin FUNCTION_LIST KF7-313C.1[36] /end FUNCTION_LIST /end CHARACTERISTIC
/begin CHARACTERISTIC mAFDIFAF "Diagnosis completion tense completion A/F convergent range" VALUE 0x00008FB6 REC_UWORD_C 0 COMP_0453 0 131.07 /begin FUNCTION_LIST KF7-313C.1[36] /end FUNCTION_LIST /end CHARACTERISTIC
/begin CHARACTERISTIC mAFDQAD "A change in the amount of diagnosis permission air" VALUE 0x00008FB8 REC_UWORD_C 0 COMP_0068 0 65535 /begin FUNCTION_LIST KF7-313C.1[36] /end FUNCTION_LIST /end CHARACTERISTIC
/begin CHARACTERISTIC mAFDQAH "Diagnosis permission air quantity upper limit" VALUE 0x00008FBA REC_UWORD_C 0 COMP_0068 0 65535 /begin FUNCTION_LIST KF7-313C.1[36] /end FUNCTION_LIST /end CHARACTERISTIC
/begin CHARACTERISTIC mAFDQAL "Diagnosis permission air quantity lower limit" VALUE 0x00008FBC REC_UWORD_C 0 COMP_0068 0 65535 /begin FUNCTION_LIST KF7-313C.1[36] /end FUNCTION_LIST /end CHARACTERISTIC
/begin CHARACTERISTIC mAFDRPMD "A change in diagnosis permission speed" VALUE 0x00008211 REC_UBYTE_C 0 COMP_0000 0 6375 /begin FUNCTION_LIST KF7-313C.1[36] /end FUNCTION_LIST /end CHARACTERISTIC
/begin CHARACTERISTIC mAFDRPMH "Diagnosis permission speed upper limit" VALUE 0x00008212 REC_UBYTE_C 0 COMP_0000 0 6375 /begin FUNCTION_LIST KF7-313C.1[36] /end FUNCTION_LIST /end CHARACTERISTIC
/begin CHARACTERISTIC mAFDRPML "Diagnosis permission speed lower limit" VALUE 0x00008213 REC_UBYTE_C 0 COMP_0000 0 6375 /begin FUNCTION_LIST KF7-313C.1[36] /end FUNCTION_LIST /end CHARACTERISTIC
/begin CHARACTERISTIC mAFDVSP "Diagnosis permission vehicle speed" VALUE 0x00008214 REC_UBYTE_C 0 COMP_0007 0 510 /begin FUNCTION_LIST KF7-313C.1[36] /end FUNCTION_LIST /end CHARACTERISTIC
/begin CHARACTERISTIC mAFEDLY "Diagnosis completion tense time" VALUE 0x00008FBE REC_UWORD_C 0 COMP_0165_S 0 655.35 /begin FUNCTION_LIST KF7-313C.1[36] /end FUNCTION_LIST /end CHARACTERISTIC
/begin CHARACTERISTIC mAFHDLY "Heater diagnosis judgement start delay" VALUE 0x00008218 REC_UBYTE_C 0 COMP_0049 0 255 /begin FUNCTION_LIST KF7-313C.1[36] KF7-500.59[6] /end FUNCTION_LIST /end CHARACTERISTIC
/begin CHARACTERISTIC mAFPSL "Lambda control start A/F sensor voltage" VALUE 0x00008FD4 REC_UWORD_C 0 COMP_0093 0 163837.5 /begin FUNCTION_LIST KF7-313C.1[36] /end FUNCTION_LIST /end CHARACTERISTIC
/begin CHARACTERISTIC mAFSHDEC "When a rich side the second slice is reset, the amount of shift subtraction" VALUE 0x00008EC0 REC_SWORD_C 0 COMP_0341_S -65.536 65.534 /begin FUNCTION_LIST KF7-313C.1[36] /end FUNCTION_LIST /end CHARACTERISTIC
/begin CHARACTERISTIC mAFSHDEC2 "When lean slices two times cross, shift learning value" VALUE 0x00008FDA REC_UWORD_C 0 COMP_0453 0 131.07 /begin FUNCTION_LIST KF7-313C.1[36] /end FUNCTION_LIST /end CHARACTERISTIC
/begin CHARACTERISTIC mAFSHINC "When a lean side the second slice is reset, the amount of shift addition" VALUE 0x00008EC2 REC_SWORD_C 0 COMP_0341_S -65.536 65.534 /begin FUNCTION_LIST KF7-313C.1[36] /end FUNCTION_LIST /end CHARACTERISTIC
/begin CHARACTERISTIC mAFSHINC2 "When rich slices two times cross, shift learning value" VALUE 0x00008FDC REC_UWORD_C 0 COMP_0453 0 131.07 /begin FUNCTION_LIST KF7-313C.1[36] /end FUNCTION_LIST /end CHARACTERISTIC
/begin CHARACTERISTIC mAFSHSMN "AFSHOS minimum value" VALUE 0x00008EC4 REC_SWORD_C 0 COMP_0341_S -65.536 65.534 /begin FUNCTION_LIST KF7-313C.1[36] /end FUNCTION_LIST /end CHARACTERISTIC
/begin CHARACTERISTIC mAFSHSMX "AFSHOS maximum value" VALUE 0x00008EC6 REC_SWORD_C 0 COMP_0341_S -65.536 65.534 /begin FUNCTION_LIST KF7-313C.1[36] /end FUNCTION_LIST /end CHARACTERISTIC
/begin CHARACTERISTIC mALPAMP "ALPHA amplitude" VALUE 0x00009008 REC_UWORD_C 0 COMP_0031 0 255.99609375 /begin FUNCTION_LIST KF7-313C.1[36] /end FUNCTION_LIST /end CHARACTERISTIC
/begin CHARACTERISTIC mALPMAXA "Air-fuel ratio compensation upper limit" VALUE 0x0000900C REC_UWORD_C 0 COMP_0031 0 255.99609375 /begin FUNCTION_LIST KF7-313C.1[36] /end FUNCTION_LIST /end CHARACTERISTIC
/begin CHARACTERISTIC mALPMINA "Air-fuel ratio compensation lower limit" VALUE 0x0000900E REC_UWORD_C 0 COMP_0031 0 255.99609375 /begin FUNCTION_LIST KF7-313C.1[36] /end FUNCTION_LIST /end CHARACTERISTIC
/begin CHARACTERISTIC mALPMND "ALPHA lower limit value (When it slows down.)" VALUE 0x0000826C REC_UBYTE_C 0 COMP_0027 0 255 /begin FUNCTION_LIST KF7-313C.1[36] /end FUNCTION_LIST /end CHARACTERISTIC
/begin CHARACTERISTIC mALPMNSM "-" VALUE 0x00009010 REC_UWORD_C 0 COMP_0031 0 255.99609375 /begin FUNCTION_LIST KF7-313C.1[36] KF7-313C.4[3] KF7-313C.5[3] /end FUNCTION_LIST /end CHARACTERISTIC
/begin CHARACTERISTIC mALPMXD "ALPHA upper limit value (When it slows down.)" VALUE 0x0000826D REC_UBYTE_C 0 COMP_0027 0 255 /begin FUNCTION_LIST KF7-313C.1[36] /end FUNCTION_LIST /end CHARACTERISTIC
/begin CHARACTERISTIC mALPMXSM "-" VALUE 0x00009012 REC_UWORD_C 0 COMP_0031 0 255.99609375 /begin FUNCTION_LIST KF7-313C.1[36] KF7-313C.4[3] KF7-313C.5[3] /end FUNCTION_LIST /end CHARACTERISTIC
/begin CHARACTERISTIC mARRATE "LSOSQ/HSOSQ release rate" VALUE 0x00009076 REC_UWORD_C 0 COMP_0173 0 4095.9375 /begin FUNCTION_LIST KF7-313C.1[36] /end FUNCTION_LIST /end CHARACTERISTIC
/begin CHARACTERISTIC mATGDLY "AT gear position judgement delay" VALUE 0x00008290 REC_UBYTE_C 0 COMP_0008 0 25500 /begin FUNCTION_LIST KF7-312.6[34] /end FUNCTION_LIST /end CHARACTERISTIC
/begin CHARACTERISTIC mB0QA1 "Coefficient b0 (Qa region #1)" VALUE 0x00008ED2 REC_SWORD_C 0 COMP_0336_S -3.2768 3.2767 /begin FUNCTION_LIST KF7-313C.1[36] /end FUNCTION_LIST /end CHARACTERISTIC
/begin CHARACTERISTIC mB0QA12 "Coefficient b0 (Qa region #1) (bank 2)" VALUE 0x00008ED4 REC_SWORD_C 0 COMP_0336_S -3.2768 3.2767 /begin FUNCTION_LIST KF7-313C.1[36] /end FUNCTION_LIST /end CHARACTERISTIC
/begin CHARACTERISTIC mB0QA2 "Coefficient b0 (Qa region #2)" VALUE 0x00008ED6 REC_SWORD_C 0 COMP_0336_S -3.2768 3.2767 /begin FUNCTION_LIST KF7-313C.1[36] /end FUNCTION_LIST /end CHARACTERISTIC
/begin CHARACTERISTIC mB0QA3 "Coefficient b0 (Qa region #3)" VALUE 0x00008EDA REC_SWORD_C 0 COMP_0336_S -3.2768 3.2767 /begin FUNCTION_LIST KF7-313C.1[36] /end FUNCTION_LIST /end CHARACTERISTIC
/begin CHARACTERISTIC mB1QA1 "Coefficient b1 (Qa region #1)" VALUE 0x00008EDE REC_SWORD_C 0 COMP_0336_S -3.2768 3.2767 /begin FUNCTION_LIST KF7-313C.1[36] /end FUNCTION_LIST /end CHARACTERISTIC
/begin CHARACTERISTIC mB1QA12 "Coefficient b1 (Qa region #1) (bank 2)" VALUE 0x00008EE0 REC_SWORD_C 0 COMP_0336_S -3.2768 3.2767 /begin FUNCTION_LIST KF7-313C.1[36] /end FUNCTION_LIST /end CHARACTERISTIC
/begin CHARACTERISTIC mB1QA2 "Coefficient b1 (Qa region #2)" VALUE 0x00008EE2 REC_SWORD_C 0 COMP_0336_S -3.2768 3.2767 /begin FUNCTION_LIST KF7-313C.1[36] /end FUNCTION_LIST /end CHARACTERISTIC
/begin CHARACTERISTIC mB1QA3 "Coefficient b1 (Qa region #3)" VALUE 0x00008EE6 REC_SWORD_C 0 COMP_0336_S -3.2768 3.2767 /begin FUNCTION_LIST KF7-313C.1[36] /end FUNCTION_LIST /end CHARACTERISTIC
/begin CHARACTERISTIC mCALPCNT "ALPHA center acquisition number of times" VALUE 0x00009096 REC_UWORD_C 0 COMP_0016 0 65535 /begin FUNCTION_LIST KF7-313C.1[36] /end FUNCTION_LIST /end CHARACTERISTIC
/begin CHARACTERISTIC mCALPDLY "Start delay" VALUE 0x00009098 REC_UWORD_C 0 COMP_0165_S 0 655.35 /begin FUNCTION_LIST KF7-313C.1[36] /end FUNCTION_LIST /end CHARACTERISTIC
/begin CHARACTERISTIC mCALPTGT "At the time of the initialization, Target A/F" VALUE 0x0000909A REC_UWORD_C 0 COMP_0453 0 131.07 /begin FUNCTION_LIST KF7-313C.1[36] /end FUNCTION_LIST /end CHARACTERISTIC
/begin CHARACTERISTIC mCAQEND "A crank angle until the intake end" VALUE 0x000082DF REC_UBYTE_C 0 COMP_0055 0 1020 /begin FUNCTION_LIST KF7-312.5A[4] KF7-312.5C[1] /end FUNCTION_LIST /end CHARACTERISTIC
/begin CHARACTERISTIC mCATSLSFT "At the time of the control for the catalyst diagnosis, lambda point compensation value" VALUE 0x00008EEC REC_SWORD_C 0 COMP_0341_S -65.536 65.534 /begin FUNCTION_LIST KF7-313C.1[36] /end FUNCTION_LIST /end CHARACTERISTIC
/begin CHARACTERISTIC mCFCD2MMD "After the M mode down-shift torque rise, cut-in delay (half-cylinder)" VALUE 0x00008310 REC_UBYTE_C 0 COMP_0014 0 2550 /begin FUNCTION_LIST KF7-312.6[34] /end FUNCTION_LIST /end CHARACTERISTIC
/begin CHARACTERISTIC mCFCDMMD "After the M mode down-shift torque rise, cut-in delay" VALUE 0x00008311 REC_UBYTE_C 0 COMP_0014 0 2550 /begin FUNCTION_LIST KF7-312.6[34] /end FUNCTION_LIST /end CHARACTERISTIC
/begin CHARACTERISTIC mCFCMAX "At the time of the start, fuel cut condition TVO upper limit" VALUE 0x000090A6 REC_UWORD_C 0 COMP_0061 0 327675 /begin FUNCTION_LIST KF7-312.1C[N] /end FUNCTION_LIST /end CHARACTERISTIC
/begin CHARACTERISTIC mCFCMIN "At the time of the start, fuel cut condition TVO lower limit" VALUE 0x000090A8 REC_UWORD_C 0 COMP_0061 0 327675 /begin FUNCTION_LIST KF7-312.1C[N] /end FUNCTION_LIST /end CHARACTERISTIC
/begin CHARACTERISTIC mCKST "At the time of the target air-fuel ratio start, basic value" VALUE 0x0000831F REC_UBYTE_C 0 COMP_0066 0 3.984375 /begin FUNCTION_LIST KF7-312.2A[16] R301.9.Target_Equivalent_Ratio_1_0_2 /end FUNCTION_LIST /end CHARACTERISTIC
/begin CHARACTERISTIC mCLCLMP "At the time of the low temperature start, CLOSE control start coolant temperature" VALUE 0x00008324 REC_UBYTE_C 0 COMP_0035 -50 205 /begin FUNCTION_LIST KF7-313C.1[36] KF7-500.39[5] /end FUNCTION_LIST /end CHARACTERISTIC
/begin CHARACTERISTIC mCLPCD "Slowdown lean clamp release delay" VALUE 0x0000832B REC_UBYTE_C 0 COMP_0071 0 255 /begin FUNCTION_LIST KF7-313C.1[36] /end FUNCTION_LIST /end CHARACTERISTIC
/begin CHARACTERISTIC mCLPD "Slowdown lean clamp delay" VALUE 0x0000832C REC_UBYTE_C 0 COMP_0071 0 255 /begin FUNCTION_LIST KF7-313C.1[36] /end FUNCTION_LIST /end CHARACTERISTIC
/begin CHARACTERISTIC mCORAMBMN "Atomospheric pressure ratio minimum value" VALUE 0x00008355 REC_UBYTE_C 0 COMP_0063 0 0.99609375 /begin FUNCTION_LIST KF7-312.1C[N] /end FUNCTION_LIST /end CHARACTERISTIC
/begin CHARACTERISTIC mCORTANMN "Intake air temperature ratio minimum value" VALUE 0x00008356 REC_UBYTE_C 0 COMP_0376_S 0.5 1.49609375 /begin FUNCTION_LIST KF7-312.1C[N] /end FUNCTION_LIST /end CHARACTERISTIC
/begin CHARACTERISTIC mCORTANMX "Intake air temperature ratio maximum value" VALUE 0x00008357 REC_UBYTE_C 0 COMP_0376_S 0.5 1.49609375 /begin FUNCTION_LIST KF7-312.1C[N] /end FUNCTION_LIST /end CHARACTERISTIC
/begin CHARACTERISTIC mCSLCID "Fuel cut rotation without a delay" VALUE 0x00008376 REC_UBYTE_C 0 COMP_0020 0 12750 /begin FUNCTION_LIST KF7-312.6[34] R301.5.FuelCut_1_2_2 /end FUNCTION_LIST /end CHARACTERISTIC
/begin CHARACTERISTIC mDAPOF1 "At the time of the KAP cut, damper/100mS" VALUE 0x000083AD REC_UBYTE_C 0 COMP_0079 0 24.90075 /begin FUNCTION_LIST KF7-312.2A[16] R301.9.Target_Equivalent_Ratio_1_0_2 /end FUNCTION_LIST /end CHARACTERISTIC
/begin CHARACTERISTIC mDAPOF2 "At the time of the KAP cut, damper/100mS" VALUE 0x000083AE REC_UBYTE_C 0 COMP_0079 0 24.90075 /begin FUNCTION_LIST KF7-312.2A[16] R301.9.Target_Equivalent_Ratio_1_0_2 /end FUNCTION_LIST /end CHARACTERISTIC
/begin CHARACTERISTIC mDAPON "At the time of the KAP addition, damper/100mS" VALUE 0x000083B1 REC_UBYTE_C 0 COMP_0079 0 24.90075 /begin FUNCTION_LIST KF7-312.2A[16] R301.9.Target_Equivalent_Ratio_1_0_2 /end FUNCTION_LIST /end CHARACTERISTIC
/begin CHARACTERISTIC mDEADTM1 "A waste time (Qa region #1) without an interpolation" VALUE 0x000083F4 REC_UBYTE_C 0 COMP_0388_S 0 255 /begin FUNCTION_LIST KF7-313C.1[36] /end FUNCTION_LIST /end CHARACTERISTIC
/begin CHARACTERISTIC mDEADTM2 "A waste time (Qa region #2) without an interpolation" VALUE 0x000083F6 REC_UBYTE_C 0 COMP_0388_S 0 255 /begin FUNCTION_LIST KF7-313C.1[36] /end FUNCTION_LIST /end CHARACTERISTIC
/begin CHARACTERISTIC mDEADTM3 "A waste time (Qa region #3) without an interpolation" VALUE 0x000083F8 REC_UBYTE_C 0 COMP_0388_S 0 255 /begin FUNCTION_LIST KF7-313C.1[36] /end FUNCTION_LIST /end CHARACTERISTIC
/begin CHARACTERISTIC mDKHOT "KHOT maximum change width" VALUE 0x00009104 REC_UWORD_C 0 COMP_0100 0 3.999941832 /begin FUNCTION_LIST KF7-312.3A[27] R301.7.KHOT_1_0_2 /end FUNCTION_LIST /end CHARACTERISTIC
/begin CHARACTERISTIC mDKSTB "KSTB loss in weight rate" VALUE 0x00009106 REC_UWORD_C 0 COMP_0099 0 3.999941832 /begin FUNCTION_LIST KF7-312.3A[27] /end FUNCTION_LIST /end CHARACTERISTIC
/begin CHARACTERISTIC mDKTST "Time compensation rate decrease rate" VALUE 0x00009108 REC_UWORD_C 0 COMP_0101 0 0.999985458 /begin FUNCTION_LIST KF7-312.1C[N] /end FUNCTION_LIST /end CHARACTERISTIC
/begin CHARACTERISTIC mDLOPEN "After the CLOSE control switchover start, time" VALUE 0x00008467 REC_UBYTE_C 0 COMP_0049 0 255 /begin FUNCTION_LIST KF7-313C.1[36] /end FUNCTION_LIST /end CHARACTERISTIC
/begin CHARACTERISTIC mDLTNEGA "POS/REF renewal speed compensation coefficient" VALUE 0x0000911C REC_UWORD_C 0 COMP_0396_S 0 0.001249975269 /begin FUNCTION_LIST KF7-312.1C[N] /end FUNCTION_LIST /end CHARACTERISTIC
/begin CHARACTERISTIC mDLYKAP "The exhaust the second air increase delay" VALUE 0x00008480 REC_UBYTE_C 0 COMP_0008 0 25500 /begin FUNCTION_LIST KF7-312.3A[27] /end FUNCTION_LIST /end CHARACTERISTIC
/begin CHARACTERISTIC mDMKMR1 "At the time of the lambda control _ switchover, damper" VALUE 0x00008487 REC_UBYTE_C 0 COMP_0106 0 0.12444 /begin FUNCTION_LIST KF7-312.2A[16] R301.9.Target_Equivalent_Ratio_1_0_2 /end FUNCTION_LIST /end CHARACTERISTIC
/begin CHARACTERISTIC mDMKMR2 "When increase moves, damper" VALUE 0x00008488 REC_UBYTE_C 0 COMP_0106 0 0.12444 /begin FUNCTION_LIST KF7-312.2A[16] R301.9.Target_Equivalent_Ratio_1_0_2 /end FUNCTION_LIST /end CHARACTERISTIC
/begin CHARACTERISTIC mDSLVSP "D range stall continuous judgement vehicle speed" VALUE 0x000084C6 REC_UBYTE_C 0 COMP_0007 0 510 /begin FUNCTION_LIST KF7-312.6[34] /end FUNCTION_LIST /end CHARACTERISTIC
/begin CHARACTERISTIC mDSTLFC "At the time of the D range stall continuance, fuel cut rotation" VALUE 0x000084CD REC_UBYTE_C 0 COMP_0000 0 6375 /begin FUNCTION_LIST KF7-312.6[34] /end FUNCTION_LIST /end CHARACTERISTIC
/begin CHARACTERISTIC mDSTLNH "D range stall continuous judgement engine speed High" VALUE 0x000084CE REC_UBYTE_C 0 COMP_0000 0 6375 /begin FUNCTION_LIST KF7-312.6[34] /end FUNCTION_LIST /end CHARACTERISTIC
/begin CHARACTERISTIC mDSTLNL "D range stall continuous judgement engine speed Low" VALUE 0x000084CF REC_UBYTE_C 0 COMP_0000 0 6375 /begin FUNCTION_LIST KF7-312.6[34] /end FUNCTION_LIST /end CHARACTERISTIC
/begin CHARACTERISTIC mDSTLRC "At the time of the D range stall continuance, fuel recover rotation" VALUE 0x000084D0 REC_UBYTE_C 0 COMP_0000 0 6375 /begin FUNCTION_LIST KF7-312.6[34] /end FUNCTION_LIST /end CHARACTERISTIC
/begin CHARACTERISTIC mDSTLTM "D range stall continuous judgement time" VALUE 0x00009148 REC_UWORD_C 0 COMP_0014 0 655350 /begin FUNCTION_LIST KF7-312.6[34] /end FUNCTION_LIST /end CHARACTERISTIC
/begin CHARACTERISTIC mDSTLUP "D range stall continuous judgement timer increase coefficient" VALUE 0x000084D1 REC_UBYTE_C 0 COMP_0120 0 255 /begin FUNCTION_LIST KF7-312.6[34] /end FUNCTION_LIST /end CHARACTERISTIC
/begin CHARACTERISTIC mDTFAD1 "TFBYA change rate limiter" VALUE 0x000084D9 REC_UBYTE_C 0 COMP_0108 0 0.99609375 /begin FUNCTION_LIST KF7-312.2A[16] R301.9.Target_Equivalent_Ratio_1_0_2 /end FUNCTION_LIST /end CHARACTERISTIC
/begin CHARACTERISTIC mDTFAD2 "TFBYA change rate limiter" VALUE 0x000084DA REC_UBYTE_C 0 COMP_0108 0 0.99609375 /begin FUNCTION_LIST KF7-312.2A[16] R301.9.Target_Equivalent_Ratio_1_0_2 /end FUNCTION_LIST /end CHARACTERISTIC
/begin CHARACTERISTIC mDTFCDN "An urgent slowdown tense F/C rotation rise fee" VALUE 0x000084DB REC_UBYTE_C 0 COMP_0000 0 6375 /begin FUNCTION_LIST KF7-312.6[34] KF7-385.1[32] /end FUNCTION_LIST /end CHARACTERISTIC
/begin CHARACTERISTIC mDTS "TS voltage compensation coefficient" VALUE 0x000084E9 REC_UBYTE_C 0 COMP_0126 0 0.249023565 /begin FUNCTION_LIST KF7-312.1C[N] /end FUNCTION_LIST /end CHARACTERISTIC
/begin CHARACTERISTIC mENLCNT "Continuous NO. Load condition formation counter value" VALUE 0x00009174 REC_UWORD_C 0 COMP_0016 0 65535 /begin FUNCTION_LIST KF7-312.6[34] /end FUNCTION_LIST /end CHARACTERISTIC
/begin CHARACTERISTIC mERACP "Interrupt injection switchover reference compensation rate" VALUE 0x00008551 REC_UBYTE_C 0 COMP_0186 0 3.984375 /begin FUNCTION_LIST KF7-312.4C[4] /end FUNCTION_LIST /end CHARACTERISTIC
/begin CHARACTERISTIC mEXNFC "Continuous NO. Load cut-in speed" VALUE 0x000085CF REC_UBYTE_C 0 COMP_0020 0 12750 /begin FUNCTION_LIST KF7-312.6[34] /end FUNCTION_LIST /end CHARACTERISTIC
/begin CHARACTERISTIC mEXNRC "Continuous NO. Load cut recover speed" VALUE 0x000085D0 REC_UBYTE_C 0 COMP_0020 0 12750 /begin FUNCTION_LIST KF7-312.6[34] /end FUNCTION_LIST /end CHARACTERISTIC
/begin CHARACTERISTIC mFCTPO "At the time of the fuel cut, TPFBAO decrease rate" VALUE 0x000085F1 REC_UBYTE_C 0 COMP_0063 0 0.99609375 /begin FUNCTION_LIST KF7-312.4C[4] /end FUNCTION_LIST /end CHARACTERISTIC
/begin CHARACTERISTIC mFCVSP "Fuel cut judgement vehicle speed" VALUE 0x000085F4 REC_UBYTE_C 0 COMP_0007 0 510 /begin FUNCTION_LIST KF7-312.6[34] /end FUNCTION_LIST /end CHARACTERISTIC
/begin CHARACTERISTIC mFD3VSP "D3 coast L/U éû lower limit vehicle speed" VALUE 0x000085F7 REC_UBYTE_C 0 COMP_0007 0 510 /begin FUNCTION_LIST KF7-312.6[34] /end FUNCTION_LIST /end CHARACTERISTIC
/begin CHARACTERISTIC mFINANG2 "Injection completion angle" VALUE 0x00008603 REC_UBYTE_C 0 COMP_0190 0 510 /begin FUNCTION_LIST KF7-311.1A[21] /end FUNCTION_LIST /end CHARACTERISTIC
/begin CHARACTERISTIC mFRMKN "FIR, minus KTW addition judgement speed" VALUE 0x00008630 REC_UBYTE_C 0 COMP_0000 0 6375 /begin FUNCTION_LIST KF7-312.3A[27] KF7-320A.12[N] /end FUNCTION_LIST /end CHARACTERISTIC
/begin CHARACTERISTIC mFRVSP1 "Fuel recover judgement vehicle speed (at the time of A/C off)" VALUE 0x00008635 REC_UBYTE_C 0 COMP_0007 0 510 /begin FUNCTION_LIST KF7-312.6[34] KF7-385.1[32] /end FUNCTION_LIST /end CHARACTERISTIC
/begin CHARACTERISTIC mFVKTRM "KTRM variable (ROM flag)" VALUE 0x00008652 REC_UBYTE_C 0 COMP_0068 0 255 /begin FUNCTION_LIST KF7-313C.1[36] KF7-314.1F[1] KF7-460.1[6] /end FUNCTION_LIST /end CHARACTERISTIC
/begin CHARACTERISTIC mFVTFA0 "TFBYA variable (ROM flag)" VALUE 0x00008653 REC_UBYTE_C 0 COMP_0068 0 255 /begin FUNCTION_LIST KF7-313C.1[36] KF7-314.1F[1] KF7-460.1[6] /end FUNCTION_LIST /end CHARACTERISTIC
/begin CHARACTERISTIC mGLMT "IDLHOS increase side limiter" VALUE 0x0000866C REC_UBYTE_C 0 COMP_0186 0 3.984375 /begin FUNCTION_LIST KF7-312.1C[N] /end FUNCTION_LIST /end CHARACTERISTIC
/begin CHARACTERISTIC mGZN0 "GZTP renewal judgement speed delay" VALUE 0x00008684 REC_UBYTE_C 0 COMP_0071 0 255 /begin FUNCTION_LIST KF7-312.4C[4] /end FUNCTION_LIST /end CHARACTERISTIC
/begin CHARACTERISTIC mGZQH0 "GZTP renewal judgement flow-quantity" VALUE 0x00008685 REC_UBYTE_C 0 COMP_0063 0 0.99609375 /begin FUNCTION_LIST KF7-312.4C[4] /end FUNCTION_LIST /end CHARACTERISTIC
/begin CHARACTERISTIC mHOSA1 "Non-straight line region compensation clause A1" VALUE 0x00009238 REC_UWORD_C 0 COMP_0417_S 0 3.999928725 /begin FUNCTION_LIST KF7-312.1C[N] KF7-312.5A[4] KF7-312.5C[1] /end FUNCTION_LIST /end CHARACTERISTIC
/begin CHARACTERISTIC mHOSA2 "Non-straight line region compensation clause A2" VALUE 0x0000923A REC_UWORD_C 0 COMP_0417_S 0 3.999928725 /begin FUNCTION_LIST KF7-312.1C[N] KF7-312.5A[4] KF7-312.5C[1] /end FUNCTION_LIST /end CHARACTERISTIC
/begin CHARACTERISTIC mHOSB1 "Non-straight line region compensation clause B1" VALUE 0x0000923C REC_UWORD_C 0 COMP_0418_S 0 3999.93894846 /begin FUNCTION_LIST KF7-312.1C[N] KF7-312.5A[4] KF7-312.5C[1] /end FUNCTION_LIST /end CHARACTERISTIC
/begin CHARACTERISTIC mHOSB2 "Non-straight line region compensation clause B2" VALUE 0x0000923E REC_UWORD_C 0 COMP_0418_S 0 3999.93894846 /begin FUNCTION_LIST KF7-312.1C[N] KF7-312.5A[4] KF7-312.5C[1] /end FUNCTION_LIST /end CHARACTERISTIC
/begin CHARACTERISTIC mHOSCINT "HOSCMAX learning : learning region HOSCMAX initial value" VALUE 0x000096AC REC_SLONG_C 0 COMP_0094_S -21474836.48 21474836.47 /begin FUNCTION_LIST KF7-313C.1[36] KF7-313C.5[3] KF7-500.21[19] /end FUNCTION_LIST /end CHARACTERISTIC
/begin CHARACTERISTIC mHOSCINT2 "HOSCMAX learning : learning region HOSCMAX initial value (bank 2)" VALUE 0x000096B0 REC_SLONG_C 0 COMP_0094_S -21474836.48 21474836.47 /begin FUNCTION_LIST KF7-313C.1[36] KF7-313C.5[3] KF7-500.21[19] /end FUNCTION_LIST /end CHARACTERISTIC
/begin CHARACTERISTIC mHYSKHT "A high coolant temperature increase judgement coolant temperature condition hysteresis" VALUE 0x000086BA REC_UBYTE_C 0 COMP_0003 0 255 /begin FUNCTION_LIST KF7-312.3A[27] R301.7.KHOT_1_0_2 /end FUNCTION_LIST /end CHARACTERISTIC
/begin CHARACTERISTIC mICLTOP "At the time of OPEN/CLOSE, I-gain change rate" VALUE 0x000086E2 REC_UBYTE_C 0 COMP_0031 0 0.99609375 /begin FUNCTION_LIST KF7-313C.1[36] /end FUNCTION_LIST /end CHARACTERISTIC
/begin CHARACTERISTIC mINJTST "A sequential fuel injection timing at the time of the start" VALUE 0x00008732 REC_UBYTE_C 0 COMP_0055 0 1020 /begin FUNCTION_LIST KF7-311.1A[21] R301.10.TITM_1_0_2 /end FUNCTION_LIST /end CHARACTERISTIC
/begin CHARACTERISTIC mINTWCP "At the time of the CLOSE control start judgement start, coolant temperature" VALUE 0x0000873E REC_UBYTE_C 0 COMP_0035 -50 205 /begin FUNCTION_LIST KF7-313C.1[36] KF7-500.39[5] /end FUNCTION_LIST /end CHARACTERISTIC
/begin CHARACTERISTIC mITRTFL "After injection timing changes are increased, delay" VALUE 0x00008777 REC_UBYTE_C 0 COMP_0014 0 2550 /begin FUNCTION_LIST KF7-311.1A[21] R301.10.TITM_1_0_2 /end FUNCTION_LIST /end CHARACTERISTIC
/begin CHARACTERISTIC mITRTM "After an injection timing change starts, delay" VALUE 0x00008778 REC_UBYTE_C 0 COMP_0049 0 255 /begin FUNCTION_LIST KF7-311.1A[21] R301.10.TITM_1_0_2 /end FUNCTION_LIST /end CHARACTERISTIC
/begin CHARACTERISTIC mITRTW "Injection timing change permission coolant temperature" VALUE 0x00008779 REC_UBYTE_C 0 COMP_0035 -50 205 /begin FUNCTION_LIST KF7-311.1A[21] R301.10.TITM_1_0_2 /end FUNCTION_LIST /end CHARACTERISTIC
/begin CHARACTERISTIC mKAVRO2S "RrO2 sensor weighted average coefficient" VALUE 0x00008783 REC_UBYTE_C 0 COMP_0045 0 1.9921875 /begin FUNCTION_LIST KF7-313C.1[36] /end FUNCTION_LIST /end CHARACTERISTIC
/begin CHARACTERISTIC mKHOTMNE "High coolant temperature increase judgement speed" VALUE 0x0000879C REC_UBYTE_C 0 COMP_0000 0 6375 /begin FUNCTION_LIST KF7-312.3A[27] R301.7.KHOT_1_0_2 /end FUNCTION_LIST /end CHARACTERISTIC
/begin CHARACTERISTIC mKHOTTW "High coolant temperature increase judgement value" VALUE 0x0000879F REC_UBYTE_C 0 COMP_0035 -50 205 /begin FUNCTION_LIST KF7-312.3A[27] R301.7.KHOT_1_0_2 /end FUNCTION_LIST /end CHARACTERISTIC
/begin CHARACTERISTIC mKHOTWN "A high coolant temperature increase judgement coolant temperature" VALUE 0x000087A0 REC_UBYTE_C 0 COMP_0035 -50 205 /begin FUNCTION_LIST KF7-312.3A[27] R301.7.KHOT_1_0_2 /end FUNCTION_LIST /end CHARACTERISTIC
/begin CHARACTERISTIC mKMCT31 "A high exhaust temperature stage delay 1" VALUE 0x000087B0 REC_UBYTE_C 0 COMP_0215 0 51 /begin FUNCTION_LIST KF7-312.2A[16] R301.9.Target_Equivalent_Ratio_1_0_2 /end FUNCTION_LIST /end CHARACTERISTIC
/begin CHARACTERISTIC mKMCT32 "A high exhaust temperature stage delay 2" VALUE 0x000087B1 REC_UBYTE_C 0 COMP_0215 0 51 /begin FUNCTION_LIST KF7-312.2A[16] R301.9.Target_Equivalent_Ratio_1_0_2 /end FUNCTION_LIST /end CHARACTERISTIC
/begin CHARACTERISTIC mKMCT41 "A low rotation stage delay 1" VALUE 0x000087B2 REC_UBYTE_C 0 COMP_0215 0 51 /begin FUNCTION_LIST KF7-312.2A[16] R301.9.Target_Equivalent_Ratio_1_0_2 /end FUNCTION_LIST /end CHARACTERISTIC
/begin CHARACTERISTIC mKMCT42 "A low rotation stage delay 2" VALUE 0x000087B3 REC_UBYTE_C 0 COMP_0215 0 51 /begin FUNCTION_LIST KF7-312.2A[16] R301.9.Target_Equivalent_Ratio_1_0_2 /end FUNCTION_LIST /end CHARACTERISTIC
/begin CHARACTERISTIC mKMRCT1 "All the delay stage delays" VALUE 0x000087C5 REC_UBYTE_C 0 COMP_0215 0 51 /begin FUNCTION_LIST KF7-312.2A[16] R301.9.Target_Equivalent_Ratio_1_0_2 /end FUNCTION_LIST /end CHARACTERISTIC
/begin CHARACTERISTIC mKMRCT2 "A full increase stage delay" VALUE 0x000087C6 REC_UBYTE_C 0 COMP_0215 0 51 /begin FUNCTION_LIST KF7-312.2A[16] R301.9.Target_Equivalent_Ratio_1_0_2 /end FUNCTION_LIST /end CHARACTERISTIC
/begin CHARACTERISTIC mKMRCTS1 "At the time of the KMR stage switchover, delay" VALUE 0x000087C7 REC_UBYTE_C 0 COMP_0215 0 51 /begin FUNCTION_LIST KF7-312.2A[16] R301.9.Target_Equivalent_Ratio_1_0_2 /end FUNCTION_LIST /end CHARACTERISTIC
/begin CHARACTERISTIC mKMRDNH "High exhaust temperature stage speed" VALUE 0x000087CC REC_UBYTE_C 0 COMP_0020 0 12750 /begin FUNCTION_LIST KF7-312.2A[16] R301.9.Target_Equivalent_Ratio_1_0_2 /end FUNCTION_LIST /end CHARACTERISTIC
/begin CHARACTERISTIC mKMRDNL "Region speed without a delay" VALUE 0x000087CD REC_UBYTE_C 0 COMP_0020 0 12750 /begin FUNCTION_LIST KF7-312.2A[16] R301.9.Target_Equivalent_Ratio_1_0_2 /end FUNCTION_LIST /end CHARACTERISTIC
/begin CHARACTERISTIC mKMRDTO "Urgent acceleration judgement delta-TVO" VALUE 0x000087CE REC_UBYTE_C 0 COMP_0002 0 89.25 /begin FUNCTION_LIST KF7-312.2A[16] R301.9.Target_Equivalent_Ratio_1_0_2 /end FUNCTION_LIST /end CHARACTERISTIC
/begin CHARACTERISTIC mKMRHT "At the time of the start, TFBYA0 maintenance time" VALUE 0x000087CF REC_UBYTE_C 0 COMP_0008 0 25500 /begin FUNCTION_LIST KF7-312.2A[16] R301.9.Target_Equivalent_Ratio_1_0_2 /end FUNCTION_LIST /end CHARACTERISTIC
/begin CHARACTERISTIC mKMRMAX "High coolant temperature increase upper limit value" VALUE 0x00009332 REC_UWORD_C 0 COMP_0217 0 3.999941832 /begin FUNCTION_LIST KF7-312.3A[27] R301.7.KHOT_1_0_2 /end FUNCTION_LIST /end CHARACTERISTIC
/begin CHARACTERISTIC mKMRNELL "KMR delay control lower limit speed" VALUE 0x000087D0 REC_UBYTE_C 0 COMP_0020 0 12750 /begin FUNCTION_LIST KF7-312.2A[16] R301.9.Target_Equivalent_Ratio_1_0_2 /end FUNCTION_LIST /end CHARACTERISTIC
/begin CHARACTERISTIC mKMRNELM "KMR delay control upper limit speed" VALUE 0x000087D1 REC_UBYTE_C 0 COMP_0020 0 12750 /begin FUNCTION_LIST KF7-312.2A[16] R301.9.Target_Equivalent_Ratio_1_0_2 /end FUNCTION_LIST /end CHARACTERISTIC
/begin CHARACTERISTIC mKMRSTP1 "At the time of the KMR stage switchover, maintenance value" VALUE 0x00009334 REC_UWORD_C 0 COMP_0217 0 3.999941832 /begin FUNCTION_LIST KF7-312.2A[16] /end FUNCTION_LIST /end CHARACTERISTIC
/begin CHARACTERISTIC mKNSTMIN "KNST lower limit value" VALUE 0x000087D7 REC_UBYTE_C 0 COMP_0032 0 0.99609375 /begin FUNCTION_LIST KF7-312.1C[N] /end FUNCTION_LIST /end CHARACTERISTIC
/begin CHARACTERISTIC mKSTBGN "An unburned advantage, increase adjustment value" VALUE 0x000087E1 REC_UBYTE_C 0 COMP_0045 0 1.9921875 /begin FUNCTION_LIST KF7-312.3A[27] /end FUNCTION_LIST /end CHARACTERISTIC
/begin CHARACTERISTIC mKTST1 "Initial injection pulse width maintenance time" VALUE 0x000087EF REC_UBYTE_C 0 COMP_0008 0 25500 /begin FUNCTION_LIST KF7-312.1C[N] /end FUNCTION_LIST /end CHARACTERISTIC
/begin CHARACTERISTIC mKUBZTW "An unburned advantage, compensation coolant temperature upper limit" VALUE 0x000087F0 REC_UBYTE_C 0 COMP_0035 -50 205 /begin FUNCTION_LIST KF7-312.3A[27] /end FUNCTION_LIST /end CHARACTERISTIC
/begin CHARACTERISTIC mLASNIA "Interrupt injection judgement delta-TP" VALUE 0x000087F7 REC_UBYTE_C 0 COMP_0001 0 31.875 /begin FUNCTION_LIST KF7-312.5C[1] /end FUNCTION_LIST /end CHARACTERISTIC
/begin CHARACTERISTIC mLCLMP "Slowdown lean clamp rate" VALUE 0x000087F8 REC_UBYTE_C 0 COMP_0027 0 255 /begin FUNCTION_LIST KF7-313C.1[36] /end FUNCTION_LIST /end CHARACTERISTIC
/begin CHARACTERISTIC mLCLMP2 "Slowdown lean clamp rate" VALUE 0x000087F9 REC_UBYTE_C 0 COMP_0027 0 255 /begin FUNCTION_LIST KF7-313C.1[36] /end FUNCTION_LIST /end CHARACTERISTIC
/begin CHARACTERISTIC mLCLPN1 "Slowdown lean clamp judgement rotation" VALUE 0x000087FA REC_UBYTE_C 0 COMP_0006 0 3187.5 /begin FUNCTION_LIST KF7-313C.1[36] /end FUNCTION_LIST /end CHARACTERISTIC
/begin CHARACTERISTIC mLCLPN2 "Slowdown lean clamp release rotation" VALUE 0x000087FB REC_UBYTE_C 0 COMP_0006 0 3187.5 /begin FUNCTION_LIST KF7-313C.1[36] /end FUNCTION_LIST /end CHARACTERISTIC
/begin CHARACTERISTIC mLEANDLY "Lean side delay" VALUE 0x0000936C REC_UWORD_C 0 COMP_0165_S 0 655.35 /begin FUNCTION_LIST KF7-313C.1[36] /end FUNCTION_LIST /end CHARACTERISTIC
/begin CHARACTERISTIC mLEANG "At the time of the fuel cut, O2 magnification" VALUE 0x00008194 REC_SBYTE_C 0 COMP_0472 -2 1.984375 /begin FUNCTION_LIST KF7-313C.1[36] /end FUNCTION_LIST /end CHARACTERISTIC
/begin CHARACTERISTIC mLEANHYS "Lean side slice hysteresis" VALUE 0x0000936E REC_UWORD_C 0 COMP_0453 0 131.07 /begin FUNCTION_LIST KF7-313C.1[36] /end FUNCTION_LIST /end CHARACTERISTIC
/begin CHARACTERISTIC mLEANLMT "Lean side combustion limit A/F" VALUE 0x00009370 REC_UWORD_C 0 COMP_0453 0 131.07 /begin FUNCTION_LIST KF7-313C.1[36] /end FUNCTION_LIST /end CHARACTERISTIC
/begin CHARACTERISTIC mLKKGZR "At the time of the urgent slowdown, KGZR" VALUE 0x00008818 REC_UBYTE_C 0 COMP_0335_S -384 126 /begin FUNCTION_LIST KF7-312.4C[4] /end FUNCTION_LIST /end CHARACTERISTIC
/begin CHARACTERISTIC mLMCLSLW "Lambda control closed permission A/F lower limit" VALUE 0x0000937A REC_UWORD_C 0 COMP_0453 0 131.07 /begin FUNCTION_LIST KF7-313C.1[36] /end FUNCTION_LIST /end CHARACTERISTIC
/begin CHARACTERISTIC mLMCLSMX "Lambda control clamp time upper limit value" VALUE 0x0000881A REC_UBYTE_C 0 COMP_0071 0 255 /begin FUNCTION_LIST KF7-313C.1[36] /end FUNCTION_LIST /end CHARACTERISTIC
/begin CHARACTERISTIC mLMCLSUP "Lambda control closed permission A/F upper limit" VALUE 0x0000937C REC_UWORD_C 0 COMP_0453 0 131.07 /begin FUNCTION_LIST KF7-313C.1[36] /end FUNCTION_LIST /end CHARACTERISTIC
/begin CHARACTERISTIC mLMDPMD "CLOSE control compulsory start delay" VALUE 0x0000881B REC_UBYTE_C 0 COMP_0008 0 25500 /begin FUNCTION_LIST KF7-313C.1[36] /end FUNCTION_LIST /end CHARACTERISTIC
/begin CHARACTERISTIC mLOCKJC "At the time of non-lockup, JECS cut lower limit speed" VALUE 0x00008823 REC_UBYTE_C 0 COMP_0000 0 6375 /begin FUNCTION_LIST KF7-312.6[34] /end FUNCTION_LIST /end CHARACTERISTIC
/begin CHARACTERISTIC mLOLMT "Target A/F lower limit value" VALUE 0x00009384 REC_UWORD_C 0 COMP_0453 0 131.07 /begin FUNCTION_LIST KF7-313C.1[36] /end FUNCTION_LIST /end CHARACTERISTIC
/begin CHARACTERISTIC mLRCRT "Lean/rich criteria" VALUE 0x00009388 REC_UWORD_C 0 COMP_0453 0 131.07 /begin FUNCTION_LIST KF7-313C.1[36] R904.1.Gst_on_can_1_0_1 /end FUNCTION_LIST /end CHARACTERISTIC
/begin CHARACTERISTIC mLTGABF "TARGET A/F LEAN SET" VALUE 0x00009394 REC_UWORD_C 0 COMP_0453 0 131.07 /begin FUNCTION_LIST KF7-313C.1[36] /end FUNCTION_LIST /end CHARACTERISTIC
/begin CHARACTERISTIC mLUOFFN "A difference in lockup release judgement rotation" VALUE 0x00008834 REC_UBYTE_C 0 COMP_0443 0 255 /begin FUNCTION_LIST KF7-312.6[34] /end FUNCTION_LIST /end CHARACTERISTIC
/begin CHARACTERISTIC mMFHDUMP "Weighted average coefficient" VALUE 0x00008844 REC_UBYTE_C 0 COMP_0252 0.00390625 1 /begin FUNCTION_LIST KF7-312.4A[6] KF7-312.4C[4] /end FUNCTION_LIST /end CHARACTERISTIC
/begin CHARACTERISTIC mMKCNG "The amount of a change in a minus KTW section compensation rate" VALUE 0x00008859 REC_UBYTE_C 0 COMP_0108 0 0.99609375 /begin FUNCTION_LIST KF7-312.3A[27] /end FUNCTION_LIST /end CHARACTERISTIC
/begin CHARACTERISTIC mMKIDL "At the time of the minus KTW idle, compensation value" VALUE 0x0000885B REC_UBYTE_C 0 COMP_0032 0 0.99609375 /begin FUNCTION_LIST KF7-312.3A[27] /end FUNCTION_LIST /end CHARACTERISTIC
/begin CHARACTERISTIC mMKINJM "Injector magnification reciprocal number" VALUE 0x000093AC REC_UWORD_C 0 COMP_0217 0 3.999941832 /begin FUNCTION_LIST KF7-312.1C[N] /end FUNCTION_LIST /end CHARACTERISTIC
/begin CHARACTERISTIC mMKKAS "Minus KTW addition judgement KAS value" VALUE 0x0000885C REC_UBYTE_C 0 COMP_0066 0 3.984375 /begin FUNCTION_LIST KF7-312.3A[27] /end FUNCTION_LIST /end CHARACTERISTIC
/begin CHARACTERISTIC mMKLMAX "Minus KTW learning value reflection width upper limit" VALUE 0x00008EA1 REC_UBYTE_C 0 COMP_0027 0 255 /begin FUNCTION_LIST KF7-312.3A[27] /end FUNCTION_LIST /end CHARACTERISTIC
/begin CHARACTERISTIC mMKLMIN "Minus KTW learning value reflection width lower limit" VALUE 0x00008EA2 REC_UBYTE_C 0 COMP_0027 0 255 /begin FUNCTION_LIST KF7-312.3A[27] /end FUNCTION_LIST /end CHARACTERISTIC
/begin CHARACTERISTIC mMKTM "After minus KTW addition judgement ST/SW off, progress time" VALUE 0x0000885E REC_UBYTE_C 0 COMP_0049 0 255 /begin FUNCTION_LIST KF7-312.3A[27] /end FUNCTION_LIST /end CHARACTERISTIC
/begin CHARACTERISTIC mMKVAPO "Minus KTW TVO compensation judgement value" VALUE 0x00008860 REC_UBYTE_C 0 COMP_0002 0 89.25 /begin FUNCTION_LIST KF7-312.3A[27] /end FUNCTION_LIST /end CHARACTERISTIC
/begin CHARACTERISTIC mMNTTCL "Monitor clamp judgment time" VALUE 0x00008863 REC_UBYTE_C 0 COMP_0008 0 25500 /begin FUNCTION_LIST KF7-313C.1[36] KF7-500.20B[4] /end FUNCTION_LIST /end CHARACTERISTIC
/begin CHARACTERISTIC mNDCTTM "N- At the time of the >D select, fuel cut judgement time" VALUE 0x00008890 REC_UBYTE_C 0 COMP_0202 0 2550 /begin FUNCTION_LIST KF7-312.6[34] /end FUNCTION_LIST /end CHARACTERISTIC
/begin CHARACTERISTIC mNDCTTW "N- At the time of the >D select, fuel cut judgement coolant temperature" VALUE 0x00008891 REC_UBYTE_C 0 COMP_0035 -50 205 /begin FUNCTION_LIST KF7-312.6[34] /end FUNCTION_LIST /end CHARACTERISTIC
/begin CHARACTERISTIC mNDCUTN "N- At the time of the >D select, fuel cut rotation" VALUE 0x00008892 REC_UBYTE_C 0 COMP_0000 0 6375 /begin FUNCTION_LIST KF7-312.6[34] /end FUNCTION_LIST /end CHARACTERISTIC
/begin CHARACTERISTIC mNDCUTV "N- At the time of the >D select, fuel cut vehicle speed" VALUE 0x00008893 REC_UBYTE_C 0 COMP_0007 0 510 /begin FUNCTION_LIST KF7-312.6[34] /end FUNCTION_LIST /end CHARACTERISTIC
/begin CHARACTERISTIC mNDRCTM "N- At the time of the >D select, fuel recover judgement time" VALUE 0x00008896 REC_UBYTE_C 0 COMP_0202 0 2550 /begin FUNCTION_LIST KF7-312.6[34] /end FUNCTION_LIST /end CHARACTERISTIC
/begin CHARACTERISTIC mNDRECN "N- At the time of the >D select, fuel recover rotation" VALUE 0x00008897 REC_UBYTE_C 0 COMP_0000 0 6375 /begin FUNCTION_LIST KF7-312.6[34] /end FUNCTION_LIST /end CHARACTERISTIC
/begin CHARACTERISTIC mNEINJT "At the time of the start, fuel injection control switching speed" VALUE 0x000088A4 REC_UBYTE_C 0 COMP_0006 0 3187.5 /begin FUNCTION_LIST KF7-311.1A[21] R301.10.TITM_1_0_2 /end FUNCTION_LIST /end CHARACTERISTIC
/begin CHARACTERISTIC mNGTIME "At the time of NG, the necessary diagnosis number of times" VALUE 0x000088B4 REC_UBYTE_C 0 COMP_0016 0 255 /begin FUNCTION_LIST KF7-313C.1[36] /end FUNCTION_LIST /end CHARACTERISTIC
/begin CHARACTERISTIC mNJISOH "Idle autonomous running clamp judgement speed upper limit value" VALUE 0x000088BC REC_UBYTE_C 0 COMP_0006 0 3187.5 /begin FUNCTION_LIST KF7-313C.1[36] /end FUNCTION_LIST /end CHARACTERISTIC
/begin CHARACTERISTIC mNJISOL "Idle autonomous running clamp judgement speed lower limit value" VALUE 0x000088BD REC_UBYTE_C 0 COMP_0006 0 3187.5 /begin FUNCTION_LIST KF7-313C.1[36] /end FUNCTION_LIST /end CHARACTERISTIC
/begin CHARACTERISTIC mNLGAIN "Non-line shape gain É≈" VALUE 0x000088BE REC_UBYTE_C 0 COMP_0373 0 2.55 /begin FUNCTION_LIST KF7-313C.1[36] /end FUNCTION_LIST /end CHARACTERISTIC
/begin CHARACTERISTIC mNMAX0 "Vehicle speed 0 Km/h cut judgement speed" VALUE 0x000088C3 REC_UBYTE_C 0 COMP_0020 0 12750 /begin FUNCTION_LIST KF7-312.6[34] /end FUNCTION_LIST /end CHARACTERISTIC
/begin CHARACTERISTIC mNMAX2 "All cylinder high rotation cut judgement speed" VALUE 0x000093CA REC_UWORD_C 0 COMP_0006 0 819187.5 /begin FUNCTION_LIST KF7-312.6[34] R204.1.CanComm_1_9_2 /end FUNCTION_LIST /end CHARACTERISTIC
/begin CHARACTERISTIC mNMAX2R "At the time of the reverse, all cylinder high rotation cut judgement speed" VALUE 0x000093CC REC_UWORD_C 0 COMP_0006 0 819187.5 /begin FUNCTION_LIST KF7-312.6[34] /end FUNCTION_LIST /end CHARACTERISTIC
/begin CHARACTERISTIC mNMAXR2 "All cylinder recover speed" VALUE 0x000093CE REC_UWORD_C 0 COMP_0006 0 819187.5 /begin FUNCTION_LIST KF7-312.6[34] /end FUNCTION_LIST /end CHARACTERISTIC
/begin CHARACTERISTIC mNMAXRR "At the time of the reverse, all cylinder recover speed" VALUE 0x000093D0 REC_UWORD_C 0 COMP_0006 0 819187.5 /begin FUNCTION_LIST KF7-312.6[34] /end FUNCTION_LIST /end CHARACTERISTIC
/begin CHARACTERISTIC mNMXCLD "At the time of KT low oil temperature, all cylinder high rotation cut judgement speed" VALUE 0x000093D2 REC_UWORD_C 0 COMP_0006 0 819187.5 /begin FUNCTION_LIST KF7-312.6[34] /end FUNCTION_LIST /end CHARACTERISTIC
/begin CHARACTERISTIC mNMXRCD "At the time of KT low oil temperature, all cylinder recover judgement speed" VALUE 0x000093D4 REC_UWORD_C 0 COMP_0006 0 819187.5 /begin FUNCTION_LIST KF7-312.6[34] /end FUNCTION_LIST /end CHARACTERISTIC
/begin CHARACTERISTIC mNOVHFC "Fuel cut speed" VALUE 0x000088D2 REC_UBYTE_C 0 COMP_0000 0 6375 /begin FUNCTION_LIST KF7-312.6[34] /end FUNCTION_LIST /end CHARACTERISTIC
/begin CHARACTERISTIC mNRVCUT "High all vehicle speeds cut cylinder recover speed" VALUE 0x000088E2 REC_UBYTE_C 0 COMP_0000 0 6375 /begin FUNCTION_LIST KF7-312.6[34] R301.5.FuelCut_1_2_2 /end FUNCTION_LIST /end CHARACTERISTIC
/begin CHARACTERISTIC mNRVHYS "A high all vehicle speeds cut cylinder recover speed hysteresis" VALUE 0x000088E3 REC_UBYTE_C 0 COMP_0000 0 6375 /begin FUNCTION_LIST KF7-312.6[34] R301.5.FuelCut_1_2_2 /end FUNCTION_LIST /end CHARACTERISTIC
/begin CHARACTERISTIC mOFCHYS "Fuel cut recover hysteresis" VALUE 0x00008941 REC_UBYTE_C 0 COMP_0000 0 6375 /begin FUNCTION_LIST KF7-312.6[34] /end FUNCTION_LIST /end CHARACTERISTIC
/begin CHARACTERISTIC mOKLRCRT "Lean/rich OK criteria" VALUE 0x000093F8 REC_UWORD_C 0 COMP_0453 0 131.07 /begin FUNCTION_LIST KF7-313C.1[36] /end FUNCTION_LIST /end CHARACTERISTIC
/begin CHARACTERISTIC mOKRLCRT "Rich/lean OK criteria" VALUE 0x000093FA REC_UWORD_C 0 COMP_0453 0 131.07 /begin FUNCTION_LIST KF7-313C.1[36] /end FUNCTION_LIST /end CHARACTERISTIC
/begin CHARACTERISTIC mOKTIMES "At the time of OK, the necessary diagnosis number of times" VALUE 0x0000894F REC_UBYTE_C 0 COMP_0016 0 255 /begin FUNCTION_LIST KF7-313C.1[36] /end FUNCTION_LIST /end CHARACTERISTIC
/begin CHARACTERISTIC mOPKHYS "Reset judgement RrO2 sensor voltage change fee" VALUE 0x000093FC REC_UWORD_C 0 COMP_0061 0 327675 /begin FUNCTION_LIST KF7-313C.1[36] /end FUNCTION_LIST /end CHARACTERISTIC
/begin CHARACTERISTIC mORSTINT2 "Rich/lean judgement time" VALUE 0x00009402 REC_UWORD_C 0 COMP_0202 0 655350 /begin FUNCTION_LIST KF7-313C.1[36] /end FUNCTION_LIST /end CHARACTERISTIC
/begin CHARACTERISTIC mPAMBAFH "A/F sensor non-compensation atomospheric pressure upper limit" VALUE 0x00009408 REC_UWORD_C 0 COMP_0486 0 5119.921875 /begin FUNCTION_LIST KF7-313C.1[36] /end FUNCTION_LIST /end CHARACTERISTIC
/begin CHARACTERISTIC mPAMBAFL "A/F sensor non-compensation atomospheric pressure lower limit" VALUE 0x0000940A REC_UWORD_C 0 COMP_0486 0 5119.921875 /begin FUNCTION_LIST KF7-313C.1[36] /end FUNCTION_LIST /end CHARACTERISTIC
/begin CHARACTERISTIC mPTNHYS "T/M requirement fuel cut recover hysteresis" VALUE 0x000089F2 REC_UBYTE_C 0 COMP_0020 0 12750 /begin FUNCTION_LIST KF7-312.6[34] /end FUNCTION_LIST /end CHARACTERISTIC
/begin CHARACTERISTIC mPTNMIN "Lower limit speed that a T/M requirement fuel cut is possible" VALUE 0x000089F3 REC_UBYTE_C 0 COMP_0020 0 12750 /begin FUNCTION_LIST KF7-312.6[34] /end FUNCTION_LIST /end CHARACTERISTIC
/begin CHARACTERISTIC mPVTRANA "Voltage physics value conversion coefficient" VALUE 0x000089F7 REC_UBYTE_C 0 COMP_0444_S 0 0.049804815 /begin FUNCTION_LIST KF7-312.1C[N] R000.1.RS_Integ_1_10_2 /end FUNCTION_LIST /end CHARACTERISTIC
/begin CHARACTERISTIC mPVTRANB "Voltage physics value conversion coefficient (intercept)" VALUE 0x0000944C REC_UWORD_C 0 COMP_0445_S 0 127.99837455 /begin FUNCTION_LIST KF7-312.1C[N] R000.1.RS_Integ_1_10_2 /end FUNCTION_LIST /end CHARACTERISTIC
/begin CHARACTERISTIC mQAHYS "Model switching hysteresis" VALUE 0x00009456 REC_UWORD_C 0 COMP_0220 0 65535 /begin FUNCTION_LIST KF7-313C.1[36] /end FUNCTION_LIST /end CHARACTERISTIC
/begin CHARACTERISTIC mQASMC1 "Qa region #1" VALUE 0x0000945A REC_UWORD_C 0 COMP_0220 0 65535 /begin FUNCTION_LIST KF7-313C.1[36] /end FUNCTION_LIST /end CHARACTERISTIC
/begin CHARACTERISTIC mQASMC2 "Qa region #2" VALUE 0x0000945C REC_UWORD_C 0 COMP_0220 0 65535 /begin FUNCTION_LIST KF7-313C.1[36] /end FUNCTION_LIST /end CHARACTERISTIC
/begin CHARACTERISTIC mRAC2 "ACD3LU progress maximum time" VALUE 0x00008A28 REC_UBYTE_C 0 COMP_0008 0 25500 /begin FUNCTION_LIST KF7-312.6[34] /end FUNCTION_LIST /end CHARACTERISTIC
/begin CHARACTERISTIC mRCLSLE "The rest O2 LEAN side initialization voltage" VALUE 0x00009484 REC_UWORD_C 0 COMP_0023 0 327675 /begin FUNCTION_LIST KF7-313C.1[36] /end FUNCTION_LIST /end CHARACTERISTIC
/begin CHARACTERISTIC mRCLSRE "The rest O2 RICH side initialization voltage" VALUE 0x00009486 REC_UWORD_C 0 COMP_0023 0 327675 /begin FUNCTION_LIST KF7-313C.1[36] /end FUNCTION_LIST /end CHARACTERISTIC
/begin CHARACTERISTIC mRCVLMT "F/C recover control limit" VALUE 0x00009488 REC_UWORD_C 0 COMP_0165_S 0 655.35 /begin FUNCTION_LIST KF7-313C.1[36] /end FUNCTION_LIST /end CHARACTERISTIC
/begin CHARACTERISTIC mRECFN "At the time of the fail, recover speed" VALUE 0x00008A33 REC_UBYTE_C 0 COMP_0000 0 6375
 /begin FUNCTION_LIST KF7-312.6[34] KF7-450.1[N] KF7-450.2[1] KF7-450.3[1] KF7-450.4[1] KF7-500.1[54] /end FUNCTION_LIST
/end CHARACTERISTIC
/begin CHARACTERISTIC mRECLOK "At the time of non-lockup, lower limit recover speed" VALUE 0x00008A34 REC_UBYTE_C 0 COMP_0000 0 6375 /begin FUNCTION_LIST KF7-312.6[34] /end FUNCTION_LIST /end CHARACTERISTIC
/begin CHARACTERISTIC mRECSHK "The point no threshold for the recover shock" VALUE 0x00008A35 REC_UBYTE_C 0 COMP_0006 0 3187.5 /begin FUNCTION_LIST KF7-312.6[34] KF7-390.3A[15] R301.5.FuelCut_1_2_2 /end FUNCTION_LIST /end CHARACTERISTIC
/begin CHARACTERISTIC mREVJIS "Idle autonomous running clamp judgement delay" VALUE 0x00008A4E REC_UBYTE_C 0 COMP_0071 0 255 /begin FUNCTION_LIST KF7-313C.1[36] /end FUNCTION_LIST /end CHARACTERISTIC
/begin CHARACTERISTIC mRICHDLY "Rich side delay" VALUE 0x000094AC REC_UWORD_C 0 COMP_0165_S 0 655.35 /begin FUNCTION_LIST KF7-313C.1[36] /end FUNCTION_LIST /end CHARACTERISTIC
/begin CHARACTERISTIC mRICHG "At the time of the rich, O2 magnification" VALUE 0x000081B1 REC_SBYTE_C 0 COMP_0472 -2 1.984375 /begin FUNCTION_LIST KF7-313C.1[36] /end FUNCTION_LIST /end CHARACTERISTIC
/begin CHARACTERISTIC mRICHHYS "Rich side slice hysteresis" VALUE 0x000094AE REC_UWORD_C 0 COMP_0453 0 131.07 /begin FUNCTION_LIST KF7-313C.1[36] /end FUNCTION_LIST /end CHARACTERISTIC
/begin CHARACTERISTIC mRICHLMT "Rich side combustion limit A/F" VALUE 0x000094B0 REC_UWORD_C 0 COMP_0453 0 131.07 /begin FUNCTION_LIST KF7-313C.1[36] /end FUNCTION_LIST /end CHARACTERISTIC
/begin CHARACTERISTIC mRINLDT "Activated judgement time" VALUE 0x000094B2 REC_UWORD_C 0 COMP_0202 0 655350 /begin FUNCTION_LIST KF7-313C.1[36] /end FUNCTION_LIST /end CHARACTERISTIC
/begin CHARACTERISTIC mRLCRT "Rich/lean criteria" VALUE 0x000094B4 REC_UWORD_C 0 COMP_0453 0 131.07 /begin FUNCTION_LIST KF7-313C.1[36] R904.1.Gst_on_can_1_0_1 /end FUNCTION_LIST /end CHARACTERISTIC
/begin CHARACTERISTIC mRO2VDEF "At the time of the AVADO2R non-activation, voltage" VALUE 0x000094DE REC_UWORD_C 0 COMP_0061 0 327675 /begin FUNCTION_LIST KF7-313C.1[36] /end FUNCTION_LIST /end CHARACTERISTIC
/begin CHARACTERISTIC mRTGABF "TARGET A/F RICH SET" VALUE 0x000094E6 REC_UWORD_C 0 COMP_0453 0 131.07 /begin FUNCTION_LIST KF7-313C.1[36] /end FUNCTION_LIST /end CHARACTERISTIC
/begin CHARACTERISTIC mSETFUPR "Setup fuel pressure" VALUE 0x00008B02 REC_UBYTE_C 0 COMP_0465_S 0 510 /begin FUNCTION_LIST KF7-312.1C[N] /end FUNCTION_LIST /end CHARACTERISTIC
/begin CHARACTERISTIC mSHOKTP "A delay for the catalyst protection fuel cut region judgement" VALUE 0x00008B06 REC_UBYTE_C 0 COMP_0014 0 2550 /begin FUNCTION_LIST KF7-312.6[34] /end FUNCTION_LIST /end CHARACTERISTIC
/begin CHARACTERISTIC mSLAC "O2 quantity reset condition delta-TVO" VALUE 0x00008B07 REC_UBYTE_C 0 COMP_0002 0 89.25 /begin FUNCTION_LIST KF7-313C.1[36] /end FUNCTION_LIST /end CHARACTERISTIC
/begin CHARACTERISTIC mSLNTGN "Switching function inclination compensation value" VALUE 0x00008B09 REC_UBYTE_C 0 COMP_0373 0 2.55 /begin FUNCTION_LIST KF7-313C.1[36] /end FUNCTION_LIST /end CHARACTERISTIC
/begin CHARACTERISTIC mSLNTHP "Switching function inclination" VALUE 0x00008B0A REC_UBYTE_C 0 COMP_0373 0 2.55 /begin FUNCTION_LIST KF7-313C.1[36] /end FUNCTION_LIST /end CHARACTERISTIC
/begin CHARACTERISTIC mSMOOTH "Smoothing constant" VALUE 0x00008B13 REC_UBYTE_C 0 COMP_0388 0 25.5 /begin FUNCTION_LIST KF7-313C.1[36] /end FUNCTION_LIST /end CHARACTERISTIC
/begin CHARACTERISTIC mTANPTP "Vehicle speed 0 Km/h cut judgement TP" VALUE 0x00008B7C REC_UBYTE_C 0 COMP_0001 0 31.875 /begin FUNCTION_LIST KF7-312.6[34] /end FUNCTION_LIST /end CHARACTERISTIC
/begin CHARACTERISTIC mTDMNCL "After the monitor clamp, CLOSE control prohibition time" VALUE 0x00008B9F REC_UBYTE_C 0 COMP_0008 0 25500 /begin FUNCTION_LIST KF7-313C.1[36] /end FUNCTION_LIST /end CHARACTERISTIC
/begin CHARACTERISTIC mTEMIN "Pulse width minimum limitation value" VALUE 0x00009580 REC_UWORD_C 0 COMP_0125 0 255.99609375 /begin FUNCTION_LIST KF7-312.1C[N] KF7-313C.1[36] KF7-371.1E[15] /end FUNCTION_LIST /end CHARACTERISTIC
/begin CHARACTERISTIC mTFAIN "TFBAY0 hysteresis" VALUE 0x00008BBB REC_UBYTE_C 0 COMP_0044 0 1.9921875 /begin FUNCTION_LIST KF7-312.2A[16] R301.9.Target_Equivalent_Ratio_1_0_2 /end FUNCTION_LIST /end CHARACTERISTIC
/begin CHARACTERISTIC mTFAIN2 "TFBAY0 hysteresis 2" VALUE 0x00008BBC REC_UBYTE_C 0 COMP_0044 0 1.9921875 /begin FUNCTION_LIST KF7-312.2A[16] R301.9.Target_Equivalent_Ratio_1_0_2 /end FUNCTION_LIST /end CHARACTERISTIC
/begin CHARACTERISTIC mTFALMT "TFBYA limiter" VALUE 0x00008BBD REC_UBYTE_C 0 COMP_0066 0 3.984375 /begin FUNCTION_LIST KF7-312.2A[16] R301.9.Target_Equivalent_Ratio_1_0_2 /end FUNCTION_LIST /end CHARACTERISTIC
/begin CHARACTERISTIC mTFAOUT "TFBAY0 hysteresis" VALUE 0x00008BBF REC_UBYTE_C 0 COMP_0044 0 1.9921875 /begin FUNCTION_LIST KF7-312.2A[16] R301.9.Target_Equivalent_Ratio_1_0_2 /end FUNCTION_LIST /end CHARACTERISTIC
/begin CHARACTERISTIC mTFBA0SPD "At the time of the rotation synchronous control, TFBYA0 upper limit value" VALUE 0x00009582 REC_UWORD_C 0 COMP_0057 0 3.999941832 /begin FUNCTION_LIST KF7-312.2A[16] R301.9.Target_Equivalent_Ratio_1_0_2 /end FUNCTION_LIST /end CHARACTERISTIC
/begin CHARACTERISTIC mTFCD "Cut-in delay (low rotation)" VALUE 0x00008BC0 REC_UBYTE_C 0 COMP_0014 0 2550 /begin FUNCTION_LIST KF7-312.6[34] R301.5.FuelCut_1_2_2 /end FUNCTION_LIST /end CHARACTERISTIC
/begin CHARACTERISTIC mTFCD2 "Cut-in delay (low rotation, half-cylinder)" VALUE 0x00008BC1 REC_UBYTE_C 0 COMP_0014 0 2550 /begin FUNCTION_LIST KF7-312.6[34] R301.5.FuelCut_1_2_2 /end FUNCTION_LIST /end CHARACTERISTIC
/begin CHARACTERISTIC mTFCDL "Cut-in delay (a low coolant temperature)" VALUE 0x00008BC2 REC_UBYTE_C 0 COMP_0014 0 2550 /begin FUNCTION_LIST KF7-312.6[34] R301.5.FuelCut_1_2_2 /end FUNCTION_LIST /end CHARACTERISTIC
/begin CHARACTERISTIC mTFCDL2 "Cut-in delay (a low coolant temperature, half-cylinder)" VALUE 0x00008BC3 REC_UBYTE_C 0 COMP_0014 0 2550 /begin FUNCTION_LIST KF7-312.6[34] R301.5.FuelCut_1_2_2 /end FUNCTION_LIST /end CHARACTERISTIC
/begin CHARACTERISTIC mTFCDN2 "Cut-in delay (high rotation, half-cylinder)" VALUE 0x00008BC4 REC_UBYTE_C 0 COMP_0014 0 2550 /begin FUNCTION_LIST KF7-312.6[34] R301.5.FuelCut_1_2_2 /end FUNCTION_LIST /end CHARACTERISTIC
/begin CHARACTERISTIC mTFCDNH "Cut-in delay (high rotation)" VALUE 0x00008BC5 REC_UBYTE_C 0 COMP_0014 0 2550 /begin FUNCTION_LIST KF7-312.6[34] R301.5.FuelCut_1_2_2 /end FUNCTION_LIST /end CHARACTERISTIC
/begin CHARACTERISTIC mTGCTMP "Catalyst activated temperature" VALUE 0x00008BD3 REC_UBYTE_C 0 COMP_0062 0 1020 /begin FUNCTION_LIST KF7-313C.1[36] /end FUNCTION_LIST /end CHARACTERISTIC
/begin CHARACTERISTIC mTGFCUT "At the time of the F/C recover control, target A/F" VALUE 0x00009588 REC_UWORD_C 0 COMP_0453 0 131.07 /begin FUNCTION_LIST KF7-313C.1[36] /end FUNCTION_LIST /end CHARACTERISTIC
/begin CHARACTERISTIC mTGIGN "An integral gain" VALUE 0x00008BD4 REC_UBYTE_C 0 COMP_0361_S 0 0.255 /begin FUNCTION_LIST KF7-313C.1[36] /end FUNCTION_LIST /end CHARACTERISTIC
/begin CHARACTERISTIC mTGTIME "Period" VALUE 0x0000958C REC_UWORD_C 0 COMP_0165_S 0 655.35 /begin FUNCTION_LIST KF7-313C.1[36] /end FUNCTION_LIST /end CHARACTERISTIC
/begin CHARACTERISTIC mTINJDIV "The number of retard recover division" VALUE 0x000095A4 REC_UWORD_C 0 COMP_0030 0 65535 /begin FUNCTION_LIST KF7-311.1A[21] /end FUNCTION_LIST /end CHARACTERISTIC
/begin CHARACTERISTIC mTINJINT "The amount of initial retard" VALUE 0x00008BF5 REC_UBYTE_C 0 COMP_0055 0 1020 /begin FUNCTION_LIST KF7-311.1A[21] /end FUNCTION_LIST /end CHARACTERISTIC
/begin CHARACTERISTIC mTLCDL "During lockup, at the time of the slowdown, cut-in delay (a low coolant temperature)" VALUE 0x00008BFA REC_UBYTE_C 0 COMP_0014 0 2550 /begin FUNCTION_LIST KF7-312.6[34] KF7-385.1[32] R301.5.FuelCut_1_2_2 /end FUNCTION_LIST /end CHARACTERISTIC
/begin CHARACTERISTIC mTLCDL2 "During lockup, at the time of the slowdown, cut-in delay (a low coolant temperature, half-cylinder)" VALUE 0x00008BFB REC_UBYTE_C 0 COMP_0014 0 2550 /begin FUNCTION_LIST KF7-312.6[34] KF7-385.1[32] R301.5.FuelCut_1_2_2 /end FUNCTION_LIST /end CHARACTERISTIC
/begin CHARACTERISTIC mTLCDN2 "During lockup, at the time of the slowdown, cut-in delay (high rotation, half-cylinder)" VALUE 0x00008BFE REC_UBYTE_C 0 COMP_0014 0 2550 /begin FUNCTION_LIST KF7-312.6[34] KF7-385.1[32] R301.5.FuelCut_1_2_2 /end FUNCTION_LIST /end CHARACTERISTIC
/begin CHARACTERISTIC mTLCDNH "During lockup, at the time of the slowdown, cut-in delay (high rotation)" VALUE 0x00008C00 REC_UBYTE_C 0 COMP_0014 0 2550 /begin FUNCTION_LIST KF7-312.6[34] KF7-385.1[32] R301.5.FuelCut_1_2_2 /end FUNCTION_LIST /end CHARACTERISTIC
/begin CHARACTERISTIC mTLFCD "During lockup, at the time of the slowdown, cut-in delay (low rotation)" VALUE 0x00008C02 REC_UBYTE_C 0 COMP_0014 0 2550 /begin FUNCTION_LIST KF7-312.6[34] KF7-385.1[32] R301.5.FuelCut_1_2_2 /end FUNCTION_LIST /end CHARACTERISTIC
/begin CHARACTERISTIC mTLFCD2 "During lockup, at the time of the slowdown, cut-in delay (low rotation, half-cylinder)" VALUE 0x00008C03 REC_UBYTE_C 0 COMP_0014 0 2550 /begin FUNCTION_LIST KF7-312.6[34] KF7-385.1[32] R301.5.FuelCut_1_2_2 /end FUNCTION_LIST /end CHARACTERISTIC
/begin CHARACTERISTIC mTMDVDG "Vehicle speed sensor trouble judgement delay" VALUE 0x00008C34 REC_UBYTE_C 0 COMP_0008 0 25500 /begin FUNCTION_LIST KF7-312.6[34] /end FUNCTION_LIST /end CHARACTERISTIC
/begin CHARACTERISTIC mTMFRGPH "TMFR gear threshold" VALUE 0x00008C49 REC_UBYTE_C 0 COMP_0068 0 255 /begin FUNCTION_LIST KF7-312.6[34] /end FUNCTION_LIST /end CHARACTERISTIC
/begin CHARACTERISTIC mTMFRGPL "TMFR gear threshold" VALUE 0x00008C4A REC_UBYTE_C 0 COMP_0068 0 255 /begin FUNCTION_LIST KF7-312.6[34] /end FUNCTION_LIST /end CHARACTERISTIC
/begin CHARACTERISTIC mTMFRKI1 "MT gear position judgement condition" VALUE 0x00008C4B REC_UBYTE_C 0 COMP_0171 0 398.4375 /begin FUNCTION_LIST KF7-312.6[34] /end FUNCTION_LIST /end CHARACTERISTIC
/begin CHARACTERISTIC mTMFRKI2 "MT gear position judgement condition" VALUE 0x00008C4C REC_UBYTE_C 0 COMP_0171 0 398.4375 /begin FUNCTION_LIST KF7-312.6[34] /end FUNCTION_LIST /end CHARACTERISTIC
/begin CHARACTERISTIC mTMFRNEH "TMFR permission speed" VALUE 0x00008C4D REC_UBYTE_C 0 COMP_0000 0 6375 /begin FUNCTION_LIST KF7-312.6[34] /end FUNCTION_LIST /end CHARACTERISTIC
/begin CHARACTERISTIC mTMR123 "Recover delay (except for TOP)" VALUE 0x00008C78 REC_UBYTE_C 0 COMP_0014 0 2550 /begin FUNCTION_LIST KF7-312.6[34] /end FUNCTION_LIST /end CHARACTERISTIC
/begin CHARACTERISTIC mTMR123D "Recover delay (except for TOP)" VALUE 0x00008C79 REC_UBYTE_C 0 COMP_0014 0 2550 /begin FUNCTION_LIST KF7-312.6[34] /end FUNCTION_LIST /end CHARACTERISTIC
/begin CHARACTERISTIC mTMROFF "Recover delay (at the time of idle off)" VALUE 0x00008C83 REC_UBYTE_C 0 COMP_0014 0 2550 /begin FUNCTION_LIST KF7-312.6[34] /end FUNCTION_LIST /end CHARACTERISTIC
/begin CHARACTERISTIC mTMRTOP "Recover delay (at the time of TOP)" VALUE 0x00008C85 REC_UBYTE_C 0 COMP_0014 0 2550 /begin FUNCTION_LIST KF7-312.6[34] /end FUNCTION_LIST /end CHARACTERISTIC
/begin CHARACTERISTIC mTMRTOPD "Recover delay (at the time of TOP)" VALUE 0x00008C86 REC_UBYTE_C 0 COMP_0014 0 2550 /begin FUNCTION_LIST KF7-312.6[34] /end FUNCTION_LIST /end CHARACTERISTIC
/begin CHARACTERISTIC mTNCUTD "A high rotation cut judgement delay" VALUE 0x00008CB3 REC_UBYTE_C 0 COMP_0049 0 255 /begin FUNCTION_LIST KF7-312.6[34] R301.5.FuelCut_1_2_2 /end FUNCTION_LIST /end CHARACTERISTIC
/begin CHARACTERISTIC mTNFCD "Cut-in delay switching rotation" VALUE 0x00008CB4 REC_UBYTE_C 0 COMP_0020 0 12750 /begin FUNCTION_LIST KF7-312.6[34] KF7-385.1[32] R301.5.FuelCut_1_2_2 /end FUNCTION_LIST /end CHARACTERISTIC
/begin CHARACTERISTIC mTO2HYS "Rich-ization release voltage - lean judgement voltage" VALUE 0x00008CBE REC_UBYTE_C 0 COMP_0061 0 1275 /begin FUNCTION_LIST KF7-313C.1[36] /end FUNCTION_LIST /end CHARACTERISTIC
/begin CHARACTERISTIC mTO2THD "At the time of the lean judgement, rich-ization release voltage" VALUE 0x000095D2 REC_UWORD_C 0 COMP_0061 0 327675 /begin FUNCTION_LIST KF7-313C.1[36] /end FUNCTION_LIST /end CHARACTERISTIC
/begin CHARACTERISTIC mTRFSTP "Urgent mild acceleration judgement delta-TP (before 10mS)" VALUE 0x00008CE8 REC_UBYTE_C 0 COMP_0001 0 31.875 /begin FUNCTION_LIST KF7-312.5C[1] /end FUNCTION_LIST /end CHARACTERISTIC
/begin CHARACTERISTIC mTRQFUL "When control is finished, upper limit torque" VALUE 0x00008F5C REC_SWORD_C 0 COMP_0228 -3276.8 3276.7 /begin FUNCTION_LIST KF7-312.6[34] KF7-360.9M[43] KF7-360.9P[22] KF7-410.21[3] /end FUNCTION_LIST /end CHARACTERISTIC
/begin CHARACTERISTIC mTS14VZ "At the time of reverse ãN absorption circuit ZD-ization éû, invalid pulse width" VALUE 0x00008CEE REC_UBYTE_C 0 COMP_0231 0 2550 /begin FUNCTION_LIST KF7-312.1C[N] /end FUNCTION_LIST /end CHARACTERISTIC
/begin CHARACTERISTIC mTVCUTD "A high vehicle speed fuel cut judgement delay" VALUE 0x00008D00 REC_UBYTE_C 0 COMP_0049 0 255 /begin FUNCTION_LIST KF7-312.6[34] R301.5.FuelCut_1_2_2 /end FUNCTION_LIST /end CHARACTERISTIC
/begin CHARACTERISTIC mTWCLMP "CLOSE control start coolant temperature" VALUE 0x00008D1F REC_UBYTE_C 0 COMP_0035 -50 205 /begin FUNCTION_LIST KF7-313C.1[36] KF7-500.39[5] /end FUNCTION_LIST /end CHARACTERISTIC
/begin CHARACTERISTIC mTWFCD "Cut-in delay switching coolant temperature" VALUE 0x00008D29 REC_UBYTE_C 0 COMP_0035 -50 205 /begin FUNCTION_LIST KF7-312.6[34] KF7-385.1[32] R301.5.FuelCut_1_2_2 /end FUNCTION_LIST /end CHARACTERISTIC
/begin CHARACTERISTIC mTWINJT "The judgement coolant temperature that a pole low coolant temperature is sequential" VALUE 0x00008D35 REC_UBYTE_C 0 COMP_0035 -50 205 /begin FUNCTION_LIST KF7-311.1A[21] /end FUNCTION_LIST /end CHARACTERISTIC
/begin CHARACTERISTIC mTWKMR "KMR delay prohibition coolant temperature" VALUE 0x00008D41 REC_UBYTE_C 0 COMP_0035 -50 205
 /begin FUNCTION_LIST KF7-312.2A[16] KF7-312.3A[27] R301.9.Target_Equivalent_Ratio_1_0_2 /end FUNCTION_LIST
/end CHARACTERISTIC
/begin CHARACTERISTIC mTWLCLP "Slowdown lean clamp judgement coolant temperature" VALUE 0x00008D43 REC_UBYTE_C 0 COMP_0035 -50 205 /begin FUNCTION_LIST KF7-313C.1[36] /end FUNCTION_LIST /end CHARACTERISTIC
/begin CHARACTERISTIC mTWNLFC "Continuous NO. Load condition formation coolant temperature" VALUE 0x00008D55 REC_UBYTE_C 0 COMP_0035 -50 205 /begin FUNCTION_LIST KF7-312.6[34] /end FUNCTION_LIST /end CHARACTERISTIC
/begin CHARACTERISTIC mTWOPEN "CLOSE control switchover coolant temperature (after the fixed time progress)" VALUE 0x00008D5B REC_UBYTE_C 0 COMP_0035 -50 205 /begin FUNCTION_LIST KF7-313C.1[36] /end FUNCTION_LIST /end CHARACTERISTIC
/begin CHARACTERISTIC mTWOVH "Overheat judgement coolant temperature" VALUE 0x00008D5C REC_UBYTE_C 0 COMP_0035 -50 205 /begin FUNCTION_LIST KF7-312.6[34] R301.5.FuelCut_1_2_2 /end FUNCTION_LIST /end CHARACTERISTIC
/begin CHARACTERISTIC mTWVTCMG "Recover start coolant temperature delay" VALUE 0x00008D75 REC_UBYTE_C 0 COMP_0003 0 255 /begin FUNCTION_LIST KF7-311.1A[21] /end FUNCTION_LIST /end CHARACTERISTIC
/begin CHARACTERISTIC mUNLOCK "Non-lockup judgement time" VALUE 0x00008D90 REC_UBYTE_C 0 COMP_0014 0 2550 /begin FUNCTION_LIST KF7-312.6[34] KF7-385.1[32] /end FUNCTION_LIST /end CHARACTERISTIC
/begin CHARACTERISTIC mUPLMT "Target A/F upper limit value" VALUE 0x0000963E REC_UWORD_C 0 COMP_0453 0 131.07 /begin FUNCTION_LIST KF7-313C.1[36] /end FUNCTION_LIST /end CHARACTERISTIC
/begin CHARACTERISTIC mVDINJ1 "REF reference position synchronous injection timing compensation" VALUE 0x00008DB4 REC_UBYTE_C 0 COMP_0017 0 255 /begin FUNCTION_LIST KF7-311.1A[21] /end FUNCTION_LIST /end CHARACTERISTIC
/begin CHARACTERISTIC mVDINJ2 "REF reference position synchronous injection timing compensation (at the time of the pole low coolant temperature)" VALUE 0x00008DB5 REC_UBYTE_C 0 COMP_0017 0 255 /begin FUNCTION_LIST KF7-311.1A[21] /end FUNCTION_LIST /end CHARACTERISTIC
/begin CHARACTERISTIC mVJISOH "At the time of the idle autonomous running clamp, judgement vehicle speed upper limit value" VALUE 0x00008DD1 REC_UBYTE_C 0 COMP_0007 0 510 /begin FUNCTION_LIST KF7-313C.1[36] /end FUNCTION_LIST /end CHARACTERISTIC
/begin CHARACTERISTIC mVJISOL "At the time of the idle autonomous running clamp, judgement vehicle speed lower limit value" VALUE 0x00008DD2 REC_UBYTE_C 0 COMP_0007 0 510 /begin FUNCTION_LIST KF7-313C.1[36] /end FUNCTION_LIST /end CHARACTERISTIC
/begin CHARACTERISTIC mVSCLPH "Slowdown lean clamp rate judgement vehicle speed" VALUE 0x00008DF6 REC_UBYTE_C 0 COMP_0007 0 510 /begin FUNCTION_LIST KF7-313C.1[36] /end FUNCTION_LIST /end CHARACTERISTIC
/begin CHARACTERISTIC mVSPCT2 "A high vehicle speed fuel cut judgement vehicle speed" VALUE 0x00008E0A REC_UBYTE_C 0 COMP_0007 0 510 /begin FUNCTION_LIST KF7-312.6[34] R301.5.FuelCut_1_2_2 /end FUNCTION_LIST /end CHARACTERISTIC
/begin CHARACTERISTIC mVSPIDL "Idle judgement vehicle speed" VALUE 0x00008E0D REC_UBYTE_C 0 COMP_0007 0 510 /begin FUNCTION_LIST KF7-313C.1[36] R301.4.AfFeedback_1_0_1 /end FUNCTION_LIST /end CHARACTERISTIC
/begin CHARACTERISTIC mVSPKAP "The exhaust the second air increase judgement vehicle speed" VALUE 0x00008E11 REC_UBYTE_C 0 COMP_0363 0 510
 /begin FUNCTION_LIST KF7-312.2A[16] KF7-312.3A[27] R301.9.Target_Equivalent_Ratio_1_0_2 /end FUNCTION_LIST
/end CHARACTERISTIC
/begin CHARACTERISTIC mVSPLCC "Slowdown lean clamp release vehicle speed" VALUE 0x00008E12 REC_UBYTE_C 0 COMP_0007 0 510 /begin FUNCTION_LIST KF7-313C.1[36] /end FUNCTION_LIST /end CHARACTERISTIC
/begin CHARACTERISTIC mVSPLCP "Slowdown lean clamp judgement vehicle speed" VALUE 0x00008E13 REC_UBYTE_C 0 COMP_0007 0 510 /begin FUNCTION_LIST KF7-313C.1[36] /end FUNCTION_LIST /end CHARACTERISTIC
/begin CHARACTERISTIC mVSPRC2 "All the cylinder recover vehicle speeds" VALUE 0x00008E17 REC_UBYTE_C 0 COMP_0007 0 510 /begin FUNCTION_LIST KF7-312.6[34] R301.5.FuelCut_1_2_2 /end FUNCTION_LIST /end CHARACTERISTIC
/begin CHARACTERISTIC mVTCTWL "A coolant temperature lower limit for the VTC drive permission" VALUE 0x00008E52 REC_UBYTE_C 0 COMP_0035 -50 205 /begin FUNCTION_LIST KF7-311.1A[21] KF7-320A.22[5] KF7-393.1C[8] /end FUNCTION_LIST /end CHARACTERISTIC
/begin CHARACTERISTIC mZLMT "IDLHOS loss in weight side limiter" VALUE 0x00008EA0 REC_UBYTE_C 0 COMP_0186 0 3.984375 /begin FUNCTION_LIST KF7-312.1C[N] /end FUNCTION_LIST /end CHARACTERISTIC
/begin CHARACTERISTIC mKHTMAP "A high coolant temperature increase map" MAP 0x0000992E REC_UBYTE_C 0 COMP_0045 0 1.9921875
 /begin AXIS_DESCR COM_AXIS NO_INPUT_QUANTITY COMP_0020 4 0 12750 AXIS_PTS_REF mKHOTN /end AXIS_DESCR
 /begin AXIS_DESCR COM_AXIS NO_INPUT_QUANTITY COMP_0045 4 0 1.9921875 AXIS_PTS_REF mKHTTP /end AXIS_DESCR
 /begin FUNCTION_LIST KF7-312.3A[27] R301.7.KHOT_1_0_2 /end FUNCTION_LIST
/end CHARACTERISTIC
/begin CHARACTERISTIC mMKUBIN "An unburned advantage, rotation load map" MAP 0x0000A3FE REC_UBYTE_C 0 COMP_0181 0 7.96875
 /begin AXIS_DESCR COM_AXIS NO_INPUT_QUANTITY COMP_0020 4 0 12750 AXIS_PTS_REF mNKUBTW /end AXIS_DESCR
 /begin AXIS_DESCR COM_AXIS NO_INPUT_QUANTITY COMP_0032 4 0 0.99609375 AXIS_PTS_REF mLKUBTW /end AXIS_DESCR
 /begin FUNCTION_LIST KF7-312.3A[27] /end FUNCTION_LIST
/end CHARACTERISTIC
/begin CHARACTERISTIC mMSTBIN "Stability rotation load compensation map" MAP 0x0000A64E REC_UBYTE_C 0 COMP_0181 0 7.96875
 /begin AXIS_DESCR COM_AXIS NO_INPUT_QUANTITY COMP_0020 4 0 12750 AXIS_PTS_REF mNKUBTW /end AXIS_DESCR
 /begin AXIS_DESCR COM_AXIS NO_INPUT_QUANTITY COMP_0032 4 0 0.99609375 AXIS_PTS_REF mLKUBTW /end AXIS_DESCR
 /begin FUNCTION_LIST KF7-312.3A[27] /end FUNCTION_LIST
/end CHARACTERISTIC
/begin CHARACTERISTIC mMABFSFT "N * TP shift map" MAP 0x0000B172 REC_UWORD_C 0 COMP_0483_S -65.536 65.534
 /begin AXIS_DESCR COM_AXIS NO_INPUT_QUANTITY COMP_0006 8 0 819187.5 AXIS_PTS_REF mMXABFSFT /end AXIS_DESCR
 /begin AXIS_DESCR COM_AXIS NO_INPUT_QUANTITY COMP_0144 8 0 31.999495335 AXIS_PTS_REF mMYABFSFT /end AXIS_DESCR
 /begin FUNCTION_LIST KF7-313C.1[36] /end FUNCTION_LIST
/end CHARACTERISTIC
/begin CHARACTERISTIC mMABFSFT2 "N * TP shift map (bank2)" MAP 0x0000B1F2 REC_UWORD_C 0 COMP_0483_S -65.536 65.534
 /begin AXIS_DESCR COM_AXIS NO_INPUT_QUANTITY COMP_0006 8 0 819187.5 AXIS_PTS_REF mMXABFSFT /end AXIS_DESCR
 /begin AXIS_DESCR COM_AXIS NO_INPUT_QUANTITY COMP_0144 8 0 31.999495335 AXIS_PTS_REF mMYABFSFT /end AXIS_DESCR
 /begin FUNCTION_LIST KF7-313C.1[36] /end FUNCTION_LIST
/end CHARACTERISTIC
/begin CHARACTERISTIC mMMFHQT "Adhesion magnification basic value (1 cylinder hit)" MAP 0x0000A40E REC_UBYTE_C 0 COMP_0464 0 31.875
 /begin AXIS_DESCR FIX_AXIS NO_INPUT_QUANTITY COMP_0278_S 8 -40 100 FIX_AXIS_PAR_DIST 0 1 8 /end AXIS_DESCR
 /begin AXIS_DESCR FIX_AXIS NO_INPUT_QUANTITY COMP_0279_S 8 0 87.5 FIX_AXIS_PAR_DIST 0 1 8 /end AXIS_DESCR
 /begin FUNCTION_LIST KF7-312.4A[6] KF7-312.4C[4] /end FUNCTION_LIST
/end CHARACTERISTIC
/begin CHARACTERISTIC mAFSFT "At the time of the RrO2 sensor non-activation, target A/F" CURVE 0x0000DE9A REC_UWORD_C 0 COMP_0453 0 131.07
 /begin AXIS_DESCR COM_AXIS NO_INPUT_QUANTITY COMP_0035 16 -50 65485 AXIS_PTS_REF mTXAFSFT /end AXIS_DESCR
 /begin FUNCTION_LIST KF7-313C.1[36] /end FUNCTION_LIST
/end CHARACTERISTIC
/begin CHARACTERISTIC mAFSFT2 "At the time of the RrO2 sensor non-activation, target A/F initial value" CURVE 0x0000DEBA REC_UWORD_C 0 COMP_0453 0 131.07
 /begin AXIS_DESCR COM_AXIS NO_INPUT_QUANTITY COMP_0035 16 -50 65485 AXIS_PTS_REF mTXAFSFT /end AXIS_DESCR
 /begin FUNCTION_LIST KF7-313C.1[36] /end FUNCTION_LIST
/end CHARACTERISTIC
/begin CHARACTERISTIC mAFSFTIDL "At the time of the RrO2 sensor non-activation, target A/F (idle)" CURVE 0x0000DEDA REC_UWORD_C 0 COMP_0453 0 131.07
 /begin AXIS_DESCR COM_AXIS NO_INPUT_QUANTITY COMP_0035 16 -50 65485 AXIS_PTS_REF mTXAFSFT /end AXIS_DESCR
 /begin FUNCTION_LIST KF7-313C.1[36] /end FUNCTION_LIST
/end CHARACTERISTIC
/begin CHARACTERISTIC mDAFSFT "At the time of the RrO2 sensor non-activation, target A/F change rate" CURVE 0x0000DF9A REC_UWORD_C 0 COMP_0490_S 0 0.031999495335
 /begin AXIS_DESCR COM_AXIS NO_INPUT_QUANTITY COMP_0035 16 -50 65485 AXIS_PTS_REF mTXAFSFT /end AXIS_DESCR
 /begin FUNCTION_LIST KF7-313C.1[36] /end FUNCTION_LIST
/end CHARACTERISTIC
/begin CHARACTERISTIC mTBLATM2 "Atomospheric pressure compensation coefficient table" CURVE 0x0000CE7A REC_UBYTE_C 0 COMP_0044 0 1.9921875
 /begin AXIS_DESCR FIX_AXIS NO_INPUT_QUANTITY COMP_0493_S 16 0 4800 FIX_AXIS_PAR_DIST 0 1 16 /end AXIS_DESCR
 /begin FUNCTION_LIST KF7-311.1A[21] KF7-312.1C[N] R000.1.RS_Integ_1_10_2 /end FUNCTION_LIST
/end CHARACTERISTIC
/begin CHARACTERISTIC mTCALABF "A/F conversion table" CURVE 0x0000E7AA REC_UWORD_C 0 COMP_0494_S 0 131.07
 /begin AXIS_DESCR COM_AXIS NO_INPUT_QUANTITY COMP_0370 16 0 163837.5 AXIS_PTS_REF mTXCLABF /end AXIS_DESCR
 /begin FUNCTION_LIST KF7-313C.1[36] /end FUNCTION_LIST
/end CHARACTERISTIC
/begin CHARACTERISTIC mTFCDCK "A cut-in delay (low rotation) for CVT" CURVE 0x0000D096 REC_UBYTE_C 0 COMP_0014 0 2550
 /begin AXIS_DESCR FIX_AXIS NO_INPUT_QUANTITY COMP_0285_S 16 12 72 FIX_AXIS_PAR_DIST 0 1 16 /end AXIS_DESCR
 /begin FUNCTION_LIST KF7-312.6[34] /end FUNCTION_LIST
/end CHARACTERISTIC
/begin CHARACTERISTIC mTFVAPO "A full increase judgement VAPO table" CURVE 0x0000D0EE REC_UBYTE_C 0 COMP_0002 0 89.25
 /begin AXIS_DESCR FIX_AXIS NO_INPUT_QUANTITY COMP_0271_S 16 0 6000 FIX_AXIS_PAR_DIST 0 1 16 /end AXIS_DESCR
 /begin FUNCTION_LIST KF7-312.2A[16] KF7-312.3A[27] R301.9.Target_Equivalent_Ratio_1_0_2 /end FUNCTION_LIST
/end CHARACTERISTIC
/begin CHARACTERISTIC mTHPAMB "Atomospheric pressure compensation coefficient" CURVE 0x0000D222 REC_UBYTE_C 0 COMP_0045 0 1.9921875
 /begin AXIS_DESCR COM_AXIS NO_INPUT_QUANTITY COMP_0054 16 0 5100 AXIS_PTS_REF mLHPAMB /end AXIS_DESCR
 /begin FUNCTION_LIST KF7-313C.1[36] /end FUNCTION_LIST
/end CHARACTERISTIC
/begin CHARACTERISTIC mTINLDTE "At the time of the start, CLOSE control prohibition time table" CURVE 0x0000D28A REC_UBYTE_C 0 COMP_0049 0 255
 /begin AXIS_DESCR COM_AXIS NO_INPUT_QUANTITY COMP_0035 16 -50 205 AXIS_PTS_REF mTWKINT /end AXIS_DESCR
 /begin FUNCTION_LIST KF7-313C.1[36] KF7-500.39[5] /end FUNCTION_LIST
/end CHARACTERISTIC
/begin CHARACTERISTIC mTKAP "The exhaust the second air increase judgement vehicle speed" CURVE 0x0000D322 REC_UBYTE_C 0 COMP_0095 0 398.4375
 /begin AXIS_DESCR FIX_AXIS NO_INPUT_QUANTITY COMP_0280_S 16 -40 110 FIX_AXIS_PAR_DIST 0 1 16 /end AXIS_DESCR
 /begin FUNCTION_LIST KF7-312.3A[27] /end FUNCTION_LIST
/end CHARACTERISTIC
/begin CHARACTERISTIC mTKNL "Continuous NO. Load KML table" CURVE 0x0000D422 REC_UBYTE_C 0 COMP_0330 -128 127
 /begin AXIS_DESCR FIX_AXIS NO_INPUT_QUANTITY COMP_0291_S 16 2000 8000 FIX_AXIS_PAR_DIST 0 1 16 /end AXIS_DESCR
 /begin FUNCTION_LIST KF7-312.6[34] /end FUNCTION_LIST
/end CHARACTERISTIC
/begin CHARACTERISTIC mTKNST "Rotation compensation table" CURVE 0x0000D432 REC_UBYTE_C 0 COMP_0032 0 0.99609375
 /begin AXIS_DESCR FIX_AXIS NO_INPUT_QUANTITY COMP_0292_S 16 0 1500 FIX_AXIS_PAR_DIST 0 1 16 /end AXIS_DESCR
 /begin FUNCTION_LIST KF7-312.1C[N] /end FUNCTION_LIST
/end CHARACTERISTIC
/begin CHARACTERISTIC mTMKTW "Minus KTW basic value table" CURVE 0x0000C872 REC_SBYTE_C 0 COMP_0338 -2 1.984375
 /begin AXIS_DESCR FIX_AXIS NO_INPUT_QUANTITY COMP_0280_S 16 -40 110 FIX_AXIS_PAR_DIST 0 1 16 /end AXIS_DESCR
 /begin FUNCTION_LIST KF7-312.3A[27] /end FUNCTION_LIST
/end CHARACTERISTIC
/begin CHARACTERISTIC mTNC "BOSCH cut speed table" CURVE 0x0000D5D4 REC_UBYTE_C 0 COMP_0000 0 6375
 /begin AXIS_DESCR FIX_AXIS NO_INPUT_QUANTITY COMP_0280_S 16 -40 110 FIX_AXIS_PAR_DIST 0 1 16 /end AXIS_DESCR
 /begin FUNCTION_LIST KF7-312.6[34] KF7-385.1[32] /end FUNCTION_LIST
/end CHARACTERISTIC
/begin CHARACTERISTIC mTNJC "JECS cut speed table" CURVE 0x0000D620 REC_UBYTE_C 0 COMP_0000 0 6375
 /begin AXIS_DESCR FIX_AXIS NO_INPUT_QUANTITY COMP_0280_S 16 -40 110 FIX_AXIS_PAR_DIST 0 1 16 /end AXIS_DESCR
 /begin FUNCTION_LIST KF7-312.6[34] KF7-385.1[32] /end FUNCTION_LIST
/end CHARACTERISTIC
/begin CHARACTERISTIC mTNR "JECS cut recover speed table" CURVE 0x0000D6B8 REC_UBYTE_C 0 COMP_0000 0 6375
 /begin AXIS_DESCR FIX_AXIS NO_INPUT_QUANTITY COMP_0280_S 16 -40 110 FIX_AXIS_PAR_DIST 0 1 16 /end AXIS_DESCR
 /begin FUNCTION_LIST KF7-312.6[34] KF7-385.1[32] /end FUNCTION_LIST
/end CHARACTERISTIC
/begin CHARACTERISTIC mTQHOS "Air quantity compensation coefficient" CURVE 0x0000EE62 REC_UWORD_C 0 COMP_0045 0 511.9921875
 /begin AXIS_DESCR COM_AXIS NO_INPUT_QUANTITY COMP_0068 16 0 65535 AXIS_PTS_REF mLTQHOS /end AXIS_DESCR
 /begin FUNCTION_LIST KF7-313C.1[36] /end FUNCTION_LIST
/end CHARACTERISTIC
/begin CHARACTERISTIC mTQHOS2 "Air quantity compensation coefficient (bank 2)" CURVE 0x0000EE82 REC_UWORD_C 0 COMP_0045 0 511.9921875
 /begin AXIS_DESCR COM_AXIS NO_INPUT_QUANTITY COMP_0068 16 0 65535 AXIS_PTS_REF mLTQHOS /end AXIS_DESCR
 /begin FUNCTION_LIST KF7-313C.1[36] /end FUNCTION_LIST
/end CHARACTERISTIC
/begin CHARACTERISTIC mTREC "BOSCH cut recover rotation table" CURVE 0x0000D7E4 REC_UBYTE_C 0 COMP_0000 0 6375
 /begin AXIS_DESCR FIX_AXIS NO_INPUT_QUANTITY COMP_0280_S 16 -40 110 FIX_AXIS_PAR_DIST 0 1 16 /end AXIS_DESCR
 /begin FUNCTION_LIST KF7-312.6[34] KF7-385.1[32] /end FUNCTION_LIST
/end CHARACTERISTIC
/begin CHARACTERISTIC mTRPBOST1 "Intake manifold pressure/atomospheric pressure basic table" CURVE 0x0000D872 REC_UBYTE_C 0 COMP_0063 0 0.99609375
 /begin AXIS_DESCR FIX_AXIS NO_INPUT_QUANTITY COMP_0053 16 0 15 FIX_AXIS_PAR_DIST 0 1 16 /end AXIS_DESCR
 /begin FUNCTION_LIST KF7-312.1C[N] /end FUNCTION_LIST
/end CHARACTERISTIC
/begin CHARACTERISTIC mTRPBOST2 "Intake manifold pressure/atomospheric pressure rotation compensation table" CURVE 0x0000D882 REC_UBYTE_C 0 COMP_0063 0 0.99609375
 /begin AXIS_DESCR FIX_AXIS NO_INPUT_QUANTITY COMP_0271_S 16 0 6000 FIX_AXIS_PAR_DIST 0 1 16 /end AXIS_DESCR
 /begin FUNCTION_LIST KF7-312.1C[N] /end FUNCTION_LIST
/end CHARACTERISTIC
/begin CHARACTERISTIC mTTNKAS "After the start, rotation compensation table" CURVE 0x0000DABE REC_UBYTE_C 0 COMP_0066 0 3.984375
 /begin AXIS_DESCR FIX_AXIS NO_INPUT_QUANTITY COMP_0283_S 16 0 3000 FIX_AXIS_PAR_DIST 0 1 16 /end AXIS_DESCR
 /begin FUNCTION_LIST KF7-312.3A[27] /end FUNCTION_LIST
/end CHARACTERISTIC
/begin CHARACTERISTIC mTMFRCNT "The number of TMFR cut cylinders" CURVE 0x0000D56A REC_UBYTE_C 0 COMP_0030 0 255
 /begin AXIS_DESCR FIX_AXIS NO_INPUT_QUANTITY COMP_0068 3 0 2 FIX_AXIS_PAR_DIST 0 1 3 /end AXIS_DESCR
 /begin FUNCTION_LIST KF7-312.6[34] /end FUNCTION_LIST
/end CHARACTERISTIC
/begin CHARACTERISTIC mTMFRTM "TMFR cut start time" CURVE 0x0000D56D REC_UBYTE_C 0 COMP_0014 0 2550
 /begin AXIS_DESCR FIX_AXIS NO_INPUT_QUANTITY COMP_0068 3 0 2 FIX_AXIS_PAR_DIST 0 1 3 /end AXIS_DESCR
 /begin FUNCTION_LIST KF7-312.6[34] /end FUNCTION_LIST
/end CHARACTERISTIC
/begin CHARACTERISTIC mTRATIO "Gear ratio table" CURVE 0x0000EEE2 REC_UWORD_C 0 COMP_0450 0 63.999056205
 /begin AXIS_DESCR FIX_AXIS NO_INPUT_QUANTITY COMP_0068 5 0 4 FIX_AXIS_PAR_DIST 0 1 5 /end AXIS_DESCR
 /begin FUNCTION_LIST KF7-312.6[34] KF7-330.9[8] KF7-340.9M[3] KF7-360.9M[43] KF7-385.1[32] /end FUNCTION_LIST
/end CHARACTERISTIC
/begin CHARACTERISTIC mFCPTN1 "Torque compensation requirement composition fuel cut pattern" CURVE 0x0000C96C REC_UBYTE_C 0 COMP_0068 0 255
 /begin AXIS_DESCR FIX_AXIS NO_INPUT_QUANTITY COMP_0310_S 6 1 6 FIX_AXIS_PAR_DIST 0 1 6 /end AXIS_DESCR
 /begin FUNCTION_LIST KF7-312.6[34] /end FUNCTION_LIST
/end CHARACTERISTIC
/begin CHARACTERISTIC mTAFSFTL "At the time of the lean, shift learning quantity RrO2 sensor voltage layout table" CURVE 0x0000E4CA REC_UWORD_C 0 COMP_0453 0 131.07
 /begin AXIS_DESCR COM_AXIS NO_INPUT_QUANTITY COMP_0023 8 0 327675 AXIS_PTS_REF mTXAFSFTL /end AXIS_DESCR
 /begin FUNCTION_LIST KF7-313C.1[36] /end FUNCTION_LIST
/end CHARACTERISTIC
/begin CHARACTERISTIC mTAFSFTR "At the time of the rich, shift learning quantity RrO2 sensor voltage layout table" CURVE 0x0000E4DA REC_UWORD_C 0 COMP_0453 0 131.07
 /begin AXIS_DESCR COM_AXIS NO_INPUT_QUANTITY COMP_0023 8 0 327675 AXIS_PTS_REF mTXAFSFTR /end AXIS_DESCR
 /begin FUNCTION_LIST KF7-313C.1[36] /end FUNCTION_LIST
/end CHARACTERISTIC
/begin CHARACTERISTIC mTDKASSIN "After the start, decrease rate table (at the time of the start, coolant temperature reference)" CURVE 0x0000E8CA REC_UWORD_C 0 COMP_0099 0 3.999941832
 /begin AXIS_DESCR FIX_AXIS NO_INPUT_QUANTITY COMP_0278_S 8 -40 100 FIX_AXIS_PAR_DIST 0 1 8 /end AXIS_DESCR
 /begin FUNCTION_LIST KF7-312.3A[27] /end FUNCTION_LIST
/end CHARACTERISTIC
/begin CHARACTERISTIC mTDVDG "Vehicle speed sensor trouble judgement engine speed table" CURVE 0x0000D026 REC_UBYTE_C 0 COMP_0000 0 6375
 /begin AXIS_DESCR FIX_AXIS NO_INPUT_QUANTITY COMP_0122_S 8 0 14 FIX_AXIS_PAR_DIST 0 1 8 /end AXIS_DESCR
 /begin FUNCTION_LIST KF7-312.6[34] /end FUNCTION_LIST
/end CHARACTERISTIC
/begin CHARACTERISTIC mTFCSOKTP "A table for the catalyst protection fuel cut region judgement" CURVE 0x0000D0B6 REC_UBYTE_C 0 COMP_0001 0 31.875
 /begin AXIS_DESCR COM_AXIS NO_INPUT_QUANTITY COMP_0000 8 0 6375 AXIS_PTS_REF mNFSOKI /end AXIS_DESCR
 /begin FUNCTION_LIST KF7-312.6[34] /end FUNCTION_LIST
/end CHARACTERISTIC
/begin CHARACTERISTIC mTFPON "Fuel rise waiting time table" CURVE 0x0000D0D6 REC_UBYTE_C 0 COMP_0014 0 2550
 /begin AXIS_DESCR FIX_AXIS NO_INPUT_QUANTITY COMP_0278_S 8 -40 100 FIX_AXIS_PAR_DIST 0 1 8 /end AXIS_DESCR
 /begin FUNCTION_LIST KF7-311.1A[21] /end FUNCTION_LIST
/end CHARACTERISTIC
/begin CHARACTERISTIC mTGHFQC "Slowdown loss in weight compensation rate load clause" CURVE 0x0000D106 REC_UBYTE_C 0 COMP_0044 0 1.9921875
 /begin AXIS_DESCR FIX_AXIS NO_INPUT_QUANTITY COMP_0279_S 8 0 87.5 FIX_AXIS_PAR_DIST 0 1 8 /end AXIS_DESCR
 /begin FUNCTION_LIST KF7-312.4A[6] KF7-312.4C[4] /end FUNCTION_LIST
/end CHARACTERISTIC
/begin CHARACTERISTIC mTGZAS "At the time of a CHOSn temperature non-balance, compensation rate" CURVE 0x0000D13E REC_UBYTE_C 0 COMP_0066 0 3.984375
 /begin AXIS_DESCR FIX_AXIS NO_INPUT_QUANTITY COMP_0278_S 8 -40 100 FIX_AXIS_PAR_DIST 0 1 8 /end AXIS_DESCR
 /begin FUNCTION_LIST KF7-312.4A[6] KF7-312.4C[4] KF7-312.5C[1] /end FUNCTION_LIST
/end CHARACTERISTIC
/begin CHARACTERISTIC mTGZMN "A wall way compensation magnification (slowdown) rotation compensation table by the cylinder" CURVE 0x0000D156 REC_UBYTE_C 0 COMP_0045 0 1.9921875
 /begin AXIS_DESCR FIX_AXIS NO_INPUT_QUANTITY COMP_0312_S 8 0 5600 FIX_AXIS_PAR_DIST 0 1 8 /end AXIS_DESCR
 /begin FUNCTION_LIST KF7-312.4C[4] /end FUNCTION_LIST
/end CHARACTERISTIC
/begin CHARACTERISTIC mTGZN "An interrupt injection compensation magnification rotation compensation rate by the cylinder" CURVE 0x0000D15E REC_UBYTE_C 0 COMP_0045 0 1.9921875
 /begin AXIS_DESCR FIX_AXIS NO_INPUT_QUANTITY COMP_0312_S 8 0 5600 FIX_AXIS_PAR_DIST 0 1 8 /end AXIS_DESCR
 /begin FUNCTION_LIST KF7-312.5C[1] /end FUNCTION_LIST
/end CHARACTERISTIC
/begin CHARACTERISTIC mTGZPN "A wall way compensation magnification (acceleration) rotation compensation table by the cylinder" CURVE 0x0000D166 REC_UBYTE_C 0 COMP_0045 0 1.9921875
 /begin AXIS_DESCR FIX_AXIS NO_INPUT_QUANTITY COMP_0312_S 8 0 5600 FIX_AXIS_PAR_DIST 0 1 8 /end AXIS_DESCR
 /begin FUNCTION_LIST KF7-312.4C[4] /end FUNCTION_LIST
/end CHARACTERISTIC
/begin CHARACTERISTIC mTGZTP "A wall way compensation magnification load compensation table by the cylinder" CURVE 0x0000D16E REC_UBYTE_C 0 COMP_0045 0 1.9921875
 /begin AXIS_DESCR FIX_AXIS NO_INPUT_QUANTITY COMP_0122_S 8 0 14 FIX_AXIS_PAR_DIST 0 1 8 /end AXIS_DESCR
 /begin FUNCTION_LIST KF7-312.4C[4] /end FUNCTION_LIST
/end CHARACTERISTIC
/begin CHARACTERISTIC mTGZTW "Interrupt injection compensation magnification by the cylinder" CURVE 0x0000D176 REC_UBYTE_C 0 COMP_0092_S 0 5.1
 /begin AXIS_DESCR FIX_AXIS NO_INPUT_QUANTITY COMP_0278_S 8 -40 100 FIX_AXIS_PAR_DIST 0 1 8 /end AXIS_DESCR
 /begin FUNCTION_LIST KF7-312.5C[1] /end FUNCTION_LIST
/end CHARACTERISTIC
/begin CHARACTERISTIC mTGZTWMM "A wall way compensation magnification (slowdown) table by the cylinder" CURVE 0x0000D18E REC_UBYTE_C 0 COMP_0092_S 0 5.1
 /begin AXIS_DESCR FIX_AXIS NO_INPUT_QUANTITY COMP_0278_S 8 -40 100 FIX_AXIS_PAR_DIST 0 1 8 /end AXIS_DESCR
 /begin FUNCTION_LIST KF7-312.4C[4] /end FUNCTION_LIST
/end CHARACTERISTIC
/begin CHARACTERISTIC mTGZTWPP "A wall way compensation magnification (acceleration) table by the cylinder" CURVE 0x0000D19E REC_UBYTE_C 0 COMP_0092_S 0 5.1
 /begin AXIS_DESCR FIX_AXIS NO_INPUT_QUANTITY COMP_0278_S 8 -40 100 FIX_AXIS_PAR_DIST 0 1 8 /end AXIS_DESCR
 /begin FUNCTION_LIST KF7-312.4C[4] /end FUNCTION_LIST
/end CHARACTERISTIC
/begin CHARACTERISTIC mTHAOSC "O2 adsorption rate table" CURVE 0x0000EA5A REC_UWORD_C 0 COMP_0456 0 1.999970916
 /begin AXIS_DESCR COM_AXIS NO_INPUT_QUANTITY COMP_0518_S 8 -83886.08 83883.52 AXIS_PTS_REF mTXHAOSC /end AXIS_DESCR
 /begin FUNCTION_LIST KF7-313C.1[36] /end FUNCTION_LIST
/end CHARACTERISTIC
/begin CHARACTERISTIC mTHATMP "Catalyst temperature O2 adsorption rate table" CURVE 0x0000D1AE REC_UBYTE_C 0 COMP_0045 0 1.9921875
 /begin AXIS_DESCR COM_AXIS NO_INPUT_QUANTITY COMP_0062 8 0 1020 AXIS_PTS_REF mTXHATMP /end AXIS_DESCR
 /begin FUNCTION_LIST KF7-313C.1[36] /end FUNCTION_LIST
/end CHARACTERISTIC
/begin CHARACTERISTIC mTHROSC "O2 release rate table" CURVE 0x0000EA6A REC_UWORD_C 0 COMP_0456 0 1.999970916
 /begin AXIS_DESCR COM_AXIS NO_INPUT_QUANTITY COMP_0518_S 8 -83886.08 83883.52 AXIS_PTS_REF mTXHROSC /end AXIS_DESCR
 /begin FUNCTION_LIST KF7-313C.1[36] /end FUNCTION_LIST
/end CHARACTERISTIC
/begin CHARACTERISTIC mTHRTMP "Catalyst temperature O2 release rate table" CURVE 0x0000D23A REC_UBYTE_C 0 COMP_0045 0 1.9921875
 /begin AXIS_DESCR COM_AXIS NO_INPUT_QUANTITY COMP_0062 8 0 1020 AXIS_PTS_REF mTXHRTMP /end AXIS_DESCR
 /begin FUNCTION_LIST KF7-313C.1[36] /end FUNCTION_LIST
/end CHARACTERISTIC
/begin CHARACTERISTIC mTINJTRT "At the time of the full increase, TITM table" CURVE 0x0000D282 REC_UBYTE_C 0 COMP_0055 0 1020
 /begin AXIS_DESCR FIX_AXIS NO_INPUT_QUANTITY COMP_0312_S 8 0 5600 FIX_AXIS_PAR_DIST 0 1 8 /end AXIS_DESCR
 /begin FUNCTION_LIST KF7-311.1A[21] R301.10.TITM_1_0_2 /end FUNCTION_LIST
/end CHARACTERISTIC
/begin CHARACTERISTIC mTKHTTW1 "A high coolant temperature increase compensation table" CURVE 0x0000D3B2 REC_UBYTE_C 0 COMP_0045 0 1.9921875
 /begin AXIS_DESCR FIX_AXIS NO_INPUT_QUANTITY COMP_0520_S 8 80 115 FIX_AXIS_PAR_DIST 0 1 8 /end AXIS_DESCR
 /begin FUNCTION_LIST KF7-312.3A[27] R301.7.KHOT_1_0_2 /end FUNCTION_LIST
/end CHARACTERISTIC
/begin CHARACTERISTIC mTKMFAS "Temperature non-balance time quantity rate compensation rate" CURVE 0x0000D3BA REC_UBYTE_C 0 COMP_0066 0 3.984375
 /begin AXIS_DESCR FIX_AXIS NO_INPUT_QUANTITY COMP_0278_S 8 -40 100 FIX_AXIS_PAR_DIST 0 1 8 /end AXIS_DESCR
 /begin FUNCTION_LIST KF7-312.4A[6] KF7-312.4C[4] /end FUNCTION_LIST
/end CHARACTERISTIC
/begin CHARACTERISTIC mTKMFN "Quantity rate rotation compensation rate" CURVE 0x0000D3C2 REC_UBYTE_C 0 COMP_0044 0 1.9921875
 /begin AXIS_DESCR FIX_AXIS NO_INPUT_QUANTITY COMP_0312_S 8 0 5600 FIX_AXIS_PAR_DIST 0 1 8 /end AXIS_DESCR
 /begin FUNCTION_LIST KF7-312.4A[6] KF7-312.4C[4] /end FUNCTION_LIST
/end CHARACTERISTIC
/begin CHARACTERISTIC mTKUBAS "Temperature non-balance basic table" CURVE 0x0000D4BA REC_UBYTE_C 0 COMP_0044 0 1.9921875
 /begin AXIS_DESCR FIX_AXIS NO_INPUT_QUANTITY COMP_0278_S 8 -40 100 FIX_AXIS_PAR_DIST 0 1 8 /end AXIS_DESCR
 /begin FUNCTION_LIST KF7-312.3A[27] /end FUNCTION_LIST
/end CHARACTERISTIC
/begin CHARACTERISTIC mTKUBIC2 "Temperature non-balance load table" CURVE 0x0000D4CA REC_UBYTE_C 0 COMP_0066 0 3.984375
 /begin AXIS_DESCR COM_AXIS NO_INPUT_QUANTITY COMP_0009 8 0 199.21875 AXIS_PTS_REF mLKUBIC /end AXIS_DESCR
 /begin FUNCTION_LIST KF7-312.3A[27] /end FUNCTION_LIST
/end CHARACTERISTIC
/begin CHARACTERISTIC mTKUBN2 "Temperature non-balance rotation table" CURVE 0x0000D4DA REC_UBYTE_C 0 COMP_0066 0 3.984375
 /begin AXIS_DESCR COM_AXIS NO_INPUT_QUANTITY COMP_0000 8 0 6375 AXIS_PTS_REF mLKUBN /end AXIS_DESCR
 /begin FUNCTION_LIST KF7-312.3A[27] /end FUNCTION_LIST
/end CHARACTERISTIC
/begin CHARACTERISTIC mTLABFLL "A target A/F setup table for a LSOSQ release" CURVE 0x0000EB12 REC_UWORD_C 0 COMP_0453 0 131.07
 /begin AXIS_DESCR COM_AXIS NO_INPUT_QUANTITY COMP_0518_S 8 -83886.08 83883.52 AXIS_PTS_REF mLABFLL /end AXIS_DESCR
 /begin FUNCTION_LIST KF7-313C.1[36] /end FUNCTION_LIST
/end CHARACTERISTIC
/begin CHARACTERISTIC mTMFHNK "Adhesion magnification rotation compensation rate" CURVE 0x0000EB42 REC_UWORD_C 0 COMP_0069 0 1.999970916
 /begin AXIS_DESCR FIX_AXIS NO_INPUT_QUANTITY COMP_0312_S 8 0 5600 FIX_AXIS_PAR_DIST 0 1 8 /end AXIS_DESCR
 /begin FUNCTION_LIST KF7-312.4A[6] KF7-312.4C[4] /end FUNCTION_LIST
/end CHARACTERISTIC
/begin CHARACTERISTIC mTMKN "Minus KTW rotation compensation value table" CURVE 0x0000D580 REC_UBYTE_C 0 COMP_0032 0 0.99609375
 /begin AXIS_DESCR FIX_AXIS NO_INPUT_QUANTITY COMP_0271_S 8 0 2800 FIX_AXIS_PAR_DIST 0 1 8 /end AXIS_DESCR
 /begin FUNCTION_LIST KF7-312.3A[27] /end FUNCTION_LIST
/end CHARACTERISTIC
/begin CHARACTERISTIC mTMKTP "Minus KTW TP compensation value table" CURVE 0x0000D588 REC_UBYTE_C 0 COMP_0032 0 0.99609375
 /begin AXIS_DESCR FIX_AXIS NO_INPUT_QUANTITY COMP_0122_S 8 0 14 FIX_AXIS_PAR_DIST 0 1 8 /end AXIS_DESCR
 /begin FUNCTION_LIST KF7-312.3A[27] /end FUNCTION_LIST
/end CHARACTERISTIC
/begin CHARACTERISTIC mTNDCTCL "At the time of KT low oil temperature, at the time of the ND select, fuel cut rotation table" CURVE 0x0000D5E4 REC_UBYTE_C 0 COMP_0000 0 6375
 /begin AXIS_DESCR FIX_AXIS NO_INPUT_QUANTITY COMP_0128_S 8 -30 5 FIX_AXIS_PAR_DIST 0 1 8 /end AXIS_DESCR
 /begin FUNCTION_LIST KF7-312.6[34] /end FUNCTION_LIST
/end CHARACTERISTIC
/begin CHARACTERISTIC mTNDRCL "At the time of KT low oil temperature, at the time of the ND select, recover rotation table" CURVE 0x0000D5EC REC_UBYTE_C 0 COMP_0000 0 6375
 /begin AXIS_DESCR FIX_AXIS NO_INPUT_QUANTITY COMP_0128_S 8 -30 5 FIX_AXIS_PAR_DIST 0 1 8 /end AXIS_DESCR
 /begin FUNCTION_LIST KF7-312.6[34] /end FUNCTION_LIST
/end CHARACTERISTIC
/begin CHARACTERISTIC mTOFOIL "At the time of KT low oil temperature, a high rotation fuel cut condition oil temperature table" CURVE 0x0000D6C8 REC_UBYTE_C 0 COMP_0128_S -30 1245
 /begin AXIS_DESCR FIX_AXIS NO_INPUT_QUANTITY COMP_0128_S 8 -30 5 FIX_AXIS_PAR_DIST 0 1 8 /end AXIS_DESCR
 /begin FUNCTION_LIST KF7-312.6[34] /end FUNCTION_LIST
/end CHARACTERISTIC
/begin CHARACTERISTIC mTQAIGN "An integral gain QA compensation table" CURVE 0x0000ED52 REC_UWORD_C 0 COMP_0388 0 6553.5
 /begin AXIS_DESCR COM_AXIS NO_INPUT_QUANTITY COMP_0220 8 0 65535 AXIS_PTS_REF mLQARANGE /end AXIS_DESCR
 /begin FUNCTION_LIST KF7-313C.1[36] /end FUNCTION_LIST
/end CHARACTERISTIC
/begin CHARACTERISTIC mTQO2S "At the time of the diagnosis rich, the amount of lack of O2" CURVE 0x0000EEA2 REC_UWORD_C 0 COMP_0068 0 65535
 /begin AXIS_DESCR COM_AXIS NO_INPUT_QUANTITY COMP_0068 8 0 65535 AXIS_PTS_REF mLTQO2S /end AXIS_DESCR
 /begin FUNCTION_LIST KF7-313C.1[36] /end FUNCTION_LIST
/end CHARACTERISTIC
/begin CHARACTERISTIC mTQO2S2 "At the time of the diagnosis rich, O2 deficiency quantity (Bank2)" CURVE 0x0000EEB2 REC_UWORD_C 0 COMP_0068 0 65535
 /begin AXIS_DESCR COM_AXIS NO_INPUT_QUANTITY COMP_0068 8 0 65535 AXIS_PTS_REF mLTQO2S /end AXIS_DESCR
 /begin FUNCTION_LIST KF7-313C.1[36] /end FUNCTION_LIST
/end CHARACTERISTIC
/begin CHARACTERISTIC mTRCSOKTP "A table for the catalyst protection fuel cut recover region judgement" CURVE 0x0000D7DC REC_UBYTE_C 0 COMP_0001 0 31.875
 /begin AXIS_DESCR COM_AXIS NO_INPUT_QUANTITY COMP_0000 8 0 6375 AXIS_PTS_REF mNFSOKO /end AXIS_DESCR
 /begin FUNCTION_LIST KF7-312.6[34] /end FUNCTION_LIST
/end CHARACTERISTIC
/begin CHARACTERISTIC mTSAOSC "LSOSQ O2 adsorption rate table" CURVE 0x0000F0F6 REC_UWORD_C 0 COMP_0456 0 1.999970916
 /begin AXIS_DESCR COM_AXIS NO_INPUT_QUANTITY COMP_0518_S 8 -83886.08 83883.52 AXIS_PTS_REF mTXSAOSC /end AXIS_DESCR
 /begin FUNCTION_LIST KF7-313C.1[36] /end FUNCTION_LIST
/end CHARACTERISTIC
/begin CHARACTERISTIC mTSATMP "LSOSQ catalyst temperature O2 adsorption rate table" CURVE 0x0000D8AA REC_UBYTE_C 0 COMP_0045 0 1.9921875
 /begin AXIS_DESCR COM_AXIS NO_INPUT_QUANTITY COMP_0062 8 0 1020 AXIS_PTS_REF mTXSATMP /end AXIS_DESCR
 /begin FUNCTION_LIST KF7-313C.1[36] /end FUNCTION_LIST
/end CHARACTERISTIC
/begin CHARACTERISTIC mTSROSC "LSOSQ O2 release rate table" CURVE 0x0000F18E REC_UWORD_C 0 COMP_0456 0 1.999970916
 /begin AXIS_DESCR COM_AXIS NO_INPUT_QUANTITY COMP_0518_S 8 -83886.08 83883.52 AXIS_PTS_REF mTXSROSC /end AXIS_DESCR
 /begin FUNCTION_LIST KF7-313C.1[36] /end FUNCTION_LIST
/end CHARACTERISTIC
/begin CHARACTERISTIC mTSRTMP "LSOSQ catalyst temperature O2 release rate table" CURVE 0x0000D8E2 REC_UBYTE_C 0 COMP_0045 0 1.9921875
 /begin AXIS_DESCR COM_AXIS NO_INPUT_QUANTITY COMP_0062 8 0 1020 AXIS_PTS_REF mTXSRTMP /end AXIS_DESCR
 /begin FUNCTION_LIST KF7-313C.1[36] /end FUNCTION_LIST
/end CHARACTERISTIC
/begin CHARACTERISTIC mTSTBTW "Stability compensation rate basic table" CURVE 0x0000D8EA REC_UBYTE_C 0 COMP_0044 0 1.9921875
 /begin AXIS_DESCR FIX_AXIS NO_INPUT_QUANTITY COMP_0278_S 8 -40 100 FIX_AXIS_PAR_DIST 0 1 8 /end AXIS_DESCR
 /begin FUNCTION_LIST KF7-312.3A[27] /end FUNCTION_LIST
/end CHARACTERISTIC
/begin CHARACTERISTIC mTTEMHOS "After F/C, EM compensation table" CURVE 0x0000F26E REC_UWORD_C 0 COMP_0217 0 3.999941832
 /begin AXIS_DESCR COM_AXIS NO_INPUT_QUANTITY COMP_0518_S 8 -83886.08 83883.52 AXIS_PTS_REF mLHSOSQ /end AXIS_DESCR
 /begin FUNCTION_LIST KF7-312.3A[27] /end FUNCTION_LIST
/end CHARACTERISTIC
/begin CHARACTERISTIC mTTGTGIN "Target A/F P-gain table" CURVE 0x0000F33E REC_UWORD_C 0 COMP_0217 0 3.999941832
 /begin AXIS_DESCR COM_AXIS NO_INPUT_QUANTITY COMP_0068 8 0 65535 AXIS_PTS_REF mTXGTGIN /end AXIS_DESCR
 /begin FUNCTION_LIST KF7-313C.1[36] /end FUNCTION_LIST
/end CHARACTERISTIC
/begin CHARACTERISTIC mTTGTGIN2 "Target A/F P-gain table (bank2)" CURVE 0x0000F34E REC_UWORD_C 0 COMP_0217 0 3.999941832
 /begin AXIS_DESCR COM_AXIS NO_INPUT_QUANTITY COMP_0068 8 0 65535 AXIS_PTS_REF mTXGTGIN /end AXIS_DESCR
 /begin FUNCTION_LIST KF7-313C.1[36] /end FUNCTION_LIST
/end CHARACTERISTIC
/begin CHARACTERISTIC mTTINJDTW "Retard maintenance coolant temperature rise quantity computed table" CURVE 0x0000DA7A REC_UBYTE_C 0 COMP_0003 0 255
 /begin AXIS_DESCR COM_AXIS NO_INPUT_QUANTITY COMP_0035 8 -50 205 AXIS_PTS_REF mLTINJDTW /end AXIS_DESCR
 /begin FUNCTION_LIST KF7-311.1A[21] /end FUNCTION_LIST
/end CHARACTERISTIC
/begin CHARACTERISTIC mTZIDL "IDLHOS gain coolant temperature table" CURVE 0x0000DDF6 REC_UBYTE_C 0 COMP_0186 0 3.984375
 /begin AXIS_DESCR FIX_AXIS NO_INPUT_QUANTITY COMP_0278_S 8 -40 100 FIX_AXIS_PAR_DIST 0 1 8 /end AXIS_DESCR
 /begin FUNCTION_LIST KF7-312.1C[N] /end FUNCTION_LIST
/end CHARACTERISTIC
/begin CHARACTERISTIC mTRECNE "É¢Ne recover speed table" CURVE 0x0000D7F4 REC_UBYTE_C 0 COMP_0000 0 6375
 /begin AXIS_DESCR COM_AXIS NO_INPUT_QUANTITY COMP_0006 4 0 3187.5 AXIS_PTS_REF mNEDWN /end AXIS_DESCR
 /begin FUNCTION_LIST KF7-312.4A[6] KF7-312.4C[4] KF7-312.6[34] KF7-330.5[53] /end FUNCTION_LIST
/end CHARACTERISTIC
/begin CHARACTERISTIC mfOVHEAT "0:Not DGN  1:DGN" VALUE 0x0001020D REC_UBYTE_C 0 COMP_0283 0 1 BIT_MASK 0x0001 /begin FUNCTION_LIST KF7-312.6[34] KF7-500.2A[29] /end FUNCTION_LIST /end CHARACTERISTIC
/begin CHARACTERISTIC mfCAT1NG "0:Not DGN  1:DGN" VALUE 0x00010212 REC_UBYTE_C 0 COMP_0283 0 1 BIT_MASK 0x0040
 /begin FUNCTION_LIST KF7-313C.1[36] KF7-500.2A[29] KF7-500.21[19] R904.1.Gst_on_can_1_0_1 Rxxx.2.Integration_Diagnostic_cycle_1_1_1 /end FUNCTION_LIST
/end CHARACTERISTIC
/begin CHARACTERISTIC mfCAT2NG "0:Not DGN  1:DGN" VALUE 0x00010212 REC_UBYTE_C 0 COMP_0283 0 1 BIT_MASK 0x0020
 /begin FUNCTION_LIST KF7-313C.1[36] KF7-500.2A[29] KF7-500.21[19] R904.1.Gst_on_can_1_0_1 Rxxx.2.Integration_Diagnostic_cycle_1_1_1 /end FUNCTION_LIST
/end CHARACTERISTIC
/begin CHARACTERISTIC mfTHOPNG "0:Not DGN  1:DGN" VALUE 0x00010230 REC_UBYTE_C 0 COMP_0283 0 1 BIT_MASK 0x0020
 /begin FUNCTION_LIST KF7-312.6[34] KF7-500.2A[29] KF7-505.33[8] KF7-505.34[3] KF7-525.2[6] KF7-525.2S[10] /end FUNCTION_LIST
/end CHARACTERISTIC
/begin AXIS_PTS mKHOTN "50rpm" 0x0000CA93 NO_INPUT_QUANTITY REC_AXIS_UBYTE 0 COMP_0020 4 0 12750 /end AXIS_PTS
/begin AXIS_PTS mKHTTP "1/128-" 0x0000CA97 NO_INPUT_QUANTITY REC_AXIS_UBYTE 0 COMP_0045 4 0 1.9921875 /end AXIS_PTS
/begin AXIS_PTS mNKUBTW "50rpm" 0x0000CC3C NO_INPUT_QUANTITY REC_AXIS_UBYTE 0 COMP_0020 4 0 12750 /end AXIS_PTS
/begin AXIS_PTS mLKUBTW "1/256Å|" 0x0000CACB NO_INPUT_QUANTITY REC_AXIS_UBYTE 0 COMP_0032 4 0 0.99609375 /end AXIS_PTS
/begin AXIS_PTS mMXABFSFT "12.5rpm" 0x0000E26C NO_INPUT_QUANTITY REC_AXIS_UWORD 0 COMP_0006 8 0 819187.5 /end AXIS_PTS
/begin AXIS_PTS mMYABFSFT "1/2048ms" 0x0000E28C NO_INPUT_QUANTITY REC_AXIS_UWORD 0 COMP_0144 8 0 31.999495335 /end AXIS_PTS
/begin AXIS_PTS mTXAFSFT "x-50Åé" 0x0000F5CE NO_INPUT_QUANTITY REC_AXIS_UWORD 0 COMP_0035 16 -50 65485 /end AXIS_PTS
/begin AXIS_PTS mTXCLABF "2.5mv" 0x0000F60E NO_INPUT_QUANTITY REC_AXIS_UWORD 0 COMP_0370 16 0 163837.5 /end AXIS_PTS
/begin AXIS_PTS mLHPAMB "20mV" 0x0000CAAB NO_INPUT_QUANTITY REC_AXIS_UBYTE 0 COMP_0054 16 0 5100 /end AXIS_PTS
/begin AXIS_PTS mTWKINT "X-50Åé" 0x0000DDAE NO_INPUT_QUANTITY REC_AXIS_UBYTE 0 COMP_0035 16 -50 205 /end AXIS_PTS
/begin AXIS_PTS mLTQHOS "1-" 0x0000E1E0 NO_INPUT_QUANTITY REC_AXIS_UWORD 0 COMP_0068 16 0 65535 /end AXIS_PTS
/begin AXIS_PTS mTXAFSFTL "5mV" 0x0000F5EE NO_INPUT_QUANTITY REC_AXIS_UWORD 0 COMP_0023 8 0 327675 /end AXIS_PTS
/begin AXIS_PTS mTXAFSFTR "5mV" 0x0000F5FE NO_INPUT_QUANTITY REC_AXIS_UWORD 0 COMP_0023 8 0 327675 /end AXIS_PTS
/begin AXIS_PTS mNFSOKI "25rpm" 0x0000CC1C NO_INPUT_QUANTITY REC_AXIS_UBYTE 0 COMP_0000 8 0 6375 /end AXIS_PTS
/begin AXIS_PTS mTXHAOSC "2.56mg" 0x0000F63E NO_INPUT_QUANTITY REC_AXIS_UWORD 0 COMP_0518_S 8 -83886.08 83883.52 /end AXIS_PTS
/begin AXIS_PTS mTXHATMP "4Åé" 0x0000DDCE NO_INPUT_QUANTITY REC_AXIS_UBYTE 0 COMP_0062 8 0 1020 /end AXIS_PTS
/begin AXIS_PTS mTXHROSC "2.56mg" 0x0000F64E NO_INPUT_QUANTITY REC_AXIS_UWORD 0 COMP_0518_S 8 -83886.08 83883.52 /end AXIS_PTS
/begin AXIS_PTS mTXHRTMP "4Åé" 0x0000DDD6 NO_INPUT_QUANTITY REC_AXIS_UBYTE 0 COMP_0062 8 0 1020 /end AXIS_PTS
/begin AXIS_PTS mLKUBIC "100/128%" 0x0000CABB NO_INPUT_QUANTITY REC_AXIS_UBYTE 0 COMP_0009 8 0 199.21875 /end AXIS_PTS
/begin AXIS_PTS mLKUBN "25rpm" 0x0000CAC3 NO_INPUT_QUANTITY REC_AXIS_UBYTE 0 COMP_0000 8 0 6375 /end AXIS_PTS
/begin AXIS_PTS mLABFLL "2.56mg" 0x0000E0D0 NO_INPUT_QUANTITY REC_AXIS_UWORD 0 COMP_0518_S 8 -83886.08 83883.52 /end AXIS_PTS
/begin AXIS_PTS mLQARANGE "1l/min" 0x0000E190 NO_INPUT_QUANTITY REC_AXIS_UWORD 0 COMP_0220 8 0 65535 /end AXIS_PTS
/begin AXIS_PTS mLTQO2S "1-" 0x0000E200 NO_INPUT_QUANTITY REC_AXIS_UWORD 0 COMP_0068 8 0 65535 /end AXIS_PTS
/begin AXIS_PTS mNFSOKO "25rpm" 0x0000CC24 NO_INPUT_QUANTITY REC_AXIS_UBYTE 0 COMP_0000 8 0 6375 /end AXIS_PTS
/begin AXIS_PTS mTXSAOSC "2.56mg" 0x0000F65E NO_INPUT_QUANTITY REC_AXIS_UWORD 0 COMP_0518_S 8 -83886.08 83883.52 /end AXIS_PTS
/begin AXIS_PTS mTXSATMP "4Åé" 0x0000DDE6 NO_INPUT_QUANTITY REC_AXIS_UBYTE 0 COMP_0062 8 0 1020 /end AXIS_PTS
/begin AXIS_PTS mTXSROSC "2.56mg" 0x0000F66E NO_INPUT_QUANTITY REC_AXIS_UWORD 0 COMP_0518_S 8 -83886.08 83883.52 /end AXIS_PTS
/begin AXIS_PTS mTXSRTMP "4Åé" 0x0000DDEE NO_INPUT_QUANTITY REC_AXIS_UBYTE 0 COMP_0062 8 0 1020 /end AXIS_PTS
/begin AXIS_PTS mLHSOSQ "2.56mg" 0x0000E160 NO_INPUT_QUANTITY REC_AXIS_UWORD 0 COMP_0518_S 8 -83886.08 83883.52 /end AXIS_PTS
/begin AXIS_PTS mTXGTGIN "1-" 0x0000F62E NO_INPUT_QUANTITY REC_AXIS_UWORD 0 COMP_0068 8 0 65535 /end AXIS_PTS
/begin AXIS_PTS mLTINJDTW "X-50Åé" 0x0000CB07 NO_INPUT_QUANTITY REC_AXIS_UBYTE 0 COMP_0035 8 -50 205 /end AXIS_PTS
/begin AXIS_PTS mNEDWN "12.5rpm" 0x0000CBF9 NO_INPUT_QUANTITY REC_AXIS_UBYTE 0 COMP_0006 4 0 3187.5 /end AXIS_PTS
/begin MEASUREMENT fABFCMP "0:ñ⁄ïWA/Få≈íËêßå‰ïsê¨óß  1:ñ⁄ïWA/Få≈íËêßå‰íÜ" UBYTE COMP_0283 1 100 0 1 BIT_MASK 0x0002 ECU_ADDRESS 0xFFFF10DC /begin FUNCTION_LIST KF7-313C.1[36] KF7-313C.5[3] KF7-313C.6[5] /end FUNCTION_LIST /end MEASUREMENT
/begin MEASUREMENT fAFSCLP "0:ïsê¨óß  1:ê¨óß" UBYTE COMP_0283 1 100 0 1 BIT_MASK 0x0002 ECU_ADDRESS 0xFFFF111D /begin FUNCTION_LIST KF7-312.3A[27] KF7-313C.1[36] /end FUNCTION_LIST /end MEASUREMENT
/begin MEASUREMENT bfALPCAL "0:ââéZÇµÇƒÇ»Ç¢  1:ââéZÇµÇΩ" UBYTE COMP_0283 1 100 0 1 BIT_MASK 0x0002 ECU_ADDRESS 0xFFFF22BD /begin FUNCTION_LIST KF7-313C.1[36] /end FUNCTION_LIST /end MEASUREMENT
/begin MEASUREMENT fALPLME "0:-  1:ALPHAÿ–Ø¿ìûíBÃ◊∏ﬁ" UBYTE COMP_0283 1 100 0 1 BIT_MASK 0x0002 ECU_ADDRESS 0xFFFF114A /begin FUNCTION_LIST KF7-313C.1[36] KF7-313C.11B[1] /end FUNCTION_LIST /end MEASUREMENT
/begin MEASUREMENT fASHLGO "0:A/Fæ›ªäwèKïsãñâ¬  1:A/Fæ›ªäwèKãñâ¬" UBYTE COMP_0283 1 100 0 1 BIT_MASK 0x0002 ECU_ADDRESS 0xFFFF288B /begin FUNCTION_LIST KF7-313C.1[36] KF7-313C.4[3] KF7-500.75[4] /end FUNCTION_LIST /end MEASUREMENT
/begin MEASUREMENT fCATCNG "0:ïsê¨óß  1:ê¨óß" UBYTE COMP_0283 1 100 0 1 BIT_MASK 0x0002 ECU_ADDRESS 0xFFFF294B /begin FUNCTION_LIST KF7-313C.1[36] /end FUNCTION_LIST /end MEASUREMENT
/begin MEASUREMENT fCATDGNST "0:ïsê¨óß  1:ê¨óß" UBYTE COMP_0283 1 100 0 1 BIT_MASK 0x0002 ECU_ADDRESS 0xFFFF294C /begin FUNCTION_LIST KF7-313C.1[36] /end FUNCTION_LIST /end MEASUREMENT
/begin MEASUREMENT fDRVJUG "0:â^ì]ê´ëŒçÙóÃàÊà»äO  1:â^ì]ê´ëŒçÙóÃàÊ" UBYTE COMP_0283 1 100 0 1 BIT_MASK 0x0002 ECU_ADDRESS 0xFFFF2AA7 /begin FUNCTION_LIST KF7-313C.1[36] /end FUNCTION_LIST /end MEASUREMENT
/begin MEASUREMENT fFCUTRCV "0:-  1:AFSHOSçXêVãñâ¬ÉtÉâÉO" UBYTE COMP_0283 1 100 0 1 BIT_MASK 0x0002 ECU_ADDRESS 0xFFFF2D30 /begin FUNCTION_LIST KF7-313C.1[36] KF7-313C.4[3] KF7-313C.5[3] /end FUNCTION_LIST /end MEASUREMENT
/begin MEASUREMENT fHIAIRFC "0:ïsê¨óß  1:ê¨óß" UBYTE COMP_0283 1 100 0 1 BIT_MASK 0x0002 ECU_ADDRESS 0xFFFF1406 /begin FUNCTION_LIST KF7-313C.1[36] /end FUNCTION_LIST /end MEASUREMENT
/begin MEASUREMENT fINTGSTP "0:ïsê¨óß  1:ê¨óß" UBYTE COMP_0283 1 100 0 1 BIT_MASK 0x0002 ECU_ADDRESS 0xFFFF2E60 /begin FUNCTION_LIST KF7-313C.1[36] KF7-313C.11B[1] /end FUNCTION_LIST /end MEASUREMENT
/begin MEASUREMENT fLJUDGE "0:-  1:AFSHOSçXêVãñâ¬ÉtÉâÉO" UBYTE COMP_0283 1 100 0 1 BIT_MASK 0x0002 ECU_ADDRESS 0xFFFF2EAA /begin FUNCTION_LIST KF7-313C.1[36] KF7-313C.4[3] KF7-313C.5[3] /end FUNCTION_LIST /end MEASUREMENT
/begin MEASUREMENT bfLMCLST "0:∏€∞ΩﬁäJénëO  1:∏€∞ΩﬁäJénå„" UBYTE COMP_0283 1 100 0 1 BIT_MASK 0x0002 ECU_ADDRESS 0xFFFF22A5 /begin FUNCTION_LIST KF7-312.3A[27] KF7-313C.1[36] /end FUNCTION_LIST /end MEASUREMENT
/begin MEASUREMENT fLMDCLP "0:OPEN  1:CLOSE" UBYTE COMP_0283 1 100 0 1 BIT_MASK 0x0002 ECU_ADDRESS 0xFFFF152E /begin FUNCTION_LIST KF7-313C.1[36] KF7-313C.6[5] KF7-500.21[19] /end FUNCTION_LIST /end MEASUREMENT
/begin MEASUREMENT bfLMDCLS "0:OPEN  1:CLOSE" UBYTE COMP_0283 1 100 0 1 BIT_MASK 0x0002 ECU_ADDRESS 0xFFFF22A6
 /begin FUNCTION_LIST KF7-312.3A[27] KF7-313C.1[36] KF7-313C.4[3] KF7-313C.5[3] KF7-314.1F[1] KF7-330.5[53] KF7-500.21[19] KF7-500.76[8] /end FUNCTION_LIST
/end MEASUREMENT
/begin MEASUREMENT bfLMDRCH "0:ÿ∞›  1:ÿØ¡" UBYTE COMP_0283 1 100 0 1 BIT_MASK 0x0002 ECU_ADDRESS 0xFFFF22A7 /begin FUNCTION_LIST KF7-313C.1[36] /end FUNCTION_LIST /end MEASUREMENT
/begin MEASUREMENT fLNRSET "0:ÿæØƒíÜÇ≈Ç»Ç¢  1:ÿæØƒíÜ" UBYTE COMP_0283 1 100 0 1 BIT_MASK 0x0002 ECU_ADDRESS 0xFFFF2EB8 /begin FUNCTION_LIST KF7-313C.1[36] KF7-313C.4[3] KF7-500.21[19] /end FUNCTION_LIST /end MEASUREMENT
/begin MEASUREMENT fMCLPEKB "0:îÒ”∆¿∏◊›Ãﬂ->”∆¿∏◊›Ãﬂïsê¨óß  1:îÒ”∆¿∏◊›Ãﬂ->”∆¿∏◊›Ãﬂê¨óß" UBYTE COMP_0283 1 100 0 1 BIT_MASK 0x0002 ECU_ADDRESS 0xFFFF2EFA /begin FUNCTION_LIST KF7-313C.1[36] KF7-314.1F[1] /end FUNCTION_LIST /end MEASUREMENT
/begin MEASUREMENT bfMOPEN "0:ñ¢î≠ê∂  1:î≠ê∂" UBYTE COMP_0283 1 100 0 1 BIT_MASK 0x0002 ECU_ADDRESS 0xFFFF22A8 /begin FUNCTION_LIST KF7-313C.1[36] KF7-314.1F[1] KF7-500.24[10] /end FUNCTION_LIST /end MEASUREMENT
/begin MEASUREMENT fOSCON "0:-  1:AFSHOSçXêVãñâ¬ÉtÉâÉO" UBYTE COMP_0283 1 100 0 1 BIT_MASK 0x0002 ECU_ADDRESS 0xFFFF3054
 /begin FUNCTION_LIST KF7-313C.1[36] KF7-313C.4[3] KF7-313C.5[3] KF7-313C.6[5] KF7-500.21[19] /end FUNCTION_LIST
/end MEASUREMENT
/begin MEASUREMENT fOSQRST "0:éûä‘åvë™  1:åvë™éûä‘ÿæØƒ" UBYTE COMP_0283 1 100 0 1 BIT_MASK 0x0002 ECU_ADDRESS 0xFFFF3055 /begin FUNCTION_LIST KF7-313C.1[36] /end FUNCTION_LIST /end MEASUREMENT
/begin MEASUREMENT fOSREL1 "0:âΩÇ‡ÇµÇ»Ç¢  1:åvéZ" UBYTE COMP_0283 1 100 0 1 BIT_MASK 0x0002 ECU_ADDRESS 0xFFFF3056 /begin FUNCTION_LIST KF7-313C.1[36] /end FUNCTION_LIST /end MEASUREMENT
/begin MEASUREMENT fOSRER1 "0:âΩÇ‡ÇµÇ»Ç¢  1:åvéZ" UBYTE COMP_0283 1 100 0 1 BIT_MASK 0x0002 ECU_ADDRESS 0xFFFF3057 /begin FUNCTION_LIST KF7-313C.1[36] /end FUNCTION_LIST /end MEASUREMENT
/begin MEASUREMENT fRCRSET "0:ÿæØƒíÜÇ≈Ç»Ç¢  1:ÿæØƒíÜ" UBYTE COMP_0283 1 100 0 1 BIT_MASK 0x0002 ECU_ADDRESS 0xFFFF30F8 /begin FUNCTION_LIST KF7-313C.1[36] KF7-313C.4[3] KF7-500.21[19] /end FUNCTION_LIST /end MEASUREMENT
/begin MEASUREMENT fRICH "0:ÿ∞›  1:ÿØ¡" UBYTE COMP_0283 1 100 0 1 BIT_MASK 0x0002 ECU_ADDRESS 0xFFFF220E
 /begin FUNCTION_LIST KF7-313C.1[36] KF7-313C.9[3] KF7-314.1F[1] KF7-500.1[54] KF7-500.2A[29] KF7-500.20B[4] KF7-500.24[10] KF7-500.39[5] /end FUNCTION_LIST
/end MEASUREMENT
/begin MEASUREMENT fRJUDGE "0:-  1:AFSHOSçXêVãñâ¬ÉtÉâÉO" UBYTE COMP_0283 1 100 0 1 BIT_MASK 0x0002 ECU_ADDRESS 0xFFFF313E /begin FUNCTION_LIST KF7-313C.1[36] KF7-313C.4[3] KF7-313C.5[3] /end FUNCTION_LIST /end MEASUREMENT
/begin MEASUREMENT fRO2FBCLP "0:âEãLà»äO  1:F/BíÜ" UBYTE COMP_0283 1 100 0 1 BIT_MASK 0x0002 ECU_ADDRESS 0xFFFF26E7
 /begin FUNCTION_LIST KF7-313C.1[36] KF7-313C.4[3] KF7-313C.5[3] KF7-313C.6[5] KF7-313C.9[3] /end FUNCTION_LIST
/end MEASUREMENT
/begin MEASUREMENT afRO2HON "0:OFF  1:ON" UBYTE COMP_0283 1 100 0 1 BIT_MASK 0x0002 ECU_ADDRESS 0xFFFF2358 /begin FUNCTION_LIST KF7-313C.1[36] KF7-378.2B[6] /end FUNCTION_LIST /end MEASUREMENT
/begin MEASUREMENT fRO2HON "0:OFF  1:ON" UBYTE COMP_0283 1 100 0 1 BIT_MASK 0x0002 ECU_ADDRESS 0xFFFF2406 /begin FUNCTION_LIST KF7-313C.1[36] KF7-378.2B[6] /end FUNCTION_LIST /end MEASUREMENT
/begin MEASUREMENT fRO2INT "0:≤∆º¨◊≤Ωﬁñ¢óπ  1:≤∆º¨◊≤ΩﬁäÆóπ" UBYTE COMP_0283 1 100 0 1 BIT_MASK 0x0002 ECU_ADDRESS 0xFFFF1766
 /begin FUNCTION_LIST KF7-313C.1[36] KF7-313C.4[3] KF7-313C.5[3] KF7-313C.6[5] KF7-378.2B[6] KF7-500.21[19] /end FUNCTION_LIST
/end MEASUREMENT
/begin MEASUREMENT fRSPKRPM "0:ïsê¨óß  1:ê¨óß" UBYTE COMP_0283 1 100 0 1 BIT_MASK 0x0002 ECU_ADDRESS 0xFFFF1775 /begin FUNCTION_LIST KF7-313C.1[36] /end FUNCTION_LIST /end MEASUREMENT
/begin MEASUREMENT fTGAFCMP "0:ïsê¨óß  1:ê¨óß" UBYTE COMP_0283 1 100 0 1 BIT_MASK 0x0002 ECU_ADDRESS 0xFFFF32FC /begin FUNCTION_LIST KF7-313C.1[36] KF7-313C.4[3] /end FUNCTION_LIST /end MEASUREMENT
/begin MEASUREMENT wfCANICNG "CAN initial diagnosis NG notice flag" UBYTE COMP_0283 1 100 0 1 BIT_MASK 0x0080 ECU_ADDRESS 0xFFFF49C9
 /begin FUNCTION_LIST KF7-312.6[34] KF7-340.13[4] KF7-360.9M[43] KF7-385.2[18] KF7-500.69[25] KF7-580.1[8] /end FUNCTION_LIST
/end MEASUREMENT
/begin MEASUREMENT wfIMMFCUT "Fuel cut requirement flag" UBYTE COMP_0283 1 100 0 1 BIT_MASK 0x0004 ECU_ADDRESS 0xFFFF49D0 /begin FUNCTION_LIST KF7-312.6[34] /end FUNCTION_LIST /end MEASUREMENT
/begin MEASUREMENT fCANICNG "CAN initial diagnosis NG notice flag" UBYTE COMP_0283 1 100 0 1 BIT_MASK 0x0080 ECU_ADDRESS 0xFFFF49D9
 /begin FUNCTION_LIST KF7-312.6[34] KF7-330.4A[53] KF7-340.13[4] KF7-360.9M[43] KF7-385.2[18] KF7-410.21[3] KF7-500.69[25] KF7-580.1[8] /end FUNCTION_LIST
/end MEASUREMENT
/begin MEASUREMENT fIMMFCUT "Fuel cut requirement flag" UBYTE COMP_0283 1 100 0 1 BIT_MASK 0x0004 ECU_ADDRESS 0xFFFF49E0 /begin FUNCTION_LIST KF7-312.6[34] /end FUNCTION_LIST /end MEASUREMENT
/begin MEASUREMENT fFLEAN "Lean/stoichiometric map switching flag" UBYTE COMP_0283 1 100 0 1 BIT_MASK 0x0080 ECU_ADDRESS 0xFFFF4278 /begin FUNCTION_LIST KF7-312.2A[16] KF7-320A.9[9] KF7-379.2[1] KF7-580.1[8] /end FUNCTION_LIST /end MEASUREMENT
/begin MEASUREMENT fFEGRDN "Electric EGR/V breakage indication flag" UBYTE COMP_0283 1 100 0 1 BIT_MASK 0x0020 ECU_ADDRESS 0xFFFF42B0 /begin FUNCTION_LIST KF7-312.6[34] /end FUNCTION_LIST /end MEASUREMENT
/begin MEASUREMENT fFLAIR "Air trouble tense flag" UBYTE COMP_0283 1 100 0 1 BIT_MASK 0x0004 ECU_ADDRESS 0xFFFF42B7
 /begin FUNCTION_LIST KF7-312.6[34] KF7-320A.13[N] KF7-330.4A[53] KF7-393.1C[8] KF7-450.3[1] R000.1.RS_Integ_1_10_2 /end FUNCTION_LIST
/end MEASUREMENT
/begin MEASUREMENT fFLBURN "Combustion trouble tense flag" UBYTE COMP_0283 1 100 0 1 BIT_MASK 0x0002 ECU_ADDRESS 0xFFFF42B7
 /begin FUNCTION_LIST KF7-312.6[34] KF7-320A.13[N] KF7-330.4A[53] KF7-393.1C[8] KF7-450.1[N] KF7-500.1[54] R000.1.RS_Integ_1_10_2 /end FUNCTION_LIST
/end MEASUREMENT
/begin MEASUREMENT fFLFUEL "Fuel trouble tense flag" UBYTE COMP_0283 1 100 0 1 BIT_MASK 0x0010 ECU_ADDRESS 0xFFFF42B8
 /begin FUNCTION_LIST KF7-312.6[34] KF7-320A.13[N] KF7-330.4A[53] KF7-450.2[1] KF7-500.1[54] R000.1.RS_Integ_1_10_2 /end FUNCTION_LIST
/end MEASUREMENT
/begin MEASUREMENT fFLIGN "Ignition trouble tense flag" UBYTE COMP_0283 1 100 0 1 BIT_MASK 0x0002 ECU_ADDRESS 0xFFFF42B8
 /begin FUNCTION_LIST KF7-312.6[34] KF7-320A.13[N] KF7-330.4A[53] KF7-450.4[1] KF7-500.1[54] R000.1.RS_Integ_1_10_2 /end FUNCTION_LIST
/end MEASUREMENT
/begin MEASUREMENT fFLOCK1 "An urgent slowdown tense 1 condition judgement flag" UBYTE COMP_0283 1 100 0 1 BIT_MASK 0x0040 ECU_ADDRESS 0xFFFF42B9 /begin FUNCTION_LIST KF7-312.6[34] /end FUNCTION_LIST /end MEASUREMENT
/begin MEASUREMENT fFNGATV "At the time of the vehicle speed sensor trouble, fuel cut fail flag" UBYTE COMP_0283 1 100 0 1 BIT_MASK 0x0002 ECU_ADDRESS 0xFFFF42BB /begin FUNCTION_LIST KF7-312.6[34] /end FUNCTION_LIST /end MEASUREMENT
/begin MEASUREMENT fFTOIL "TOILST fixed flag" UBYTE COMP_0283 1 100 0 1 BIT_MASK 0x0040 ECU_ADDRESS 0xFFFF42C2 /begin FUNCTION_LIST KF7-312.6[34] KF7-360.9M[43] /end FUNCTION_LIST /end MEASUREMENT
/begin MEASUREMENT fNOVHFC "NOVHFC# hysteresis flag" UBYTE COMP_0283 1 100 0 1 BIT_MASK 0x0004 ECU_ADDRESS 0xFFFF42D8 /begin FUNCTION_LIST KF7-312.6[34] /end FUNCTION_LIST /end MEASUREMENT
/begin MEASUREMENT fPVTCTRG "The test requirement flag that PS-VTCTRG is active" UBYTE COMP_0283 1 100 0 1 BIT_MASK 0x0040 ECU_ADDRESS 0xFFFF42E6 /begin FUNCTION_LIST KF7-313C.1[36] /end FUNCTION_LIST /end MEASUREMENT
/begin MEASUREMENT fTINJRCV "Retard compensation recover flag" UBYTE COMP_0283 1 100 0 1 BIT_MASK 0x0040 ECU_ADDRESS 0xFFFF42F4 /begin FUNCTION_LIST KF7-311.1A[21] /end FUNCTION_LIST /end MEASUREMENT
/begin MEASUREMENT fTWOVH "TWOVH# hysteresis flag" UBYTE COMP_0283 1 100 0 1 BIT_MASK 0x0002 ECU_ADDRESS 0xFFFF42F6 /begin FUNCTION_LIST KF7-312.6[34] /end FUNCTION_LIST /end MEASUREMENT
/begin MEASUREMENT afREQREV "Speed control executive flag" UBYTE COMP_0283 1 100 0 1 BIT_MASK 0x0004 ECU_ADDRESS 0xFFFF4357 /begin FUNCTION_LIST KF7-312.2A[16] KF7-360.12[6] /end FUNCTION_LIST /end MEASUREMENT
/begin MEASUREMENT fREQREV "Speed control executive flag" UBYTE COMP_0283 1 100 0 1 BIT_MASK 0x0004 ECU_ADDRESS 0xFFFF4368
 /begin FUNCTION_LIST KF7-312.2A[16] KF7-360.12[6] R301.9.Target_Equivalent_Ratio_1_0_2 /end FUNCTION_LIST
/end MEASUREMENT
/begin MEASUREMENT wfOILPNG "An idle UP requirement signal by the oil pressure unusual time" UBYTE COMP_0283 1 100 0 1 BIT_MASK 0x0008 ECU_ADDRESS 0xFFFF8A90 /begin FUNCTION_LIST KF7-312.6[34] KF7-330.4A[53] /end FUNCTION_LIST /end MEASUREMENT
/begin MEASUREMENT fOILPNG "An idle UP requirement signal by the oil pressure unusual time" UBYTE COMP_0283 1 100 0 1 BIT_MASK 0x0008 ECU_ADDRESS 0xFFFF8A93 /begin FUNCTION_LIST KF7-312.6[34] KF7-330.4A[53] /end FUNCTION_LIST /end MEASUREMENT
/begin MEASUREMENT bfFLUP "During lockup, control condition formation flag" UBYTE COMP_0283 1 100 0 1 BIT_MASK 0x0080 ECU_ADDRESS 0xFFFF2454 /begin FUNCTION_LIST KF7-312.6[34] KF7-385.1[32] R301.5.FuelCut_1_2_2 /end FUNCTION_LIST /end MEASUREMENT
/begin MEASUREMENT bfFREVRS "Reverse judgement flag" UBYTE COMP_0283 1 100 0 1 BIT_MASK 0x0002 ECU_ADDRESS 0xFFFF2456 /begin FUNCTION_LIST KF7-312.6[34] KF7-376.2[21] /end FUNCTION_LIST /end MEASUREMENT
/begin MEASUREMENT bfFULTVO "A full increase judgement" UBYTE COMP_0283 1 100 0 1 BIT_MASK 0x0001 ECU_ADDRESS 0xFFFF2456 /begin FUNCTION_LIST KF7-312.3A[27] KF7-500.7[12] /end FUNCTION_LIST /end MEASUREMENT
/begin MEASUREMENT fCLTFB0 "CLOSED LOOP for the catalyst early activated control, TFBYA condition" UBYTE COMP_0283 1 100 0 1 BIT_MASK 0x0040 ECU_ADDRESS 0xFFFF246A /begin FUNCTION_LIST KF7-313C.1[36] /end FUNCTION_LIST /end MEASUREMENT
/begin MEASUREMENT fEXNFC "Continuous NO. Load high rotation cut judgement" UBYTE COMP_0283 1 100 0 1 BIT_MASK 0x0008 ECU_ADDRESS 0xFFFF2475 /begin FUNCTION_LIST KF7-312.6[34] /end FUNCTION_LIST /end MEASUREMENT
/begin MEASUREMENT fFAACOF "(UJ-QA-95-002)" UBYTE COMP_0283 1 100 0 1 BIT_MASK 0x0040 ECU_ADDRESS 0xFFFF2476 /begin FUNCTION_LIST KF7-312.2A[16] /end FUNCTION_LIST /end MEASUREMENT
/begin MEASUREMENT fFCGAKTW "A hysteresis flag for the GAK2 computation" UBYTE COMP_0283 1 100 0 1 BIT_MASK 0x0004 ECU_ADDRESS 0xFFFF2477 /begin FUNCTION_LIST KF7-312.4A[6] /end FUNCTION_LIST /end MEASUREMENT
/begin MEASUREMENT fFKMRDTO "Delta-TVO judgement flag" UBYTE COMP_0283 1 100 0 1 BIT_MASK 0x0008 ECU_ADDRESS 0xFFFF247D /begin FUNCTION_LIST KF7-312.2A[16] R301.9.Target_Equivalent_Ratio_1_0_2 /end FUNCTION_LIST /end MEASUREMENT
/begin MEASUREMENT fFKMRLM "At the time of use of KMR map value, flag" UBYTE COMP_0283 1 100 0 1 BIT_MASK 0x0004 ECU_ADDRESS 0xFFFF247D
 /begin FUNCTION_LIST KF7-312.2A[16] KF7-386.1[4] R301.9.Target_Equivalent_Ratio_1_0_2 /end FUNCTION_LIST
/end MEASUREMENT
/begin MEASUREMENT fFLNST "Lean switchover, stoichiometric switchover judgement flag" UBYTE COMP_0283 1 100 0 1 BIT_MASK 0x0004 ECU_ADDRESS 0xFFFF247E /begin FUNCTION_LIST KF7-312.2A[16] /end FUNCTION_LIST /end MEASUREMENT
/begin MEASUREMENT fFPTNHI "T/M requirement fuel cut condition flag" UBYTE COMP_0283 1 100 0 1 BIT_MASK 0x0004 ECU_ADDRESS 0xFFFF2480 /begin FUNCTION_LIST KF7-312.6[34] /end FUNCTION_LIST /end MEASUREMENT
/begin MEASUREMENT fFRMKN "Hysteresis flag" UBYTE COMP_0283 1 100 0 1 BIT_MASK 0x0020 ECU_ADDRESS 0xFFFF2481 /begin FUNCTION_LIST KF7-312.3A[27] KF7-320A.12[N] /end FUNCTION_LIST /end MEASUREMENT
/begin MEASUREMENT fFRVSP "Hysteresis flag" UBYTE COMP_0283 1 100 0 1 BIT_MASK 0x0002 ECU_ADDRESS 0xFFFF2481 /begin FUNCTION_LIST KF7-312.6[34] KF7-385.1[32] /end FUNCTION_LIST /end MEASUREMENT
/begin MEASUREMENT fFRVSP1 "Hysteresis flag" UBYTE COMP_0283 1 100 0 1 BIT_MASK 0x0001 ECU_ADDRESS 0xFFFF2481 /begin FUNCTION_LIST KF7-312.6[34] KF7-385.1[32] /end FUNCTION_LIST /end MEASUREMENT
/begin MEASUREMENT fFVTCOK "VTC operation OK flag" UBYTE COMP_0283 1 100 0 1 BIT_MASK 0x0008 ECU_ADDRESS 0xFFFF2485 /begin FUNCTION_LIST KF7-313C.1[36] KF7-393.1C[8] KF7-500.7[12] KF7-580.1[8] /end FUNCTION_LIST /end MEASUREMENT
/begin MEASUREMENT fFVTCOKE "VTC drive permission condition flag" UBYTE COMP_0283 1 100 0 1 BIT_MASK 0x0004 ECU_ADDRESS 0xFFFF2485 /begin FUNCTION_LIST KF7-313C.1[36] KF7-580.1[8] /end FUNCTION_LIST /end MEASUREMENT
/begin MEASUREMENT fGHFSCV "-" UBYTE COMP_0283 1 100 0 1 BIT_MASK 0x0080 ECU_ADDRESS 0xFFFF2486 /begin FUNCTION_LIST KF7-312.4A[6] KF7-312.4C[4] /end FUNCTION_LIST /end MEASUREMENT
/begin MEASUREMENT fGZTWQH "GZTWQH switching flag" UBYTE COMP_0283 1 100 0 1 BIT_MASK 0x0004 ECU_ADDRESS 0xFFFF2486 /begin FUNCTION_LIST KF7-312.5A[4] KF7-312.5C[1] /end FUNCTION_LIST /end MEASUREMENT
/begin MEASUREMENT fIJSLLI "GZTWQI# addition condition áB formation flag" UBYTE COMP_0283 1 100 0 1 BIT_MASK 0x0008 ECU_ADDRESS 0xFFFF2488 /begin FUNCTION_LIST KF7-312.5A[4] KF7-312.5C[1] /end FUNCTION_LIST /end MEASUREMENT
/begin MEASUREMENT fKMRNE1 "KMR delay rotation condition" UBYTE COMP_0283 1 100 0 1 BIT_MASK 0x0080 ECU_ADDRESS 0xFFFF248B /begin FUNCTION_LIST KF7-312.3A[27] /end FUNCTION_LIST /end MEASUREMENT
/begin MEASUREMENT fKMRNE2 "KMR delay rotation condition" UBYTE COMP_0283 1 100 0 1 BIT_MASK 0x0040 ECU_ADDRESS 0xFFFF248B /begin FUNCTION_LIST KF7-312.3A[27] /end FUNCTION_LIST /end MEASUREMENT
/begin MEASUREMENT fKTAPLT "Change rate limiter control-in-progress flag" UBYTE COMP_0283 1 100 0 1 BIT_MASK 0x0001 ECU_ADDRESS 0xFFFF248B /begin FUNCTION_LIST KF7-312.6[34] KF7-360.9M[43] /end FUNCTION_LIST /end MEASUREMENT
/begin MEASUREMENT fKTAPOF "TRQKT1 torque going down control-in-progress flag" UBYTE COMP_0283 1 100 0 1 BIT_MASK 0x0080 ECU_ADDRESS 0xFFFF248C /begin FUNCTION_LIST KF7-312.6[34] KF7-360.9M[43] /end FUNCTION_LIST /end MEASUREMENT
/begin MEASUREMENT fLMDCPM "CLOSED LOOP control permission judgement" UBYTE COMP_0283 1 100 0 1 BIT_MASK 0x0080 ECU_ADDRESS 0xFFFF248D /begin FUNCTION_LIST KF7-312.3A[27] KF7-313C.1[36] /end FUNCTION_LIST /end MEASUREMENT
/begin MEASUREMENT fMDLCNGE "Reference model switching flag" UBYTE COMP_0283 1 100 0 1 BIT_MASK 0x0010 ECU_ADDRESS 0xFFFF248E /begin FUNCTION_LIST KF7-313C.1[36] /end FUNCTION_LIST /end MEASUREMENT
/begin MEASUREMENT fMKTVO "Minus KTW TVO" UBYTE COMP_0283 1 100 0 1 BIT_MASK 0x0001 ECU_ADDRESS 0xFFFF248E /begin FUNCTION_LIST KF7-312.3A[27] /end FUNCTION_LIST /end MEASUREMENT
/begin MEASUREMENT fNMAX2 "At the time of the high rotation, all the cylinder cut judgements" UBYTE COMP_0283 1 100 0 1 BIT_MASK 0x0080 ECU_ADDRESS 0xFFFF2490 /begin FUNCTION_LIST KF7-312.6[34] /end FUNCTION_LIST /end MEASUREMENT
/begin MEASUREMENT fOILCLD "At the time of KT low oil temperature, control-in-progress flag" UBYTE COMP_0283 1 100 0 1 BIT_MASK 0x0080 ECU_ADDRESS 0xFFFF2492 /begin FUNCTION_LIST KF7-312.6[34] KF7-360.9M[43] /end FUNCTION_LIST /end MEASUREMENT
/begin MEASUREMENT fPVTCTRGE "The test requirement exhaust side where an electromagnetic type is active" UBYTE COMP_0283 1 100 0 1 BIT_MASK 0x0010 ECU_ADDRESS 0xFFFF2497 /begin FUNCTION_LIST KF7-313C.1[36] /end FUNCTION_LIST /end MEASUREMENT
/begin MEASUREMENT fSONITC "-" UBYTE COMP_0283 1 100 0 1 BIT_MASK 0x0002 ECU_ADDRESS 0xFFFF249B /begin FUNCTION_LIST KF7-312.4A[6] KF7-312.4C[4] /end FUNCTION_LIST /end MEASUREMENT
/begin MEASUREMENT fTEMIN "(TP*TFBYA+KATHOS) In the case of *MKINJ<=TEMIN#, DIG, TP*TFBYAX+KATHOS*KINJ<=TIMIN#" UBYTE COMP_0283 1 100 0 1 BIT_MASK 0x0080 ECU_ADDRESS 0xFFFF249E /begin FUNCTION_LIST KF7-312.1C[N] KF7-313C.1[36] KF7-371.1E[15] /end FUNCTION_LIST /end MEASUREMENT
/begin MEASUREMENT fTWKMR "KMR delay prohibition coolant temperature condition" UBYTE COMP_0283 1 100 0 1 BIT_MASK 0x0001 ECU_ADDRESS 0xFFFF24A1 /begin FUNCTION_LIST KF7-312.2A[16] KF7-312.3A[27] /end FUNCTION_LIST /end MEASUREMENT
/begin MEASUREMENT fVSPCT2 "At the time of the high vehicle speed, all the cylinder cut judgements" UBYTE COMP_0283 1 100 0 1 BIT_MASK 0x0040 ECU_ADDRESS 0xFFFF24A6 /begin FUNCTION_LIST KF7-312.6[34] /end FUNCTION_LIST /end MEASUREMENT
/begin MEASUREMENT fVSPKAP "KAP addition vehicle speed upper limit" UBYTE COMP_0283 1 100 0 1 BIT_MASK 0x0010 ECU_ADDRESS 0xFFFF24A6 /begin FUNCTION_LIST KF7-312.2A[16] KF7-312.3A[27] /end FUNCTION_LIST /end MEASUREMENT
/begin MEASUREMENT fVTCTWL "A coolant temperature lower limit hysteresis flag for the VTC condition" UBYTE COMP_0283 1 100 0 1 BIT_MASK 0x0080 ECU_ADDRESS 0xFFFF24A9 /begin FUNCTION_LIST KF7-311.1A[21] KF7-320A.22[5] KF7-393.1C[8] /end FUNCTION_LIST /end MEASUREMENT
/begin MEASUREMENT tTAFHDLY "Heater diagnosis judgement start timer" UBYTE COMP_0201_S 1 100 0 255 ECU_ADDRESS 0xFFFF43E9 /begin FUNCTION_LIST KF7-313C.1[36] KF7-500.59[6] /end FUNCTION_LIST /end MEASUREMENT
/begin MEASUREMENT tTMOVNG "Overheat judgement delay timer" UBYTE COMP_0202_S 1 100 0 255 ECU_ADDRESS 0xFFFF4529 /begin FUNCTION_LIST KF7-312.6[34] /end FUNCTION_LIST /end MEASUREMENT
/begin MEASUREMENT tTWNGTM "The delay timer which unusually judges a coolant temperature sensor" UBYTE COMP_0202_S 1 100 0 255 ECU_ADDRESS 0xFFFF4563 /begin FUNCTION_LIST KF7-312.6[34] /end FUNCTION_LIST /end MEASUREMENT
/begin MEASUREMENT tTWOKTM "The release delay timer which unusually judges a coolant temperature sensor" UBYTE COMP_0202_S 1 100 0 255 ECU_ADDRESS 0xFFFF4564 /begin FUNCTION_LIST KF7-312.6[34] /end FUNCTION_LIST /end MEASUREMENT
/begin MEASUREMENT tSPDCFCD "After speed control, timer" UBYTE COMP_0203_S 1 100 0 255 ECU_ADDRESS 0xFFFF4605 /begin FUNCTION_LIST KF7-312.6[34] /end FUNCTION_LIST /end MEASUREMENT
/begin MEASUREMENT tDMFSTD "Self-excited vibration judgement condition START SW delay timer" UWORD COMP_0203_S 1 100 0 65535 ECU_ADDRESS 0xFFFF46E4 /begin FUNCTION_LIST KF7-312.6[34] /end FUNCTION_LIST /end MEASUREMENT
/begin MEASUREMENT tDLOPEN "After the CLOSE control switchover start, time timer" UBYTE COMP_0201_S 1 100 0 255 ECU_ADDRESS 0xFFFF24E2 /begin FUNCTION_LIST KF7-313C.1[36] /end FUNCTION_LIST /end MEASUREMENT
/begin MEASUREMENT tITRTM "After an injection timing change starts, delay timer" UBYTE COMP_0201_S 1 100 0 255 ECU_ADDRESS 0xFFFF24EE /begin FUNCTION_LIST KF7-311.1A[21] /end FUNCTION_LIST /end MEASUREMENT
/begin MEASUREMENT tMKTM "After minus KTW addition judgement ST/SW off, progress time" UBYTE COMP_0201_S 1 100 0 255 ECU_ADDRESS 0xFFFF24F0 /begin FUNCTION_LIST KF7-312.3A[27] /end FUNCTION_LIST /end MEASUREMENT
/begin MEASUREMENT tTNCUTD "At the time of all the cylinder high rotation, delay" UBYTE COMP_0201_S 1 100 0 255 ECU_ADDRESS 0xFFFF2514 /begin FUNCTION_LIST KF7-312.6[34] /end FUNCTION_LIST /end MEASUREMENT
/begin MEASUREMENT tTPOTM1 "A delay timer for the low-load high rotation stage fuel cut region 1 judgement" UBYTE COMP_0201_S 1 100 0 255 ECU_ADDRESS 0xFFFF2517 /begin FUNCTION_LIST KF7-312.6[34] /end FUNCTION_LIST /end MEASUREMENT
/begin MEASUREMENT tTPOTM2 "A delay timer for the low-load high rotation stage fuel cut region 2 judgement" UBYTE COMP_0201_S 1 100 0 255 ECU_ADDRESS 0xFFFF2518 /begin FUNCTION_LIST KF7-312.6[34] /end FUNCTION_LIST /end MEASUREMENT
/begin MEASUREMENT tTVCUTD "At the time of all the cylinder high vehicle speeds, delay" UBYTE COMP_0201_S 1 100 0 255 ECU_ADDRESS 0xFFFF251B /begin FUNCTION_LIST KF7-312.6[34] /end FUNCTION_LIST /end MEASUREMENT
/begin MEASUREMENT tATGDLY "AT gear position judgement delay timer" UBYTE COMP_0202_S 1 100 0 255 ECU_ADDRESS 0xFFFF2528 /begin FUNCTION_LIST KF7-312.6[34] /end FUNCTION_LIST /end MEASUREMENT
/begin MEASUREMENT tDLYKAP "The exhaust the second air increase delay timer" UBYTE COMP_0202_S 1 100 0 255 ECU_ADDRESS 0xFFFF2536 /begin FUNCTION_LIST KF7-312.3A[27] /end FUNCTION_LIST /end MEASUREMENT
/begin MEASUREMENT tKMRHT "At the time of the start, TFBYA0 maintenance time" UBYTE COMP_0202_S 1 100 0 255 ECU_ADDRESS 0xFFFF2566 /begin FUNCTION_LIST KF7-312.2A[16] /end FUNCTION_LIST /end MEASUREMENT
/begin MEASUREMENT tLMDPMD "CLOSE control compulsory start delay" UBYTE COMP_0202_S 1 100 0 255 ECU_ADDRESS 0xFFFF2567 /begin FUNCTION_LIST KF7-313C.1[36] /end FUNCTION_LIST /end MEASUREMENT
/begin MEASUREMENT tNGTIME "The judgement delay whose VTC maximum-retard degree diagnosis reference position is unusual" UBYTE COMP_0202_S 1 100 0 255 ECU_ADDRESS 0xFFFF2571 /begin FUNCTION_LIST KF7-313C.1[36] /end FUNCTION_LIST /end MEASUREMENT
/begin MEASUREMENT tNMAX0 "Vehicle speed 0km /h cut-in delay" UBYTE COMP_0202_S 1 100 0 255 ECU_ADDRESS 0xFFFF2575 /begin FUNCTION_LIST KF7-312.6[34] /end FUNCTION_LIST /end MEASUREMENT
/begin MEASUREMENT tPBFCD "PB fuel cut judgement delay" UBYTE COMP_0202_S 1 100 0 255 ECU_ADDRESS 0xFFFF2578 /begin FUNCTION_LIST KF7-312.6[34] /end FUNCTION_LIST /end MEASUREMENT
/begin MEASUREMENT tTDMNCL "After the monitor clamp, CLOSE control prohibition time" UBYTE COMP_0202_S 1 100 0 255 ECU_ADDRESS 0xFFFF2598 /begin FUNCTION_LIST KF7-313C.1[36] /end FUNCTION_LIST /end MEASUREMENT
/begin MEASUREMENT tTMAS "KTST1 judgement timer" UBYTE COMP_0202_S 1 100 0 255 ECU_ADDRESS 0xFFFF25A8 /begin FUNCTION_LIST KF7-312.1C[N] /end FUNCTION_LIST /end MEASUREMENT
/begin MEASUREMENT tTMDVDG "Vehicle speed sensor trouble judgement delay" UBYTE COMP_0202_S 1 100 0 255 ECU_ADDRESS 0xFFFF25A9 /begin FUNCTION_LIST KF7-312.6[34] /end FUNCTION_LIST /end MEASUREMENT
/begin MEASUREMENT tTPFCD "TP fuel cut judgement delay" UBYTE COMP_0202_S 1 100 0 255 ECU_ADDRESS 0xFFFF25B4 /begin FUNCTION_LIST KF7-312.6[34] /end FUNCTION_LIST /end MEASUREMENT
/begin MEASUREMENT tCFCD "Half-cylinder F/C delay timer" UBYTE COMP_0203_S 1 100 0 255 ECU_ADDRESS 0xFFFF25D3
 /begin FUNCTION_LIST KF7-312.6[34] KF7-385.1[32] KF7-390.3A[15] R301.5.FuelCut_1_2_2 R301.23.ADV_calculation_1_1_2 /end FUNCTION_LIST
/end MEASUREMENT
/begin MEASUREMENT tCFCD2 "All the cylinder F/C delay timers" UBYTE COMP_0203_S 1 100 0 255 ECU_ADDRESS 0xFFFF25D4
 /begin FUNCTION_LIST KF7-312.6[34] KF7-385.1[32] KF7-390.3A[15] R301.5.FuelCut_1_2_2 R301.23.ADV_calculation_1_1_2 /end FUNCTION_LIST
/end MEASUREMENT
/begin MEASUREMENT tDMFTIM "At the time of the self-excited vibration, fuel cut timer" UBYTE COMP_0203_S 1 100 0 255 ECU_ADDRESS 0xFFFF25E7 /begin FUNCTION_LIST KF7-312.6[34] /end FUNCTION_LIST /end MEASUREMENT
/begin MEASUREMENT tDMFTMM "Self-excited vibration periodic measuring timer" UBYTE COMP_0203_S 1 100 0 255 ECU_ADDRESS 0xFFFF25E8 /begin FUNCTION_LIST KF7-312.6[34] /end FUNCTION_LIST /end MEASUREMENT
/begin MEASUREMENT tEXNFC "One-second judgement timer" UBYTE COMP_0203_S 1 100 0 255 ECU_ADDRESS 0xFFFF25FF /begin FUNCTION_LIST KF7-312.6[34] /end FUNCTION_LIST /end MEASUREMENT
/begin MEASUREMENT tGHFSCV "A progress timer from SCV opening and closing" UBYTE COMP_0203_S 1 100 0 255 ECU_ADDRESS 0xFFFF2601 /begin FUNCTION_LIST KF7-312.4A[6] KF7-312.4C[4] /end FUNCTION_LIST /end MEASUREMENT
/begin MEASUREMENT tITRTFL "TITM full increase treatment full figure quantity delay timer" UBYTE COMP_0203_S 1 100 0 255 ECU_ADDRESS 0xFFFF2606 /begin FUNCTION_LIST KF7-311.1A[21] /end FUNCTION_LIST /end MEASUREMENT
/begin MEASUREMENT tPSRTMR "PSR control start judgement timer" UBYTE COMP_0203_S 1 100 0 255 ECU_ADDRESS 0xFFFF261F /begin FUNCTION_LIST KF7-312.6[34] /end FUNCTION_LIST /end MEASUREMENT
/begin MEASUREMENT tSHOKTP "A delay timer for the catalyst protection fuel cut region judgement" UBYTE COMP_0203_S 1 100 0 255 ECU_ADDRESS 0xFFFF263B /begin FUNCTION_LIST KF7-312.6[34] /end FUNCTION_LIST /end MEASUREMENT
/begin MEASUREMENT tTGZDLY "Transient state judgement completion delay timer" UBYTE COMP_0203_S 1 100 0 255 ECU_ADDRESS 0xFFFF264C /begin FUNCTION_LIST KF7-312.5A[4] KF7-312.5C[1] /end FUNCTION_LIST /end MEASUREMENT
/begin MEASUREMENT tUNLOCK "Non-lockup judgement time" UBYTE COMP_0203_S 1 100 0 255 ECU_ADDRESS 0xFFFF267F /begin FUNCTION_LIST KF7-312.6[34] /end FUNCTION_LIST /end MEASUREMENT
/begin MEASUREMENT cCLPCD "Slowdown lean clamp release delay" UBYTE COMP_0191 1 100 0 255 ECU_ADDRESS 0xFFFF2698 /begin FUNCTION_LIST KF7-313C.1[36] /end FUNCTION_LIST /end MEASUREMENT
/begin MEASUREMENT cCLPD "Slowdown lean clamp delay" UBYTE COMP_0191 1 100 0 255 ECU_ADDRESS 0xFFFF269A /begin FUNCTION_LIST KF7-313C.1[36] /end FUNCTION_LIST /end MEASUREMENT
/begin MEASUREMENT tRINLDT "A rear O2 voltage condition judgement timer for the A/F sensor system" UWORD COMP_0203_S 1 100 0 65535 ECU_ADDRESS 0xFFFF26D2 /begin FUNCTION_LIST KF7-313C.1[36] /end FUNCTION_LIST /end MEASUREMENT
/begin MEASUREMENT avANGTM "Injection start timing" UBYTE COMP_0055 1 100 0 1020 ECU_ADDRESS 0xFFFF22FF /begin FUNCTION_LIST KF7-311.1A[21] KF7-450.9A[5] /end FUNCTION_LIST /end MEASUREMENT
/begin MEASUREMENT avCTI "Output pulse width by the cylinder" UWORD COMP_0231 1 100 0 655350 ECU_ADDRESS 0xFFFF2306 /begin FUNCTION_LIST KF7-311.1A[21] KF7-312.1C[N] KF7-312.5A[4] KF7-312.5C[1] /end FUNCTION_LIST /end MEASUREMENT
/begin MEASUREMENT avCTIF "After output ZD-ization compensation by the cylinder, pulse width" UWORD COMP_0192 1 100 0 655350 ECU_ADDRESS 0xFFFF2312 /begin FUNCTION_LIST KF7-311.1A[21] KF7-312.1C[N] /end FUNCTION_LIST /end MEASUREMENT
/begin MEASUREMENT avIJSET "The amount of interruption injection" UWORD COMP_0231 1 100 0 655350 ECU_ADDRESS 0xFFFF232C /begin FUNCTION_LIST KF7-312.4C[4] KF7-312.5A[4] KF7-312.5C[1] /end FUNCTION_LIST /end MEASUREMENT
/begin MEASUREMENT avINJOFS "The amount of injection start offset" UBYTE COMP_0068 1 100 0 255 ECU_ADDRESS 0xFFFF2338 /begin FUNCTION_LIST KF7-311.1A[21] KF7-450.9A[5] /end FUNCTION_LIST /end MEASUREMENT
/begin MEASUREMENT avPPAMB "Atomospheric pressure value" UWORD COMP_0445_S 1 100 0 127.99837455 ECU_ADDRESS 0xFFFFB706 /begin FUNCTION_LIST KF7-312.1C[N] KF7-500.1[54] KF7-500.7[12] /end FUNCTION_LIST /end MEASUREMENT
/begin MEASUREMENT avTGABFE "Target A/F" UWORD COMP_0453 1 100 0 131.07 ECU_ADDRESS 0xFFFF418C
 /begin FUNCTION_LIST KF7-313C.1[36] KF7-314.1F[1] KF7-371.1E[15] KF7-500.1[54] KF7-500.20B[4] /end FUNCTION_LIST
/end MEASUREMENT
/begin MEASUREMENT avTGABFE_R#1 "Target A/F" UWORD COMP_0453 1 100 0 131.07 ECU_ADDRESS 0xFFFF418C
 /begin FUNCTION_LIST KF7-313C.1[36] KF7-314.1F[1] KF7-371.1E[15] KF7-500.1[54] KF7-500.20B[4] /end FUNCTION_LIST
/end MEASUREMENT
/begin MEASUREMENT avTGABFE_R#2 "Target A/F" UWORD COMP_0453 1 100 0 131.07 ECU_ADDRESS 0xFFFF418E
 /begin FUNCTION_LIST KF7-313C.1[36] KF7-314.1F[1] KF7-371.1E[15] KF7-500.1[54] KF7-500.20B[4] /end FUNCTION_LIST
/end MEASUREMENT
/begin MEASUREMENT avTIPDF "After simultaneous injection ZD-ization compensation, pulse width" UWORD COMP_0192 1 100 0 655350 ECU_ADDRESS 0xFFFF2364 /begin FUNCTION_LIST KF7-312.1C[N] /end FUNCTION_LIST /end MEASUREMENT
/begin MEASUREMENT avTIPS "At the time of the sequential injection, output pulse width" UWORD COMP_0231 1 100 0 655350 ECU_ADDRESS 0xFFFF2366 /begin FUNCTION_LIST KF7-312.1C[N] KF7-313C.9[3] KF7-450.50[10] /end FUNCTION_LIST /end MEASUREMENT
/begin MEASUREMENT avTIPS_R#1 "At the time of the sequential injection, output pulse width" UWORD COMP_0231 1 100 0 655350 ECU_ADDRESS 0xFFFF2366 /begin FUNCTION_LIST KF7-312.1C[N] KF7-313C.9[3] KF7-450.50[10] /end FUNCTION_LIST /end MEASUREMENT
/begin MEASUREMENT avTIPS_R#2 "At the time of the sequential injection, output pulse width" UWORD COMP_0231 1 100 0 655350 ECU_ADDRESS 0xFFFF2368 /begin FUNCTION_LIST KF7-312.1C[N] KF7-313C.9[3] KF7-450.50[10] /end FUNCTION_LIST /end MEASUREMENT
/begin MEASUREMENT avTIPST "Initial injection pulse width" UWORD COMP_0192 1 100 0 655350 ECU_ADDRESS 0xFFFF236A /begin FUNCTION_LIST KF7-312.1C[N] /end FUNCTION_LIST /end MEASUREMENT
/begin MEASUREMENT avTIPSTF "Initial injection pulse width" UWORD COMP_0192 1 100 0 655350 ECU_ADDRESS 0xFFFF236C /begin FUNCTION_LIST KF7-312.1C[N] /end FUNCTION_LIST /end MEASUREMENT
/begin MEASUREMENT avTIST "At the time of the initial injection, output pulse width" UWORD COMP_0509 1 100 0 655350 ECU_ADDRESS 0xFFFF236E /begin FUNCTION_LIST KF7-311.1A[21] KF7-312.1C[N] KF7-580.1[8] /end FUNCTION_LIST /end MEASUREMENT
/begin MEASUREMENT avTIST1 "At the time of the initial injection, output pulse width #1" UWORD COMP_0192 1 100 0 655350 ECU_ADDRESS 0xFFFF2370 /begin FUNCTION_LIST KF7-312.1C[N] /end FUNCTION_LIST /end MEASUREMENT
/begin MEASUREMENT avTIST2 "At the time of the initial injection, output pulse width #2" UWORD COMP_0192 1 100 0 655350 ECU_ADDRESS 0xFFFF2372 /begin FUNCTION_LIST KF7-312.1C[N] /end FUNCTION_LIST /end MEASUREMENT
/begin MEASUREMENT avTIST3 "At the time of the initial injection, output pulse width #3" UWORD COMP_0192 1 100 0 655350 ECU_ADDRESS 0xFFFF2374 /begin FUNCTION_LIST KF7-312.1C[N] /end FUNCTION_LIST /end MEASUREMENT
/begin MEASUREMENT avTIST4 "At the time of the initial injection, output pulse width #4" UWORD COMP_0192 1 100 0 655350 ECU_ADDRESS 0xFFFF2376 /begin FUNCTION_LIST KF7-311.1A[21] KF7-312.1C[N] /end FUNCTION_LIST /end MEASUREMENT
/begin MEASUREMENT avTISTF "After initial injection ZD-ization compensation, pulse width" UWORD COMP_0192 1 100 0 655350 ECU_ADDRESS 0xFFFF237A /begin FUNCTION_LIST KF7-312.1C[N] /end FUNCTION_LIST /end MEASUREMENT
/begin MEASUREMENT avTISTF1 "After initial injection ZD-ization compensation, pulse width #1" UWORD COMP_0192 1 100 0 655350 ECU_ADDRESS 0xFFFF237C /begin FUNCTION_LIST KF7-312.1C[N] /end FUNCTION_LIST /end MEASUREMENT
/begin MEASUREMENT avTISTF2 "After initial injection ZD-ization compensation, pulse width #2" UWORD COMP_0192 1 100 0 655350 ECU_ADDRESS 0xFFFF237E /begin FUNCTION_LIST KF7-312.1C[N] /end FUNCTION_LIST /end MEASUREMENT
/begin MEASUREMENT avTISTF3 "After initial injection ZD-ization compensation, pulse width #3" UWORD COMP_0192 1 100 0 655350 ECU_ADDRESS 0xFFFF2380 /begin FUNCTION_LIST KF7-312.1C[N] /end FUNCTION_LIST /end MEASUREMENT
/begin MEASUREMENT avTISTF4 "After initial injection ZD-ization compensation, pulse width #4" UWORD COMP_0192 1 100 0 655350 ECU_ADDRESS 0xFFFF2382 /begin FUNCTION_LIST KF7-311.1A[21] KF7-312.1C[N] /end FUNCTION_LIST /end MEASUREMENT
/begin MEASUREMENT avfLJUDGEE "Lean judgement flag (0 : It is 1:Lean which is not Lean.)" UBYTE COMP_0283 1 100 0 255 ECU_ADDRESS 0xFFFF4136 /begin FUNCTION_LIST KF7-313C.1[36] /end FUNCTION_LIST /end MEASUREMENT
/begin MEASUREMENT avfLJUDGEE_R#1 "Lean judgement flag (0 : It is 1:Lean which is not Lean.)" UBYTE COMP_0283 1 100 0 255 ECU_ADDRESS 0xFFFF4136 /begin FUNCTION_LIST KF7-313C.1[36] /end FUNCTION_LIST /end MEASUREMENT
/begin MEASUREMENT avfLJUDGEE_R#2 "Lean judgement flag (0 : It is 1:Lean which is not Lean.)" UBYTE COMP_0283 1 100 0 255 ECU_ADDRESS 0xFFFF4137 /begin FUNCTION_LIST KF7-313C.1[36] /end FUNCTION_LIST /end MEASUREMENT
/begin MEASUREMENT avfRJUDGEE "Rich judgement flag (0 : It is 1:Rich which is not Rich.)" UBYTE COMP_0283 1 100 0 255 ECU_ADDRESS 0xFFFF4138 /begin FUNCTION_LIST KF7-313C.1[36] /end FUNCTION_LIST /end MEASUREMENT
/begin MEASUREMENT avfRJUDGEE_R#1 "Rich judgement flag (0 : It is 1:Rich which is not Rich.)" UBYTE COMP_0283 1 100 0 255 ECU_ADDRESS 0xFFFF4138 /begin FUNCTION_LIST KF7-313C.1[36] /end FUNCTION_LIST /end MEASUREMENT
/begin MEASUREMENT avfRJUDGEE_R#2 "Rich judgement flag (0 : It is 1:Rich which is not Rich.)" UBYTE COMP_0283 1 100 0 255 ECU_ADDRESS 0xFFFF4139 /begin FUNCTION_LIST KF7-313C.1[36] /end FUNCTION_LIST /end MEASUREMENT
/begin MEASUREMENT bvALPHAE "Lambda control compensation coefficient" UWORD COMP_0031 1 100 0 255.99609375 ECU_ADDRESS 0xFFFF40AE /begin FUNCTION_LIST KF7-313C.1[36] KF7-580.1[8] /end FUNCTION_LIST /end MEASUREMENT
/begin MEASUREMENT bvALPHAE_R#1 "Lambda control compensation coefficient" UWORD COMP_0031 1 100 0 255.99609375 ECU_ADDRESS 0xFFFF40AE /begin FUNCTION_LIST KF7-313C.1[36] KF7-580.1[8] /end FUNCTION_LIST /end MEASUREMENT
/begin MEASUREMENT bvALPHAE_R#2 "Lambda control compensation coefficient" UWORD COMP_0031 1 100 0 255.99609375 ECU_ADDRESS 0xFFFF40B0 /begin FUNCTION_LIST KF7-313C.1[36] KF7-580.1[8] /end FUNCTION_LIST /end MEASUREMENT
/begin MEASUREMENT bvEALSFT "The amount of evapo alpha shift" SBYTE COMP_0407 1 100 -32 31.75 ECU_ADDRESS 0xFFFF22BF /begin FUNCTION_LIST KF7-313C.1[36] /end FUNCTION_LIST /end MEASUREMENT
/begin MEASUREMENT bvEALSFT_R#1 "The amount of evapo alpha shift" SBYTE COMP_0407 1 100 -32 31.75 ECU_ADDRESS 0xFFFF22BF /begin FUNCTION_LIST KF7-313C.1[36] /end FUNCTION_LIST /end MEASUREMENT
/begin MEASUREMENT bvEALSFT_R#2 "The amount of evapo alpha shift" SBYTE COMP_0407 1 100 -32 31.75 ECU_ADDRESS 0xFFFF22C0 /begin FUNCTION_LIST KF7-313C.1[36] /end FUNCTION_LIST /end MEASUREMENT
/begin MEASUREMENT bvFCAT "The number of duette requirement fuel cut cylinders" UBYTE COMP_0251 1 100 0 255 ECU_ADDRESS 0xFFFF22C4
 /begin FUNCTION_LIST KF7-312.6[34] KF7-386.1[4] KF7-386.2[4] KF7-390.3A[15] KF7-580.1[8] /end FUNCTION_LIST
/end MEASUREMENT
/begin MEASUREMENT bvFHOS "Purge fuel compensation coefficient" UWORD COMP_0031 1 100 0 255.99609375 ECU_ADDRESS 0xFFFF40CC /begin FUNCTION_LIST KF7-312.1C[N] KF7-371.1E[15] /end FUNCTION_LIST /end MEASUREMENT
/begin MEASUREMENT bvKBLRCB "The whole area reflection learning value" UWORD COMP_0031 1 100 0 255.99609375 ECU_ADDRESS 0xFFFFB676
 /begin FUNCTION_LIST KF7-313C.1[36] KF7-314.1F[1] KF7-500.20B[4] R901.1.Diag_on_can_app_1_6_2 /end FUNCTION_LIST
/end MEASUREMENT
/begin MEASUREMENT bvKBLRCB_R#1 "The whole area reflection learning value" UWORD COMP_0031 1 100 0 255.99609375 ECU_ADDRESS 0xFFFFB676
 /begin FUNCTION_LIST KF7-313C.1[36] KF7-314.1F[1] KF7-500.20B[4] R901.1.Diag_on_can_app_1_6_2 /end FUNCTION_LIST
/end MEASUREMENT
/begin MEASUREMENT bvKBLRCB_R#2 "The whole area reflection learning value" UWORD COMP_0031 1 100 0 255.99609375 ECU_ADDRESS 0xFFFFB678
 /begin FUNCTION_LIST KF7-313C.1[36] KF7-314.1F[1] KF7-500.20B[4] R901.1.Diag_on_can_app_1_6_2 /end FUNCTION_LIST
/end MEASUREMENT
/begin MEASUREMENT bvKUB "An unburned advantage, increase rate" UWORD COMP_0057 1 100 0 3.999941832 ECU_ADDRESS 0xFFFF22D4 /begin FUNCTION_LIST KF7-312.3A[27] KF7-320A.8[2] /end FUNCTION_LIST /end MEASUREMENT
/begin MEASUREMENT bvLTSBU "TS learning value" UWORD COMP_0458 1 100 -1280 1279.9609375 ECU_ADDRESS 0xFFFF22D6 /begin FUNCTION_LIST KF7-312.1C[N] KF7-313C.9[3] KF7-450.50[10] /end FUNCTION_LIST /end MEASUREMENT
/begin MEASUREMENT bvLTSBU_R#1 "TS learning value" UWORD COMP_0458 1 100 -1280 1279.9609375 ECU_ADDRESS 0xFFFF22D6 /begin FUNCTION_LIST KF7-312.1C[N] KF7-313C.9[3] KF7-450.50[10] /end FUNCTION_LIST /end MEASUREMENT
/begin MEASUREMENT bvLTSBU_R#2 "TS learning value" UWORD COMP_0458 1 100 -1280 1279.9609375 ECU_ADDRESS 0xFFFF22D8 /begin FUNCTION_LIST KF7-312.1C[N] KF7-313C.9[3] KF7-450.50[10] /end FUNCTION_LIST /end MEASUREMENT
/begin MEASUREMENT bvTHOS "Target air-fuel ratio temperature compensation rate" UWORD COMP_0057 1 100 0 3.999941832 ECU_ADDRESS 0xFFFF22E2 /begin FUNCTION_LIST KF7-312.2A[16] KF7-312.3A[27] KF7-320A.8[2] /end FUNCTION_LIST /end MEASUREMENT
/begin MEASUREMENT bvTMONT "Control periodic monitor" UBYTE COMP_0008 1 100 0 25500 ECU_ADDRESS 0xFFFF22E4 /begin FUNCTION_LIST KF7-313C.1[36] KF7-313C.9[3] KF7-500.24[10] /end FUNCTION_LIST /end MEASUREMENT
/begin MEASUREMENT bvTMONT_R#1 "Control periodic monitor" UBYTE COMP_0008 1 100 0 25500 ECU_ADDRESS 0xFFFF22E4 /begin FUNCTION_LIST KF7-313C.1[36] KF7-313C.9[3] KF7-500.24[10] /end FUNCTION_LIST /end MEASUREMENT
/begin MEASUREMENT bvTMONT_R#2 "Control periodic monitor" UBYTE COMP_0008 1 100 0 25500 ECU_ADDRESS 0xFFFF22E5 /begin FUNCTION_LIST KF7-313C.1[36] KF7-313C.9[3] KF7-500.24[10] /end FUNCTION_LIST /end MEASUREMENT
/begin MEASUREMENT bvTMONTE "Control periodic monitor" UWORD COMP_0014 1 100 0 655350 ECU_ADDRESS 0xFFFF40DE /begin FUNCTION_LIST KF7-313C.1[36] /end FUNCTION_LIST /end MEASUREMENT
/begin MEASUREMENT bvTMONTE_R#1 "Control periodic monitor" UWORD COMP_0014 1 100 0 655350 ECU_ADDRESS 0xFFFF40DE /begin FUNCTION_LIST KF7-313C.1[36] /end FUNCTION_LIST /end MEASUREMENT
/begin MEASUREMENT bvTMONTE_R#2 "Control periodic monitor" UWORD COMP_0014 1 100 0 655350 ECU_ADDRESS 0xFFFF40E0 /begin FUNCTION_LIST KF7-313C.1[36] /end FUNCTION_LIST /end MEASUREMENT
/begin MEASUREMENT vA0MODEL "System line A0" SWORD COMP_0336_S 1 100 -3.2768 3.2767 ECU_ADDRESS 0xFFFF10B0 /begin FUNCTION_LIST KF7-313C.1[36] /end FUNCTION_LIST /end MEASUREMENT
/begin MEASUREMENT vA0MODEL_R#1 "System line A0" SWORD COMP_0336_S 1 100 -3.2768 3.2767 ECU_ADDRESS 0xFFFF10B0 /begin FUNCTION_LIST KF7-313C.1[36] /end FUNCTION_LIST /end MEASUREMENT
/begin MEASUREMENT vA0MODEL_R#2 "System line A0" SWORD COMP_0336_S 1 100 -3.2768 3.2767 ECU_ADDRESS 0xFFFF10B2 /begin FUNCTION_LIST KF7-313C.1[36] /end FUNCTION_LIST /end MEASUREMENT
/begin MEASUREMENT vA1MODEL "System line A1" SWORD COMP_0336_S 1 100 -3.2768 3.2767 ECU_ADDRESS 0xFFFF10B4 /begin FUNCTION_LIST KF7-313C.1[36] /end FUNCTION_LIST /end MEASUREMENT
/begin MEASUREMENT vA1MODEL_R#1 "System line A1" SWORD COMP_0336_S 1 100 -3.2768 3.2767 ECU_ADDRESS 0xFFFF10B4 /begin FUNCTION_LIST KF7-313C.1[36] /end FUNCTION_LIST /end MEASUREMENT
/begin MEASUREMENT vA1MODEL_R#2 "System line A1" SWORD COMP_0336_S 1 100 -3.2768 3.2767 ECU_ADDRESS 0xFFFF10B6 /begin FUNCTION_LIST KF7-313C.1[36] /end FUNCTION_LIST /end MEASUREMENT
/begin MEASUREMENT vABFCMPV "A/F clamp value" UWORD COMP_0453 1 100 0 131.07 ECU_ADDRESS 0xFFFF10DE /begin FUNCTION_LIST KF7-313C.1[36] KF7-313C.6[5] /end FUNCTION_LIST /end MEASUREMENT
/begin MEASUREMENT vABFCMPV_R#1 "A/F clamp value" UWORD COMP_0453 1 100 0 131.07 ECU_ADDRESS 0xFFFF10DE /begin FUNCTION_LIST KF7-313C.1[36] KF7-313C.6[5] /end FUNCTION_LIST /end MEASUREMENT
/begin MEASUREMENT vABFCMPV_R#2 "A/F clamp value" UWORD COMP_0453 1 100 0 131.07 ECU_ADDRESS 0xFFFF10E0 /begin FUNCTION_LIST KF7-313C.1[36] KF7-313C.6[5] /end FUNCTION_LIST /end MEASUREMENT
/begin MEASUREMENT vABYOMA "Low frequency response gain inside ratio" UWORD COMP_0063 1 100 0 255.99609375 ECU_ADDRESS 0xFFFF10E4 /begin FUNCTION_LIST KF7-312.4A[6] KF7-312.5A[4] KF7-312.5C[1] /end FUNCTION_LIST /end MEASUREMENT
/begin MEASUREMENT vACD3LU "A/C At the time of on, D3 coast L/U continuation time" UBYTE COMP_0008 1 100 0 25500 ECU_ADDRESS 0xFFFF277C /begin FUNCTION_LIST KF7-312.6[34] /end FUNCTION_LIST /end MEASUREMENT
/begin MEASUREMENT vAFDDQAE "For 100mS, delta-QAE" SWORD COMP_0263 1 100 -32768 32767 ECU_ADDRESS 0xFFFF27AE /begin FUNCTION_LIST KF7-313C.1[36] /end FUNCTION_LIST /end MEASUREMENT
/begin MEASUREMENT vAFDDRPM "For 100mS, delta-NRPM" SWORD COMP_0262 1 100 -409600 409587.5 ECU_ADDRESS 0xFFFF27B0 /begin FUNCTION_LIST KF7-313C.1[36] /end FUNCTION_LIST /end MEASUREMENT
/begin MEASUREMENT vAFSAF "An actual air-fuel ratio" UWORD COMP_0453 1 100 0 131.07 ECU_ADDRESS 0xFFFF27C4
 /begin FUNCTION_LIST KF7-313C.1[36] KF7-313C.11B[1] KF7-314.1F[1] KF7-371.1E[15] KF7-500.1[54] KF7-500.20B[4] KF7-500.74[11] /end FUNCTION_LIST
/end MEASUREMENT
/begin MEASUREMENT vAFSAF_R#1 "An actual air-fuel ratio" UWORD COMP_0453 1 100 0 131.07 ECU_ADDRESS 0xFFFF27C4
 /begin FUNCTION_LIST KF7-313C.1[36] KF7-313C.11B[1] KF7-314.1F[1] KF7-371.1E[15] KF7-500.1[54] KF7-500.20B[4] KF7-500.74[11] /end FUNCTION_LIST
/end MEASUREMENT
/begin MEASUREMENT vAFSAF_R#2 "An actual air-fuel ratio" UWORD COMP_0453 1 100 0 131.07 ECU_ADDRESS 0xFFFF27C6
 /begin FUNCTION_LIST KF7-313C.1[36] KF7-313C.11B[1] KF7-314.1F[1] KF7-371.1E[15] KF7-500.1[54] KF7-500.20B[4] KF7-500.74[11] /end FUNCTION_LIST
/end MEASUREMENT
/begin MEASUREMENT vAFSCNL2 "Lean side fixed shift renewal number of times counter" UBYTE COMP_0030 1 100 0 255 ECU_ADDRESS 0xFFFF27CD /begin FUNCTION_LIST KF7-313C.1[36] KF7-500.75[4] /end FUNCTION_LIST /end MEASUREMENT
/begin MEASUREMENT vAFSCNL2_R#1 "Lean side fixed shift renewal number of times counter" UBYTE COMP_0030 1 100 0 255 ECU_ADDRESS 0xFFFF27CD /begin FUNCTION_LIST KF7-313C.1[36] KF7-500.75[4] /end FUNCTION_LIST /end MEASUREMENT
/begin MEASUREMENT vAFSCNL2_R#2 "Lean side fixed shift renewal number of times counter" UBYTE COMP_0030 1 100 0 255 ECU_ADDRESS 0xFFFF27CE /begin FUNCTION_LIST KF7-313C.1[36] KF7-500.75[4] /end FUNCTION_LIST /end MEASUREMENT
/begin MEASUREMENT vAFSCNL3 "Lean side moment fixed shift renewal number of times counter" UBYTE COMP_0030 1 100 0 255 ECU_ADDRESS 0xFFFF27CF /begin FUNCTION_LIST KF7-313C.1[36] KF7-500.75[4] /end FUNCTION_LIST /end MEASUREMENT
/begin MEASUREMENT vAFSCNL3_R#1 "Lean side moment fixed shift renewal number of times counter" UBYTE COMP_0030 1 100 0 255 ECU_ADDRESS 0xFFFF27CF /begin FUNCTION_LIST KF7-313C.1[36] KF7-500.75[4] /end FUNCTION_LIST /end MEASUREMENT
/begin MEASUREMENT vAFSCNL3_R#2 "Lean side moment fixed shift renewal number of times counter" UBYTE COMP_0030 1 100 0 255 ECU_ADDRESS 0xFFFF27D0 /begin FUNCTION_LIST KF7-313C.1[36] KF7-500.75[4] /end FUNCTION_LIST /end MEASUREMENT
/begin MEASUREMENT vAFSCNR2 "Rich side fixed shift renewal number of times counter" UBYTE COMP_0030 1 100 0 255 ECU_ADDRESS 0xFFFF27D1 /begin FUNCTION_LIST KF7-313C.1[36] KF7-500.75[4] /end FUNCTION_LIST /end MEASUREMENT
/begin MEASUREMENT vAFSCNR2_R#1 "Rich side fixed shift renewal number of times counter" UBYTE COMP_0030 1 100 0 255 ECU_ADDRESS 0xFFFF27D1 /begin FUNCTION_LIST KF7-313C.1[36] KF7-500.75[4] /end FUNCTION_LIST /end MEASUREMENT
/begin MEASUREMENT vALPCAT "The rest O2 sensor feedback control coefficient" UWORD COMP_0031 1 100 0 255.99609375 ECU_ADDRESS 0xFFFF281E /begin FUNCTION_LIST KF7-312.1C[N] KF7-313C.9[3] /end FUNCTION_LIST /end MEASUREMENT
/begin MEASUREMENT vALPCAT_R#1 "The rest O2 sensor feedback control coefficient" UWORD COMP_0031 1 100 0 255.99609375 ECU_ADDRESS 0xFFFF281E /begin FUNCTION_LIST KF7-312.1C[N] KF7-313C.9[3] /end FUNCTION_LIST /end MEASUREMENT
/begin MEASUREMENT vALPCAT_R#2 "The rest O2 sensor feedback control coefficient" UWORD COMP_0031 1 100 0 255.99609375 ECU_ADDRESS 0xFFFF2820 /begin FUNCTION_LIST KF7-312.1C[N] KF7-313C.9[3] /end FUNCTION_LIST /end MEASUREMENT
/begin MEASUREMENT vALT "Atomospheric pressure" UWORD COMP_0017_S 1 100 0 2047.96875 ECU_ADDRESS 0xFFFF9FEC /begin FUNCTION_LIST KF7-312.6[34] /end FUNCTION_LIST /end MEASUREMENT
/begin MEASUREMENT vANGTM "Injection start timing" UBYTE COMP_0055 1 100 0 1020 ECU_ADDRESS 0xFFFF23AD /begin FUNCTION_LIST KF7-311.1A[21] KF7-450.9A[5] /end FUNCTION_LIST /end MEASUREMENT
/begin MEASUREMENT vCA10MS "A crank angle between 10 ms" UBYTE COMP_0017 1 100 0 255 ECU_ADDRESS 0xFFFF897C /begin FUNCTION_LIST KF7-312.5A[4] KF7-312.5C[1] /end FUNCTION_LIST /end MEASUREMENT
/begin MEASUREMENT vCORTP "Volume flow-quantity conversion TP" UBYTE COMP_0182 1 100 0 15.9375 ECU_ADDRESS 0xFFFF1200 /begin FUNCTION_LIST KF7-312.1C[N] /end FUNCTION_LIST /end MEASUREMENT
/begin MEASUREMENT vCTI "Output pulse width by the cylinder" UWORD COMP_0231 1 100 0 655350 ECU_ADDRESS 0xFFFF23B4
 /begin FUNCTION_LIST KF7-311.1A[21] KF7-312.1C[N] KF7-312.5A[4] KF7-312.5C[1] R301.11.INJDiag_1_1_2 /end FUNCTION_LIST
/end MEASUREMENT
/begin MEASUREMENT vCTIF "After output ZD-ization compensation by the cylinder, pulse width" UWORD COMP_0192 1 100 0 655350 ECU_ADDRESS 0xFFFF23C0 /begin FUNCTION_LIST KF7-311.1A[21] KF7-312.1C[N] /end FUNCTION_LIST /end MEASUREMENT
/begin MEASUREMENT vDKASS "After the start, decrease rate" UWORD COMP_0099 1 100 0 3.999941832 ECU_ADDRESS 0xFFFF2A48 /begin FUNCTION_LIST KF7-312.3A[27] /end FUNCTION_LIST /end MEASUREMENT
/begin MEASUREMENT vDKASSIN "After the start, decrease rate" UWORD COMP_0099 1 100 0 3.999941832 ECU_ADDRESS 0xFFFF1272 /begin FUNCTION_LIST KF7-312.3A[27] /end FUNCTION_LIST /end MEASUREMENT
/begin MEASUREMENT vDLYCOND "TFBYA computed delay condition" UBYTE COMP_0004 1 100 0 255 ECU_ADDRESS 0xFFFF1280 /begin FUNCTION_LIST KF7-312.2A[16] R301.9.Target_Equivalent_Ratio_1_0_2 /end FUNCTION_LIST /end MEASUREMENT
/begin MEASUREMENT vDLYRANGE "TFBYA computed region" UBYTE COMP_0004 1 100 0 255 ECU_ADDRESS 0xFFFF1281 /begin FUNCTION_LIST KF7-312.2A[16] /end FUNCTION_LIST /end MEASUREMENT
/begin MEASUREMENT vDML "Fuel-air ratio" UWORD COMP_0271 1 100 0 199.99696053 ECU_ADDRESS 0xFFFF101A
 /begin FUNCTION_LIST KF7-311.1A[21] KF7-312.2A[16] KF7-320A.9[9] KF7-379.3[3] KF7-379.4[1] KF7-379.5[3] R301.9.Target_Equivalent_Ratio_1_0_2 /end FUNCTION_LIST
/end MEASUREMENT
/begin MEASUREMENT vDRTKSTB "KSTB loss in weight rate" UWORD COMP_0217 1 100 0 3.999941832 ECU_ADDRESS 0xFFFF1296 /begin FUNCTION_LIST KF7-312.3A[27] /end FUNCTION_LIST /end MEASUREMENT
/begin MEASUREMENT vDTPFBA "The amount of a change in TPÅ~TFBYA" SWORD COMP_0523 1 100 -32.000016384 31.999039821 ECU_ADDRESS 0xFFFF12A2 /begin FUNCTION_LIST KF7-312.4C[4] /end FUNCTION_LIST /end MEASUREMENT
/begin MEASUREMENT vDVDG "Vehicle speed sensor trouble judgement engine speed" UBYTE COMP_0000 1 100 0 6375 ECU_ADDRESS 0xFFFF12B0 /begin FUNCTION_LIST KF7-312.6[34] /end FUNCTION_LIST /end MEASUREMENT
/begin MEASUREMENT vERACI "Interrupt injection switchover pulse width" SWORD COMP_0589_S 1 100 -327680 327670 ECU_ADDRESS 0xFFFF12E6 /begin FUNCTION_LIST KF7-312.1C[N] KF7-312.4C[4] /end FUNCTION_LIST /end MEASUREMENT
/begin MEASUREMENT vFCTCS "The number of TCS control requirement fuel cut cylinders" UBYTE COMP_0251 1 100 0 255 ECU_ADDRESS 0xFFFF2D2E
 /begin FUNCTION_LIST KF7-312.6[34] KF7-385.2[18] KF7-386.1[4] KF7-386.2[4] KF7-410.12[2] /end FUNCTION_LIST
/end MEASUREMENT
/begin MEASUREMENT vFLGIB "Immobilizer communication control flag" UBYTE COMP_0068 1 100 0 255 ECU_ADDRESS 0xFFFF3D62 /begin FUNCTION_LIST KF7-312.6[34] KF7-500.10[3] /end FUNCTION_LIST /end MEASUREMENT
/begin MEASUREMENT vFLGYRI "Roll-back occurrence flag" UBYTE COMP_0283 1 100 0 255 ECU_ADDRESS 0xFFFF1392 /begin FUNCTION_LIST KF7-311.1A[21] KF7-450.9A[5] /end FUNCTION_LIST /end MEASUREMENT
/begin MEASUREMENT vFPONTM "Fuel rise waiting time" UBYTE COMP_0014 1 100 0 2550 ECU_ADDRESS 0xFFFF139D /begin FUNCTION_LIST KF7-311.1A[21] /end FUNCTION_LIST /end MEASUREMENT
/begin MEASUREMENT vFRVSP "Fuel recover judgement vehicle speed" UBYTE COMP_0007 1 100 0 510 ECU_ADDRESS 0xFFFF13AC /begin FUNCTION_LIST KF7-312.6[34] KF7-385.1[32] /end FUNCTION_LIST /end MEASUREMENT
/begin MEASUREMENT vFSEST1_0 "The existence of the diagnosis of FSENST1=1 and FMILON=1" UBYTE COMP_0004 1 100 0 255 ECU_ADDRESS 0xFFFFA434
 /begin FUNCTION_LIST KF7-312.6[34] KF7-330.4A[53] KF7-500.1[54] R000.1.RS_Integ_1_10_2 /end FUNCTION_LIST
/end MEASUREMENT
/begin MEASUREMENT vFTVO "A full increase judgement TVO" UBYTE COMP_0002 1 100 0 89.25 ECU_ADDRESS 0xFFFF13AF /begin FUNCTION_LIST KF7-312.2A[16] /end FUNCTION_LIST /end MEASUREMENT
/begin MEASUREMENT vFVAPO "A full increase judgement VAPO" UBYTE COMP_0002 1 100 0 89.25 ECU_ADDRESS 0xFFFF13B1
 /begin FUNCTION_LIST KF7-312.2A[16] KF7-312.3A[27] R301.9.Target_Equivalent_Ratio_1_0_2 /end FUNCTION_LIST
/end MEASUREMENT
/begin MEASUREMENT vGAK2 "GAK2 addition time" UBYTE COMP_0176 1 100 0 3.984375 ECU_ADDRESS 0xFFFF13C0 /begin FUNCTION_LIST KF7-312.4A[6] /end FUNCTION_LIST /end MEASUREMENT
/begin MEASUREMENT vGHF "KATHOS compensation rate" UBYTE COMP_0186 1 100 0 3.984375 ECU_ADDRESS 0xFFFF13C8 /begin FUNCTION_LIST KF7-312.4A[6] KF7-312.4C[4] /end FUNCTION_LIST /end MEASUREMENT
/begin MEASUREMENT vGHFITC "TGHSCV reference value" UBYTE COMP_0045 1 100 0 1.9921875 ECU_ADDRESS 0xFFFF13C9 /begin FUNCTION_LIST KF7-312.4A[6] KF7-312.4C[4] /end FUNCTION_LIST /end MEASUREMENT
/begin MEASUREMENT vGHFSV "At the time of the SCV close, slowdown loss in weight compensation rate" UBYTE COMP_0045 1 100 0 1.9921875 ECU_ADDRESS 0xFFFF13CA /begin FUNCTION_LIST KF7-312.4A[6] KF7-312.4C[4] /end FUNCTION_LIST /end MEASUREMENT
/begin MEASUREMENT vGPSEL "Parameter choice gear position" UBYTE COMP_0068 1 100 0 255 ECU_ADDRESS 0xFFFF13DA
 /begin FUNCTION_LIST KF7-312.6[34] KF7-360.8M[4] R301.8.Inverse_filter_1_1_3 R301.23.ADV_calculation_1_1_2 /end FUNCTION_LIST
/end MEASUREMENT
/begin MEASUREMENT vGZCY "A counter for the interrupt injection by cylinder" UWORD COMP_0017 1 100 0 65535 ECU_ADDRESS 0xFFFF13E4 /begin FUNCTION_LIST KF7-312.5A[4] KF7-312.5C[1] /end FUNCTION_LIST /end MEASUREMENT
/begin MEASUREMENT vGZCYTN "TGZCYL or TGZCLS reference value" UBYTE COMP_0186 1 100 0 3.984375 ECU_ADDRESS 0xFFFF13F1 /begin FUNCTION_LIST KF7-312.4C[4] KF7-312.5C[1] /end FUNCTION_LIST /end MEASUREMENT
/begin MEASUREMENT vGZMN "A response gain rotation compensation rate (slowdown) for CHOSn" UBYTE COMP_0045 1 100 0 1.9921875 ECU_ADDRESS 0xFFFF13F2 /begin FUNCTION_LIST KF7-312.4C[4] /end FUNCTION_LIST /end MEASUREMENT
/begin MEASUREMENT vGZN "TGZN reference value" UBYTE COMP_0045 1 100 0 1.9921875 ECU_ADDRESS 0xFFFF13F3 /begin FUNCTION_LIST KF7-312.5C[1] /end FUNCTION_LIST /end MEASUREMENT
/begin MEASUREMENT vGZPN "A response gain rotation compensation rate (acceleration) for CHOSn" UBYTE COMP_0045 1 100 0 1.9921875 ECU_ADDRESS 0xFFFF13F4 /begin FUNCTION_LIST KF7-312.4C[4] /end FUNCTION_LIST /end MEASUREMENT
/begin MEASUREMENT vGZTP "A response gain load compensation rate for CHOSn" UBYTE COMP_0045 1 100 0 1.9921875 ECU_ADDRESS 0xFFFF13F5 /begin FUNCTION_LIST KF7-312.4C[4] /end FUNCTION_LIST /end MEASUREMENT
/begin MEASUREMENT vGZTW "Interrupt injection compensation magnification by the cylinder" UBYTE COMP_0092_S 1 100 0 5.1 ECU_ADDRESS 0xFFFF13F6 /begin FUNCTION_LIST KF7-312.4C[4] KF7-312.5A[4] KF7-312.5C[1] /end FUNCTION_LIST /end MEASUREMENT
/begin MEASUREMENT vGZTW0 "TGZTW reference value" UBYTE COMP_0092_S 1 100 0 5.1 ECU_ADDRESS 0xFFFF13F7 /begin FUNCTION_LIST KF7-312.5C[1] /end FUNCTION_LIST /end MEASUREMENT
/begin MEASUREMENT vGZTWC "A response gain for CHOSn" UBYTE COMP_0434 1 100 0 10.2 ECU_ADDRESS 0xFFFF13F8 /begin FUNCTION_LIST KF7-312.1C[N] KF7-312.4A[6] /end FUNCTION_LIST /end MEASUREMENT
/begin MEASUREMENT vGZTWCH "A response gain for CHOSn" UBYTE COMP_0092_S 1 100 0 5.1 ECU_ADDRESS 0xFFFF13F9 /begin FUNCTION_LIST KF7-312.4C[4] /end FUNCTION_LIST /end MEASUREMENT
/begin MEASUREMENT vGZTWM "A response gain (slowdown) for CHOSn" UBYTE COMP_0434 1 100 0 10.2 ECU_ADDRESS 0xFFFF13FA /begin FUNCTION_LIST KF7-312.4A[6] /end FUNCTION_LIST /end MEASUREMENT
/begin MEASUREMENT vGZTWM0 "Response gain basic value (slowdown) for CHOSn" UBYTE COMP_0092_S 1 100 0 5.1 ECU_ADDRESS 0xFFFF13FB /begin FUNCTION_LIST KF7-312.4C[4] /end FUNCTION_LIST /end MEASUREMENT
/begin MEASUREMENT vGZTWMM "A response gain (slowdown) for CHOSn" UBYTE COMP_0092_S 1 100 0 5.1 ECU_ADDRESS 0xFFFF13FC /begin FUNCTION_LIST KF7-312.4C[4] /end FUNCTION_LIST /end MEASUREMENT
/begin MEASUREMENT vGZTWP "A response gain (acceleration) for CHOSn" UBYTE COMP_0434 1 100 0 10.2 ECU_ADDRESS 0xFFFF13FD /begin FUNCTION_LIST KF7-312.4A[6] KF7-312.5A[4] KF7-312.5C[1] /end FUNCTION_LIST /end MEASUREMENT
/begin MEASUREMENT vGZTWP0 "Response gain basic value (acceleration) for CHOSn" UBYTE COMP_0092_S 1 100 0 5.1 ECU_ADDRESS 0xFFFF13FE /begin FUNCTION_LIST KF7-312.4C[4] /end FUNCTION_LIST /end MEASUREMENT
/begin MEASUREMENT vGZTWPP "A response gain (acceleration) for CHOSn" UBYTE COMP_0092_S 1 100 0 5.1 ECU_ADDRESS 0xFFFF13FF /begin FUNCTION_LIST KF7-312.4C[4] /end FUNCTION_LIST /end MEASUREMENT
/begin MEASUREMENT vGZTWQH "Interrupt injection first compensation rate" UBYTE COMP_0435 1 100 0 7.96875 ECU_ADDRESS 0xFFFF1400 /begin FUNCTION_LIST KF7-312.5A[4] KF7-312.5C[1] /end FUNCTION_LIST /end MEASUREMENT
/begin MEASUREMENT vHSOSQ "-" SLONG COMP_0094_S 1 100 -21474836.48 21474836.47 ECU_ADDRESS 0xFFFF2E34 /begin FUNCTION_LIST KF7-312.3A[27] KF7-313C.1[36] KF7-313C.7[1] KF7-500.21[19] /end FUNCTION_LIST /end MEASUREMENT
/begin MEASUREMENT vHSOSQ_R#1 "-" SLONG COMP_0094_S 1 100 -21474836.48 21474836.47 ECU_ADDRESS 0xFFFF2E34 /begin FUNCTION_LIST KF7-312.3A[27] KF7-313C.1[36] KF7-313C.7[1] KF7-500.21[19] /end FUNCTION_LIST /end MEASUREMENT
/begin MEASUREMENT vHSOSQ_R#2 "-" SLONG COMP_0094_S 1 100 -21474836.48 21474836.47 ECU_ADDRESS 0xFFFF2E38 /begin FUNCTION_LIST KF7-312.3A[27] KF7-313C.1[36] KF7-313C.7[1] KF7-500.21[19] /end FUNCTION_LIST /end MEASUREMENT
/begin MEASUREMENT vIDLHOS "At the time of the idle, basic pulse width" UWORD COMP_0052 1 100 0 31.99956087 ECU_ADDRESS 0xFFFF3DA8 /begin FUNCTION_LIST KF7-312.1C[N] /end FUNCTION_LIST /end MEASUREMENT
/begin MEASUREMENT vIJCYOM "A profit by the cylinder gets crowded, permission flag" UBYTE COMP_0068 1 100 0 255 ECU_ADDRESS 0xFFFF1445 /begin FUNCTION_LIST KF7-312.5A[4] KF7-312.5C[1] /end FUNCTION_LIST /end MEASUREMENT
/begin MEASUREMENT vIJSET "The amount of interruption injection" UWORD COMP_0231 1 100 0 655350 ECU_ADDRESS 0xFFFF23DA
 /begin FUNCTION_LIST KF7-312.4C[4] KF7-312.5A[4] KF7-312.5C[1] R901.1.Diag_on_can_app_1_6_2 /end FUNCTION_LIST
/end MEASUREMENT
/begin MEASUREMENT vIJSETF "After interruption injection ZD-ization compensation, the amount of injection" UWORD COMP_0192 1 100 0 655350 ECU_ADDRESS 0xFFFF1450 /begin FUNCTION_LIST KF7-312.5A[4] KF7-312.5C[1] /end FUNCTION_LIST /end MEASUREMENT
/begin MEASUREMENT vIJTPUP "The one by the cylinder, usually, injection completion zone flag" UBYTE COMP_0068 1 100 0 255 ECU_ADDRESS 0xFFFF145C /begin FUNCTION_LIST KF7-312.5C[1] /end FUNCTION_LIST /end MEASUREMENT
/begin MEASUREMENT vINJOFS "The amount of injection start offset" UBYTE COMP_0068 1 100 0 255 ECU_ADDRESS 0xFFFF23E6 /begin FUNCTION_LIST KF7-311.1A[21] KF7-450.9A[5] /end FUNCTION_LIST /end MEASUREMENT
/begin MEASUREMENT vINPN "Turbine rotation" UWORD COMP_0443 1 100 0 65535 ECU_ADDRESS 0xFFFF146C /begin FUNCTION_LIST KF7-312.6[34] /end FUNCTION_LIST /end MEASUREMENT
/begin MEASUREMENT vKAP "The exhaust the second increase coefficient" UWORD COMP_0448 1 100 0 399.9941832 ECU_ADDRESS 0xFFFF14BC
 /begin FUNCTION_LIST KF7-312.2A[16] KF7-312.3A[27] R301.9.Target_Equivalent_Ratio_1_0_2 /end FUNCTION_LIST
/end MEASUREMENT
/begin MEASUREMENT vKAS "After the start, increase" UWORD COMP_0217 1 100 0 3.999941832 ECU_ADDRESS 0xFFFF14BE /begin FUNCTION_LIST KF7-312.3A[27] KF7-314.1F[1] R203.2.crk_restx_1_0_8 /end FUNCTION_LIST /end MEASUREMENT
/begin MEASUREMENT vKASS "After the start, increase compensation value" UWORD COMP_0217 1 100 0 3.999941832 ECU_ADDRESS 0xFFFF2E78 /begin FUNCTION_LIST KF7-312.3A[27] R203.2.crk_restx_1_0_8 /end FUNCTION_LIST /end MEASUREMENT
/begin MEASUREMENT vKGZR "At the time of the recover, compensation magnification" UBYTE COMP_0603_S 1 100 0 510 ECU_ADDRESS 0xFFFF14CC /begin FUNCTION_LIST KF7-312.4C[4] KF7-312.5C[1] /end FUNCTION_LIST /end MEASUREMENT
/begin MEASUREMENT vKHOT "A high coolant temperature increase compensation rate" UWORD COMP_0217 1 100 0 3.999941832 ECU_ADDRESS 0xFFFF14CE /begin FUNCTION_LIST KF7-312.3A[27] KF7-314.1F[1] R301.7.KHOT_1_0_2 /end FUNCTION_LIST /end MEASUREMENT
/begin MEASUREMENT vKHOTMP "A high coolant temperature increase basis" UBYTE COMP_0045 1 100 0 1.9921875 ECU_ADDRESS 0xFFFF14D1 /begin FUNCTION_LIST KF7-312.3A[27] R301.7.KHOT_1_0_2 /end FUNCTION_LIST /end MEASUREMENT
/begin MEASUREMENT vKHOTTN "High coolant temperature increase coolant temperature compensation" UBYTE COMP_0045 1 100 0 1.9921875 ECU_ADDRESS 0xFFFF14D2 /begin FUNCTION_LIST KF7-312.3A[27] R301.7.KHOT_1_0_2 /end FUNCTION_LIST /end MEASUREMENT
/begin MEASUREMENT vKMF "Quantity rate" UBYTE COMP_0395 1 100 0 0.062255955 ECU_ADDRESS 0xFFFF14D7 /begin FUNCTION_LIST KF7-312.4A[6] KF7-312.4C[4] /end FUNCTION_LIST /end MEASUREMENT
/begin MEASUREMENT vKMKTW "Minus KTW compensation coefficient" UBYTE COMP_0063 1 100 0 0.99609375 ECU_ADDRESS 0xFFFF14D8 /begin FUNCTION_LIST KF7-312.3A[27] /end FUNCTION_LIST /end MEASUREMENT
/begin MEASUREMENT vKMKTW0 "Minus KTW compensation rate section condition" UBYTE COMP_0068 1 100 0 255 ECU_ADDRESS 0xFFFF14D9 /begin FUNCTION_LIST KF7-312.3A[27] /end FUNCTION_LIST /end MEASUREMENT
/begin MEASUREMENT vKMRCNT1 "Lambda control _ delay stage counter" UWORD COMP_0452 1 100 0 51.19921875 ECU_ADDRESS 0xFFFF14DA /begin FUNCTION_LIST KF7-312.2A[16] R301.9.Target_Equivalent_Ratio_1_0_2 /end FUNCTION_LIST /end MEASUREMENT
/begin MEASUREMENT vKMRCNT2 "A full increase stage counter" UWORD COMP_0452 1 100 0 51.19921875 ECU_ADDRESS 0xFFFF14DC /begin FUNCTION_LIST KF7-312.2A[16] R301.9.Target_Equivalent_Ratio_1_0_2 /end FUNCTION_LIST /end MEASUREMENT
/begin MEASUREMENT vKMRCNT3 "A high exhaust temperature stage counter" UWORD COMP_0452 1 100 0 51.19921875 ECU_ADDRESS 0xFFFF14DE /begin FUNCTION_LIST KF7-312.2A[16] R301.9.Target_Equivalent_Ratio_1_0_2 /end FUNCTION_LIST /end MEASUREMENT
/begin MEASUREMENT vKMRCNT4 "A low rotation stage counter" UWORD COMP_0452 1 100 0 51.19921875 ECU_ADDRESS 0xFFFF14E0 /begin FUNCTION_LIST KF7-312.2A[16] R301.9.Target_Equivalent_Ratio_1_0_2 /end FUNCTION_LIST /end MEASUREMENT
/begin MEASUREMENT vKMRM "Target air-fuel ratio map reference value" UBYTE COMP_0044 1 100 0 1.9921875 ECU_ADDRESS 0xFFFF14E3
 /begin FUNCTION_LIST KF7-311.1A[21] KF7-312.2A[16] KF7-320A.17[N] KF7-386.1[4] R301.9.Target_Equivalent_Ratio_1_0_2 R301.10.TITM_1_0_2 /end FUNCTION_LIST
/end MEASUREMENT
/begin MEASUREMENT vKNST1 "Rotation compensation coefficient cost" UBYTE COMP_0063 1 100 0 0.99609375 ECU_ADDRESS 0xFFFF14E7 /begin FUNCTION_LIST KF7-312.1C[N] /end FUNCTION_LIST /end MEASUREMENT
/begin MEASUREMENT vKNSTHOS "POS/REF renewal speed compensation value" SBYTE COMP_0203 1 100 -0.5 0.49609375 ECU_ADDRESS 0xFFFF14E8 /begin FUNCTION_LIST KF7-312.1C[N] /end FUNCTION_LIST /end MEASUREMENT
/begin MEASUREMENT vKSTB "The stability compensation rate of interest" SLONG COMP_0455 1 100 -131072.09395241 131072.093891374 ECU_ADDRESS 0xFFFF14F4 /begin FUNCTION_LIST KF7-312.3A[27] KF7-320A.10[14] KF7-320A.14[1] /end FUNCTION_LIST /end MEASUREMENT
/begin MEASUREMENT vKSTBA "The stability compensation rate of interest" UWORD COMP_0217 1 100 0 3.999941832 ECU_ADDRESS 0xFFFF14F8 /begin FUNCTION_LIST KF7-312.3A[27] KF7-320A.14[1] /end FUNCTION_LIST /end MEASUREMENT
/begin MEASUREMENT vKSTBC "The stability compensation rate of interest" SWORD COMP_0455 1 100 -2.0000014336 1.9999403984 ECU_ADDRESS 0xFFFF14FA /begin FUNCTION_LIST KF7-312.3A[27] KF7-320A.14[1] /end FUNCTION_LIST /end MEASUREMENT
/begin MEASUREMENT vKSTBLMD "At the time of the lambda control start, KSTB" UBYTE COMP_0045 1 100 0 1.9921875 ECU_ADDRESS 0xFFFF14FC /begin FUNCTION_LIST KF7-312.3A[27] /end FUNCTION_LIST /end MEASUREMENT
/begin MEASUREMENT vKSTBTW "Stability coolant temperature compensation rate" UBYTE COMP_0045 1 100 0 1.9921875 ECU_ADDRESS 0xFFFF14FD /begin FUNCTION_LIST KF7-312.3A[27] /end FUNCTION_LIST /end MEASUREMENT
/begin MEASUREMENT vKTPLIM "Fuel increase limitation limiter" UWORD COMP_0217 1 100 0 3.999941832 ECU_ADDRESS 0xFFFF2E92 /begin FUNCTION_LIST KF7-312.3A[27] /end FUNCTION_LIST /end MEASUREMENT
/begin MEASUREMENT vKTST "Time compensation rate" UWORD COMP_0290 1 100 0 0.999985458 ECU_ADDRESS 0xFFFF1506 /begin FUNCTION_LIST KF7-312.1C[N] R203.2.crk_restx_1_0_8 /end FUNCTION_LIST /end MEASUREMENT
/begin MEASUREMENT vKUBDTW "Temperature rise compensation coefficient" UBYTE COMP_0063 1 100 0 0.99609375 ECU_ADDRESS 0xFFFF1508 /begin FUNCTION_LIST KF7-312.3A[27] /end FUNCTION_LIST /end MEASUREMENT
/begin MEASUREMENT vKVC "Return-less compensation clause" UBYTE COMP_0341 1 100 0 0.99705 ECU_ADDRESS 0xFFFF150A /begin FUNCTION_LIST KF7-312.1C[N] /end FUNCTION_LIST /end MEASUREMENT
/begin MEASUREMENT vLLDML "Lean limit compensation value" UWORD COMP_0271 1 100 0 199.99696053 ECU_ADDRESS 0xFFFF1520 /begin FUNCTION_LIST KF7-312.2A[16] /end FUNCTION_LIST /end MEASUREMENT
/begin MEASUREMENT vLLDMLX "Lean limit feedback value" UWORD COMP_0271 1 100 0 199.99696053 ECU_ADDRESS 0xFFFF1522 /begin FUNCTION_LIST KF7-312.2A[16] /end FUNCTION_LIST /end MEASUREMENT
/begin MEASUREMENT vLMCSTTW "At the time of the lambda control trawl start, coolant temperature" UBYTE COMP_0035 1 100 -50 205 ECU_ADDRESS 0xFFFF152C /begin FUNCTION_LIST KF7-312.3A[27] /end FUNCTION_LIST /end MEASUREMENT
/begin MEASUREMENT vLUOFFNB "Reference rotation for lockup release judgement" UBYTE COMP_0443 1 100 0 255 ECU_ADDRESS 0xFFFF1554 /begin FUNCTION_LIST KF7-312.6[34] /end FUNCTION_LIST /end MEASUREMENT
/begin MEASUREMENT vLUOFFNE "Engine rotation-turbine rotation" UBYTE COMP_0443 1 100 0 255 ECU_ADDRESS 0xFFFF1555 /begin FUNCTION_LIST KF7-312.6[34] /end FUNCTION_LIST /end MEASUREMENT
/begin MEASUREMENT vMFC "The amount of adhesion by the cylinder" UWORD COMP_0344 1 100 0 8191.875 ECU_ADDRESS 0xFFFF1580 /begin FUNCTION_LIST KF7-312.4A[6] /end FUNCTION_LIST /end MEASUREMENT
/begin MEASUREMENT vMFH "The amount of a balance adhesion" UWORD COMP_0001 1 100 0 8191.875 ECU_ADDRESS 0xFFFF158C /begin FUNCTION_LIST KF7-312.4A[6] KF7-312.4C[4] /end FUNCTION_LIST /end MEASUREMENT
/begin MEASUREMENT vMFHRPM "MFHNK, KMFN reference speed" UWORD COMP_0065 1 100 0 204796.875 ECU_ADDRESS 0xFFFF1022 /begin FUNCTION_LIST KF7-312.4A[6] KF7-312.4C[4] /end FUNCTION_LIST /end MEASUREMENT
/begin MEASUREMENT vMFHTVOK "A balance adhesion magnification" UWORD COMP_0466 1 100 0 31.999495335 ECU_ADDRESS 0xFFFF158E /begin FUNCTION_LIST KF7-312.4A[6] KF7-312.4C[4] /end FUNCTION_LIST /end MEASUREMENT
/begin MEASUREMENT vMKCNG1 "Minus KTW section compensation rate 1" UBYTE COMP_0108 1 100 0 0.99609375 ECU_ADDRESS 0xFFFF1595 /begin FUNCTION_LIST KF7-312.3A[27] /end FUNCTION_LIST /end MEASUREMENT
/begin MEASUREMENT vMKCNG2 "Minus KTW section compensation rate 2" UBYTE COMP_0108 1 100 0 0.99609375 ECU_ADDRESS 0xFFFF1596 /begin FUNCTION_LIST KF7-312.3A[27] /end FUNCTION_LIST /end MEASUREMENT
/begin MEASUREMENT vMKIDL "At the time of the minus KTW idle, compensation value" UBYTE COMP_0063 1 100 0 0.99609375 ECU_ADDRESS 0xFFFF1597 /begin FUNCTION_LIST KF7-312.3A[27] /end FUNCTION_LIST /end MEASUREMENT
/begin MEASUREMENT vMKINJ "#INJBAI Reciprocal number memory" UWORD COMP_0217 1 100 0 3.999941832 ECU_ADDRESS 0xFFFF1598
 /begin FUNCTION_LIST KF7-312.1C[N] KF7-312.4A[6] KF7-312.4C[4] KF7-312.5A[4] KF7-312.5C[1] KF7-313C.1[36] KF7-313C.9[3] KF7-450.50[10] R000.1.RS_Integ_1_10_2 R203.2.crk_restx_1_0_8 /end FUNCTION_LIST
/end MEASUREMENT
/begin MEASUREMENT vMTKAS "After the start, increase coolant temperature compensation value" UBYTE COMP_0186 1 100 0 3.984375 ECU_ADDRESS 0xFFFF15BA /begin FUNCTION_LIST KF7-312.3A[27] /end FUNCTION_LIST /end MEASUREMENT
/begin MEASUREMENT vNDCTCL "At the time of KT low oil temperature, at the time of the ND select, fuel cut rotation" UBYTE COMP_0000 1 100 0 6375 ECU_ADDRESS 0xFFFF15C9 /begin FUNCTION_LIST KF7-312.6[34] /end FUNCTION_LIST /end MEASUREMENT
/begin MEASUREMENT vNDCTMR "N- After the >D select, timer" UBYTE COMP_0202 1 100 0 2550 ECU_ADDRESS 0xFFFF15CA /begin FUNCTION_LIST KF7-312.6[34] /end FUNCTION_LIST /end MEASUREMENT
/begin MEASUREMENT vNDRCCL "At the time of KT low oil temperature, at the time of the ND select, recover rotation" UBYTE COMP_0000 1 100 0 6375 ECU_ADDRESS 0xFFFF15CB /begin FUNCTION_LIST KF7-312.6[34] /end FUNCTION_LIST /end MEASUREMENT
/begin MEASUREMENT vNLCNT "Continuous NO. Load rotation counter" UWORD COMP_0016 1 100 0 65535 ECU_ADDRESS 0xFFFF15E0 /begin FUNCTION_LIST KF7-312.6[34] /end FUNCTION_LIST /end MEASUREMENT
/begin MEASUREMENT vNR "JECS cut recover rotation" UBYTE COMP_0000 1 100 0 6375 ECU_ADDRESS 0xFFFF15E6
 /begin FUNCTION_LIST KF7-312.6[34] KF7-320A.1[6] KF7-376.2[21] KF7-385.1[32] KF7-580.1[8] R301.23.ADV_calculation_1_1_2 /end FUNCTION_LIST
/end MEASUREMENT
/begin MEASUREMENT vOFFOIL "At the time of KT low oil temperature, high rotation fuel cut condition oil temperature" UBYTE COMP_0128_S 1 100 -30 1245 ECU_ADDRESS 0xFFFF161C /begin FUNCTION_LIST KF7-312.6[34] /end FUNCTION_LIST /end MEASUREMENT
/begin MEASUREMENT vONEBYA "The reciprocal number of the low frequency response gain" UWORD COMP_0063 1 100 0 255.99609375 ECU_ADDRESS 0xFFFF162C /begin FUNCTION_LIST KF7-312.4A[6] KF7-312.5A[4] KF7-312.5C[1] /end FUNCTION_LIST /end MEASUREMENT
/begin MEASUREMENT vPIPBOST "Estimated intake manifold negative pressure" UWORD COMP_0445_S 1 100 0 127.99837455 ECU_ADDRESS 0xFFFF308C /begin FUNCTION_LIST KF7-312.1C[N] /end FUNCTION_LIST /end MEASUREMENT
/begin MEASUREMENT vPPAMB "Atomospheric pressure value" UWORD COMP_0445_S 1 100 0 127.99837455 ECU_ADDRESS 0xFFFFB7AE
 /begin FUNCTION_LIST KF7-312.1C[N] KF7-500.1[54] KF7-500.7[12] R000.1.RS_Integ_1_10_2 R904.1.Gst_on_can_1_0_1 /end FUNCTION_LIST
/end MEASUREMENT
/begin MEASUREMENT vPTNHI "T/M requirement fuel cut speed" UBYTE COMP_0020 1 100 0 12750 ECU_ADDRESS 0xFFFF30AC /begin FUNCTION_LIST KF7-312.6[34] /end FUNCTION_LIST /end MEASUREMENT
/begin MEASUREMENT vPTNHIC "T/M requirement fuel cut speed (CAN receiving value)" UBYTE COMP_0020 1 100 0 12750 ECU_ADDRESS 0xFFFF495A /begin FUNCTION_LIST KF7-312.6[34] KF7-360.9M[43] /end FUNCTION_LIST /end MEASUREMENT
/begin MEASUREMENT vREALTP "Cylinder intake quantity equivalent pulse width (the front to deal with a limiter)" UWORD COMP_0144 1 100 0 31.999495335 ECU_ADDRESS 0xFFFF888E /begin FUNCTION_LIST KF7-312.6[34] /end FUNCTION_LIST /end MEASUREMENT
/begin MEASUREMENT vREC "BOSCH cut recover rotation" UBYTE COMP_0000 1 100 0 6375 ECU_ADDRESS 0xFFFF1726
 /begin FUNCTION_LIST KF7-312.6[34] KF7-320A.1[6] KF7-376.2[21] KF7-385.1[32] R301.23.ADV_calculation_1_1_2 /end FUNCTION_LIST
/end MEASUREMENT
/begin MEASUREMENT vREFAPP "Between APPs, the number of REFs" UBYTE COMP_0004 1 100 0 255 ECU_ADDRESS 0xFFFF8A50 /begin FUNCTION_LIST KF7-312.2A[16] /end FUNCTION_LIST /end MEASUREMENT
/begin MEASUREMENT vRPBOST "Intake manifold pressure/atomospheric pressure ratio" UBYTE COMP_0063 1 100 0 0.99609375 ECU_ADDRESS 0xFFFF176E /begin FUNCTION_LIST KF7-312.1C[N] /end FUNCTION_LIST /end MEASUREMENT
/begin MEASUREMENT vRPBOST1 "Intake manifold pressure/atomospheric pressure basic value" UBYTE COMP_0063 1 100 0 0.99609375 ECU_ADDRESS 0xFFFF176F /begin FUNCTION_LIST KF7-312.1C[N] /end FUNCTION_LIST /end MEASUREMENT
/begin MEASUREMENT vRPBOST2 "Intake manifold pressure/atomospheric pressure rotation compensation value" UBYTE COMP_0063 1 100 0 0.99609375 ECU_ADDRESS 0xFFFF1770 /begin FUNCTION_LIST KF7-312.1C[N] /end FUNCTION_LIST /end MEASUREMENT
/begin MEASUREMENT vSCVTP "At the time of SCV switching, a wall way compensation rate by the cylinder" UBYTE COMP_0009 1 100 0 199.21875 ECU_ADDRESS 0xFFFF177D /begin FUNCTION_LIST KF7-312.4C[4] /end FUNCTION_LIST /end MEASUREMENT
/begin MEASUREMENT vSONITC "From SCV opening and closing, ITAC in the SOFDLY# progress" UBYTE COMP_0009 1 100 0 199.21875 ECU_ADDRESS 0xFFFF17B4 /begin FUNCTION_LIST KF7-312.4A[6] KF7-312.4C[4] /end FUNCTION_LIST /end MEASUREMENT
/begin MEASUREMENT vSQKVC "Before the square-root calculation, return-less compensation clause" UBYTE COMP_0341 1 100 0 0.99705 ECU_ADDRESS 0xFFFF17B9 /begin FUNCTION_LIST KF7-312.1C[N] /end FUNCTION_LIST /end MEASUREMENT
/begin MEASUREMENT vSTBICN "Stability rotation load compensation rate" UBYTE COMP_0181 1 100 0 7.96875 ECU_ADDRESS 0xFFFF17BA /begin FUNCTION_LIST KF7-312.3A[27] /end FUNCTION_LIST /end MEASUREMENT
/begin MEASUREMENT vSTSTATE "After the start, condition value" UBYTE COMP_0068 1 100 0 255 ECU_ADDRESS 0xFFFF1039
 /begin FUNCTION_LIST KF7-312.3A[27] KF7-320A.10[14] KF7-320A.19[7] KF7-320A.20[2] /end FUNCTION_LIST
/end MEASUREMENT
/begin MEASUREMENT vTATM "At the time of the start, pulse width PRESS compensation rate" UBYTE COMP_0384 1 100 0 1.992315 ECU_ADDRESS 0xFFFF180A
 /begin FUNCTION_LIST KF7-311.1A[21] KF7-312.1C[N] R000.1.RS_Integ_1_10_2 R203.2.crk_restx_1_0_8 /end FUNCTION_LIST
/end MEASUREMENT
/begin MEASUREMENT vTCSTSB "The amount of spare injection" UWORD COMP_0231 1 100 0 655350 ECU_ADDRESS 0xFFFF1828 /begin FUNCTION_LIST KF7-311.1A[21] /end FUNCTION_LIST /end MEASUREMENT
/begin MEASUREMENT vTEMHOS "Target air-fuel ratio exhaust compensation rate" UWORD COMP_0057 1 100 0 3.999941832 ECU_ADDRESS 0xFFFF1896
 /begin FUNCTION_LIST KF7-312.2A[16] KF7-312.3A[27] R301.9.Target_Equivalent_Ratio_1_0_2 /end FUNCTION_LIST
/end MEASUREMENT
/begin MEASUREMENT vTINJDTW "The amount of rise in retard maintenance coolant temperature" UBYTE COMP_0003 1 100 0 255 ECU_ADDRESS 0xFFFF3330 /begin FUNCTION_LIST KF7-311.1A[21] /end FUNCTION_LIST /end MEASUREMENT
/begin MEASUREMENT vTINJRTD "At the time of the low temperature, retard-ization compensation coefficient" UBYTE COMP_0055 1 100 0 1020 ECU_ADDRESS 0xFFFF3331 /begin FUNCTION_LIST KF7-311.1A[21] R301.10.TITM_1_0_2 /end FUNCTION_LIST /end MEASUREMENT
/begin MEASUREMENT vTINJSTP "The amount of ignition timing return step" UWORD COMP_0634_S 1 100 0 655.35 ECU_ADDRESS 0xFFFF3332 /begin FUNCTION_LIST KF7-311.1A[21] /end FUNCTION_LIST /end MEASUREMENT
/begin MEASUREMENT vTIPD "At the time of the simultaneous injection, output pulse width" UWORD COMP_0231 1 100 0 655350 ECU_ADDRESS 0xFFFF1934 /begin FUNCTION_LIST KF7-312.1C[N] KF7-450.50[10] /end FUNCTION_LIST /end MEASUREMENT
/begin MEASUREMENT vTIPDF "After simultaneous injection ZD-ization compensation, pulse width" UWORD COMP_0192 1 100 0 655350 ECU_ADDRESS 0xFFFF2412 /begin FUNCTION_LIST KF7-312.1C[N] /end FUNCTION_LIST /end MEASUREMENT
/begin MEASUREMENT vTIPS "At the time of the sequential injection, output pulse width" UWORD COMP_0231 1 100 0 655350 ECU_ADDRESS 0xFFFF2414
 /begin FUNCTION_LIST KF7-312.1C[N] KF7-313C.9[3] KF7-450.50[10] R301.13.FFDforDiagOnCAN_1_1_3 R901.1.Diag_on_can_app_1_6_2 /end FUNCTION_LIST
/end MEASUREMENT
/begin MEASUREMENT vTIPS_R#1 "At the time of the sequential injection, output pulse width" UWORD COMP_0231 1 100 0 655350 ECU_ADDRESS 0xFFFF2414
 /begin FUNCTION_LIST KF7-312.1C[N] KF7-313C.9[3] KF7-450.50[10] R301.13.FFDforDiagOnCAN_1_1_3 R901.1.Diag_on_can_app_1_6_2 /end FUNCTION_LIST
/end MEASUREMENT
/begin MEASUREMENT vTIPS_R#2 "At the time of the sequential injection, output pulse width" UWORD COMP_0231 1 100 0 655350 ECU_ADDRESS 0xFFFF2416
 /begin FUNCTION_LIST KF7-312.1C[N] KF7-313C.9[3] KF7-450.50[10] R301.13.FFDforDiagOnCAN_1_1_3 R901.1.Diag_on_can_app_1_6_2 /end FUNCTION_LIST
/end MEASUREMENT
/begin MEASUREMENT vTIPST "Initial injection pulse width" UWORD COMP_0192 1 100 0 655350 ECU_ADDRESS 0xFFFF2418 /begin FUNCTION_LIST KF7-312.1C[N] /end FUNCTION_LIST /end MEASUREMENT
/begin MEASUREMENT vTIPSTF "Initial injection pulse width" UWORD COMP_0192 1 100 0 655350 ECU_ADDRESS 0xFFFF241A /begin FUNCTION_LIST KF7-312.1C[N] /end FUNCTION_LIST /end MEASUREMENT
/begin MEASUREMENT vTIST "At the time of the initial injection, output pulse width" UWORD COMP_0231 1 100 0 655350 ECU_ADDRESS 0xFFFF241C /begin FUNCTION_LIST KF7-311.1A[21] KF7-312.1C[N] KF7-580.1[8] /end FUNCTION_LIST /end MEASUREMENT
/begin MEASUREMENT vTIST1 "At the time of the initial injection, output pulse width #1" UWORD COMP_0192 1 100 0 655350 ECU_ADDRESS 0xFFFF241E /begin FUNCTION_LIST KF7-312.1C[N] /end FUNCTION_LIST /end MEASUREMENT
/begin MEASUREMENT vTIST2 "At the time of the initial injection, output pulse width #2" UWORD COMP_0192 1 100 0 655350 ECU_ADDRESS 0xFFFF2420 /begin FUNCTION_LIST KF7-312.1C[N] /end FUNCTION_LIST /end MEASUREMENT
/begin MEASUREMENT vTIST3 "At the time of the initial injection, output pulse width #3" UWORD COMP_0192 1 100 0 655350 ECU_ADDRESS 0xFFFF2422 /begin FUNCTION_LIST KF7-312.1C[N] /end FUNCTION_LIST /end MEASUREMENT
/begin MEASUREMENT vTIST4 "At the time of the initial injection, output pulse width #4" UWORD COMP_0192 1 100 0 655350 ECU_ADDRESS 0xFFFF2424 /begin FUNCTION_LIST KF7-311.1A[21] KF7-312.1C[N] /end FUNCTION_LIST /end MEASUREMENT
/begin MEASUREMENT vTISTF "After initial injection ZD-ization compensation, pulse width" UWORD COMP_0192 1 100 0 655350 ECU_ADDRESS 0xFFFF2428 /begin FUNCTION_LIST KF7-312.1C[N] /end FUNCTION_LIST /end MEASUREMENT
/begin MEASUREMENT vTISTF1 "After initial injection ZD-ization compensation, pulse width #1" UWORD COMP_0192 1 100 0 655350 ECU_ADDRESS 0xFFFF242A /begin FUNCTION_LIST KF7-312.1C[N] /end FUNCTION_LIST /end MEASUREMENT
/begin MEASUREMENT vTISTF2 "After initial injection ZD-ization compensation, pulse width #2" UWORD COMP_0192 1 100 0 655350 ECU_ADDRESS 0xFFFF242C /begin FUNCTION_LIST KF7-312.1C[N] /end FUNCTION_LIST /end MEASUREMENT
/begin MEASUREMENT vTISTF3 "After initial injection ZD-ization compensation, pulse width #3" UWORD COMP_0192 1 100 0 655350 ECU_ADDRESS 0xFFFF242E /begin FUNCTION_LIST KF7-312.1C[N] /end FUNCTION_LIST /end MEASUREMENT
/begin MEASUREMENT vTISTF4 "After initial injection ZD-ization compensation, pulse width #4" UWORD COMP_0192 1 100 0 655350 ECU_ADDRESS 0xFFFF2430 /begin FUNCTION_LIST KF7-311.1A[21] KF7-312.1C[N] /end FUNCTION_LIST /end MEASUREMENT
/begin MEASUREMENT vTMDSTL "D range stall continuous judgement timer" UWORD COMP_0202 1 100 0 655350 ECU_ADDRESS 0xFFFF1940 /begin FUNCTION_LIST KF7-312.6[34] /end FUNCTION_LIST /end MEASUREMENT
/begin MEASUREMENT vTMFRCNT "TMFR cut cylinder number counter" UBYTE COMP_0030 1 100 0 255 ECU_ADDRESS 0xFFFF194B /begin FUNCTION_LIST KF7-312.6[34] /end FUNCTION_LIST /end MEASUREMENT
/begin MEASUREMENT vTMFRCNTB "TMFR cut cylinder number buffer" UBYTE COMP_0030 1 100 0 255 ECU_ADDRESS 0xFFFF194C /begin FUNCTION_LIST KF7-312.6[34] /end FUNCTION_LIST /end MEASUREMENT
/begin MEASUREMENT vTMFRM "TMFR operation monitor" UBYTE COMP_0068 1 100 0 255 ECU_ADDRESS 0xFFFF194D /begin FUNCTION_LIST KF7-312.6[34] /end FUNCTION_LIST /end MEASUREMENT
/begin MEASUREMENT vTMFRTM "TMFR cut start timer" UBYTE COMP_0014 1 100 0 2550 ECU_ADDRESS 0xFFFF194E /begin FUNCTION_LIST KF7-312.6[34] /end FUNCTION_LIST /end MEASUREMENT
/begin MEASUREMENT vTMKAS "After the start, decrease time rate" UBYTE COMP_0063 1 100 0 0.99609375 ECU_ADDRESS 0xFFFF1951 /begin FUNCTION_LIST KF7-312.3A[27] /end FUNCTION_LIST /end MEASUREMENT
/begin MEASUREMENT vTNKAS "After the start, rotation compensation rate" UBYTE COMP_0186 1 100 0 3.984375 ECU_ADDRESS 0xFFFF1971 /begin FUNCTION_LIST KF7-312.3A[27] /end FUNCTION_LIST /end MEASUREMENT
/begin MEASUREMENT vTOILST "At the time of the start, KT oil temperature" UBYTE COMP_0128_S 1 100 -30 1245 ECU_ADDRESS 0xFFFF3380 /begin FUNCTION_LIST KF7-312.6[34] KF7-360.9M[43] /end FUNCTION_LIST /end MEASUREMENT
/begin MEASUREMENT vTPFBAO "Last time, at the time of the injection, use TPÅ~TFBYA" UWORD COMP_0166_S 1 100 0 63.999056205 ECU_ADDRESS 0xFFFF197A /begin FUNCTION_LIST KF7-312.4C[4] /end FUNCTION_LIST /end MEASUREMENT
/begin MEASUREMENT vTPISFS "At the time of the idle, basic pulse width" UWORD COMP_0052 1 100 0 31.99956087 ECU_ADDRESS 0xFFFF103E
 /begin FUNCTION_LIST KF7-312.1C[N] KF7-312.4A[6] KF7-312.4C[4] KF7-312.5A[4] KF7-312.5C[1] KF7-313C.11B[1] /end FUNCTION_LIST
/end MEASUREMENT
/begin MEASUREMENT vTRQKT1 "At the time of KT low oil temperature, drive protection control torque" SWORD COMP_0228 1 100 -3276.8 3276.7 ECU_ADDRESS 0xFFFF33DA /begin FUNCTION_LIST KF7-312.6[34] KF7-360.9M[43] /end FUNCTION_LIST /end MEASUREMENT
/begin MEASUREMENT vTRQNTU "Rotation synchronous control target torque" SWORD COMP_0228 1 100 -3276.8 3276.7 ECU_ADDRESS 0xFFFF33E8
 /begin FUNCTION_LIST KF7-312.6[34] KF7-340.1M[8] KF7-360.9M[43] KF7-360.9P[22] KF7-410.17M[5] /end FUNCTION_LIST
/end MEASUREMENT
/begin MEASUREMENT vUNLOCKT "Actual lockup release delay time" UBYTE COMP_0014 1 100 0 2550 ECU_ADDRESS 0xFFFF1A54 /begin FUNCTION_LIST KF7-312.6[34] KF7-385.1[32] /end FUNCTION_LIST /end MEASUREMENT
/begin MEASUREMENT vVMF "Adhesion speed" SWORD COMP_0523 1 100 -32.000016384 31.999039821 ECU_ADDRESS 0xFFFF1A8A /begin FUNCTION_LIST KF7-312.4A[6] KF7-312.4C[4] /end FUNCTION_LIST /end MEASUREMENT
/begin MEASUREMENT vVMFO "Last time, at the time of the injection, use VMF" SWORD COMP_0523 1 100 -32.000016384 31.999039821 ECU_ADDRESS 0xFFFF1A8C /begin FUNCTION_LIST KF7-312.4A[6] /end FUNCTION_LIST /end MEASUREMENT
/begin MEASUREMENT vZIDLTW "IDLHOS gain coolant temperature table reference value" UBYTE COMP_0186 1 100 0 3.984375 ECU_ADDRESS 0xFFFF1C2A /begin FUNCTION_LIST KF7-312.1C[N] /end FUNCTION_LIST /end MEASUREMENT
/begin MEASUREMENT wvALT "Atomospheric pressure" UWORD COMP_0017_S 1 100 0 2047.96875 ECU_ADDRESS 0xFFFF9F48 /begin FUNCTION_LIST KF7-312.6[34] /end FUNCTION_LIST /end MEASUREMENT
/begin MEASUREMENT wvCA10MS "A crank angle between 10 ms" UBYTE COMP_0017 1 100 0 255 ECU_ADDRESS 0xFFFF88F0 /begin FUNCTION_LIST KF7-312.5A[4] KF7-312.5C[1] /end FUNCTION_LIST /end MEASUREMENT
/begin MEASUREMENT wvPTNHIC "T/M requirement fuel cut speed (CAN receiving value)" UBYTE COMP_0020 1 100 0 12750 ECU_ADDRESS 0xFFFF4858 /begin FUNCTION_LIST KF7-312.6[34] KF7-360.9M[43] /end FUNCTION_LIST /end MEASUREMENT
/begin MEASUREMENT wvREALTP "Cylinder intake quantity equivalent pulse width (the front to deal with a limiter)" UWORD COMP_0144 1 100 0 31.999495335 ECU_ADDRESS 0xFFFF887E /begin FUNCTION_LIST KF7-312.6[34] /end FUNCTION_LIST /end MEASUREMENT
/begin MEASUREMENT wvREFAPP "Between APPs, the number of REFs" UBYTE COMP_0004 1 100 0 255 ECU_ADDRESS 0xFFFF8A18 /begin FUNCTION_LIST KF7-312.2A[16] /end FUNCTION_LIST /end MEASUREMENT
/begin MEASUREMENT OVHEAT "RAM value OVHEAT" UBYTE COMP_0068 1 100 0 255 ECU_ADDRESS 0xFFFF9C6F
 /begin FUNCTION_LIST KF7-312.6[34] KF7-500.2A[29] R000.3.RS_SelfDiagflags_1_1_2 R301.5.FuelCut_1_2_2 /end FUNCTION_LIST
/end MEASUREMENT
/begin MEASUREMENT THOPNG "RAM value THOPNG" UBYTE COMP_0068 1 100 0 255 ECU_ADDRESS 0xFFFF9D08
 /begin FUNCTION_LIST KF7-312.6[34] KF7-500.2A[29] KF7-505.33[8] KF7-505.34[3] KF7-525.2[6] KF7-525.2S[10] /end FUNCTION_LIST
/end MEASUREMENT
/begin MEASUREMENT vOVHEAT "RAM value vOVHEAT" UWORD COMP_0068 1 100 0 65535 ECU_ADDRESS 0xFFFF9C70 /begin FUNCTION_LIST KF7-312.6[34] KF7-500.2A[29] /end FUNCTION_LIST /end MEASUREMENT
/* COMPU_METHOD --------------------------------------------------------- */
/begin COMPU_METHOD COMP_0017 "1deg" RAT_FUNC "%8.2" "deg" COEFFS 0 1 0 0 0 1 /end COMPU_METHOD
/begin COMPU_METHOD COMP_0205_S "fixed axis Long" RAT_FUNC "%8.2" "Long" COEFFS 0 1 0 0 0 1 /end COMPU_METHOD
/begin COMPU_METHOD COMP_0290 "1/65536-" RAT_FUNC "%8.6" "-" COEFFS 0 1 0 0 0 0.0000152588 /end COMPU_METHOD
/begin COMPU_METHOD COMP_0068 "1-" RAT_FUNC "%8.2" "-" COEFFS 0 1 0 0 0 1 /end COMPU_METHOD
/begin COMPU_METHOD COMP_0004 "1Å|" RAT_FUNC "%8.2" "Å|" COEFFS 0 1 0 0 0 1 /end COMPU_METHOD
/begin COMPU_METHOD COMP_0334_S "2.56mg" RAT_FUNC "%8.2" "mg" COEFFS 0 1 0 0 0 2.56 /end COMPU_METHOD
/begin COMPU_METHOD COMP_0061 "5mv" RAT_FUNC "%8.2" "mv" COEFFS 0 1 0 0 0 5 /end COMPU_METHOD
/begin COMPU_METHOD COMP_0023 "5mV" RAT_FUNC "%8.2" "mV" COEFFS 0 1 0 0 0 5 /end COMPU_METHOD
/begin COMPU_METHOD COMP_0335_S "2%" RAT_FUNC "%8.2" "%" COEFFS 0 1 384 0 0 2 /end COMPU_METHOD
/begin COMPU_METHOD COMP_0045 "1/128-" RAT_FUNC "%8.4" "-" COEFFS 0 1 0 0 0 0.0078125 /end COMPU_METHOD
/begin COMPU_METHOD COMP_0186 "1/64-" RAT_FUNC "%8.3" "-" COEFFS 0 1 0 0 0 0.015625 /end COMPU_METHOD
/begin COMPU_METHOD COMP_0001 "1/8ms" RAT_FUNC "%8.2" "ms" COEFFS 0 1 0 0 0 0.125 /end COMPU_METHOD
/begin COMPU_METHOD COMP_0020 "50rpm" RAT_FUNC "%8.2" "rpm" COEFFS 0 1 0 0 0 50 /end COMPU_METHOD
/begin COMPU_METHOD COMP_0336_S "0.0001-" RAT_FUNC "%8.5" "-" COEFFS 0 1 0 0 0 0.0001 /end COMPU_METHOD
/begin COMPU_METHOD COMP_0002 "0.35deg" RAT_FUNC "%8.2" "deg" COEFFS 0 1 0 0 0 0.35 /end COMPU_METHOD
/begin COMPU_METHOD COMP_0003 "1Åé" RAT_FUNC "%8.2" "Åé" COEFFS 0 1 0 0 0 1 /end COMPU_METHOD
/begin COMPU_METHOD COMP_0453 "0.002-" RAT_FUNC "%8.4" "-" COEFFS 0 1 0 0 0 0.002 /end COMPU_METHOD
/begin COMPU_METHOD COMP_0014 "10ms" RAT_FUNC "%8.2" "ms" COEFFS 0 1 0 0 0 10 /end COMPU_METHOD
/begin COMPU_METHOD COMP_0006 "12.5rpm" RAT_FUNC "%8.2" "rpm" COEFFS 0 1 0 0 0 12.5 /end COMPU_METHOD
/begin COMPU_METHOD COMP_0008 "100ms" RAT_FUNC "%8.2" "ms" COEFFS 0 1 0 0 0 100 /end COMPU_METHOD
/begin COMPU_METHOD COMP_0009 "100/128%" RAT_FUNC "%8.2" "%" COEFFS 0 1 0 0 0 0.78125 /end COMPU_METHOD
/begin COMPU_METHOD COMP_0000 "25rpm" RAT_FUNC "%8.2" "rpm" COEFFS 0 1 0 0 0 25 /end COMPU_METHOD
/begin COMPU_METHOD COMP_0486 "20/256mv" RAT_FUNC "%8.3" "mv" COEFFS 0 1 0 0 0 0.078125 /end COMPU_METHOD
/begin COMPU_METHOD COMP_0007 "2km/h" RAT_FUNC "%8.2" "km/h" COEFFS 0 1 0 0 0 2 /end COMPU_METHOD
/begin COMPU_METHOD COMP_0217 "1/16384-" RAT_FUNC "%8.6" "-" COEFFS 0 1 0 0 0 0.0000610352 /end COMPU_METHOD
/begin COMPU_METHOD COMP_0027 "1%" RAT_FUNC "%8.2" "%" COEFFS 0 1 0 0 0 1 /end COMPU_METHOD
/begin COMPU_METHOD COMP_0267_S "0.1sec" RAT_FUNC "%8.2" "sec" COEFFS 0 1 0 0 0 0.1 /end COMPU_METHOD
/begin COMPU_METHOD COMP_0165_S "secsec" RAT_FUNC "%8.3" "sec" COEFFS 0 1 0 0 0 0.01 /end COMPU_METHOD
/begin COMPU_METHOD COMP_0049 "1sec" RAT_FUNC "%8.2" "sec" COEFFS 0 1 0 0 0 1 /end COMPU_METHOD
/begin COMPU_METHOD COMP_0032 "1/256Å|" RAT_FUNC "%8.4" "Å|" COEFFS 0 1 0 0 0 0.00390625 /end COMPU_METHOD
/begin COMPU_METHOD COMP_0066 "1/64Å|" RAT_FUNC "%8.3" "Å|" COEFFS 0 1 0 0 0 0.015625 /end COMPU_METHOD
/begin COMPU_METHOD COMP_0063 "1/256-" RAT_FUNC "%8.4" "-" COEFFS 0 1 0 0 0 0.00390625 /end COMPU_METHOD
/begin COMPU_METHOD COMP_0370 "2.5mv" RAT_FUNC "%8.2" "mv" COEFFS 0 1 0 0 0 2.5 /end COMPU_METHOD
/begin COMPU_METHOD COMP_0093 "2.5mV" RAT_FUNC "%8.2" "mV" COEFFS 0 1 0 0 0 2.5 /end COMPU_METHOD
/begin COMPU_METHOD COMP_0030 "1âÒ" RAT_FUNC "%8.2" "âÒ" COEFFS 0 1 0 0 0 1 /end COMPU_METHOD
/begin COMPU_METHOD COMP_0341_S "0.002-" RAT_FUNC "%8.4" "-" COEFFS 0 1 0 0 0 0.002 /end COMPU_METHOD
/begin COMPU_METHOD COMP_0443 "1rpm" RAT_FUNC "%8.2" "rpm" COEFFS 0 1 0 0 0 1 /end COMPU_METHOD
/begin COMPU_METHOD COMP_0031 "1/256%" RAT_FUNC "%8.4" "%" COEFFS 0 1 0 0 0 0.00390625 /end COMPU_METHOD
/begin COMPU_METHOD COMP_0361_S "0.001-" RAT_FUNC "%8.4" "-" COEFFS 0 1 0 0 0 0.001 /end COMPU_METHOD
/begin COMPU_METHOD COMP_0173 "1/16-" RAT_FUNC "%8.3" "-" COEFFS 0 1 0 0 0 0.0625 /end COMPU_METHOD
/begin COMPU_METHOD COMP_0044 "1/128Å|" RAT_FUNC "%8.4" "Å|" COEFFS 0 1 0 0 0 0.0078125 /end COMPU_METHOD
/begin COMPU_METHOD COMP_0016 "1count" RAT_FUNC "%8.2" "count" COEFFS 0 1 0 0 0 1 /end COMPU_METHOD
/begin COMPU_METHOD COMP_0054 "20mV" RAT_FUNC "%8.2" "mV" COEFFS 0 1 0 0 0 20 /end COMPU_METHOD
/begin COMPU_METHOD COMP_0055 "4deg" RAT_FUNC "%8.2" "deg" COEFFS 0 1 0 0 0 4 /end COMPU_METHOD
/begin COMPU_METHOD COMP_0373 "1/100-" RAT_FUNC "%8.3" "-" COEFFS 0 1 0 0 0 0.01 /end COMPU_METHOD
/begin COMPU_METHOD COMP_0035 "X-50Åé" RAT_FUNC "%8.2" "Åé" COEFFS 0 1 50 0 0 1 /end COMPU_METHOD
/begin COMPU_METHOD COMP_0071 "1rev" RAT_FUNC "%8.2" "rev" COEFFS 0 1 0 0 0 1 /end COMPU_METHOD
/begin COMPU_METHOD COMP_0376_S "1/256-" RAT_FUNC "%8.4" "-" COEFFS 0 1 -0.5 0 0 0.00390625 /end COMPU_METHOD
/begin COMPU_METHOD COMP_0228 "0.1Nm" RAT_FUNC "%8.2" "Nm" COEFFS 0 1 0 0 0 0.1 /end COMPU_METHOD
/begin COMPU_METHOD COMP_0262 "12.5rpm" RAT_FUNC "%8.2" "rpm" COEFFS 0 1 0 0 0 12.5 /end COMPU_METHOD
/begin COMPU_METHOD COMP_0079 "100/1024%" RAT_FUNC "%8.3" "%" COEFFS 0 1 0 0 0 0.09765 /end COMPU_METHOD
/begin COMPU_METHOD COMP_0388_S "1x10ms" RAT_FUNC "%8.2" "x10ms" COEFFS 0 1 0 0 0 1 /end COMPU_METHOD
/begin COMPU_METHOD COMP_0095 "400/256%" RAT_FUNC "%8.2" "%" COEFFS 0 1 0 0 0 1.5625 /end COMPU_METHOD
/begin COMPU_METHOD COMP_0100 "1/163841/10ms" RAT_FUNC "%8.6" "1/10ms" COEFFS 0 1 0 0 0 0.0000610352 /end COMPU_METHOD
/begin COMPU_METHOD COMP_0099 "1/16384/10ms" RAT_FUNC "%8.6" "/10ms" COEFFS 0 1 0 0 0 0.0000610352 /end COMPU_METHOD
/begin COMPU_METHOD COMP_0101 "1/65536Å|" RAT_FUNC "%8.6" "Å|" COEFFS 0 1 0 0 0 0.0000152588 /end COMPU_METHOD
/begin COMPU_METHOD COMP_0396_S "1/16384/256/12.51/rpm" RAT_FUNC "%8.6" "1/rpm" COEFFS 0 1 0 0 0 0.0000000190734 /end COMPU_METHOD
/begin COMPU_METHOD COMP_0106 "1/(8*256)Å|" RAT_FUNC "%8.5" "Å|" COEFFS 0 1 0 0 0 0.000488 /end COMPU_METHOD
/begin COMPU_METHOD COMP_0069 "1/(128*256)Å|" RAT_FUNC "%8.6" "Å|" COEFFS 0 1 0 0 0 0.0000305176 /end COMPU_METHOD
/begin COMPU_METHOD COMP_0120 "1î{" RAT_FUNC "%8.2" "î{" COEFFS 0 1 0 0 0 1 /end COMPU_METHOD
/begin COMPU_METHOD COMP_0108 "1/256/10ms" RAT_FUNC "%8.4" "/10ms" COEFFS 0 1 0 0 0 0.00390625 /end COMPU_METHOD
/begin COMPU_METHOD COMP_0125 "1/256ms" RAT_FUNC "%8.4" "ms" COEFFS 0 1 0 0 0 0.00390625 /end COMPU_METHOD
/begin COMPU_METHOD COMP_0126 "1/1024ms/V" RAT_FUNC "%8.5" "ms/V" COEFFS 0 1 0 0 0 0.000976563 /end COMPU_METHOD
/begin COMPU_METHOD COMP_0456 "1/(256Å~128)-" RAT_FUNC "%8.6" "-" COEFFS 0 1 0 0 0 0.0000305176 /end COMPU_METHOD
/begin COMPU_METHOD COMP_0190 "2deg" RAT_FUNC "%8.2" "deg" COEFFS 0 1 0 0 0 2 /end COMPU_METHOD
/begin COMPU_METHOD COMP_0450 "1/1024-" RAT_FUNC "%8.5" "-" COEFFS 0 1 0 0 0 0.000976563 /end COMPU_METHOD
/begin COMPU_METHOD COMP_0341 "1/256-" RAT_FUNC "%8.4" "-" COEFFS 0 1 0 0 0 0.00391 /end COMPU_METHOD
/begin COMPU_METHOD COMP_0417_S "1/16384-" RAT_FUNC "%8.6" "-" COEFFS 0 1 0 0 0 0.000061035 /end COMPU_METHOD
/begin COMPU_METHOD COMP_0418_S "1000/16384É s" RAT_FUNC "%8.3" "É s" COEFFS 0 1 0 0 0 0.061035156 /end COMPU_METHOD
/begin COMPU_METHOD COMP_0094_S "mgmg" RAT_FUNC "%8.3" "mg" COEFFS 0 1 0 0 0 0.01 /end COMPU_METHOD
/begin COMPU_METHOD COMP_0464 "1/8-" RAT_FUNC "%8.2" "-" COEFFS 0 1 0 0 0 0.125 /end COMPU_METHOD
/begin COMPU_METHOD COMP_0191 "1REV" RAT_FUNC "%8.2" "REV" COEFFS 0 1 0 0 0 1 /end COMPU_METHOD
/begin COMPU_METHOD COMP_0203 "1/256-" RAT_FUNC "%8.4" "-" COEFFS 0 1 0 0 0 0.00390625 /end COMPU_METHOD
/begin COMPU_METHOD COMP_0062 "4Åé" RAT_FUNC "%8.2" "Åé" COEFFS 0 1 0 0 0 4 /end COMPU_METHOD
/begin COMPU_METHOD COMP_0215 "0.2sec" RAT_FUNC "%8.2" "sec" COEFFS 0 1 0 0 0 0.2 /end COMPU_METHOD
/begin COMPU_METHOD COMP_0220 "1l/min" RAT_FUNC "%8.2" "l/min" COEFFS 0 1 0 0 0 1 /end COMPU_METHOD
/begin COMPU_METHOD COMP_0435 "1/32-" RAT_FUNC "%8.3" "-" COEFFS 0 1 0 0 0 0.03125 /end COMPU_METHOD
/begin COMPU_METHOD COMP_0472 "1/64-" RAT_FUNC "%8.3" "-" COEFFS 0 1 0 0 0 0.015625 /end COMPU_METHOD
/begin COMPU_METHOD COMP_0252 "1/256Å|" RAT_FUNC "%8.4" "Å|" COEFFS 0 1 -0.00390625 0 0 0.00390625 /end COMPU_METHOD
/begin COMPU_METHOD COMP_0395 "1/4096-" RAT_FUNC "%8.5" "-" COEFFS 0 1 0 0 0 0.000244141 /end COMPU_METHOD
/begin COMPU_METHOD COMP_0202 "10msec" RAT_FUNC "%8.2" "msec" COEFFS 0 1 0 0 0 10 /end COMPU_METHOD
/begin COMPU_METHOD COMP_0263 "1-" RAT_FUNC "%8.2" "-" COEFFS 0 1 0 0 0 1 /end COMPU_METHOD
/begin COMPU_METHOD COMP_0444_S "1/5120kPa/mV" RAT_FUNC "%8.5" "kPa/mV" COEFFS 0 1 0 0 0 0.000195313 /end COMPU_METHOD
/begin COMPU_METHOD COMP_0445_S "1/512kPa" RAT_FUNC "%8.4" "kPa" COEFFS 0 1 0 0 0 0.00195313 /end COMPU_METHOD
/begin COMPU_METHOD COMP_0065 "3.125rpm" RAT_FUNC "%8.2" "rpm" COEFFS 0 1 0 0 0 3.125 /end COMPU_METHOD
/begin COMPU_METHOD COMP_0052 "1/2048ms" RAT_FUNC "%8.5" "ms" COEFFS 0 1 0 0 0 0.000488282 /end COMPU_METHOD
/begin COMPU_METHOD COMP_0388 "0.1-" RAT_FUNC "%8.2" "-" COEFFS 0 1 0 0 0 0.1 /end COMPU_METHOD
/begin COMPU_METHOD COMP_0465_S "2kPa" RAT_FUNC "%8.2" "kPa" COEFFS 0 1 0 0 0 2 /end COMPU_METHOD
/begin COMPU_METHOD COMP_0057 "1/16384Å|" RAT_FUNC "%8.6" "Å|" COEFFS 0 1 0 0 0 0.0000610352 /end COMPU_METHOD
/begin COMPU_METHOD COMP_0171 "1.5625rpm/km/h" RAT_FUNC "%8.2" "rpm/km/h" COEFFS 0 1 0 0 0 1.5625 /end COMPU_METHOD
/begin COMPU_METHOD COMP_0144 "1/2048ms" RAT_FUNC "%8.5" "ms" COEFFS 0 1 0 0 0 0.000488281 /end COMPU_METHOD
/begin COMPU_METHOD COMP_0231 "10É S" RAT_FUNC "%8.2" "É S" COEFFS 0 1 0 0 0 10 /end COMPU_METHOD
/begin COMPU_METHOD COMP_0363 "2km" RAT_FUNC "%8.2" "km" COEFFS 0 1 0 0 0 2 /end COMPU_METHOD
/begin COMPU_METHOD COMP_0053 "1ms" RAT_FUNC "%8.2" "ms" COEFFS 0 1 0 0 0 1 /end COMPU_METHOD
/begin COMPU_METHOD COMP_0181 "1/32Å|" RAT_FUNC "%8.3" "Å|" COEFFS 0 1 0 0 0 0.03125 /end COMPU_METHOD
/begin COMPU_METHOD COMP_0483_S "0.002-" RAT_FUNC "%8.4" "-" COEFFS 0 1 65.536 0 0 0.002 /end COMPU_METHOD
/begin COMPU_METHOD COMP_0278_S "fixed axis Åé" RAT_FUNC "%8.2" "Åé" COEFFS 0 1 40 0 0 20 /end COMPU_METHOD
/begin COMPU_METHOD COMP_0271_S "fixed axis rpm" RAT_FUNC "%8.2" "rpm" COEFFS 0 1 0 0 0 400 /end COMPU_METHOD
/begin COMPU_METHOD COMP_0279_S "fixed axis %" RAT_FUNC "%8.2" "%" COEFFS 0 1 0 0 0 12.5 /end COMPU_METHOD
/begin COMPU_METHOD COMP_0271 "100/128/256%" RAT_FUNC "%8.4" "%" COEFFS 0 1 0 0 0 0.003051758 /end COMPU_METHOD
/begin COMPU_METHOD COMP_0490_S "0.002/4096-" RAT_FUNC "%8.6" "-" COEFFS 0 1 0 0 0 0.000000488281 /end COMPU_METHOD
/begin COMPU_METHOD COMP_0280_S "fixed axis Åé" RAT_FUNC "%8.2" "Åé" COEFFS 0 1 40 0 0 10 /end COMPU_METHOD
/begin COMPU_METHOD COMP_0493_S "fixed axis mV" RAT_FUNC "%8.2" "mV" COEFFS 0 1 0 0 0 320 /end COMPU_METHOD
/begin COMPU_METHOD COMP_0494_S "0.002Å[" RAT_FUNC "%8.4" "Å[" COEFFS 0 1 0 0 0 0.002 /end COMPU_METHOD
/begin COMPU_METHOD COMP_0285_S "fixed axis km/h" RAT_FUNC "%8.2" "km/h" COEFFS 0 1 -12 0 0 4 /end COMPU_METHOD
/begin COMPU_METHOD COMP_0283_S "fixed axis rpm" RAT_FUNC "%8.2" "rpm" COEFFS 0 1 0 0 0 200 /end COMPU_METHOD
/begin COMPU_METHOD COMP_0330 "1count" RAT_FUNC "%8.2" "count" COEFFS 0 1 128 0 0 1 /end COMPU_METHOD
/begin COMPU_METHOD COMP_0291_S "fixed axis rpm" RAT_FUNC "%8.2" "rpm" COEFFS 0 1 -2000 0 0 400 /end COMPU_METHOD
/begin COMPU_METHOD COMP_0292_S "fixed axis rpm" RAT_FUNC "%8.2" "rpm" COEFFS 0 1 0 0 0 100 /end COMPU_METHOD
/begin COMPU_METHOD COMP_0338 "1/64Å|" RAT_FUNC "%8.3" "Å|" COEFFS 0 1 0 0 0 0.015625 /end COMPU_METHOD
/begin COMPU_METHOD COMP_0310_S "fixed axis CYL" RAT_FUNC "%8.2" "CYL" COEFFS 0 1 -1 0 0 1 /end COMPU_METHOD
/begin COMPU_METHOD COMP_0122_S "msms" RAT_FUNC "%8.2" "ms" COEFFS 0 1 0 0 0 2 /end COMPU_METHOD
/begin COMPU_METHOD COMP_0312_S "fixed axis rpm" RAT_FUNC "%8.2" "rpm" COEFFS 0 1 0 0 0 800 /end COMPU_METHOD
/begin COMPU_METHOD COMP_0092_S "--" RAT_FUNC "%8.3" "-" COEFFS 0 1 0 0 0 0.02 /end COMPU_METHOD
/begin COMPU_METHOD COMP_0518_S "2.56mg" RAT_FUNC "%8.2" "mg" COEFFS 0 1 83886.08 0 0 2.56 /end COMPU_METHOD
/begin COMPU_METHOD COMP_0520_S "fixed axis Åé" RAT_FUNC "%8.2" "Åé" COEFFS 0 1 -80 0 0 5 /end COMPU_METHOD
/begin COMPU_METHOD COMP_0128_S "ÅéÅé" RAT_FUNC "%8.2" "Åé" COEFFS 0 1 30 0 0 5 /end COMPU_METHOD
/begin COMPU_METHOD COMP_0283 "1flag" RAT_FUNC "%8.2" "flag" COEFFS 0 1 0 0 0 1 /end COMPU_METHOD
/begin COMPU_METHOD COMP_0201_S "1s1s" RAT_FUNC "%8.2" "1s" COEFFS 0 1 0 0 0 1 /end COMPU_METHOD
/begin COMPU_METHOD COMP_0202_S "100ms100ms" RAT_FUNC "%8.2" "100ms" COEFFS 0 1 0 0 0 1 /end COMPU_METHOD
/begin COMPU_METHOD COMP_0203_S "10ms10ms" RAT_FUNC "%8.2" "10ms" COEFFS 0 1 0 0 0 1 /end COMPU_METHOD
/begin COMPU_METHOD COMP_0192 "10É s" RAT_FUNC "%8.2" "É s" COEFFS 0 1 0 0 0 10 /end COMPU_METHOD
/begin COMPU_METHOD COMP_0509 "10É Çì" RAT_FUNC "%8.2" "É Çì" COEFFS 0 1 0 0 0 10 /end COMPU_METHOD
/begin COMPU_METHOD COMP_0166_S "msms" RAT_FUNC "%8.5" "ms" COEFFS 0 1 0 0 0 0.000976563 /end COMPU_METHOD
/begin COMPU_METHOD COMP_0407 "64/256%" RAT_FUNC "%8.2" "%" COEFFS 0 1 0 0 0 0.25 /end COMPU_METHOD
/begin COMPU_METHOD COMP_0251 "1cyl" RAT_FUNC "%8.2" "cyl" COEFFS 0 1 0 0 0 1 /end COMPU_METHOD
/begin COMPU_METHOD COMP_0458 "10/256É S" RAT_FUNC "%8.3" "É S" COEFFS 0 1 1280 0 0 0.0390625 /end COMPU_METHOD
/begin COMPU_METHOD COMP_0017_S "mmHgmmHg" RAT_FUNC "%8.3" "mmHg" COEFFS 0 1 0 0 0 0.03125 /end COMPU_METHOD
/begin COMPU_METHOD COMP_0384 "1/128-" RAT_FUNC "%8.4" "-" COEFFS 0 1 0 0 0 0.007813 /end COMPU_METHOD
/begin COMPU_METHOD COMP_0182 "1/16ms" RAT_FUNC "%8.3" "ms" COEFFS 0 1 0 0 0 0.0625 /end COMPU_METHOD
/begin COMPU_METHOD COMP_0523 "1/1024ms" RAT_FUNC "%8.5" "ms" COEFFS 0 1 0 0 0 0.000976563 /end COMPU_METHOD
/begin COMPU_METHOD COMP_0589_S "É sÉ s" RAT_FUNC "%8.2" "É s" COEFFS 0 1 0 0 0 10 /end COMPU_METHOD
/begin COMPU_METHOD COMP_0176 "1/64ms" RAT_FUNC "%8.3" "ms" COEFFS 0 1 0 0 0 0.015625 /end COMPU_METHOD
/begin COMPU_METHOD COMP_0434 "1/25-" RAT_FUNC "%8.3" "-" COEFFS 0 1 0 0 0 0.04 /end COMPU_METHOD
/begin COMPU_METHOD COMP_0448 "100/16384%" RAT_FUNC "%8.4" "%" COEFFS 0 1 0 0 0 0.00610352 /end COMPU_METHOD
/begin COMPU_METHOD COMP_0603_S "%%" RAT_FUNC "%8.2" "%" COEFFS 0 1 0 0 0 2 /end COMPU_METHOD
/begin COMPU_METHOD COMP_0452 "0.2/256/100ms" RAT_FUNC "%8.5" "/100ms" COEFFS 0 1 0 0 0 0.00078125 /end COMPU_METHOD
/begin COMPU_METHOD COMP_0455 "1/(64*256)-" RAT_FUNC "%8.6" "-" COEFFS 0 1 0 0 0 0.0000610352 /end COMPU_METHOD
/begin COMPU_METHOD COMP_0344 "1/8msec" RAT_FUNC "%8.2" "msec" COEFFS 0 1 0 0 0 0.125 /end COMPU_METHOD
/begin COMPU_METHOD COMP_0466 "1/2048-" RAT_FUNC "%8.5" "-" COEFFS 0 1 0 0 0 0.000488281 /end COMPU_METHOD
/begin COMPU_METHOD COMP_0634_S "degdeg" RAT_FUNC "%8.3" "deg" COEFFS 0 1 0 0 0 0.01 /end COMPU_METHOD
/* RECORD_LAYOUT ------------------------------------------------------ */
/begin RECORD_LAYOUT REC_UBYTE_C FNC_VALUES 1 UBYTE COLUMN_DIR DIRECT /end RECORD_LAYOUT
/begin RECORD_LAYOUT REC_UWORD_C FNC_VALUES 1 UWORD COLUMN_DIR DIRECT /end RECORD_LAYOUT
/begin RECORD_LAYOUT REC_SWORD_C FNC_VALUES 1 SWORD COLUMN_DIR DIRECT /end RECORD_LAYOUT
/begin RECORD_LAYOUT REC_SBYTE_C FNC_VALUES 1 SBYTE COLUMN_DIR DIRECT /end RECORD_LAYOUT
/begin RECORD_LAYOUT REC_SLONG_C FNC_VALUES 1 SLONG COLUMN_DIR DIRECT /end RECORD_LAYOUT
/begin RECORD_LAYOUT REC_AXIS_UBYTE AXIS_PTS_X 1 UBYTE INDEX_INCR DIRECT /end RECORD_LAYOUT
/begin RECORD_LAYOUT REC_AXIS_UWORD AXIS_PTS_X 1 UWORD INDEX_INCR DIRECT /end RECORD_LAYOUT
/end MODULE
/end PROJECT
