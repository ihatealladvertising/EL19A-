ASAP2_VERSION 1 3_BETA
/begin PROJECT TK_X91_EUR_VC ""
/begin HEADER "" /* key HEADER ++ "comment" Ç… Par.scomment */ PROJECT_NO TK_X91_EUR_VC /* key PROJECT_NO ++ project number Ç… car_eng_desti_lot */ VERSION "7V4YHZEB2" /* key VERSION ++ version number Ç… mProgver */ /end HEADER
/begin MODULE DIM ""
/begin MOD_COMMON "" DEPOSIT ABSOLUTE BYTE_ORDER MSB_FIRST /* ﬁ≤ƒµ∞¿ﬁ∞Ç™ÿÃﬂ⁄∞ΩÇ≥ÇÍÇÈ */ /end MOD_COMMON
/begin FUNCTION KF7-500.39[5] "Lambda control closed loop activation delay diagnosis" /end FUNCTION
/begin FUNCTION KF7-500.44[3] "Intake air temperature sensor diagnosis" /end FUNCTION
/begin FUNCTION KF7-500.47B[15] "Continuous variable VTC self-diagnosis" /end FUNCTION
/begin FUNCTION KF7-500.51[3] "Absolute pressure sensor diagnosis for both intake manifold inner pressure/atmospheric pressure" /end FUNCTION
/begin FUNCTION KF7-500.56[2] "VIAS diagnosis" /end FUNCTION
/begin FUNCTION KF7-500.59[6] "Front A/F sensor heater diagnosis" /end FUNCTION
/begin FUNCTION KF7-500.60[5] "Thermostat diagnosis" /end FUNCTION
/begin FUNCTION KF7-500.69[25] "CAN communication self-diagnosis" /end FUNCTION
/begin FUNCTION KF7-500.73[1] "Power steering oil pressure diagnosis" /end FUNCTION
/begin FUNCTION KF7-500.74[11] "Front A/F sensor response deterioration / intermediate voltage failure diagnosis (F/C type)" /end FUNCTION
/begin FUNCTION KF7-500.74B[5] "Front A/F sensor diagnosis (active type)" /end FUNCTION
/begin FUNCTION KF7-500.75[4] "Front A/F sensor shift diagnosis" /end FUNCTION
/begin FUNCTION KF7-500.76[8] "Front A/F sensor connectivity diagnosis" /end FUNCTION
/begin FUNCTION KF7-505.2[9] "ETC control APS/TPS diagnosis" /end FUNCTION
/begin FUNCTION KF7-505.9[3] "APO input value mismatch diagnosis (for 1CPU) " /end FUNCTION
/begin FUNCTION KF7-505.10[2] "Water temperature sensor input mismatch diagnosis [For 1CPU]" /end FUNCTION
/begin FUNCTION KF7-505.12[6] "[Designated] RAM diagnosis (main)" /end FUNCTION
/begin FUNCTION KF7-505.15[4] "Throttle feedback control system monitoring control" /end FUNCTION
/begin FUNCTION KF7-505.16[1] "TGTVO mismatch diagnosis" /end FUNCTION
/begin FUNCTION KF7-505.17[3] "APOST mismatch diagnosis (for 1CPU)" /end FUNCTION
/begin FUNCTION KF7-505.18[3] "WDT diagnosis (for 1 CPU)" /end FUNCTION
/begin FUNCTION KF7-505.19[1] "Task execution cycle/order diagnosis " /end FUNCTION
/begin FUNCTION KF7-505.22[3] "EEPROM diagnosis (for 1 CPU)" /end FUNCTION
/begin FUNCTION KF7-505.23[2] "NEUT Switch diagnosis (for ETC)" /end FUNCTION
/begin FUNCTION KF7-505.24[1] "Backup RAM system diagnosis " /end FUNCTION
/begin FUNCTION KF7-505.25[3] "Self-shutoff system diagnosis" /end FUNCTION
/begin FUNCTION KF7-505.26[2] "Diagnosis parameter monitoring function " /end FUNCTION
/begin FUNCTION KF7-505.27[4] "Diagnosis for sticking of brake switch OFF" /end FUNCTION
/begin FUNCTION KF7-505.28[1] "Failure diagnosis of TPS1 4 times input signal" /end FUNCTION
/begin FUNCTION KF7-505.29[4] "Diagnosis of learning value at full closing throttle sensor " /end FUNCTION
/begin FUNCTION KF7-505.30[6] "Diagnosis of unperformed learning at full closing throttle sensor " /end FUNCTION
/begin FUNCTION KF7-505.31[5] "Motor relay diagnosis " /end FUNCTION
/begin FUNCTION KF7-505.32[6] "ETC diagnosis" /end FUNCTION
/begin FUNCTION KF7-505.33[8] "ETCACTR mechanical failure diagnosis (for 1 CPU)" /end FUNCTION
/begin FUNCTION KF7-505.34[3] "Throttle open stick diagnosis " /end FUNCTION
/begin FUNCTION KF7-505.35[2] "High speed ROM diagnosis" /end FUNCTION
/begin FUNCTION KF7-505.36[2] "High speed RAM diagnosis " /end FUNCTION
/begin FUNCTION KF7-505.37[1] "Timer / clock diagnosis" /end FUNCTION
/begin FUNCTION KF7-505.38[4] "AD port diagnosis" /end FUNCTION
/begin FUNCTION KF7-505.39[2] "Diagnosis execution request judgment of exercise calculation" /end FUNCTION
/begin FUNCTION KF7-505.40[1] "Diagnosis of exercise calculation set part" /end FUNCTION
/begin FUNCTION KF7-505.41[2] "Operation of example for ALU diagnosis" /end FUNCTION
/begin FUNCTION KF7-505.42[2] "Operation result matching function diagnosis " /end FUNCTION
/begin FUNCTION KF7-505.43[3] "SYNC monitor block diagnosis" /end FUNCTION
/begin FUNCTION KF7-505.47[3] "AT input revolution sensor diagnosis" /end FUNCTION
/begin FUNCTION KF7-505.49[3] "PTD vehicle speed sensor mismatch diagnosis  " /end FUNCTION
/begin FUNCTION KF7-505.50[1] "TQH0AP mismatch diagnosis" /end FUNCTION
/begin FUNCTION KF7-505.51[2] "Target engine torque mismatch diagnosis" /end FUNCTION
/begin FUNCTION KF7-505.52[1] "[Designated] TATE mismatch diagnosis" /end FUNCTION
/begin FUNCTION KF7-505.53[1] "[Designated] TTEP mismatch diagnosis" /end FUNCTION
/begin FUNCTION KF7-505.54[2] "[Designated] DRPTSP mismatch diagnosis" /end FUNCTION
/begin FUNCTION KF7-505.90[N] "[Designated] DCPUNG flag regulation " /end FUNCTION
/begin FUNCTION KF7-505.91[2] "DTVONG/DAPSNG flag regulation" /end FUNCTION
/begin FUNCTION KF7-525.1[4] "Data memory control (main CPU)" /end FUNCTION
/begin FUNCTION KF7-525.2[6] "Data compression specifications (main CPU)" /end FUNCTION
/begin FUNCTION KF7-525.2S[10] "Data compression specifications (sub CPU)" /end FUNCTION
/begin FUNCTION KF7-560.1[N] "Control designated for INCA" /end FUNCTION
/begin CHARACTERISTIC mCANDLMID "DDL data monitor permission flag" CURVE 0x0000C8C7 REC_UBYTE_C 0 COMP_0068 0 255
 /begin AXIS_DESCR FIX_AXIS NO_INPUT_QUANTITY COMP_0205_S 2 0 1 FIX_AXIS_PAR_DIST 0 1 2 /end AXIS_DESCR
 /begin FUNCTION_LIST KF7-500.69[25] KF7-580.1[8] /end FUNCTION_LIST
/end CHARACTERISTIC
/begin CHARACTERISTIC mABFRCV "In front of the lean rich response measuring permission F/cut recover, A/F" VALUE 0x00008F96 REC_UWORD_C 0 COMP_0453 0 131.07 /begin FUNCTION_LIST KF7-500.74[11] /end FUNCTION_LIST /end CHARACTERISTIC
/begin CHARACTERISTIC mAFHMAX "Diagnosis criteria upper limit value" VALUE 0x00008FC2 REC_UWORD_C 0 COMP_0023 0 327675 /begin FUNCTION_LIST KF7-500.59[6] /end FUNCTION_LIST /end CHARACTERISTIC
/begin CHARACTERISTIC mAFHMIN "Diagnosis criteria lower limit value" VALUE 0x00008FC4 REC_UWORD_C 0 COMP_0023 0 327675 /begin FUNCTION_LIST KF7-500.59[6] /end FUNCTION_LIST /end CHARACTERISTIC
/begin CHARACTERISTIC mAFHNGT "Heater diagnosis NG judgement time" VALUE 0x0000821A REC_UBYTE_C 0 COMP_0049 0 255 /begin FUNCTION_LIST KF7-500.59[6] /end FUNCTION_LIST /end CHARACTERISTIC
/begin CHARACTERISTIC mAFHVBL "A/F sensor heater trouble diagnosis VB lower limit value" VALUE 0x0000821E REC_UBYTE_C 0 COMP_0033 0 20400 /begin FUNCTION_LIST KF7-500.59[6] /end FUNCTION_LIST /end CHARACTERISTIC
/begin CHARACTERISTIC mAFSAFHI "Diagnosis region condition actual A/F upper limit value" VALUE 0x00008FD6 REC_UWORD_C 0 COMP_0453 0 131.07 /begin FUNCTION_LIST KF7-500.74[11] /end FUNCTION_LIST /end CHARACTERISTIC
/begin CHARACTERISTIC mAFSAFLO "Diagnosis region condition actual A/F lower limit value" VALUE 0x00008FD8 REC_UWORD_C 0 COMP_0453 0 131.07 /begin FUNCTION_LIST KF7-500.74[11] /end FUNCTION_LIST /end CHARACTERISTIC
/begin CHARACTERISTIC mAFSDLY "A/F sensor breakage diagnosis judgement start delay" VALUE 0x0000822B REC_UBYTE_C 0 COMP_0049 0 255 /begin FUNCTION_LIST KF7-500.76[8] /end FUNCTION_LIST /end CHARACTERISTIC
/begin CHARACTERISTIC mAFSDLY1 "AFS response deterioration diagnosis judgement start delay" VALUE 0x0000822C REC_UBYTE_C 0 COMP_0013 0 255 /begin FUNCTION_LIST KF7-500.74[11] /end FUNCTION_LIST /end CHARACTERISTIC
/begin CHARACTERISTIC mAFSHDTYL "Heater diagnosis permission DUTY lower limit value" VALUE 0x0000822E REC_UBYTE_C 0 COMP_0047 0 127.5 /begin FUNCTION_LIST KF7-500.59[6] /end FUNCTION_LIST /end CHARACTERISTIC
/begin CHARACTERISTIC mAFSNEH "A/F sensor breakage diagnosis Nrpm upper limit value" VALUE 0x0000822F REC_UBYTE_C 0 COMP_0000 0 6375 /begin FUNCTION_LIST KF7-500.76[8] /end FUNCTION_LIST /end CHARACTERISTIC
/begin CHARACTERISTIC mAFSNEH1 "Diagnosis region condition rotation upper limit value" VALUE 0x00008230 REC_UBYTE_C 0 COMP_0000 0 6375 /begin FUNCTION_LIST KF7-500.74[11] /end FUNCTION_LIST /end CHARACTERISTIC
/begin CHARACTERISTIC mAFSNEH2 "Lean rich response diagnosis region condition rotation upper limit value" VALUE 0x00008231 REC_UBYTE_C 0 COMP_0000 0 6375 /begin FUNCTION_LIST KF7-500.74[11] /end FUNCTION_LIST /end CHARACTERISTIC
/begin CHARACTERISTIC mAFSNEL "A/F sensor breakage diagnosis Nrpm lower limit value" VALUE 0x00008232 REC_UBYTE_C 0 COMP_0000 0 6375 /begin FUNCTION_LIST KF7-500.76[8] /end FUNCTION_LIST /end CHARACTERISTIC
/begin CHARACTERISTIC mAFSNEL1 "Diagnosis region condition rotation lower limit value" VALUE 0x00008233 REC_UBYTE_C 0 COMP_0000 0 6375 /begin FUNCTION_LIST KF7-500.74[11] /end FUNCTION_LIST /end CHARACTERISTIC
/begin CHARACTERISTIC mAFSNEL2 "Lean rich response diagnosis region condition rotation lower limit value" VALUE 0x00008234 REC_UBYTE_C 0 COMP_0000 0 6375 /begin FUNCTION_LIST KF7-500.74[11] /end FUNCTION_LIST /end CHARACTERISTIC
/begin CHARACTERISTIC mAFSNTPH "Lean rich response diagnosis region condition N-TP upper limit value" VALUE 0x00008FE4 REC_UWORD_C 0 COMP_0342_S 0 204796.875 /begin FUNCTION_LIST KF7-500.74[11] /end FUNCTION_LIST /end CHARACTERISTIC
/begin CHARACTERISTIC mAFSNTPL "Lean rich response diagnosis region condition N-TP lower limit value" VALUE 0x00008FE6 REC_UWORD_C 0 COMP_0342_S 0 204796.875 /begin FUNCTION_LIST KF7-500.74[11] /end FUNCTION_LIST /end CHARACTERISTIC
/begin CHARACTERISTIC mAFSTPH "A/F sensor breakage diagnosis TP upper limit value" VALUE 0x00008237 REC_UBYTE_C 0 COMP_0001 0 31.875 /begin FUNCTION_LIST KF7-500.76[8] /end FUNCTION_LIST /end CHARACTERISTIC
/begin CHARACTERISTIC mAFSTPH1 "Diagnosis region condition TP upper limit value" VALUE 0x00008238 REC_UBYTE_C 0 COMP_0001 0 31.875 /begin FUNCTION_LIST KF7-500.74[11] /end FUNCTION_LIST /end CHARACTERISTIC
/begin CHARACTERISTIC mAFSTPL "A/F sensor breakage diagnosis TP lower limit value" VALUE 0x00008239 REC_UBYTE_C 0 COMP_0001 0 31.875 /begin FUNCTION_LIST KF7-500.76[8] /end FUNCTION_LIST /end CHARACTERISTIC
/begin CHARACTERISTIC mAFSTPL1 "Diagnosis region condition TP lower limit value" VALUE 0x0000823A REC_UBYTE_C 0 COMP_0001 0 31.875 /begin FUNCTION_LIST KF7-500.74[11] /end FUNCTION_LIST /end CHARACTERISTIC
/begin CHARACTERISTIC mAFSVBH "A/F sensor breakage diagnosis VB upper limit value" VALUE 0x0000823B REC_UBYTE_C 0 COMP_0033 0 20400 /begin FUNCTION_LIST KF7-500.76[8] /end FUNCTION_LIST /end CHARACTERISTIC
/begin CHARACTERISTIC mAFSVBL "A/F sensor breakage diagnosis VB lower limit value" VALUE 0x0000823C REC_UBYTE_C 0 COMP_0033 0 20400 /begin FUNCTION_LIST KF7-500.76[8] /end FUNCTION_LIST /end CHARACTERISTIC
/begin CHARACTERISTIC mAFVNGH1 "A/F sensor breakage slice level upper limit value 1" VALUE 0x00008FE8 REC_UWORD_C 0 COMP_0023 0 327675 /begin FUNCTION_LIST KF7-500.76[8] /end FUNCTION_LIST /end CHARACTERISTIC
/begin CHARACTERISTIC mAFVNGH2 "A/F sensor breakage slice level upper limit value 1" VALUE 0x00008FEA REC_UWORD_C 0 COMP_0023 0 327675 /begin FUNCTION_LIST KF7-500.76[8] R904.1.Gst_on_can_1_0_1 /end FUNCTION_LIST /end CHARACTERISTIC
/begin CHARACTERISTIC mAFVNGL1 "A/F sensor breakage slice level lower limit value 1" VALUE 0x00008FEC REC_UWORD_C 0 COMP_0023 0 327675 /begin FUNCTION_LIST KF7-500.76[8] /end FUNCTION_LIST /end CHARACTERISTIC
/begin CHARACTERISTIC mAFVNGL2 "A/F sensor breakage slice level lower limit value 1" VALUE 0x00008FEE REC_UWORD_C 0 COMP_0023 0 327675 /begin FUNCTION_LIST KF7-500.76[8] R904.1.Gst_on_can_1_0_1 /end FUNCTION_LIST /end CHARACTERISTIC
/begin CHARACTERISTIC mAFVNGT1 "A/F sensor breakage NG judgement time" VALUE 0x0000823D REC_UBYTE_C 0 COMP_0049 0 255 /begin FUNCTION_LIST KF7-500.76[8] /end FUNCTION_LIST /end CHARACTERISTIC
/begin CHARACTERISTIC mAFVSPH "A/F sensor breakage diagnosis vehicle speed upper limit value" VALUE 0x0000823E REC_UBYTE_C 0 COMP_0007 0 510 /begin FUNCTION_LIST KF7-500.76[8] /end FUNCTION_LIST /end CHARACTERISTIC
/begin CHARACTERISTIC mAFVSPH1 "Diagnosis region condition vehicle speed upper limit value" VALUE 0x0000823F REC_UBYTE_C 0 COMP_0007 0 510 /begin FUNCTION_LIST KF7-500.74[11] /end FUNCTION_LIST /end CHARACTERISTIC
/begin CHARACTERISTIC mAFVSPL "A/F sensor breakage diagnosis vehicle speed lower limit value" VALUE 0x00008240 REC_UBYTE_C 0 COMP_0007 0 510 /begin FUNCTION_LIST KF7-500.76[8] /end FUNCTION_LIST /end CHARACTERISTIC
/begin CHARACTERISTIC mAFVSPL1 "Diagnosis region condition vehicle speed lower limit value" VALUE 0x00008241 REC_UBYTE_C 0 COMP_0007 0 510 /begin FUNCTION_LIST KF7-500.74[11] /end FUNCTION_LIST /end CHARACTERISTIC
/begin CHARACTERISTIC mAHOSNGH "A/F sensor rich side NG criteria" VALUE 0x00008ECA REC_SWORD_C 0 COMP_0341_S -65.536 65.534 /begin FUNCTION_LIST KF7-500.75[4] R904.1.Gst_on_can_1_0_1 /end FUNCTION_LIST /end CHARACTERISTIC
/begin CHARACTERISTIC mAHOSNGL "A/F sensor lean side NG criteria" VALUE 0x00008ECC REC_SWORD_C 0 COMP_0341_S -65.536 65.534 /begin FUNCTION_LIST KF7-500.75[4] R904.1.Gst_on_can_1_0_1 /end FUNCTION_LIST /end CHARACTERISTIC
/begin CHARACTERISTIC mAHOSNMX "AFSHOS integration number of times" VALUE 0x0000824D REC_UBYTE_C 0 COMP_0030 0 255 /begin FUNCTION_LIST KF7-500.75[4] /end FUNCTION_LIST /end CHARACTERISTIC
/begin CHARACTERISTIC mAHOSTMH "Learning convergent judgement time" VALUE 0x0000824E REC_UBYTE_C 0 COMP_0013 0 255 /begin FUNCTION_LIST KF7-500.75[4] /end FUNCTION_LIST /end CHARACTERISTIC
/begin CHARACTERISTIC mCLDLY1 "Closed-loop diagnosis judgement delay" VALUE 0x00008325 REC_UBYTE_C 0 COMP_0049 0 255 /begin FUNCTION_LIST KF7-500.39[5] /end FUNCTION_LIST /end CHARACTERISTIC
/begin CHARACTERISTIC mCLDLY2 "Closed-loop diagnosis judgement delay" VALUE 0x00008326 REC_UBYTE_C 0 COMP_0049 0 255 /begin FUNCTION_LIST KF7-500.39[5] /end FUNCTION_LIST /end CHARACTERISTIC
/begin CHARACTERISTIC mCLERRTIM "The response diagnosis judgement deviation" VALUE 0x00008327 REC_UBYTE_C 0 COMP_0008 0 25500 /begin FUNCTION_LIST KF7-500.47B[15] /end FUNCTION_LIST /end CHARACTERISTIC
/begin CHARACTERISTIC mCLPVSP "Vehicle speed lower limit condition" VALUE 0x0000832D REC_UBYTE_C 0 COMP_0007 0 510 /begin FUNCTION_LIST KF7-500.39[5] /end FUNCTION_LIST /end CHARACTERISTIC
/begin CHARACTERISTIC mCLTAMN "At least, intake air temperature criteria" VALUE 0x00008332 REC_UBYTE_C 0 COMP_0035 -50 205 /begin FUNCTION_LIST KF7-500.39[5] /end FUNCTION_LIST /end CHARACTERISTIC
/begin CHARACTERISTIC mCLVBHI "Closed-loop diagnosis permission battery voltage" VALUE 0x00008337 REC_UBYTE_C 0 COMP_0033 0 20400 /begin FUNCTION_LIST KF7-500.39[5] /end FUNCTION_LIST /end CHARACTERISTIC
/begin CHARACTERISTIC mCOQATH "Unit conversion value for QATHMO" VALUE 0x00008354 REC_UBYTE_C 0 COMP_0004 0 255 /begin FUNCTION_LIST KF7-500.60[5] /end FUNCTION_LIST /end CHARACTERISTIC
/begin CHARACTERISTIC mDABFHIS "Delta-A/F monotone increasing judgement value" VALUE 0x00008EF0 REC_SWORD_C 0 COMP_0384_S -131.072 131.068 /begin FUNCTION_LIST KF7-500.74[11] /end FUNCTION_LIST /end CHARACTERISTIC
/begin CHARACTERISTIC mDAFSAF "Response deterioration diagnosis criteria" VALUE 0x000090DC REC_UWORD_C 0 COMP_0385_S 0 262.14 /begin FUNCTION_LIST KF7-500.74[11] /end FUNCTION_LIST /end CHARACTERISTIC
/begin CHARACTERISTIC mDAFSAFMN "Lean rich response deterioration diagnosis criteria" VALUE 0x00008EFC REC_SWORD_C 0 COMP_0384_S -131.072 131.068 /begin FUNCTION_LIST KF7-500.74[11] /end FUNCTION_LIST /end CHARACTERISTIC
/begin CHARACTERISTIC mDLTNIN2 "CVT input speed allowable width 2" VALUE 0x0000911E REC_UWORD_C 0 COMP_0443 0 65535 /begin FUNCTION_LIST KF7-505.47[3] /end FUNCTION_LIST /end CHARACTERISTIC
/begin CHARACTERISTIC mFCAFCAN "At the time of a change in NÅ~TP, diagnosis cancellation condition computed time" VALUE 0x000085DF REC_UBYTE_C 0 COMP_0105 0 25.5 /begin FUNCTION_LIST KF7-500.74[11] /end FUNCTION_LIST /end CHARACTERISTIC
/begin CHARACTERISTIC mFCAFHZ "F/cut formation delay time" VALUE 0x000085E0 REC_UBYTE_C 0 COMP_0105 0 25.5 /begin FUNCTION_LIST KF7-500.74[11] /end FUNCTION_LIST /end CHARACTERISTIC
/begin CHARACTERISTIC mFCAFHZF "F/cut time" VALUE 0x000085E1 REC_UBYTE_C 0 COMP_0105 0 25.5 /begin FUNCTION_LIST KF7-500.74[11] /end FUNCTION_LIST /end CHARACTERISTIC
/begin CHARACTERISTIC mFCAFHZF2 "Lean rich response measuring start F/cut time" VALUE 0x000085E2 REC_UBYTE_C 0 COMP_0008 0 25500 /begin FUNCTION_LIST KF7-500.74[11] /end FUNCTION_LIST /end CHARACTERISTIC
/begin CHARACTERISTIC mFCAFHZF3 "Lean rich response deterioration diagnosis parameter monitor time" VALUE 0x000085E3 REC_UBYTE_C 0 COMP_0408_S 0 25.5 /begin FUNCTION_LIST KF7-500.74[11] /end FUNCTION_LIST /end CHARACTERISTIC
/begin CHARACTERISTIC mFFDENST "A trigger level for the engine stall" VALUE 0x000085FC REC_UBYTE_C 0 COMP_0068 0 255 /begin FUNCTION_LIST KF7-525.1[4] /end FUNCTION_LIST /end CHARACTERISTIC
/begin CHARACTERISTIC mFFDSRM "FFD sampling rate" VALUE 0x000085FD REC_UBYTE_C 0 COMP_0014 0 2550 /begin FUNCTION_LIST KF7-525.1[4] /end FUNCTION_LIST /end CHARACTERISTIC
/begin CHARACTERISTIC mFFNENST "Engine stall judgement speed" VALUE 0x000085FE REC_UBYTE_C 0 COMP_0006 0 3187.5 /begin FUNCTION_LIST KF7-525.1[4] /end FUNCTION_LIST /end CHARACTERISTIC
/begin CHARACTERISTIC mFFNHYS "Engine stall judgement speed hysteresis" VALUE 0x000085FF REC_UBYTE_C 0 COMP_0006 0 3187.5 /begin FUNCTION_LIST KF7-525.1[4] /end FUNCTION_LIST /end CHARACTERISTIC
/begin CHARACTERISTIC mFO2HDD "Closed-loop diagnosis O2/H on delay" VALUE 0x00008612 REC_UBYTE_C 0 COMP_0049 0 255 /begin FUNCTION_LIST KF7-500.39[5] /end FUNCTION_LIST /end CHARACTERISTIC
/begin CHARACTERISTIC mHRVSPDGN "AT-PTD vehicle speed sensor diagnosis start vehicle speed" VALUE 0x00009244 REC_UWORD_C 0 COMP_0436 0 6553.5 /begin FUNCTION_LIST KF7-505.49[3] /end FUNCTION_LIST /end CHARACTERISTIC
/begin CHARACTERISTIC mINLD "Engine rotation delay" VALUE 0x00008734 REC_UBYTE_C 0 COMP_0191 0 255 /begin FUNCTION_LIST KF7-500.39[5] /end FUNCTION_LIST /end CHARACTERISTIC
/begin CHARACTERISTIC mLVAFSMN "Middle electric potential trouble diagnosis criteria lower limit value" VALUE 0x00009396 REC_UWORD_C 0 COMP_0023 0 327675 /begin FUNCTION_LIST KF7-500.74[11] R904.1.Gst_on_can_1_0_1 /end FUNCTION_LIST /end CHARACTERISTIC
/begin CHARACTERISTIC mLVAFSMX "Middle electric potential trouble diagnosis criteria upper limit value" VALUE 0x00009398 REC_UWORD_C 0 COMP_0023 0 327675 /begin FUNCTION_LIST KF7-500.74[11] R904.1.Gst_on_can_1_0_1 /end FUNCTION_LIST /end CHARACTERISTIC
/begin CHARACTERISTIC mNCLMP1 "MNRPM condition lower limit" VALUE 0x0000888C REC_UBYTE_C 0 COMP_0000 0 6375 /begin FUNCTION_LIST KF7-500.39[5] /end FUNCTION_LIST /end CHARACTERISTIC
/begin CHARACTERISTIC mNCLMP2 "MNRPM condition lower limit" VALUE 0x0000888D REC_UBYTE_C 0 COMP_0000 0 6375 /begin FUNCTION_LIST KF7-500.39[5] /end FUNCTION_LIST /end CHARACTERISTIC
/begin CHARACTERISTIC mNTPCAN1 "NÅ~TP change judgement criteria 1" VALUE 0x000093D8 REC_UWORD_C 0 COMP_0434_S 0 12799.8046875 /begin FUNCTION_LIST KF7-500.74[11] /end FUNCTION_LIST /end CHARACTERISTIC
/begin CHARACTERISTIC mNTPCAN2 "NÅ~TP change judgement criteria 2" VALUE 0x000093DA REC_UWORD_C 0 COMP_0434_S 0 12799.8046875 /begin FUNCTION_LIST KF7-500.74[11] /end FUNCTION_LIST /end CHARACTERISTIC
/begin CHARACTERISTIC mOFANGCB "Steady state deviation allowable value (retard side)" VALUE 0x0000893D REC_UBYTE_C 0 COMP_0048 0 127.5 /begin FUNCTION_LIST KF7-500.47B[15] /end FUNCTION_LIST /end CHARACTERISTIC
/begin CHARACTERISTIC mOFANGCF "Steady state deviation allowable value (advance side)" VALUE 0x0000893E REC_UBYTE_C 0 COMP_0048 0 127.5 /begin FUNCTION_LIST KF7-500.47B[15] /end FUNCTION_LIST /end CHARACTERISTIC
/begin CHARACTERISTIC mPAMBHZH "AFS response deterioration diagnosis atomospheric pressure upper limit value" VALUE 0x00008973 REC_UBYTE_C 0 COMP_0054 0 5100 /begin FUNCTION_LIST KF7-500.74[11] /end FUNCTION_LIST /end CHARACTERISTIC
/begin CHARACTERISTIC mPAMBHZL "AFS response deterioration diagnosis atomospheric pressure lower limit value" VALUE 0x00008974 REC_UBYTE_C 0 COMP_0054 0 5100 /begin FUNCTION_LIST KF7-500.74[11] /end FUNCTION_LIST /end CHARACTERISTIC
/begin CHARACTERISTIC mPPSFAIL "P/S oil pressure sensor trouble judgement time" VALUE 0x000089B2 REC_UBYTE_C 0 COMP_0014 0 2550 /begin FUNCTION_LIST KF7-500.73[1] /end FUNCTION_LIST /end CHARACTERISTIC
/begin CHARACTERISTIC mPPSFAILH "P/S oil pressure sensor trouble judgement voltage (Hi)" VALUE 0x000089B3 REC_UBYTE_C 0 COMP_0054 0 5100 /begin FUNCTION_LIST KF7-500.73[1] /end FUNCTION_LIST /end CHARACTERISTIC
/begin CHARACTERISTIC mPPSFAILL "P/S oil pressure sensor trouble judgement voltage (Low)" VALUE 0x000089B4 REC_UBYTE_C 0 COMP_0054 0 5100 /begin FUNCTION_LIST KF7-500.73[1] /end FUNCTION_LIST /end CHARACTERISTIC
/begin CHARACTERISTIC mSOLFSDLY "When a solenoid diagnosis breaks down, judgement number of times" VALUE 0x00008B1B REC_UBYTE_C 0 COMP_0030 0 255 /begin FUNCTION_LIST KF7-500.47B[15] /end FUNCTION_LIST /end CHARACTERISTIC
/begin CHARACTERISTIC mSOLMLDLY "Solenoid diagnosis NG judgement number of times" VALUE 0x00008B1D REC_UBYTE_C 0 COMP_0030 0 255 /begin FUNCTION_LIST KF7-500.47B[15] /end FUNCTION_LIST /end CHARACTERISTIC
/begin CHARACTERISTIC mTANTHM "Diagnosis permission intake air temperature condition lower limit value" VALUE 0x00008B7E REC_UBYTE_C 0 COMP_0035 -50 205 /begin FUNCTION_LIST KF7-500.60[5] /end FUNCTION_LIST /end CHARACTERISTIC
/begin CHARACTERISTIC mTANVDY "Vehicle speed condition judgement delay" VALUE 0x00008B7F REC_UBYTE_C 0 COMP_0013 0 255 /begin FUNCTION_LIST KF7-500.44[3] /end FUNCTION_LIST /end CHARACTERISTIC
/begin CHARACTERISTIC mTANVSP "Intake air temperature sensor diagnosis vehicle speed condition lower limit" VALUE 0x00008B80 REC_UBYTE_C 0 COMP_0007 0 510 /begin FUNCTION_LIST KF7-500.44[3] /end FUNCTION_LIST /end CHARACTERISTIC
/begin CHARACTERISTIC mTATWH "Intake air temperature sensor diagnosis coolant temperature condition upper limit" VALUE 0x00008B8A REC_UBYTE_C 0 COMP_0035 -50 205 /begin FUNCTION_LIST KF7-500.44[3] /end FUNCTION_LIST /end CHARACTERISTIC
/begin CHARACTERISTIC mTDABF "Delta-A/F value computed delay time" VALUE 0x00008B9D REC_UBYTE_C 0 COMP_0105 0 25.5 /begin FUNCTION_LIST KF7-500.74[11] /end FUNCTION_LIST /end CHARACTERISTIC
/begin CHARACTERISTIC mTHMACR "A/C At the time of on, QA compensation value" VALUE 0x00008BDF REC_UBYTE_C 0 COMP_0004 0 255 /begin FUNCTION_LIST KF7-500.60[5] /end FUNCTION_LIST /end CHARACTERISTIC
/begin CHARACTERISTIC mTHTWTH "Coolant temperature convergent judgement value" VALUE 0x00008BEB REC_UBYTE_C 0 COMP_0003 0 255 /begin FUNCTION_LIST KF7-500.60[5] /end FUNCTION_LIST /end CHARACTERISTIC
/begin CHARACTERISTIC mTMTHMO "After the engine start, delay" VALUE 0x00008CA7 REC_UBYTE_C 0 COMP_0096 0 2550 /begin FUNCTION_LIST KF7-500.60[5] /end FUNCTION_LIST /end CHARACTERISTIC
/begin CHARACTERISTIC mTPCLP1 "TP condition lower limit" VALUE 0x00008CC6 REC_UBYTE_C 0 COMP_0001 0 31.875 /begin FUNCTION_LIST KF7-500.39[5] /end FUNCTION_LIST /end CHARACTERISTIC
/begin CHARACTERISTIC mTPCLP2 "TP condition lower limit" VALUE 0x00008CC7 REC_UBYTE_C 0 COMP_0001 0 31.875 /begin FUNCTION_LIST KF7-500.39[5] /end FUNCTION_LIST /end CHARACTERISTIC
/begin CHARACTERISTIC mTPSVH "TPS output normality range upper limit" VALUE 0x00009602 REC_UWORD_C 0 COMP_0023 0 327675 /begin FUNCTION_LIST KF7-505.2[9] /end FUNCTION_LIST /end CHARACTERISTIC
/begin CHARACTERISTIC mTPSVL "TPS output normality range lower limit" VALUE 0x00009604 REC_UWORD_C 0 COMP_0023 0 327675 /begin FUNCTION_LIST KF7-505.2[9] /end FUNCTION_LIST /end CHARACTERISTIC
/begin CHARACTERISTIC mTTHIVL "Coolant temperature convergent judgement section coefficient" VALUE 0x00008CF6 REC_UBYTE_C 0 COMP_0004 0 255 /begin FUNCTION_LIST KF7-500.60[5] /end FUNCTION_LIST /end CHARACTERISTIC
/begin CHARACTERISTIC mTVSPNG "Vehicle speed sensor un-adjustment diagnosis time" VALUE 0x00008D0A REC_UBYTE_C 0 COMP_0008 0 25500 /begin FUNCTION_LIST KF7-505.49[3] /end FUNCTION_LIST /end CHARACTERISTIC
/begin CHARACTERISTIC mTWAFH "A/F sensor breakage diagnosis coolant temperature upper limit value" VALUE 0x00008D16 REC_UBYTE_C 0 COMP_0035 -50 205 /begin FUNCTION_LIST KF7-500.76[8] /end FUNCTION_LIST /end CHARACTERISTIC
/begin CHARACTERISTIC mTWAFHZH "AFS response deterioration diagnosis coolant temperature upper limit value" VALUE 0x00008D17 REC_UBYTE_C 0 COMP_0035 -50 205 /begin FUNCTION_LIST KF7-500.74[11] /end FUNCTION_LIST /end CHARACTERISTIC
/begin CHARACTERISTIC mTWAFHZL "AFS response deterioration diagnosis coolant temperature lower limit value" VALUE 0x00008D18 REC_UBYTE_C 0 COMP_0035 -50 205 /begin FUNCTION_LIST KF7-500.74[11] /end FUNCTION_LIST /end CHARACTERISTIC
/begin CHARACTERISTIC mTWAFL "A/F sensor breakage diagnosis coolant temperature lower limit value" VALUE 0x00008D19 REC_UBYTE_C 0 COMP_0035 -50 205 /begin FUNCTION_LIST KF7-500.76[8] /end FUNCTION_LIST /end CHARACTERISTIC
/begin CHARACTERISTIC mTWFSH "Intake air temperature sensor diagnosis coolant temperature sensor voltage upper limit" VALUE 0x00008D2B REC_UBYTE_C 0 COMP_0054 0 5100 /begin FUNCTION_LIST KF7-500.44[3] /end FUNCTION_LIST /end CHARACTERISTIC
/begin CHARACTERISTIC mTWFSL "Intake air temperature sensor diagnosis coolant temperature sensor voltage lower limit" VALUE 0x00008D2C REC_UBYTE_C 0 COMP_0054 0 5100 /begin FUNCTION_LIST KF7-500.44[3] /end FUNCTION_LIST /end CHARACTERISTIC
/begin CHARACTERISTIC mTWINTH "At the time of the diagnosis permission start, coolant temperature condition upper limit value" VALUE 0x00008D36 REC_UBYTE_C 0 COMP_0035 -50 205 /begin FUNCTION_LIST KF7-500.60[5] /end FUNCTION_LIST /end CHARACTERISTIC
/begin CHARACTERISTIC mTWINTL "At the time of the diagnosis permission start, coolant temperature condition lower limit value" VALUE 0x00008D37 REC_UBYTE_C 0 COMP_0035 -50 205 /begin FUNCTION_LIST KF7-500.60[5] /end FUNCTION_LIST /end CHARACTERISTIC
/begin CHARACTERISTIC mTWTHNG "NG judgement value" VALUE 0x00008D71 REC_UBYTE_C 0 COMP_0035 -50 205 /begin FUNCTION_LIST KF7-500.60[5] /end FUNCTION_LIST /end CHARACTERISTIC
/begin CHARACTERISTIC mTWTHOK "OK judgement value" VALUE 0x00008D72 REC_UBYTE_C 0 COMP_0035 -50 205 /begin FUNCTION_LIST KF7-500.60[5] /end FUNCTION_LIST /end CHARACTERISTIC
/begin CHARACTERISTIC mVPRNGL "In the intake manifold, absolute pressure" VALUE 0x0000965A REC_UWORD_C 0 COMP_0050 0 5119.921875 /begin FUNCTION_LIST KF7-500.51[3] /end FUNCTION_LIST /end CHARACTERISTIC
/begin CHARACTERISTIC mVSPGAP "Vehicle speed sensor un-adjustment diagnosis threshold" VALUE 0x0000966A REC_UWORD_C 0 COMP_0436 0 6553.5 /begin FUNCTION_LIST KF7-505.49[3] /end FUNCTION_LIST /end CHARACTERISTIC
/begin CHARACTERISTIC mVSPGAP2 "Vehicle speed sensor un-adjustment judgement value" VALUE 0x0000966C REC_UWORD_C 0 COMP_0436 0 6553.5 /begin FUNCTION_LIST KF7-505.49[3] /end FUNCTION_LIST /end CHARACTERISTIC
/begin CHARACTERISTIC mVTCCNEH "VTC drive diagnosis permission engine speed upper limit" VALUE 0x00008E24 REC_UBYTE_C 0 COMP_0006 0 3187.5 /begin FUNCTION_LIST KF7-500.47B[15] /end FUNCTION_LIST /end CHARACTERISTIC
/begin CHARACTERISTIC mVTCCNEL "VTC drive abnormality diagnosis permission engine speed lower limit" VALUE 0x00008E25 REC_UBYTE_C 0 COMP_0006 0 3187.5 /begin FUNCTION_LIST KF7-500.47B[15] /end FUNCTION_LIST /end CHARACTERISTIC
/begin CHARACTERISTIC mVTCCTWH "VTC drive abnormality diagnosis permission coolant temperature upper limit" VALUE 0x00008E26 REC_UBYTE_C 0 COMP_0035 -50 205 /begin FUNCTION_LIST KF7-500.47B[15] /end FUNCTION_LIST /end CHARACTERISTIC
/begin CHARACTERISTIC mVTCCTWL "VTC drive abnormality diagnosis permission coolant temperature lower limit" VALUE 0x00008E27 REC_UBYTE_C 0 COMP_0035 -50 205 /begin FUNCTION_LIST KF7-500.47B[15] /end FUNCTION_LIST /end CHARACTERISTIC
/begin CHARACTERISTIC mVTCDNE "VTC operation permission engine speed" VALUE 0x00008E29 REC_UBYTE_C 0 COMP_0006 0 3187.5 /begin FUNCTION_LIST KF7-500.47B[15] /end FUNCTION_LIST /end CHARACTERISTIC
/begin CHARACTERISTIC mVTNEDML "CVTC Delay time for MIL lighting" VALUE 0x00008E6E REC_UBYTE_C 0 COMP_0295 0 25500 /begin FUNCTION_LIST KF7-500.47B[15] /end FUNCTION_LIST /end CHARACTERISTIC
/begin CHARACTERISTIC mVTTRLIM "Target angle change rate limitation value for the drive abnormality diagnosis" VALUE 0x00008E8C REC_UBYTE_C 0 COMP_0048 0 127.5 /begin FUNCTION_LIST KF7-500.47B[15] /end FUNCTION_LIST /end CHARACTERISTIC
/begin CHARACTERISTIC mCNGDLY "VTC drive abnormality diagnosis judgement delay" MAP 0x0000986E REC_UBYTE_C 0 COMP_0008 0 25500
 /begin AXIS_DESCR COM_AXIS NO_INPUT_QUANTITY COMP_0020 8 0 12750 AXIS_PTS_REF mCDLYNEJ /end AXIS_DESCR
 /begin AXIS_DESCR COM_AXIS NO_INPUT_QUANTITY COMP_0035 8 -50 205 AXIS_PTS_REF mCDLYTWJ /end AXIS_DESCR
 /begin FUNCTION_LIST KF7-500.47B[15] /end FUNCTION_LIST
/end CHARACTERISTIC
/begin CHARACTERISTIC mTHOSNTP "NÅ~TP compensation table" CURVE 0x0000D1F2 REC_UBYTE_C 0 COMP_0045 0 1.9921875
 /begin AXIS_DESCR COM_AXIS NO_INPUT_QUANTITY COMP_0434_S 16 0 12799.8046875 AXIS_PTS_REF mLHOSNTP /end AXIS_DESCR
 /begin FUNCTION_LIST KF7-500.74[11] /end FUNCTION_LIST
/end CHARACTERISTIC
/begin CHARACTERISTIC mTHOSRCV "NÅ~TP compensation table" CURVE 0x0000D202 REC_UBYTE_C 0 COMP_0045 0 1.9921875
 /begin AXIS_DESCR COM_AXIS NO_INPUT_QUANTITY COMP_0434_S 16 0 12799.8046875 AXIS_PTS_REF mLHOSRCV /end AXIS_DESCR
 /begin FUNCTION_LIST KF7-500.74[11] /end FUNCTION_LIST
/end CHARACTERISTIC
/begin CHARACTERISTIC mTTHVSR "A table for THVSPR" CURVE 0x0000DA6A REC_UBYTE_C 0 COMP_0009 0 199.21875
 /begin AXIS_DESCR FIX_AXIS NO_INPUT_QUANTITY COMP_0268_S 16 0 120 FIX_AXIS_PAR_DIST 0 1 16 /end AXIS_DESCR
 /begin FUNCTION_LIST KF7-500.60[5] /end FUNCTION_LIST
/end CHARACTERISTIC
/begin CHARACTERISTIC mTQATHM "A table for THQATH" CURVE 0x0000D768 REC_UBYTE_C 0 COMP_0004 0 255
 /begin AXIS_DESCR FIX_AXIS NO_INPUT_QUANTITY COMP_0523_S 8 -20 50 FIX_AXIS_PAR_DIST 0 1 8 /end AXIS_DESCR
 /begin FUNCTION_LIST KF7-500.60[5] /end FUNCTION_LIST
/end CHARACTERISTIC
/begin CHARACTERISTIC mTTQATH "A table for TOQATH" CURVE 0x0000F3BE REC_UWORD_C 0 COMP_0004 0 65535
 /begin AXIS_DESCR FIX_AXIS NO_INPUT_QUANTITY COMP_0523_S 8 -20 50 FIX_AXIS_PAR_DIST 0 1 8 /end AXIS_DESCR
 /begin FUNCTION_LIST KF7-500.60[5] /end FUNCTION_LIST
/end CHARACTERISTIC
/begin CHARACTERISTIC mfNG1RLYON "Motor relay diagnosis 2TRIP flag" VALUE 0x00008CE9 REC_UBYTE_C 0 COMP_0283 0 1 BIT_MASK 0x0008 /begin FUNCTION_LIST KF7-505.31[5] /end FUNCTION_LIST /end CHARACTERISTIC
/begin AXIS_PTS mCDLYNEJ "50rpm" 0x0000C911 NO_INPUT_QUANTITY REC_AXIS_UBYTE 0 COMP_0020 8 0 12750 /end AXIS_PTS
/begin AXIS_PTS mCDLYTWJ "1Åé" 0x0000C919 NO_INPUT_QUANTITY REC_AXIS_UBYTE 0 COMP_0035 8 -50 205 /end AXIS_PTS
/begin AXIS_PTS mLHOSNTP "25*1/128rpm*ms" 0x0000E120 NO_INPUT_QUANTITY REC_AXIS_UWORD 0 COMP_0434_S 16 0 12799.8046875 /end AXIS_PTS
/begin AXIS_PTS mLHOSRCV "25*1/128rpm*ms" 0x0000E140 NO_INPUT_QUANTITY REC_AXIS_UWORD 0 COMP_0434_S 16 0 12799.8046875 /end AXIS_PTS
/begin MEASUREMENT fAFHZGO "0:êfífóÃàÊèåèïsê¨óß  1:êfífóÃàÊèåèê¨óß" UBYTE COMP_0283 1 100 0 1 BIT_MASK 0x0002 ECU_ADDRESS 0xFFFF27B3 /begin FUNCTION_LIST KF7-500.74[11] /end FUNCTION_LIST /end MEASUREMENT
/begin MEASUREMENT fAFHZLROK "0:ÉäÉbÉ`Å®ÉäÅ[ÉìâûìöóÚâªêfífOKîªíË  1:ÉäÉbÉ`Å®ÉäÅ[ÉìâûìöóÚâªêfífOKîªíË" UBYTE COMP_0283 1 100 0 1 BIT_MASK 0x0002 ECU_ADDRESS 0xFFFF27B4 /begin FUNCTION_LIST KF7-500.74[11] /end FUNCTION_LIST /end MEASUREMENT
/begin MEASUREMENT fAFHZRCV "0:ÉäÅ[ÉìÅ®ÉäÉbÉ`âûìöóÚâªêfífóÃàÊè  1:ÉäÅ[ÉìÅ®ÉäÉbÉ`âûìöóÚâªêfífóÃàÊè" UBYTE COMP_0283 1 100 0 1 BIT_MASK 0x0002 ECU_ADDRESS 0xFFFF1117 /begin FUNCTION_LIST KF7-500.74[11] /end FUNCTION_LIST /end MEASUREMENT
/begin MEASUREMENT fAFHZRLOK "0:ÉäÅ[ÉìÅ®ÉäÉbÉ`âûìöóÚâªêfífOKîªíË  1:ÉäÅ[ÉìÅ®ÉäÉbÉ`âûìöóÚâªêfífOKîªíË" UBYTE COMP_0283 1 100 0 1 BIT_MASK 0x0002 ECU_ADDRESS 0xFFFF27B5 /begin FUNCTION_LIST KF7-500.74[11] /end FUNCTION_LIST /end MEASUREMENT
/begin MEASUREMENT fASHTEND "0:âEãLà»äO  1:A/Fæ›ªºÃƒêfífèIóπ" UBYTE COMP_0283 1 100 0 1 BIT_MASK 0x0002 ECU_ADDRESS 0xFFFF288D /begin FUNCTION_LIST KF7-500.75[4] /end FUNCTION_LIST /end MEASUREMENT
/begin MEASUREMENT fDABFHIS "0:ëSãCìõF/CíÜÇ…DABFÅÖDABFHIS#Çåv  1:ëSãCìõF/CíÜÇ…DABFÅÖDABFHIS#Çåv" UBYTE COMP_0283 1 100 0 1 BIT_MASK 0x0002 ECU_ADDRESS 0xFFFF1228 /begin FUNCTION_LIST KF7-500.74[11] /end FUNCTION_LIST /end MEASUREMENT
/begin MEASUREMENT fERROR "0:ê≥èÌ  1:àŸèÌ" UBYTE COMP_0283 1 100 0 1 BIT_MASK 0x0002 ECU_ADDRESS 0xFFFF12F9 /begin FUNCTION_LIST KF7-500.47B[15] /end FUNCTION_LIST /end MEASUREMENT
/begin MEASUREMENT fFAFAVNG1 "0:ëOA./Fæ›ªíÜä‘ìdà åÃè·NG1âÒñ⁄îªíË  1:ëOA./Fæ›ªíÜä‘ìdà åÃè·NG1âÒñ⁄îªíË" UBYTE COMP_0283 1 100 0 1 BIT_MASK 0x0002 ECU_ADDRESS 0xFFFFA3A6 /begin FUNCTION_LIST KF7-500.74[11] /end FUNCTION_LIST /end MEASUREMENT
/begin MEASUREMENT fFAFAVOK "0:ëOA./Fæ›ªíÜä‘ìdà åÃè·OKîªíËñ¢éØ  1:ëOA./Fæ›ªíÜä‘ìdà åÃè·OKîªíËéØï " UBYTE COMP_0283 1 100 0 1 BIT_MASK 0x0002 ECU_ADDRESS 0xFFFFA3A8 /begin FUNCTION_LIST KF7-500.74[11] KF7-500.76[8] /end FUNCTION_LIST /end MEASUREMENT
/begin MEASUREMENT fFAFHNG1 "0:À∞¿êfíf1stƒÿØÃﬂNGñ¢åüèo  1:À∞¿êfíf1stƒÿØÃﬂNGåüèo" UBYTE COMP_0283 1 100 0 1 BIT_MASK 0x0002 ECU_ADDRESS 0xFFFFA3A9 /begin FUNCTION_LIST KF7-500.59[6] /end FUNCTION_LIST /end MEASUREMENT
/begin MEASUREMENT fFAFHZNG1 "0:ëOA./Fæ›ªâûìöóÚâªêfífNG1âÒñ⁄îªíË  1:ëOA./Fæ›ªâûìöóÚâªêfífNG1âÒñ⁄îªíË" UBYTE COMP_0283 1 100 0 1 BIT_MASK 0x0002 ECU_ADDRESS 0xFFFFA3AC /begin FUNCTION_LIST KF7-500.74[11] KF7-500.74B[5] /end FUNCTION_LIST /end MEASUREMENT
/begin MEASUREMENT fFAFHZOK "0:ëOA./Fæ›ªâûìöóÚâªêfífOKîªíËñ¢éØ  1:ëOA./Fæ›ªâûìöóÚâªêfífOKîªíËéØï " UBYTE COMP_0283 1 100 0 1 BIT_MASK 0x0002 ECU_ADDRESS 0xFFFFA3AE /begin FUNCTION_LIST KF7-500.74[11] KF7-500.74B[5] KF7-500.76[8] /end FUNCTION_LIST /end MEASUREMENT
/begin MEASUREMENT fFAFLNG1 "0:A./Fæ›ªºÃƒêfífÿ∞›ºÃƒNG1âÒñ⁄îªíË  1:A./Fæ›ªºÃƒêfífÿ∞›ºÃƒNG1âÒñ⁄îªíË" UBYTE COMP_0283 1 100 0 1 BIT_MASK 0x0002 ECU_ADDRESS 0xFFFFA3AF /begin FUNCTION_LIST KF7-500.75[4] /end FUNCTION_LIST /end MEASUREMENT
/begin MEASUREMENT fFAFLROK "0:ÉäÉbÉ`Å®ÉäÅ[ÉìâûìöóÚâªêfífOKîªíË  1:ÉäÉbÉ`Å®ÉäÅ[ÉìâûìöóÚâªêfífOKîªíË" UBYTE COMP_0283 1 100 0 1 BIT_MASK 0x0002 ECU_ADDRESS 0xFFFFA3B2 /begin FUNCTION_LIST KF7-500.74[11] KF7-500.74B[5] /end FUNCTION_LIST /end MEASUREMENT
/begin MEASUREMENT fFAFONG1 "0:A/Fæ›ªífê¸êfífÇPÇìÇîƒÿØÃﬂNGåüèo  1:E/Fæ›ªífê¸êfífÇPÇìÇîƒÿØÃﬂNGåüèo" UBYTE COMP_0283 1 100 0 1 BIT_MASK 0x0002 ECU_ADDRESS 0xFFFFA3B4 /begin FUNCTION_LIST KF7-500.76[8] /end FUNCTION_LIST /end MEASUREMENT
/begin MEASUREMENT fFAFRLOK "0:ÉäÅ[ÉìÅ®ÉäÉbÉ`âûìöóÚâªêfífOKîªíË  1:ÉäÅ[ÉìÅ®ÉäÉbÉ`âûìöóÚâªêfífOKîªíË" UBYTE COMP_0283 1 100 0 1 BIT_MASK 0x0002 ECU_ADDRESS 0xFFFFA3B6 /begin FUNCTION_LIST KF7-500.74[11] KF7-500.74B[5] /end FUNCTION_LIST /end MEASUREMENT
/begin MEASUREMENT fFAFRNG1 "0:A./Fæ›ªºÃƒêfífÿØ¡ºÃƒNG1âÒñ⁄îªíË  1:A./Fæ›ªºÃƒêfífÿØ¡ºÃƒNG1âÒñ⁄îªíË" UBYTE COMP_0283 1 100 0 1 BIT_MASK 0x0002 ECU_ADDRESS 0xFFFFA3B7 /begin FUNCTION_LIST KF7-500.75[4] /end FUNCTION_LIST /end MEASUREMENT
/begin MEASUREMENT fFAFRVNG1 "0:ÿ∞›Å®ÿØ¡âûìöóÚâªêfíf 1st TRIP NG  1:ÿ∞›Å®ÿØ¡âûìöóÚâªêfíf 1st TRIP NG" UBYTE COMP_0283 1 100 0 1 BIT_MASK 0x0002 ECU_ADDRESS 0xFFFFA3BA /begin FUNCTION_LIST KF7-500.74[11] KF7-500.74B[5] /end FUNCTION_LIST /end MEASUREMENT
/begin MEASUREMENT fFCAFHZ "0:ëOA/Fæ›ªâûìöóÚâª/íÜä‘ìdà êfífópF  1:ëOA/Fæ›ªâûìöóÚâª/íÜä‘ìdà êfífópF" UBYTE COMP_0283 1 100 0 1 BIT_MASK 0x0002 ECU_ADDRESS 0xFFFF1362 /begin FUNCTION_LIST KF7-500.74[11] /end FUNCTION_LIST /end MEASUREMENT
/begin MEASUREMENT fFCAFHZF "0:ëOA/Fæ›ªâûìöóÚâª/íÜä‘ìdà êfífópF  1:ëOA/Fæ›ªâûìöóÚâª/íÜä‘ìdà êfífópF" UBYTE COMP_0283 1 100 0 1 BIT_MASK 0x0002 ECU_ADDRESS 0xFFFF1364 /begin FUNCTION_LIST KF7-500.74[11] /end FUNCTION_LIST /end MEASUREMENT
/begin MEASUREMENT fFCAFHZF2 "0:É¢A/Fç≈è¨íléZèoäJénèåèéûä‘ïsê¨  1:É¢A/Fç≈è¨íléZèoäJénèåèéûä‘ê¨óß" UBYTE COMP_0283 1 100 0 1 BIT_MASK 0x0002 ECU_ADDRESS 0xFFFF1363 /begin FUNCTION_LIST KF7-500.74[11] /end FUNCTION_LIST /end MEASUREMENT
/begin MEASUREMENT fNGBSTP "0:éÊìæñ¢èIóπ  1:éÊìæèIóπ" UBYTE COMP_0283 1 100 0 1 BIT_MASK 0x0002 ECU_ADDRESS 0xFFFFACD8 /begin FUNCTION_LIST KF7-500.74[11] /end FUNCTION_LIST /end MEASUREMENT
/begin MEASUREMENT fNTPST "0:ñ¢éZèo  1:éZèoçœÇ›" UBYTE COMP_0283 1 100 0 1 BIT_MASK 0x0002 ECU_ADDRESS 0xFFFF3038 /begin FUNCTION_LIST KF7-500.74[11] /end FUNCTION_LIST /end MEASUREMENT
/begin MEASUREMENT fVCLSL "0:ñ¢äàê´  1:äàê´çœÇ›" UBYTE COMP_0283 1 100 0 1 BIT_MASK 0x0002 ECU_ADDRESS 0xFFFF1A84 /begin FUNCTION_LIST KF7-500.39[5] /end FUNCTION_LIST /end MEASUREMENT
/begin MEASUREMENT fVCLSR "0:ñ¢äàê´  1:äàê´çœÇ›" UBYTE COMP_0283 1 100 0 1 BIT_MASK 0x0002 ECU_ADDRESS 0xFFFF1A85 /begin FUNCTION_LIST KF7-500.39[5] /end FUNCTION_LIST /end MEASUREMENT
/begin MEASUREMENT fVTCDG1_S "0:ïsê¨óß  1:ê¨óß" UBYTE COMP_0283 1 100 0 1 BIT_MASK 0x0002 ECU_ADDRESS 0xFFFF353C /begin FUNCTION_LIST KF7-500.47B[15] /end FUNCTION_LIST /end MEASUREMENT
/begin MEASUREMENT fVTCDG2_S "0:ïsê¨óß  1:ê¨óß" UBYTE COMP_0283 1 100 0 1 BIT_MASK 0x0002 ECU_ADDRESS 0xFFFF353D /begin FUNCTION_LIST KF7-500.47B[15] /end FUNCTION_LIST /end MEASUREMENT
/begin MEASUREMENT fVTCDG3_S "0:ïsê¨óß  1:ê¨óß" UBYTE COMP_0283 1 100 0 1 BIT_MASK 0x0002 ECU_ADDRESS 0xFFFF353E /begin FUNCTION_LIST KF7-500.47B[15] /end FUNCTION_LIST /end MEASUREMENT
/begin MEASUREMENT fVTCDG4_S "0:ïsê¨óß  1:ê¨óß" UBYTE COMP_0283 1 100 0 1 BIT_MASK 0x0002 ECU_ADDRESS 0xFFFF353F /begin FUNCTION_LIST KF7-500.47B[15] /end FUNCTION_LIST /end MEASUREMENT
/begin MEASUREMENT fVTCDG5_S "0:ïsê¨óß  1:ê¨óß" UBYTE COMP_0283 1 100 0 1 BIT_MASK 0x0002 ECU_ADDRESS 0xFFFF3540 /begin FUNCTION_LIST KF7-500.47B[15] /end FUNCTION_LIST /end MEASUREMENT
/begin MEASUREMENT fVTCDGN1S "0:ïsê¨óß  1:ê¨óß" UBYTE COMP_0283 1 100 0 1 BIT_MASK 0x0002 ECU_ADDRESS 0xFFFF426D /begin FUNCTION_LIST KF7-500.47B[15] /end FUNCTION_LIST /end MEASUREMENT
/begin MEASUREMENT fVTCDGN2S "0:ïsê¨óß  1:ê¨óß" UBYTE COMP_0283 1 100 0 1 BIT_MASK 0x0002 ECU_ADDRESS 0xFFFF4270 /begin FUNCTION_LIST KF7-500.47B[15] /end FUNCTION_LIST /end MEASUREMENT
/begin MEASUREMENT fVTCDGN4S "0:êfífïsãñâ¬  1:êfífãñâ¬" UBYTE COMP_0283 1 100 0 1 BIT_MASK 0x0002 ECU_ADDRESS 0xFFFF34AF /begin FUNCTION_LIST KF7-500.47B[15] /end FUNCTION_LIST /end MEASUREMENT
/begin MEASUREMENT fVTCDGN5 "0:ïsê¨óß  1:ê¨óß" UBYTE COMP_0283 1 100 0 1 BIT_MASK 0x0002 ECU_ADDRESS 0xFFFF26ED /begin FUNCTION_LIST KF7-500.47B[15] /end FUNCTION_LIST /end MEASUREMENT
/begin MEASUREMENT fVTCDGN6 "0:ïsê¨óß  1:ê¨óß" UBYTE COMP_0283 1 100 0 1 BIT_MASK 0x0002 ECU_ADDRESS 0xFFFF26EE /begin FUNCTION_LIST KF7-500.47B[15] /end FUNCTION_LIST /end MEASUREMENT
/begin MEASUREMENT fVTCFS3_S "0:ê≥èÌîªíË  1:ÉtÉFÅ[ÉãÉZÅ[ÉtNGîªíË" UBYTE COMP_0283 1 100 0 1 BIT_MASK 0x0002 ECU_ADDRESS 0xFFFF3541 /begin FUNCTION_LIST KF7-500.47B[15] /end FUNCTION_LIST /end MEASUREMENT
/begin MEASUREMENT fVTCFS4_S "0:ê≥èÌîªíË  1:ÉtÉFÅ[ÉãÉZÅ[ÉtNGîªíË" UBYTE COMP_0283 1 100 0 1 BIT_MASK 0x0002 ECU_ADDRESS 0xFFFF3542 /begin FUNCTION_LIST KF7-500.47B[15] /end FUNCTION_LIST /end MEASUREMENT
/begin MEASUREMENT fVTCFS5_S "0:ïsê¨óß  1:ê¨óß" UBYTE COMP_0283 1 100 0 1 BIT_MASK 0x0002 ECU_ADDRESS 0xFFFF3543 /begin FUNCTION_LIST KF7-500.47B[15] /end FUNCTION_LIST /end MEASUREMENT
/begin MEASUREMENT fGAVGAFH "0:GST ﬂ◊“∞¿çXêVóñ≥Çµ  1:GST ﬂ◊“∞¿çXêVóÇ†ÇË" UBYTE COMP_0283 1 100 0 1 BIT_MASK 0x0002 ECU_ADDRESS 0xFFFF2E04 /begin FUNCTION_LIST KF7-500.59[6] /end FUNCTION_LIST /end MEASUREMENT
/begin MEASUREMENT wfACCMSGCA "ACCMSG CA flag" UBYTE COMP_0283 1 100 0 1 BIT_MASK 0x0040 ECU_ADDRESS 0xFFFF49C6 /begin FUNCTION_LIST KF7-505.27[4] /end FUNCTION_LIST /end MEASUREMENT
/begin MEASUREMENT fACCMSGCA "ACCMSG CA flag" UBYTE COMP_0283 1 100 0 1 BIT_MASK 0x0040 ECU_ADDRESS 0xFFFF49D6 /begin FUNCTION_LIST KF7-505.27[4] /end FUNCTION_LIST /end MEASUREMENT
/begin MEASUREMENT fCANINIT "CAN initial completion flag" UBYTE COMP_0283 1 100 0 1 BIT_MASK 0x0040 ECU_ADDRESS 0xFFFF49D9 /begin FUNCTION_LIST KF7-500.69[25] /end FUNCTION_LIST /end MEASUREMENT
/begin MEASUREMENT fASCCOM "Watch IC communication requirement flag" UBYTE COMP_0283 1 100 0 1 BIT_MASK 0x0002 ECU_ADDRESS 0xFFFF4282 /begin FUNCTION_LIST KF7-505.39[2] KF7-505.41[2] /end FUNCTION_LIST /end MEASUREMENT
/begin MEASUREMENT fASCDGN "Watch IC diagnosis requirement flag" UBYTE COMP_0283 1 100 0 1 BIT_MASK 0x0040 ECU_ADDRESS 0xFFFF4283 /begin FUNCTION_LIST KF7-505.39[2] KF7-505.41[2] KF7-505.42[2] KF7-505.43[3] /end FUNCTION_LIST /end MEASUREMENT
/begin MEASUREMENT fCLDGNE "Operation result collation function diagnosis completion flag" UBYTE COMP_0283 1 100 0 1 BIT_MASK 0x0080 ECU_ADDRESS 0xFFFF428B /begin FUNCTION_LIST KF7-505.39[2] KF7-505.42[2] /end FUNCTION_LIST /end MEASUREMENT
/begin MEASUREMENT fCPUDGN "ALU diagnosis requirement flag" UBYTE COMP_0283 1 100 0 1 BIT_MASK 0x0040 ECU_ADDRESS 0xFFFF428D /begin FUNCTION_LIST KF7-505.39[2] KF7-505.40[1] KF7-505.41[2] /end FUNCTION_LIST /end MEASUREMENT
/begin MEASUREMENT fFLGAFSV "A/F sensor breakage diagnosis criteria choice flag" UBYTE COMP_0283 1 100 0 1 BIT_MASK 0x0008 ECU_ADDRESS 0xFFFF42B8 /begin FUNCTION_LIST KF7-500.76[8] /end FUNCTION_LIST /end MEASUREMENT
/begin MEASUREMENT fFSTLN "Brake stratified permission prohibition flag" UBYTE COMP_0283 1 100 0 1 BIT_MASK 0x0040 ECU_ADDRESS 0xFFFF42C1 DISPLAY_IDENTIFIER Vbx_mvac_cut_req
 /begin FUNCTION_LIST KF7-505.36[2] R000.1.RS_Integ_1_10_2 R106.5.epw_ptcxx_1_1_0 /end FUNCTION_LIST
/end MEASUREMENT
/begin MEASUREMENT fIFLEANP "Lean/stoichiometric map switching permission flag (bit reversal value)" UBYTE COMP_0283 1 100 0 1 BIT_MASK 0x0004 ECU_ADDRESS 0xFFFF42C8 /begin FUNCTION_LIST KF7-505.36[2] /end FUNCTION_LIST /end MEASUREMENT
/begin MEASUREMENT fIFSTLN "Brake necessary condition lean permission flag (bit reversal value)" UBYTE COMP_0283 1 100 0 1 BIT_MASK 0x0002 ECU_ADDRESS 0xFFFF42C8 /begin FUNCTION_LIST KF7-505.36[2] /end FUNCTION_LIST /end MEASUREMENT
/begin MEASUREMENT fIRAMNGF1 "RAM diagnosis (lead light check) the first time NG flag (reversal value)" UBYTE COMP_0283 1 100 0 1 BIT_MASK 0x0040 ECU_ADDRESS 0xFFFF42CA /begin FUNCTION_LIST KF7-505.12[6] KF7-505.36[2] /end FUNCTION_LIST /end MEASUREMENT
/begin MEASUREMENT fIRAMNGF2 "RAM diagnosis (evacuation data reversion check) the first time NG flag (reversal value)" UBYTE COMP_0283 1 100 0 1 BIT_MASK 0x0020 ECU_ADDRESS 0xFFFF42CA /begin FUNCTION_LIST KF7-505.12[6] KF7-505.36[2] /end FUNCTION_LIST /end MEASUREMENT
/begin MEASUREMENT fLMDCNT "Closed-loop start time diagnosis detection flag" UBYTE COMP_0283 1 100 0 1 BIT_MASK 0x0008 ECU_ADDRESS 0xFFFF42CD /begin FUNCTION_LIST KF7-500.39[5] KF7-580.1[8] /end FUNCTION_LIST /end MEASUREMENT
/begin MEASUREMENT fMECHAST "During the ETC mechanical trouble diagnosis movement, flag" UBYTE COMP_0283 1 100 0 1 BIT_MASK 0x0008 ECU_ADDRESS 0xFFFF42CF /begin FUNCTION_LIST KF7-505.33[8] /end FUNCTION_LIST /end MEASUREMENT
/begin MEASUREMENT fNGANSRQ "Mis-answer requirement flag" UBYTE COMP_0283 1 100 0 1 BIT_MASK 0x0020 ECU_ADDRESS 0xFFFF42D8 /begin FUNCTION_LIST KF7-505.41[2] KF7-505.42[2] /end FUNCTION_LIST /end MEASUREMENT
/begin MEASUREMENT fRAMNGF1 "RAM diagnosis (lead light check) the first time NG flag" UBYTE COMP_0283 1 100 0 1 BIT_MASK 0x0008 ECU_ADDRESS 0xFFFF42E7 /begin FUNCTION_LIST KF7-505.12[6] KF7-505.36[2] /end FUNCTION_LIST /end MEASUREMENT
/begin MEASUREMENT fRAMNGF2 "RAM diagnosis (evacuation data reversion check) the first time NG flag" UBYTE COMP_0283 1 100 0 1 BIT_MASK 0x0004 ECU_ADDRESS 0xFFFF42E7 /begin FUNCTION_LIST KF7-505.12[6] KF7-505.36[2] /end FUNCTION_LIST /end MEASUREMENT
/begin MEASUREMENT fSSFTRG "A flag for the S/S/ off system diagnosis" UBYTE COMP_0283 1 100 0 1 BIT_MASK 0x0004 ECU_ADDRESS 0xFFFF42EF /begin FUNCTION_LIST KF7-505.25[3] /end FUNCTION_LIST /end MEASUREMENT
/begin MEASUREMENT fSYDGNE "SYNC watch part diagnosis completion flag" UBYTE COMP_0283 1 100 0 1 BIT_MASK 0x0008 ECU_ADDRESS 0xFFFF42F1 /begin FUNCTION_LIST KF7-505.39[2] KF7-505.43[3] /end FUNCTION_LIST /end MEASUREMENT
/begin MEASUREMENT fSYDGNS "SYNC watch part diagnosis start flag" UBYTE COMP_0283 1 100 0 1 BIT_MASK 0x0004 ECU_ADDRESS 0xFFFF42F1 /begin FUNCTION_LIST KF7-505.43[3] /end FUNCTION_LIST /end MEASUREMENT
/begin MEASUREMENT fTPOLOV "TPO control lower limit overcoat flag" UBYTE COMP_0283 1 100 0 1 BIT_MASK 0x0008 ECU_ADDRESS 0xFFFF42F4 /begin FUNCTION_LIST KF7-505.15[4] /end FUNCTION_LIST /end MEASUREMENT
/begin MEASUREMENT fTPOUOV "TPO control upper limit overcoat flag" UBYTE COMP_0283 1 100 0 1 BIT_MASK 0x0004 ECU_ADDRESS 0xFFFF42F4 /begin FUNCTION_LIST KF7-505.15[4] /end FUNCTION_LIST /end MEASUREMENT
/begin MEASUREMENT fVTCCNEL "VTC drive abnormality diagnosis permission engine speed lower limit judgement" UBYTE COMP_0283 1 100 0 1 BIT_MASK 0x0010 ECU_ADDRESS 0xFFFF42FA /begin FUNCTION_LIST KF7-500.47B[15] /end FUNCTION_LIST /end MEASUREMENT
/begin MEASUREMENT fVTCCTWH "VTC drive abnormality diagnosis permission coolant temperature upper limit judgement" UBYTE COMP_0283 1 100 0 1 BIT_MASK 0x0008 ECU_ADDRESS 0xFFFF42FA /begin FUNCTION_LIST KF7-500.47B[15] /end FUNCTION_LIST /end MEASUREMENT
/begin MEASUREMENT fVTCCTWL "VTC drive abnormality diagnosis permission coolant temperature lower limit judgement" UBYTE COMP_0283 1 100 0 1 BIT_MASK 0x0004 ECU_ADDRESS 0xFFFF42FA /begin FUNCTION_LIST KF7-500.47B[15] /end FUNCTION_LIST /end MEASUREMENT
/begin MEASUREMENT fVTCDNE "Engine rotation condition hysteresis flag" UBYTE COMP_0283 1 100 0 1 BIT_MASK 0x0002 ECU_ADDRESS 0xFFFF42FA /begin FUNCTION_LIST KF7-500.47B[15] /end FUNCTION_LIST /end MEASUREMENT
/begin MEASUREMENT fDCPUNG_S "CPU system NG" UBYTE COMP_0283 1 100 0 1 BIT_MASK 0x0004 ECU_ADDRESS 0xFFFF42FF /begin FUNCTION_LIST KF7-505.25[3] /end FUNCTION_LIST /end MEASUREMENT
/begin MEASUREMENT fAPS1CA "APS1 system precaution flag" UBYTE COMP_0283 1 100 0 1 BIT_MASK 0x0020 ECU_ADDRESS 0xFFFF430F /begin FUNCTION_LIST KF7-505.2[9] /end FUNCTION_LIST /end MEASUREMENT
/begin MEASUREMENT fAPS2CA "APS2 system precaution flag" UBYTE COMP_0283 1 100 0 1 BIT_MASK 0x0002 ECU_ADDRESS 0xFFFF430F /begin FUNCTION_LIST KF7-505.2[9] /end FUNCTION_LIST /end MEASUREMENT
/begin MEASUREMENT fAPSXCA "APS un-adjustment precaution flag" UBYTE COMP_0283 1 100 0 1 BIT_MASK 0x0008 ECU_ADDRESS 0xFFFF4310 /begin FUNCTION_LIST KF7-505.2[9] /end FUNCTION_LIST /end MEASUREMENT
/begin MEASUREMENT fCANADBUS "CAN address bus diagnosis complete flag" UBYTE COMP_0283 1 100 0 1 BIT_MASK 0x0004 ECU_ADDRESS 0xFFFF4312 /begin FUNCTION_LIST KF7-500.69[25] /end FUNCTION_LIST /end MEASUREMENT
/begin MEASUREMENT fCANREG "CAN registor diagnosis complete flag" UBYTE COMP_0283 1 100 0 1 BIT_MASK 0x0020 ECU_ADDRESS 0xFFFF4313 /begin FUNCTION_LIST KF7-500.69[25] /end FUNCTION_LIST /end MEASUREMENT
/begin MEASUREMENT fCANSETV "After CAN initialization value writing, a complete flag" UBYTE COMP_0283 1 100 0 1 BIT_MASK 0x0008 ECU_ADDRESS 0xFFFF4313 /begin FUNCTION_LIST KF7-500.69[25] /end FUNCTION_LIST /end MEASUREMENT
/begin MEASUREMENT fDADIND "An input flag for the AD diagnosis" UBYTE COMP_0283 1 100 0 1 BIT_MASK 0x0004 ECU_ADDRESS 0xFFFF4318 /begin FUNCTION_LIST KF7-505.38[4] /end FUNCTION_LIST /end MEASUREMENT
/begin MEASUREMENT fDEFODGN "During the default mechanism diagnosis, flag" UBYTE COMP_0283 1 100 0 1 BIT_MASK 0x0020 ECU_ADDRESS 0xFFFF4319 /begin FUNCTION_LIST KF7-505.33[8] /end FUNCTION_LIST /end MEASUREMENT
/begin MEASUREMENT fDEFOST "Default mechanism diagnosis start flag" UBYTE COMP_0283 1 100 0 1 BIT_MASK 0x0010 ECU_ADDRESS 0xFFFF4319 /begin FUNCTION_LIST KF7-505.33[8] /end FUNCTION_LIST /end MEASUREMENT
/begin MEASUREMENT fFCANFNG "CAN communication initial diagnosis judgement flag" UBYTE COMP_0283 1 100 0 1 BIT_MASK 0x0001 ECU_ADDRESS 0xFFFF4325 /begin FUNCTION_LIST KF7-500.69[25] /end FUNCTION_LIST /end MEASUREMENT
/begin MEASUREMENT fFCANNG "CAN communication interval diagnosis judgement flag" UBYTE COMP_0283 1 100 0 1 BIT_MASK 0x0080 ECU_ADDRESS 0xFFFF4326 /begin FUNCTION_LIST KF7-500.69[25] /end FUNCTION_LIST /end MEASUREMENT
/begin MEASUREMENT fFCANNGNE "CAN communication interval diagnosis judgement flag (non emission-related message)" UBYTE COMP_0283 1 100 0 1 BIT_MASK 0x0040 ECU_ADDRESS 0xFFFF4326 /begin FUNCTION_LIST KF7-500.69[25] /end FUNCTION_LIST /end MEASUREMENT
/begin MEASUREMENT fTPS1CA "TPS1 system precaution flag" UBYTE COMP_0283 1 100 0 1 BIT_MASK 0x0001 ECU_ADDRESS 0xFFFF433D /begin FUNCTION_LIST KF7-505.2[9] KF7-505.15[4] KF7-505.34[3] /end FUNCTION_LIST /end MEASUREMENT
/begin MEASUREMENT fTPS2CA "TPS2 system precaution flag" UBYTE COMP_0283 1 100 0 1 BIT_MASK 0x0080 ECU_ADDRESS 0xFFFF433E /begin FUNCTION_LIST KF7-505.2[9] /end FUNCTION_LIST /end MEASUREMENT
/begin MEASUREMENT fTTPSNG "NG condition formation flag" UBYTE COMP_0283 1 100 0 1 BIT_MASK 0x0040 ECU_ADDRESS 0xFFFF433F /begin FUNCTION_LIST KF7-505.38[4] /end FUNCTION_LIST /end MEASUREMENT
/begin MEASUREMENT fVBRLYOK "Relay off trouble diagnosis condition formation flag" UBYTE COMP_0283 1 100 0 1 BIT_MASK 0x0002 ECU_ADDRESS 0xFFFF4340 /begin FUNCTION_LIST KF7-505.31[5] /end FUNCTION_LIST /end MEASUREMENT
/begin MEASUREMENT afBPFS_NO "BPFS NO flag" UBYTE COMP_0283 1 100 0 1 BIT_MASK 0x0010 ECU_ADDRESS 0xFFFF434C /begin FUNCTION_LIST KF7-505.27[4] /end FUNCTION_LIST /end MEASUREMENT
/begin MEASUREMENT fBPFS_NO "BPFS NO flag" UBYTE COMP_0283 1 100 0 1 BIT_MASK 0x0010 ECU_ADDRESS 0xFFFF435D /begin FUNCTION_LIST KF7-505.27[4] /end FUNCTION_LIST /end MEASUREMENT
/begin MEASUREMENT wfEXCALCHK "Exercise operation collation result monitor signal" UBYTE COMP_0283 1 100 0 1 BIT_MASK 0x0008 ECU_ADDRESS 0xFFFF8A8F /begin FUNCTION_LIST KF7-525.2[6] /end FUNCTION_LIST /end MEASUREMENT
/begin MEASUREMENT wfSLFCHK "Neutral SW" UBYTE COMP_0283 1 100 0 1 BIT_MASK 0x0080 ECU_ADDRESS 0xFFFF8A91 /begin FUNCTION_LIST KF7-525.2[6] /end FUNCTION_LIST /end MEASUREMENT
/begin MEASUREMENT wfSYNCCHK "SYNC diagnosis result monitor signal" UBYTE COMP_0283 1 100 0 1 BIT_MASK 0x0040 ECU_ADDRESS 0xFFFF8A91 /begin FUNCTION_LIST KF7-525.2[6] /end FUNCTION_LIST /end MEASUREMENT
/begin MEASUREMENT fEXCALCHK "Exercise operation collation result monitor signal" UBYTE COMP_0283 1 100 0 1 BIT_MASK 0x0008 ECU_ADDRESS 0xFFFF8A92 /begin FUNCTION_LIST KF7-525.2[6] /end FUNCTION_LIST /end MEASUREMENT
/begin MEASUREMENT fSLFCHK "SELF CHECK result monitor signal" UBYTE COMP_0283 1 100 0 1 BIT_MASK 0x0080 ECU_ADDRESS 0xFFFF8A94 /begin FUNCTION_LIST KF7-525.2[6] /end FUNCTION_LIST /end MEASUREMENT
/begin MEASUREMENT fSYNCCHK "SYNC diagnosis result monitor signal" UBYTE COMP_0283 1 100 0 1 BIT_MASK 0x0040 ECU_ADDRESS 0xFFFF8A94 /begin FUNCTION_LIST KF7-525.2[6] /end FUNCTION_LIST /end MEASUREMENT
/begin MEASUREMENT fVTCCNEH "VTC drive diagnosis engine speed upper limit hysteresis flag" UBYTE COMP_0283 1 100 0 1 BIT_MASK 0x0080 ECU_ADDRESS 0xFFFF24A7 /begin FUNCTION_LIST KF7-500.47B[15] /end FUNCTION_LIST /end MEASUREMENT
/begin MEASUREMENT fDADOUT "An output flag for the AD diagnosis" UBYTE COMP_0283 1 100 0 1 BIT_MASK 0x0002 ECU_ADDRESS 0xFFFF24B6 /begin FUNCTION_LIST KF7-505.38[4] /end FUNCTION_LIST /end MEASUREMENT
/begin MEASUREMENT fECHOK "The back of the echo" UBYTE COMP_0283 1 100 0 1 BIT_MASK 0x0040 ECU_ADDRESS 0xFFFF24B7
 /begin FUNCTION_LIST KF7-500.47B[15] KF7-505.50[1] KF7-505.51[2] KF7-505.52[1] KF7-505.53[1] KF7-525.2S[10] /end FUNCTION_LIST
/end MEASUREMENT
/begin MEASUREMENT fONSHIFT "During gear shift, signal" UBYTE COMP_0283 1 100 0 1 BIT_MASK 0x0080 ECU_ADDRESS 0xFFFF24BC /begin FUNCTION_LIST KF7-505.47[3] /end FUNCTION_LIST /end MEASUREMENT
/begin MEASUREMENT fBRKSW_S "Brake switch" UBYTE COMP_0283 1 100 0 1 BIT_MASK 0x0001 ECU_ADDRESS 0xFFFF24BF /begin FUNCTION_LIST KF7-525.2S[10] /end FUNCTION_LIST /end MEASUREMENT
/begin MEASUREMENT fPODLST "POS sensor diagnosis delay timer initialization prohibition flag" UBYTE COMP_0283 1 100 0 1 BIT_MASK 0x0040 ECU_ADDRESS 0xFFFF24C4 /begin FUNCTION_LIST KF7-500.47B[15] /end FUNCTION_LIST /end MEASUREMENT
/begin MEASUREMENT fVFYDGN "After KeyOFF, watch IC diagnosis switching flag" UBYTE COMP_0283 1 100 0 1 BIT_MASK 0x0008 ECU_ADDRESS 0xFFFFB7E3 /begin FUNCTION_LIST KF7-505.39[2] KF7-505.41[2] KF7-505.42[2] KF7-505.43[3] /end FUNCTION_LIST /end MEASUREMENT
/begin MEASUREMENT tAFSDLY "A/F sensor breakage diagnosis judgement start delay" UBYTE COMP_0201_S 1 100 0 255 ECU_ADDRESS 0xFFFF4371 /begin FUNCTION_LIST KF7-500.76[8] /end FUNCTION_LIST /end MEASUREMENT
/begin MEASUREMENT tAFSDLY1 "AFS response deterioration diagnosis judgement start delay" UBYTE COMP_0201_S 1 100 0 255 ECU_ADDRESS 0xFFFF4373 /begin FUNCTION_LIST KF7-500.74[11] /end FUNCTION_LIST /end MEASUREMENT
/begin MEASUREMENT tAFVNGT1 "A/F sensor breakage NG judgement time" UBYTE COMP_0201_S 1 100 0 255 ECU_ADDRESS 0xFFFF4375 /begin FUNCTION_LIST KF7-500.76[8] /end FUNCTION_LIST /end MEASUREMENT
/begin MEASUREMENT tCCLDL1 "Closed-loop diagnosis judgement delay 1" UBYTE COMP_0201_S 1 100 0 255 ECU_ADDRESS 0xFFFF437C /begin FUNCTION_LIST KF7-500.39[5] /end FUNCTION_LIST /end MEASUREMENT
/begin MEASUREMENT tCCLDL2 "Closed-loop diagnosis judgement delay 2" UBYTE COMP_0201_S 1 100 0 255 ECU_ADDRESS 0xFFFF437E /begin FUNCTION_LIST KF7-500.39[5] /end FUNCTION_LIST /end MEASUREMENT
/begin MEASUREMENT tGAVGAFH "Heater diagnosis OK judgement timer" UBYTE COMP_0201_S 1 100 0 255 ECU_ADDRESS 0xFFFF4394 /begin FUNCTION_LIST KF7-500.59[6] /end FUNCTION_LIST /end MEASUREMENT
/begin MEASUREMENT tNEUTCNT "NEUT SW Timer for on sticking diagnosis" UBYTE COMP_0201_S 1 100 0 255 ECU_ADDRESS 0xFFFF439E /begin FUNCTION_LIST KF7-505.23[2] KF7-505.26[2] /end FUNCTION_LIST /end MEASUREMENT
/begin MEASUREMENT tO2JNGD "Breakage diagnosis NG continuation timer" UBYTE COMP_0201_S 1 100 0 255 ECU_ADDRESS 0xFFFF43AA /begin FUNCTION_LIST KF7-505.26[2] /end FUNCTION_LIST /end MEASUREMENT
/begin MEASUREMENT tTAFHNGT "Heater diagnosis NG judgement timer" UBYTE COMP_0201_S 1 100 0 255 ECU_ADDRESS 0xFFFF43EB /begin FUNCTION_LIST KF7-500.59[6] /end FUNCTION_LIST /end MEASUREMENT
/begin MEASUREMENT tTIMPB1 "Absolute pressure sensor diagnosis region 1 judgement time" UBYTE COMP_0201_S 1 100 0 255 ECU_ADDRESS 0xFFFF440C /begin FUNCTION_LIST KF7-500.51[3] /end FUNCTION_LIST /end MEASUREMENT
/begin MEASUREMENT tTIMPB2 "Absolute pressure sensor diagnosis region 2 judgement time" UBYTE COMP_0201_S 1 100 0 255 ECU_ADDRESS 0xFFFF440D /begin FUNCTION_LIST KF7-500.51[3] /end FUNCTION_LIST /end MEASUREMENT
/begin MEASUREMENT tTVSPNG "Vehicle speed sensor NG judgement delay timer" UBYTE COMP_0201_S 1 100 0 255 ECU_ADDRESS 0xFFFF443B /begin FUNCTION_LIST KF7-505.49[3] /end FUNCTION_LIST /end MEASUREMENT
/begin MEASUREMENT tTWPASS "After the coolant temperature condition formation, delay" UBYTE COMP_0201_S 1 100 0 255 ECU_ADDRESS 0xFFFF443C /begin FUNCTION_LIST KF7-500.74[11] /end FUNCTION_LIST /end MEASUREMENT
/begin MEASUREMENT tACCMSGCA "A delay timer for the ACC communication system diagnosis NG judgement" UBYTE COMP_0202_S 1 100 0 255 ECU_ADDRESS 0xFFFF4442 /begin FUNCTION_LIST KF7-505.27[4] /end FUNCTION_LIST /end MEASUREMENT
/begin MEASUREMENT tFCAFCAN "At the time of a change in NÅ~TP, all the cylinder F/C progress time for the diagnosis cancellation condition computation" UBYTE COMP_0202_S 1 100 0 255 ECU_ADDRESS 0xFFFF447B /begin FUNCTION_LIST KF7-500.74[11] /end FUNCTION_LIST /end MEASUREMENT
/begin MEASUREMENT tIGNON "IGN/SW After OFFON, timer" UBYTE COMP_0202_S 1 100 0 255 ECU_ADDRESS 0xFFFF448F /begin FUNCTION_LIST KF7-505.15[4] /end FUNCTION_LIST /end MEASUREMENT
/begin MEASUREMENT tO2AVNG "An unusual voltage NG continuation timer" UBYTE COMP_0202_S 1 100 0 255 ECU_ADDRESS 0xFFFF449A /begin FUNCTION_LIST KF7-505.26[2] /end FUNCTION_LIST /end MEASUREMENT
/begin MEASUREMENT tVTNEDML "A delay timer for VTC breakage trouble diagnosis MIL lighting" UBYTE COMP_0202_S 1 100 0 255 ECU_ADDRESS 0xFFFF459C /begin FUNCTION_LIST KF7-500.47B[15] /end FUNCTION_LIST /end MEASUREMENT
/begin MEASUREMENT tDTEPNG "TTEP un-adjustment diagnosis judgement timer" UBYTE COMP_0203_S 1 100 0 255 ECU_ADDRESS 0xFFFF45E3 /begin FUNCTION_LIST KF7-505.26[2] /end FUNCTION_LIST /end MEASUREMENT
/begin MEASUREMENT tTAF1NG "AFM breakage trouble diagnosis timer" UBYTE COMP_0203_S 1 100 0 255 ECU_ADDRESS 0xFFFF460B /begin FUNCTION_LIST KF7-505.26[2] /end FUNCTION_LIST /end MEASUREMENT
/begin MEASUREMENT tTAFSNG "AFM short trouble diagnosis timer" UBYTE COMP_0203_S 1 100 0 255 ECU_ADDRESS 0xFFFF460E /begin FUNCTION_LIST KF7-505.26[2] /end FUNCTION_LIST /end MEASUREMENT
/begin MEASUREMENT tTCLNGT "Target open-degree collation un-adjustment allowable time measuring timer" UBYTE COMP_0203_S 1 100 0 255 ECU_ADDRESS 0xFFFF4615 /begin FUNCTION_LIST KF7-505.26[2] /end FUNCTION_LIST /end MEASUREMENT
/begin MEASUREMENT tTDGNG "A timer for the operation result collation function diagnosis NG judgement" UBYTE COMP_0203_S 1 100 0 255 ECU_ADDRESS 0xFFFF461D /begin FUNCTION_LIST KF7-505.42[2] /end FUNCTION_LIST /end MEASUREMENT
/begin MEASUREMENT tTFBDWNNG "Throttle open-degree decline diagnosis time" UBYTE COMP_0203_S 1 100 0 255 ECU_ADDRESS 0xFFFF4624 /begin FUNCTION_LIST KF7-505.26[2] /end FUNCTION_LIST /end MEASUREMENT
/begin MEASUREMENT tTMAVCCNG "AVCC Unusual judgement time" UBYTE COMP_0203_S 1 100 0 255 ECU_ADDRESS 0xFFFF4635 /begin FUNCTION_LIST KF7-505.26[2] /end FUNCTION_LIST /end MEASUREMENT
/begin MEASUREMENT tTMCRNTHI "Over-electric current judgement time" UBYTE COMP_0203_S 1 100 0 255 ECU_ADDRESS 0xFFFF4639 /begin FUNCTION_LIST KF7-505.26[2] /end FUNCTION_LIST /end MEASUREMENT
/begin MEASUREMENT tTMOVCR1 "Over-electric current judgement time" UBYTE COMP_0203_S 1 100 0 255 ECU_ADDRESS 0xFFFF4649 /begin FUNCTION_LIST KF7-505.26[2] /end FUNCTION_LIST /end MEASUREMENT
/begin MEASUREMENT tTMTATE "Un-adjustment diagnosis judgement timer" UBYTE COMP_0203_S 1 100 0 255 ECU_ADDRESS 0xFFFF4665 /begin FUNCTION_LIST KF7-505.26[2] /end FUNCTION_LIST /end MEASUREMENT
/begin MEASUREMENT tTMTEPTD "TTEPTD un-adjustment diagnosis timer" UBYTE COMP_0203_S 1 100 0 255 ECU_ADDRESS 0xFFFF4667 /begin FUNCTION_LIST KF7-505.26[2] /end FUNCTION_LIST /end MEASUREMENT
/begin MEASUREMENT tTMTHOP "Throttle open sticking time" UBYTE COMP_0203_S 1 100 0 255 ECU_ADDRESS 0xFFFF4668 /begin FUNCTION_LIST KF7-505.26[2] /end FUNCTION_LIST /end MEASUREMENT
/begin MEASUREMENT tTQAPNG "TQH0AP un-adjustment diagnosis timer" UBYTE COMP_0203_S 1 100 0 255 ECU_ADDRESS 0xFFFF4675 /begin FUNCTION_LIST KF7-505.26[2] /end FUNCTION_LIST /end MEASUREMENT
/begin MEASUREMENT tTSYDGNG "A timer for the SYNC watch part diagnosis NG judgement" UBYTE COMP_0203_S 1 100 0 255 ECU_ADDRESS 0xFFFF4679 /begin FUNCTION_LIST KF7-505.43[3] /end FUNCTION_LIST /end MEASUREMENT
/begin MEASUREMENT tTTWXNG "Coolant temperature sensor input value un-adjustment diagnosis delay timer" UBYTE COMP_0203_S 1 100 0 255 ECU_ADDRESS 0xFFFF467C /begin FUNCTION_LIST KF7-505.10[2] /end FUNCTION_LIST /end MEASUREMENT
/begin MEASUREMENT tTVAPNG "VAPO un-adjustment judgement delay time" UBYTE COMP_0203_S 1 100 0 255 ECU_ADDRESS 0xFFFF467F /begin FUNCTION_LIST KF7-505.26[2] /end FUNCTION_LIST /end MEASUREMENT
/begin MEASUREMENT tTMTHMO "After the engine start, delay" UWORD COMP_0201_S 1 100 0 65535 ECU_ADDRESS 0xFFFF46BA /begin FUNCTION_LIST KF7-500.60[5] /end FUNCTION_LIST /end MEASUREMENT
/begin MEASUREMENT tTTHIVL "Coolant temperature convergent judgement section timer" UWORD COMP_0201_S 1 100 0 65535 ECU_ADDRESS 0xFFFF46BC /begin FUNCTION_LIST KF7-500.60[5] /end FUNCTION_LIST /end MEASUREMENT
/begin MEASUREMENT tTMDEFNG1 "Time to judge a default mechanism unusually" UWORD COMP_0203_S 1 100 0 65535 ECU_ADDRESS 0xFFFF4714 /begin FUNCTION_LIST KF7-505.26[2] /end FUNCTION_LIST /end MEASUREMENT
/begin MEASUREMENT tTMSPONNG1 "Time to judge a return spring unusually" UWORD COMP_0203_S 1 100 0 65535 ECU_ADDRESS 0xFFFF471A /begin FUNCTION_LIST KF7-505.26[2] /end FUNCTION_LIST /end MEASUREMENT
/begin MEASUREMENT tTMSPRGNG1 "Time to judge a return spring unusually" UWORD COMP_0203_S 1 100 0 65535 ECU_ADDRESS 0xFFFF471C /begin FUNCTION_LIST KF7-505.26[2] /end FUNCTION_LIST /end MEASUREMENT
/begin MEASUREMENT tTPSX4BNG1 "TPS four times judgement timer" UWORD COMP_0203_S 1 100 0 65535 ECU_ADDRESS 0xFFFF472C /begin FUNCTION_LIST KF7-505.26[2] /end FUNCTION_LIST /end MEASUREMENT
/begin MEASUREMENT tTTPSNG "A timer for TTPSNG measuring" UWORD COMP_0203_S 1 100 0 65535 ECU_ADDRESS 0xFFFF4730 /begin FUNCTION_LIST KF7-505.38[4] /end FUNCTION_LIST /end MEASUREMENT
/begin MEASUREMENT tINLDST "Lambda control start prohibition timer" UBYTE COMP_0201_S 1 100 0 255 ECU_ADDRESS 0xFFFF24EB /begin FUNCTION_LIST KF7-500.39[5] /end FUNCTION_LIST /end MEASUREMENT
/begin MEASUREMENT tCLERRTIM "C-VTC drive abnormality diagnosis prohibition time timer" UBYTE COMP_0202_S 1 100 0 255 ECU_ADDRESS 0xFFFF252F /begin FUNCTION_LIST KF7-500.47B[15] /end FUNCTION_LIST /end MEASUREMENT
/begin MEASUREMENT tFCAFHZ "F/cut formation delay time" UBYTE COMP_0202_S 1 100 0 255 ECU_ADDRESS 0xFFFF2545 /begin FUNCTION_LIST KF7-500.74[11] /end FUNCTION_LIST /end MEASUREMENT
/begin MEASUREMENT tFCAFHZF "F/cut time" UBYTE COMP_0202_S 1 100 0 255 ECU_ADDRESS 0xFFFF2547 /begin FUNCTION_LIST KF7-500.74[11] /end FUNCTION_LIST /end MEASUREMENT
/begin MEASUREMENT tFCAFHZF2 "Lean rich response measuring start F/cut time" UBYTE COMP_0202_S 1 100 0 255 ECU_ADDRESS 0xFFFF2549 /begin FUNCTION_LIST KF7-500.74[11] /end FUNCTION_LIST /end MEASUREMENT
/begin MEASUREMENT tFCAFHZF3 "Lean rich response deterioration diagnosis parameter monitor time" UBYTE COMP_0202_S 1 100 0 255 ECU_ADDRESS 0xFFFF254B /begin FUNCTION_LIST KF7-500.74[11] /end FUNCTION_LIST /end MEASUREMENT
/begin MEASUREMENT tTDABF "Delta-A/F value computed delay time" UBYTE COMP_0202_S 1 100 0 255 ECU_ADDRESS 0xFFFF2595 /begin FUNCTION_LIST KF7-500.74[11] /end FUNCTION_LIST /end MEASUREMENT
/begin MEASUREMENT tAPS1CA "-" UBYTE COMP_0203_S 1 100 0 255 ECU_ADDRESS 0xFFFF25CE /begin FUNCTION_LIST KF7-505.2[9] /end FUNCTION_LIST /end MEASUREMENT
/begin MEASUREMENT tAPS2CA "-" UBYTE COMP_0203_S 1 100 0 255 ECU_ADDRESS 0xFFFF25CF /begin FUNCTION_LIST KF7-505.2[9] /end FUNCTION_LIST /end MEASUREMENT
/begin MEASUREMENT tAPSXCA "-" UBYTE COMP_0203_S 1 100 0 255 ECU_ADDRESS 0xFFFF25D0 /begin FUNCTION_LIST KF7-505.2[9] KF7-505.26[2] /end FUNCTION_LIST /end MEASUREMENT
/begin MEASUREMENT tTCLNGA "APS un-adjustment precaution continuation timer" UBYTE COMP_0203_S 1 100 0 255 ECU_ADDRESS 0xFFFF2649 /begin FUNCTION_LIST KF7-505.26[2] /end FUNCTION_LIST /end MEASUREMENT
/begin MEASUREMENT tTPS1CA "-" UBYTE COMP_0203_S 1 100 0 255 ECU_ADDRESS 0xFFFF2673 /begin FUNCTION_LIST KF7-505.2[9] KF7-505.15[4] KF7-505.34[3] /end FUNCTION_LIST /end MEASUREMENT
/begin MEASUREMENT tTPS2CA "-" UBYTE COMP_0203_S 1 100 0 255 ECU_ADDRESS 0xFFFF2674 /begin FUNCTION_LIST KF7-505.2[9] /end FUNCTION_LIST /end MEASUREMENT
/begin MEASUREMENT tDLINPNG "CVT input speed diagnosis time" UWORD COMP_0203_S 1 100 0 65535 ECU_ADDRESS 0xFFFF26C6 /begin FUNCTION_LIST KF7-505.26[2] KF7-505.47[3] /end FUNCTION_LIST /end MEASUREMENT
/begin MEASUREMENT avVTCDGN1S "RAM value avVTCDGN1S" UBYTE COMP_0004 1 100 0 255 ECU_ADDRESS 0xFFFF41AC /begin FUNCTION_LIST KF7-500.47B[15] /end FUNCTION_LIST /end MEASUREMENT
/begin MEASUREMENT avVTCDGN2S "RAM value avVTCDGN2S" UBYTE COMP_0004 1 100 0 255 ECU_ADDRESS 0xFFFF41B0 /begin FUNCTION_LIST KF7-500.47B[15] /end FUNCTION_LIST /end MEASUREMENT
/begin MEASUREMENT vAFMIMIN "Middle electric potential fixed trouble diagnosis time (minimum value)" UBYTE COMP_0014 1 100 0 2550 ECU_ADDRESS 0xFFFFA096 /begin FUNCTION_LIST KF7-505.26[2] /end FUNCTION_LIST /end MEASUREMENT
/begin MEASUREMENT vAFOPMIN "Breakage trouble diagnosis time (minimum value)" UBYTE COMP_0014 1 100 0 2550 ECU_ADDRESS 0xFFFFA0B3 /begin FUNCTION_LIST KF7-505.26[2] /end FUNCTION_LIST /end MEASUREMENT
/begin MEASUREMENT vAFSHMIN "Short trouble diagnosis time (minimum value)" UBYTE COMP_0014 1 100 0 2550 ECU_ADDRESS 0xFFFFA0B4 /begin FUNCTION_LIST KF7-505.26[2] /end FUNCTION_LIST /end MEASUREMENT
/begin MEASUREMENT vAFSMAX "Front A/F sensor output maximum voltage value" UWORD COMP_0023 1 100 0 327675 ECU_ADDRESS 0xFFFF27D8 /begin FUNCTION_LIST KF7-500.74[11] /end FUNCTION_LIST /end MEASUREMENT
/begin MEASUREMENT vAFSMIN "Front A/F sensor output minimum voltage value" UWORD COMP_0023 1 100 0 327675 ECU_ADDRESS 0xFFFF27DC /begin FUNCTION_LIST KF7-500.74[11] /end FUNCTION_LIST /end MEASUREMENT
/begin MEASUREMENT vAHBAH1 "Heater electric current value A/D value weighted average value time series data (bank1)" UWORD COMP_0023 1 100 0 327675 ECU_ADDRESS 0xFFFFA0BA /begin FUNCTION_LIST KF7-500.59[6] /end FUNCTION_LIST /end MEASUREMENT
/begin MEASUREMENT vAHBAH1_R#1 "Heater electric current value A/D value weighted average value time series data (bank1)" UWORD COMP_0023 1 100 0 327675 ECU_ADDRESS 0xFFFFA0BA /begin FUNCTION_LIST KF7-500.59[6] /end FUNCTION_LIST /end MEASUREMENT
/begin MEASUREMENT vAHBAH1_R#2 "Heater electric current value A/D value weighted average value time series data (bank1)" UWORD COMP_0023 1 100 0 327675 ECU_ADDRESS 0xFFFFA0BC /begin FUNCTION_LIST KF7-500.59[6] /end FUNCTION_LIST /end MEASUREMENT
/begin MEASUREMENT vAHBAH1_R#3 "Heater electric current value A/D value weighted average value time series data (bank1)" UWORD COMP_0023 1 100 0 327675 ECU_ADDRESS 0xFFFFA0BE /begin FUNCTION_LIST KF7-500.59[6] /end FUNCTION_LIST /end MEASUREMENT
/begin MEASUREMENT vAHBAH1_R#4 "Heater electric current value A/D value weighted average value time series data (bank1)" UWORD COMP_0023 1 100 0 327675 ECU_ADDRESS 0xFFFFA0C0 /begin FUNCTION_LIST KF7-500.59[6] /end FUNCTION_LIST /end MEASUREMENT
/begin MEASUREMENT vAHBAH1_R#5 "Heater electric current value A/D value weighted average value time series data (bank1)" UWORD COMP_0023 1 100 0 327675 ECU_ADDRESS 0xFFFFA0C2 /begin FUNCTION_LIST KF7-500.59[6] /end FUNCTION_LIST /end MEASUREMENT
/begin MEASUREMENT vAHBAH1_R#6 "Heater electric current value A/D value weighted average value time series data (bank1)" UWORD COMP_0023 1 100 0 327675 ECU_ADDRESS 0xFFFFA0C4 /begin FUNCTION_LIST KF7-500.59[6] /end FUNCTION_LIST /end MEASUREMENT
/begin MEASUREMENT vAHBAH1_R#7 "Heater electric current value A/D value weighted average value time series data (bank1)" UWORD COMP_0023 1 100 0 327675 ECU_ADDRESS 0xFFFFA0C6 /begin FUNCTION_LIST KF7-500.59[6] /end FUNCTION_LIST /end MEASUREMENT
/begin MEASUREMENT vAHBAH1_R#8 "Heater electric current value A/D value weighted average value time series data (bank1)" UWORD COMP_0023 1 100 0 327675 ECU_ADDRESS 0xFFFFA0C8 /begin FUNCTION_LIST KF7-500.59[6] /end FUNCTION_LIST /end MEASUREMENT
/begin MEASUREMENT vAHBAH1_R#9 "Heater electric current value A/D value weighted average value time series data (bank1)" UWORD COMP_0023 1 100 0 327675 ECU_ADDRESS 0xFFFFA0CA /begin FUNCTION_LIST KF7-500.59[6] /end FUNCTION_LIST /end MEASUREMENT
/begin MEASUREMENT vAHBAH1_R#10 "Heater electric current value A/D value weighted average value time series data (bank1)" UWORD COMP_0023 1 100 0 327675 ECU_ADDRESS 0xFFFFA0CC /begin FUNCTION_LIST KF7-500.59[6] /end FUNCTION_LIST /end MEASUREMENT
/begin MEASUREMENT vAHBAH1_R#11 "Heater electric current value A/D value weighted average value time series data (bank1)" UWORD COMP_0023 1 100 0 327675 ECU_ADDRESS 0xFFFFA0CE /begin FUNCTION_LIST KF7-500.59[6] /end FUNCTION_LIST /end MEASUREMENT
/begin MEASUREMENT vAHBAH2 "Heater electric current value A/D value weighted average value time series data (bank2)" UWORD COMP_0023 1 100 0 327675 ECU_ADDRESS 0xFFFFA0D0 /begin FUNCTION_LIST KF7-500.59[6] /end FUNCTION_LIST /end MEASUREMENT
/begin MEASUREMENT vAHBAH2_R#1 "Heater electric current value A/D value weighted average value time series data (bank2)" UWORD COMP_0023 1 100 0 327675 ECU_ADDRESS 0xFFFFA0D0 /begin FUNCTION_LIST KF7-500.59[6] /end FUNCTION_LIST /end MEASUREMENT
/begin MEASUREMENT vAHBAH2_R#2 "Heater electric current value A/D value weighted average value time series data (bank2)" UWORD COMP_0023 1 100 0 327675 ECU_ADDRESS 0xFFFFA0D2 /begin FUNCTION_LIST KF7-500.59[6] /end FUNCTION_LIST /end MEASUREMENT
/begin MEASUREMENT vAHBAH2_R#3 "Heater electric current value A/D value weighted average value time series data (bank2)" UWORD COMP_0023 1 100 0 327675 ECU_ADDRESS 0xFFFFA0D4 /begin FUNCTION_LIST KF7-500.59[6] /end FUNCTION_LIST /end MEASUREMENT
/begin MEASUREMENT vAHBAH2_R#4 "Heater electric current value A/D value weighted average value time series data (bank2)" UWORD COMP_0023 1 100 0 327675 ECU_ADDRESS 0xFFFFA0D6 /begin FUNCTION_LIST KF7-500.59[6] /end FUNCTION_LIST /end MEASUREMENT
/begin MEASUREMENT vAHBAH2_R#5 "Heater electric current value A/D value weighted average value time series data (bank2)" UWORD COMP_0023 1 100 0 327675 ECU_ADDRESS 0xFFFFA0D8 /begin FUNCTION_LIST KF7-500.59[6] /end FUNCTION_LIST /end MEASUREMENT
/begin MEASUREMENT vAHBAH2_R#6 "Heater electric current value A/D value weighted average value time series data (bank2)" UWORD COMP_0023 1 100 0 327675 ECU_ADDRESS 0xFFFFA0DA /begin FUNCTION_LIST KF7-500.59[6] /end FUNCTION_LIST /end MEASUREMENT
/begin MEASUREMENT vAHBAH2_R#7 "Heater electric current value A/D value weighted average value time series data (bank2)" UWORD COMP_0023 1 100 0 327675 ECU_ADDRESS 0xFFFFA0DC /begin FUNCTION_LIST KF7-500.59[6] /end FUNCTION_LIST /end MEASUREMENT
/begin MEASUREMENT vAHBAH2_R#8 "Heater electric current value A/D value weighted average value time series data (bank2)" UWORD COMP_0023 1 100 0 327675 ECU_ADDRESS 0xFFFFA0DE /begin FUNCTION_LIST KF7-500.59[6] /end FUNCTION_LIST /end MEASUREMENT
/begin MEASUREMENT vAHBAH2_R#9 "Heater electric current value A/D value weighted average value time series data (bank2)" UWORD COMP_0023 1 100 0 327675 ECU_ADDRESS 0xFFFFA0E0 /begin FUNCTION_LIST KF7-500.59[6] /end FUNCTION_LIST /end MEASUREMENT
/begin MEASUREMENT vAHBAH2_R#10 "Heater electric current value A/D value weighted average value time series data (bank2)" UWORD COMP_0023 1 100 0 327675 ECU_ADDRESS 0xFFFFA0E2 /begin FUNCTION_LIST KF7-500.59[6] /end FUNCTION_LIST /end MEASUREMENT
/begin MEASUREMENT vAHBAH2_R#11 "Heater electric current value A/D value weighted average value time series data (bank2)" UWORD COMP_0023 1 100 0 327675 ECU_ADDRESS 0xFFFFA0E4 /begin FUNCTION_LIST KF7-500.59[6] /end FUNCTION_LIST /end MEASUREMENT
/begin MEASUREMENT vAHBDY1 "A/F sensor heater duty time series data (bank1)" UWORD COMP_0419 1 100 0 6553.5 ECU_ADDRESS 0xFFFFA0E8 /begin FUNCTION_LIST KF7-500.59[6] /end FUNCTION_LIST /end MEASUREMENT
/begin MEASUREMENT vAHBDY1_R#1 "A/F sensor heater duty time series data (bank1)" UWORD COMP_0419 1 100 0 6553.5 ECU_ADDRESS 0xFFFFA0E8 /begin FUNCTION_LIST KF7-500.59[6] /end FUNCTION_LIST /end MEASUREMENT
/begin MEASUREMENT vAHBDY1_R#2 "A/F sensor heater duty time series data (bank1)" UWORD COMP_0419 1 100 0 6553.5 ECU_ADDRESS 0xFFFFA0EA /begin FUNCTION_LIST KF7-500.59[6] /end FUNCTION_LIST /end MEASUREMENT
/begin MEASUREMENT vAHBDY1_R#3 "A/F sensor heater duty time series data (bank1)" UWORD COMP_0419 1 100 0 6553.5 ECU_ADDRESS 0xFFFFA0EC /begin FUNCTION_LIST KF7-500.59[6] /end FUNCTION_LIST /end MEASUREMENT
/begin MEASUREMENT vAHBDY1_R#4 "A/F sensor heater duty time series data (bank1)" UWORD COMP_0419 1 100 0 6553.5 ECU_ADDRESS 0xFFFFA0EE /begin FUNCTION_LIST KF7-500.59[6] /end FUNCTION_LIST /end MEASUREMENT
/begin MEASUREMENT vAHBDY1_R#5 "A/F sensor heater duty time series data (bank1)" UWORD COMP_0419 1 100 0 6553.5 ECU_ADDRESS 0xFFFFA0F0 /begin FUNCTION_LIST KF7-500.59[6] /end FUNCTION_LIST /end MEASUREMENT
/begin MEASUREMENT vAHBDY1_R#6 "A/F sensor heater duty time series data (bank1)" UWORD COMP_0419 1 100 0 6553.5 ECU_ADDRESS 0xFFFFA0F2 /begin FUNCTION_LIST KF7-500.59[6] /end FUNCTION_LIST /end MEASUREMENT
/begin MEASUREMENT vAHBDY1_R#7 "A/F sensor heater duty time series data (bank1)" UWORD COMP_0419 1 100 0 6553.5 ECU_ADDRESS 0xFFFFA0F4 /begin FUNCTION_LIST KF7-500.59[6] /end FUNCTION_LIST /end MEASUREMENT
/begin MEASUREMENT vAHBDY1_R#8 "A/F sensor heater duty time series data (bank1)" UWORD COMP_0419 1 100 0 6553.5 ECU_ADDRESS 0xFFFFA0F6 /begin FUNCTION_LIST KF7-500.59[6] /end FUNCTION_LIST /end MEASUREMENT
/begin MEASUREMENT vAHBDY1_R#9 "A/F sensor heater duty time series data (bank1)" UWORD COMP_0419 1 100 0 6553.5 ECU_ADDRESS 0xFFFFA0F8 /begin FUNCTION_LIST KF7-500.59[6] /end FUNCTION_LIST /end MEASUREMENT
/begin MEASUREMENT vAHBDY1_R#10 "A/F sensor heater duty time series data (bank1)" UWORD COMP_0419 1 100 0 6553.5 ECU_ADDRESS 0xFFFFA0FA /begin FUNCTION_LIST KF7-500.59[6] /end FUNCTION_LIST /end MEASUREMENT
/begin MEASUREMENT vAHBDY1_R#11 "A/F sensor heater duty time series data (bank1)" UWORD COMP_0419 1 100 0 6553.5 ECU_ADDRESS 0xFFFFA0FC /begin FUNCTION_LIST KF7-500.59[6] /end FUNCTION_LIST /end MEASUREMENT
/begin MEASUREMENT vAHBDY2 "A/F sensor heater duty time series data (bank2)" UWORD COMP_0419 1 100 0 6553.5 ECU_ADDRESS 0xFFFFA0FE /begin FUNCTION_LIST KF7-500.59[6] /end FUNCTION_LIST /end MEASUREMENT
/begin MEASUREMENT vAHBDY2_R#1 "A/F sensor heater duty time series data (bank2)" UWORD COMP_0419 1 100 0 6553.5 ECU_ADDRESS 0xFFFFA0FE /begin FUNCTION_LIST KF7-500.59[6] /end FUNCTION_LIST /end MEASUREMENT
/begin MEASUREMENT vAHBDY2_R#2 "A/F sensor heater duty time series data (bank2)" UWORD COMP_0419 1 100 0 6553.5 ECU_ADDRESS 0xFFFFA100 /begin FUNCTION_LIST KF7-500.59[6] /end FUNCTION_LIST /end MEASUREMENT
/begin MEASUREMENT vAHBDY2_R#3 "A/F sensor heater duty time series data (bank2)" UWORD COMP_0419 1 100 0 6553.5 ECU_ADDRESS 0xFFFFA102 /begin FUNCTION_LIST KF7-500.59[6] /end FUNCTION_LIST /end MEASUREMENT
/begin MEASUREMENT vAHBDY2_R#4 "A/F sensor heater duty time series data (bank2)" UWORD COMP_0419 1 100 0 6553.5 ECU_ADDRESS 0xFFFFA104 /begin FUNCTION_LIST KF7-500.59[6] /end FUNCTION_LIST /end MEASUREMENT
/begin MEASUREMENT vAHBDY2_R#5 "A/F sensor heater duty time series data (bank2)" UWORD COMP_0419 1 100 0 6553.5 ECU_ADDRESS 0xFFFFA106 /begin FUNCTION_LIST KF7-500.59[6] /end FUNCTION_LIST /end MEASUREMENT
/begin MEASUREMENT vAHBDY2_R#6 "A/F sensor heater duty time series data (bank2)" UWORD COMP_0419 1 100 0 6553.5 ECU_ADDRESS 0xFFFFA108 /begin FUNCTION_LIST KF7-500.59[6] /end FUNCTION_LIST /end MEASUREMENT
/begin MEASUREMENT vAHBDY2_R#7 "A/F sensor heater duty time series data (bank2)" UWORD COMP_0419 1 100 0 6553.5 ECU_ADDRESS 0xFFFFA10A /begin FUNCTION_LIST KF7-500.59[6] /end FUNCTION_LIST /end MEASUREMENT
/begin MEASUREMENT vAHBDY2_R#8 "A/F sensor heater duty time series data (bank2)" UWORD COMP_0419 1 100 0 6553.5 ECU_ADDRESS 0xFFFFA10C /begin FUNCTION_LIST KF7-500.59[6] /end FUNCTION_LIST /end MEASUREMENT
/begin MEASUREMENT vAHBDY2_R#9 "A/F sensor heater duty time series data (bank2)" UWORD COMP_0419 1 100 0 6553.5 ECU_ADDRESS 0xFFFFA10E /begin FUNCTION_LIST KF7-500.59[6] /end FUNCTION_LIST /end MEASUREMENT
/begin MEASUREMENT vAHBDY2_R#10 "A/F sensor heater duty time series data (bank2)" UWORD COMP_0419 1 100 0 6553.5 ECU_ADDRESS 0xFFFFA110 /begin FUNCTION_LIST KF7-500.59[6] /end FUNCTION_LIST /end MEASUREMENT
/begin MEASUREMENT vAHBDY2_R#11 "A/F sensor heater duty time series data (bank2)" UWORD COMP_0419 1 100 0 6553.5 ECU_ADDRESS 0xFFFFA112 /begin FUNCTION_LIST KF7-500.59[6] /end FUNCTION_LIST /end MEASUREMENT
/begin MEASUREMENT vAHBMN "A/F sensor heater engine speed time series data" UBYTE COMP_0000 1 100 0 6375 ECU_ADDRESS 0xFFFFA114 /begin FUNCTION_LIST KF7-500.59[6] /end FUNCTION_LIST /end MEASUREMENT
/begin MEASUREMENT vAHBMN_R#1 "A/F sensor heater engine speed time series data" UBYTE COMP_0000 1 100 0 6375 ECU_ADDRESS 0xFFFFA114 /begin FUNCTION_LIST KF7-500.59[6] /end FUNCTION_LIST /end MEASUREMENT
/begin MEASUREMENT vAHBMN_R#2 "A/F sensor heater engine speed time series data" UBYTE COMP_0000 1 100 0 6375 ECU_ADDRESS 0xFFFFA115 /begin FUNCTION_LIST KF7-500.59[6] /end FUNCTION_LIST /end MEASUREMENT
/begin MEASUREMENT vAHBMN_R#3 "A/F sensor heater engine speed time series data" UBYTE COMP_0000 1 100 0 6375 ECU_ADDRESS 0xFFFFA116 /begin FUNCTION_LIST KF7-500.59[6] /end FUNCTION_LIST /end MEASUREMENT
/begin MEASUREMENT vAHBMN_R#4 "A/F sensor heater engine speed time series data" UBYTE COMP_0000 1 100 0 6375 ECU_ADDRESS 0xFFFFA117 /begin FUNCTION_LIST KF7-500.59[6] /end FUNCTION_LIST /end MEASUREMENT
/begin MEASUREMENT vAHBMN_R#5 "A/F sensor heater engine speed time series data" UBYTE COMP_0000 1 100 0 6375 ECU_ADDRESS 0xFFFFA118 /begin FUNCTION_LIST KF7-500.59[6] /end FUNCTION_LIST /end MEASUREMENT
/begin MEASUREMENT vAHBMN_R#6 "A/F sensor heater engine speed time series data" UBYTE COMP_0000 1 100 0 6375 ECU_ADDRESS 0xFFFFA119 /begin FUNCTION_LIST KF7-500.59[6] /end FUNCTION_LIST /end MEASUREMENT
/begin MEASUREMENT vAHBMN_R#7 "A/F sensor heater engine speed time series data" UBYTE COMP_0000 1 100 0 6375 ECU_ADDRESS 0xFFFFA11A /begin FUNCTION_LIST KF7-500.59[6] /end FUNCTION_LIST /end MEASUREMENT
/begin MEASUREMENT vAHBMN_R#8 "A/F sensor heater engine speed time series data" UBYTE COMP_0000 1 100 0 6375 ECU_ADDRESS 0xFFFFA11B /begin FUNCTION_LIST KF7-500.59[6] /end FUNCTION_LIST /end MEASUREMENT
/begin MEASUREMENT vAHBMN_R#9 "A/F sensor heater engine speed time series data" UBYTE COMP_0000 1 100 0 6375 ECU_ADDRESS 0xFFFFA11C /begin FUNCTION_LIST KF7-500.59[6] /end FUNCTION_LIST /end MEASUREMENT
/begin MEASUREMENT vAHBMN_R#10 "A/F sensor heater engine speed time series data" UBYTE COMP_0000 1 100 0 6375 ECU_ADDRESS 0xFFFFA11D /begin FUNCTION_LIST KF7-500.59[6] /end FUNCTION_LIST /end MEASUREMENT
/begin MEASUREMENT vAHBMN_R#11 "A/F sensor heater engine speed time series data" UBYTE COMP_0000 1 100 0 6375 ECU_ADDRESS 0xFFFFA11E /begin FUNCTION_LIST KF7-500.59[6] /end FUNCTION_LIST /end MEASUREMENT
/begin MEASUREMENT vAHBMN2 "A/F sensor heater engine speed time series data (bank2)" UBYTE COMP_0000 1 100 0 6375 ECU_ADDRESS 0xFFFFA11F /begin FUNCTION_LIST KF7-500.59[6] /end FUNCTION_LIST /end MEASUREMENT
/begin MEASUREMENT vAHBMN2_R#1 "A/F sensor heater engine speed time series data (bank2)" UBYTE COMP_0000 1 100 0 6375 ECU_ADDRESS 0xFFFFA11F /begin FUNCTION_LIST KF7-500.59[6] /end FUNCTION_LIST /end MEASUREMENT
/begin MEASUREMENT vAHBMN2_R#2 "A/F sensor heater engine speed time series data (bank2)" UBYTE COMP_0000 1 100 0 6375 ECU_ADDRESS 0xFFFFA120 /begin FUNCTION_LIST KF7-500.59[6] /end FUNCTION_LIST /end MEASUREMENT
/begin MEASUREMENT vAHBMN2_R#3 "A/F sensor heater engine speed time series data (bank2)" UBYTE COMP_0000 1 100 0 6375 ECU_ADDRESS 0xFFFFA121 /begin FUNCTION_LIST KF7-500.59[6] /end FUNCTION_LIST /end MEASUREMENT
/begin MEASUREMENT vAHBMN2_R#4 "A/F sensor heater engine speed time series data (bank2)" UBYTE COMP_0000 1 100 0 6375 ECU_ADDRESS 0xFFFFA122 /begin FUNCTION_LIST KF7-500.59[6] /end FUNCTION_LIST /end MEASUREMENT
/begin MEASUREMENT vAHBMN2_R#5 "A/F sensor heater engine speed time series data (bank2)" UBYTE COMP_0000 1 100 0 6375 ECU_ADDRESS 0xFFFFA123 /begin FUNCTION_LIST KF7-500.59[6] /end FUNCTION_LIST /end MEASUREMENT
/begin MEASUREMENT vAHBMN2_R#6 "A/F sensor heater engine speed time series data (bank2)" UBYTE COMP_0000 1 100 0 6375 ECU_ADDRESS 0xFFFFA124 /begin FUNCTION_LIST KF7-500.59[6] /end FUNCTION_LIST /end MEASUREMENT
/begin MEASUREMENT vAHBMN2_R#7 "A/F sensor heater engine speed time series data (bank2)" UBYTE COMP_0000 1 100 0 6375 ECU_ADDRESS 0xFFFFA125 /begin FUNCTION_LIST KF7-500.59[6] /end FUNCTION_LIST /end MEASUREMENT
/begin MEASUREMENT vAHBMN2_R#8 "A/F sensor heater engine speed time series data (bank2)" UBYTE COMP_0000 1 100 0 6375 ECU_ADDRESS 0xFFFFA126 /begin FUNCTION_LIST KF7-500.59[6] /end FUNCTION_LIST /end MEASUREMENT
/begin MEASUREMENT vAHBMN2_R#9 "A/F sensor heater engine speed time series data (bank2)" UBYTE COMP_0000 1 100 0 6375 ECU_ADDRESS 0xFFFFA127 /begin FUNCTION_LIST KF7-500.59[6] /end FUNCTION_LIST /end MEASUREMENT
/begin MEASUREMENT vAHBMN2_R#10 "A/F sensor heater engine speed time series data (bank2)" UBYTE COMP_0000 1 100 0 6375 ECU_ADDRESS 0xFFFFA128 /begin FUNCTION_LIST KF7-500.59[6] /end FUNCTION_LIST /end MEASUREMENT
/begin MEASUREMENT vAHBMN2_R#11 "A/F sensor heater engine speed time series data (bank2)" UBYTE COMP_0000 1 100 0 6375 ECU_ADDRESS 0xFFFFA129 /begin FUNCTION_LIST KF7-500.59[6] /end FUNCTION_LIST /end MEASUREMENT
/begin MEASUREMENT vAHBTP "A/F sensor heater cylinder air quantity equivalent pulse width time series data" UWORD COMP_0144 1 100 0 31.999495335 ECU_ADDRESS 0xFFFFA12A /begin FUNCTION_LIST KF7-500.59[6] /end FUNCTION_LIST /end MEASUREMENT
/begin MEASUREMENT vAHBTP_R#1 "A/F sensor heater cylinder air quantity equivalent pulse width time series data" UWORD COMP_0144 1 100 0 31.999495335 ECU_ADDRESS 0xFFFFA12A /begin FUNCTION_LIST KF7-500.59[6] /end FUNCTION_LIST /end MEASUREMENT
/begin MEASUREMENT vAHBTP_R#2 "A/F sensor heater cylinder air quantity equivalent pulse width time series data" UWORD COMP_0144 1 100 0 31.999495335 ECU_ADDRESS 0xFFFFA12C /begin FUNCTION_LIST KF7-500.59[6] /end FUNCTION_LIST /end MEASUREMENT
/begin MEASUREMENT vAHBTP_R#3 "A/F sensor heater cylinder air quantity equivalent pulse width time series data" UWORD COMP_0144 1 100 0 31.999495335 ECU_ADDRESS 0xFFFFA12E /begin FUNCTION_LIST KF7-500.59[6] /end FUNCTION_LIST /end MEASUREMENT
/begin MEASUREMENT vAHBTP_R#4 "A/F sensor heater cylinder air quantity equivalent pulse width time series data" UWORD COMP_0144 1 100 0 31.999495335 ECU_ADDRESS 0xFFFFA130 /begin FUNCTION_LIST KF7-500.59[6] /end FUNCTION_LIST /end MEASUREMENT
/begin MEASUREMENT vAHBTP_R#5 "A/F sensor heater cylinder air quantity equivalent pulse width time series data" UWORD COMP_0144 1 100 0 31.999495335 ECU_ADDRESS 0xFFFFA132 /begin FUNCTION_LIST KF7-500.59[6] /end FUNCTION_LIST /end MEASUREMENT
/begin MEASUREMENT vAHBTP_R#6 "A/F sensor heater cylinder air quantity equivalent pulse width time series data" UWORD COMP_0144 1 100 0 31.999495335 ECU_ADDRESS 0xFFFFA134 /begin FUNCTION_LIST KF7-500.59[6] /end FUNCTION_LIST /end MEASUREMENT
/begin MEASUREMENT vAHBTP_R#7 "A/F sensor heater cylinder air quantity equivalent pulse width time series data" UWORD COMP_0144 1 100 0 31.999495335 ECU_ADDRESS 0xFFFFA136 /begin FUNCTION_LIST KF7-500.59[6] /end FUNCTION_LIST /end MEASUREMENT
/begin MEASUREMENT vAHBTP_R#8 "A/F sensor heater cylinder air quantity equivalent pulse width time series data" UWORD COMP_0144 1 100 0 31.999495335 ECU_ADDRESS 0xFFFFA138 /begin FUNCTION_LIST KF7-500.59[6] /end FUNCTION_LIST /end MEASUREMENT
/begin MEASUREMENT vAHBTP_R#9 "A/F sensor heater cylinder air quantity equivalent pulse width time series data" UWORD COMP_0144 1 100 0 31.999495335 ECU_ADDRESS 0xFFFFA13A /begin FUNCTION_LIST KF7-500.59[6] /end FUNCTION_LIST /end MEASUREMENT
/begin MEASUREMENT vAHBTP_R#10 "A/F sensor heater cylinder air quantity equivalent pulse width time series data" UWORD COMP_0144 1 100 0 31.999495335 ECU_ADDRESS 0xFFFFA13C /begin FUNCTION_LIST KF7-500.59[6] /end FUNCTION_LIST /end MEASUREMENT
/begin MEASUREMENT vAHBTP_R#11 "A/F sensor heater cylinder air quantity equivalent pulse width time series data" UWORD COMP_0144 1 100 0 31.999495335 ECU_ADDRESS 0xFFFFA13E /begin FUNCTION_LIST KF7-500.59[6] /end FUNCTION_LIST /end MEASUREMENT
/begin MEASUREMENT vAHBTP2 "A/F sensor heater cylinder air quantity equivalent pulse width time series data (bank2)" UWORD COMP_0144 1 100 0 31.999495335 ECU_ADDRESS 0xFFFFA140 /begin FUNCTION_LIST KF7-500.59[6] /end FUNCTION_LIST /end MEASUREMENT
/begin MEASUREMENT vAHBTP2_R#1 "A/F sensor heater cylinder air quantity equivalent pulse width time series data (bank2)" UWORD COMP_0144 1 100 0 31.999495335 ECU_ADDRESS 0xFFFFA140 /begin FUNCTION_LIST KF7-500.59[6] /end FUNCTION_LIST /end MEASUREMENT
/begin MEASUREMENT vAHBTP2_R#2 "A/F sensor heater cylinder air quantity equivalent pulse width time series data (bank2)" UWORD COMP_0144 1 100 0 31.999495335 ECU_ADDRESS 0xFFFFA142 /begin FUNCTION_LIST KF7-500.59[6] /end FUNCTION_LIST /end MEASUREMENT
/begin MEASUREMENT vAHBTP2_R#3 "A/F sensor heater cylinder air quantity equivalent pulse width time series data (bank2)" UWORD COMP_0144 1 100 0 31.999495335 ECU_ADDRESS 0xFFFFA144 /begin FUNCTION_LIST KF7-500.59[6] /end FUNCTION_LIST /end MEASUREMENT
/begin MEASUREMENT vAHBTP2_R#4 "A/F sensor heater cylinder air quantity equivalent pulse width time series data (bank2)" UWORD COMP_0144 1 100 0 31.999495335 ECU_ADDRESS 0xFFFFA146 /begin FUNCTION_LIST KF7-500.59[6] /end FUNCTION_LIST /end MEASUREMENT
/begin MEASUREMENT vAHBTP2_R#5 "A/F sensor heater cylinder air quantity equivalent pulse width time series data (bank2)" UWORD COMP_0144 1 100 0 31.999495335 ECU_ADDRESS 0xFFFFA148 /begin FUNCTION_LIST KF7-500.59[6] /end FUNCTION_LIST /end MEASUREMENT
/begin MEASUREMENT vAHBTP2_R#6 "A/F sensor heater cylinder air quantity equivalent pulse width time series data (bank2)" UWORD COMP_0144 1 100 0 31.999495335 ECU_ADDRESS 0xFFFFA14A /begin FUNCTION_LIST KF7-500.59[6] /end FUNCTION_LIST /end MEASUREMENT
/begin MEASUREMENT vAHBTP2_R#7 "A/F sensor heater cylinder air quantity equivalent pulse width time series data (bank2)" UWORD COMP_0144 1 100 0 31.999495335 ECU_ADDRESS 0xFFFFA14C /begin FUNCTION_LIST KF7-500.59[6] /end FUNCTION_LIST /end MEASUREMENT
/begin MEASUREMENT vAHBTP2_R#8 "A/F sensor heater cylinder air quantity equivalent pulse width time series data (bank2)" UWORD COMP_0144 1 100 0 31.999495335 ECU_ADDRESS 0xFFFFA14E /begin FUNCTION_LIST KF7-500.59[6] /end FUNCTION_LIST /end MEASUREMENT
/begin MEASUREMENT vAHBTP2_R#9 "A/F sensor heater cylinder air quantity equivalent pulse width time series data (bank2)" UWORD COMP_0144 1 100 0 31.999495335 ECU_ADDRESS 0xFFFFA150 /begin FUNCTION_LIST KF7-500.59[6] /end FUNCTION_LIST /end MEASUREMENT
/begin MEASUREMENT vAHBTP2_R#10 "A/F sensor heater cylinder air quantity equivalent pulse width time series data (bank2)" UWORD COMP_0144 1 100 0 31.999495335 ECU_ADDRESS 0xFFFFA152 /begin FUNCTION_LIST KF7-500.59[6] /end FUNCTION_LIST /end MEASUREMENT
/begin MEASUREMENT vAHBTP2_R#11 "A/F sensor heater cylinder air quantity equivalent pulse width time series data (bank2)" UWORD COMP_0144 1 100 0 31.999495335 ECU_ADDRESS 0xFFFFA154 /begin FUNCTION_LIST KF7-500.59[6] /end FUNCTION_LIST /end MEASUREMENT
/begin MEASUREMENT vAHBVB "A/F sensor heater battery voltage time series data" UBYTE COMP_0033 1 100 0 20400 ECU_ADDRESS 0xFFFFA156 /begin FUNCTION_LIST KF7-500.59[6] /end FUNCTION_LIST /end MEASUREMENT
/begin MEASUREMENT vAHBVB_R#1 "A/F sensor heater battery voltage time series data" UBYTE COMP_0033 1 100 0 20400 ECU_ADDRESS 0xFFFFA156 /begin FUNCTION_LIST KF7-500.59[6] /end FUNCTION_LIST /end MEASUREMENT
/begin MEASUREMENT vAHBVB_R#2 "A/F sensor heater battery voltage time series data" UBYTE COMP_0033 1 100 0 20400 ECU_ADDRESS 0xFFFFA157 /begin FUNCTION_LIST KF7-500.59[6] /end FUNCTION_LIST /end MEASUREMENT
/begin MEASUREMENT vAHBVB_R#3 "A/F sensor heater battery voltage time series data" UBYTE COMP_0033 1 100 0 20400 ECU_ADDRESS 0xFFFFA158 /begin FUNCTION_LIST KF7-500.59[6] /end FUNCTION_LIST /end MEASUREMENT
/begin MEASUREMENT vAHBVB_R#4 "A/F sensor heater battery voltage time series data" UBYTE COMP_0033 1 100 0 20400 ECU_ADDRESS 0xFFFFA159 /begin FUNCTION_LIST KF7-500.59[6] /end FUNCTION_LIST /end MEASUREMENT
/begin MEASUREMENT vAHBVB_R#5 "A/F sensor heater battery voltage time series data" UBYTE COMP_0033 1 100 0 20400 ECU_ADDRESS 0xFFFFA15A /begin FUNCTION_LIST KF7-500.59[6] /end FUNCTION_LIST /end MEASUREMENT
/begin MEASUREMENT vAHBVB_R#6 "A/F sensor heater battery voltage time series data" UBYTE COMP_0033 1 100 0 20400 ECU_ADDRESS 0xFFFFA15B /begin FUNCTION_LIST KF7-500.59[6] /end FUNCTION_LIST /end MEASUREMENT
/begin MEASUREMENT vAHBVB_R#7 "A/F sensor heater battery voltage time series data" UBYTE COMP_0033 1 100 0 20400 ECU_ADDRESS 0xFFFFA15C /begin FUNCTION_LIST KF7-500.59[6] /end FUNCTION_LIST /end MEASUREMENT
/begin MEASUREMENT vAHBVB_R#8 "A/F sensor heater battery voltage time series data" UBYTE COMP_0033 1 100 0 20400 ECU_ADDRESS 0xFFFFA15D /begin FUNCTION_LIST KF7-500.59[6] /end FUNCTION_LIST /end MEASUREMENT
/begin MEASUREMENT vAHBVB_R#9 "A/F sensor heater battery voltage time series data" UBYTE COMP_0033 1 100 0 20400 ECU_ADDRESS 0xFFFFA15E /begin FUNCTION_LIST KF7-500.59[6] /end FUNCTION_LIST /end MEASUREMENT
/begin MEASUREMENT vAHBVB_R#10 "A/F sensor heater battery voltage time series data" UBYTE COMP_0033 1 100 0 20400 ECU_ADDRESS 0xFFFFA15F /begin FUNCTION_LIST KF7-500.59[6] /end FUNCTION_LIST /end MEASUREMENT
/begin MEASUREMENT vAHBVB_R#11 "A/F sensor heater battery voltage time series data" UBYTE COMP_0033 1 100 0 20400 ECU_ADDRESS 0xFFFFA160 /begin FUNCTION_LIST KF7-500.59[6] /end FUNCTION_LIST /end MEASUREMENT
/begin MEASUREMENT vAHBVB2 "A/F sensor heater battery voltage time series data (bank2)" UBYTE COMP_0033 1 100 0 20400 ECU_ADDRESS 0xFFFFA161 /begin FUNCTION_LIST KF7-500.59[6] /end FUNCTION_LIST /end MEASUREMENT
/begin MEASUREMENT vAHBVB2_R#1 "A/F sensor heater battery voltage time series data (bank2)" UBYTE COMP_0033 1 100 0 20400 ECU_ADDRESS 0xFFFFA161 /begin FUNCTION_LIST KF7-500.59[6] /end FUNCTION_LIST /end MEASUREMENT
/begin MEASUREMENT vAHBVB2_R#2 "A/F sensor heater battery voltage time series data (bank2)" UBYTE COMP_0033 1 100 0 20400 ECU_ADDRESS 0xFFFFA162 /begin FUNCTION_LIST KF7-500.59[6] /end FUNCTION_LIST /end MEASUREMENT
/begin MEASUREMENT vAHBVB2_R#3 "A/F sensor heater battery voltage time series data (bank2)" UBYTE COMP_0033 1 100 0 20400 ECU_ADDRESS 0xFFFFA163 /begin FUNCTION_LIST KF7-500.59[6] /end FUNCTION_LIST /end MEASUREMENT
/begin MEASUREMENT vAHBVB2_R#4 "A/F sensor heater battery voltage time series data (bank2)" UBYTE COMP_0033 1 100 0 20400 ECU_ADDRESS 0xFFFFA164 /begin FUNCTION_LIST KF7-500.59[6] /end FUNCTION_LIST /end MEASUREMENT
/begin MEASUREMENT vAHBVB2_R#5 "A/F sensor heater battery voltage time series data (bank2)" UBYTE COMP_0033 1 100 0 20400 ECU_ADDRESS 0xFFFFA165 /begin FUNCTION_LIST KF7-500.59[6] /end FUNCTION_LIST /end MEASUREMENT
/begin MEASUREMENT vAHBVB2_R#6 "A/F sensor heater battery voltage time series data (bank2)" UBYTE COMP_0033 1 100 0 20400 ECU_ADDRESS 0xFFFFA166 /begin FUNCTION_LIST KF7-500.59[6] /end FUNCTION_LIST /end MEASUREMENT
/begin MEASUREMENT vAHBVB2_R#7 "A/F sensor heater battery voltage time series data (bank2)" UBYTE COMP_0033 1 100 0 20400 ECU_ADDRESS 0xFFFFA167 /begin FUNCTION_LIST KF7-500.59[6] /end FUNCTION_LIST /end MEASUREMENT
/begin MEASUREMENT vAHBVB2_R#8 "A/F sensor heater battery voltage time series data (bank2)" UBYTE COMP_0033 1 100 0 20400 ECU_ADDRESS 0xFFFFA168 /begin FUNCTION_LIST KF7-500.59[6] /end FUNCTION_LIST /end MEASUREMENT
/begin MEASUREMENT vAHBVB2_R#9 "A/F sensor heater battery voltage time series data (bank2)" UBYTE COMP_0033 1 100 0 20400 ECU_ADDRESS 0xFFFFA169 /begin FUNCTION_LIST KF7-500.59[6] /end FUNCTION_LIST /end MEASUREMENT
/begin MEASUREMENT vAHBVB2_R#10 "A/F sensor heater battery voltage time series data (bank2)" UBYTE COMP_0033 1 100 0 20400 ECU_ADDRESS 0xFFFFA16A /begin FUNCTION_LIST KF7-500.59[6] /end FUNCTION_LIST /end MEASUREMENT
/begin MEASUREMENT vAHBVB2_R#11 "A/F sensor heater battery voltage time series data (bank2)" UBYTE COMP_0033 1 100 0 20400 ECU_ADDRESS 0xFFFFA16B /begin FUNCTION_LIST KF7-500.59[6] /end FUNCTION_LIST /end MEASUREMENT
/begin MEASUREMENT vAHBVS2 "A/F sensor heater vehicle speed time series data (bank2)" UBYTE COMP_0007 1 100 0 510 ECU_ADDRESS 0xFFFFA16C /begin FUNCTION_LIST KF7-500.59[6] /end FUNCTION_LIST /end MEASUREMENT
/begin MEASUREMENT vAHBVS2_R#1 "A/F sensor heater vehicle speed time series data (bank2)" UBYTE COMP_0007 1 100 0 510 ECU_ADDRESS 0xFFFFA16C /begin FUNCTION_LIST KF7-500.59[6] /end FUNCTION_LIST /end MEASUREMENT
/begin MEASUREMENT vAHBVS2_R#2 "A/F sensor heater vehicle speed time series data (bank2)" UBYTE COMP_0007 1 100 0 510 ECU_ADDRESS 0xFFFFA16D /begin FUNCTION_LIST KF7-500.59[6] /end FUNCTION_LIST /end MEASUREMENT
/begin MEASUREMENT vAHBVS2_R#3 "A/F sensor heater vehicle speed time series data (bank2)" UBYTE COMP_0007 1 100 0 510 ECU_ADDRESS 0xFFFFA16E /begin FUNCTION_LIST KF7-500.59[6] /end FUNCTION_LIST /end MEASUREMENT
/begin MEASUREMENT vAHBVS2_R#4 "A/F sensor heater vehicle speed time series data (bank2)" UBYTE COMP_0007 1 100 0 510 ECU_ADDRESS 0xFFFFA16F /begin FUNCTION_LIST KF7-500.59[6] /end FUNCTION_LIST /end MEASUREMENT
/begin MEASUREMENT vAHBVS2_R#5 "A/F sensor heater vehicle speed time series data (bank2)" UBYTE COMP_0007 1 100 0 510 ECU_ADDRESS 0xFFFFA170 /begin FUNCTION_LIST KF7-500.59[6] /end FUNCTION_LIST /end MEASUREMENT
/begin MEASUREMENT vAHBVS2_R#6 "A/F sensor heater vehicle speed time series data (bank2)" UBYTE COMP_0007 1 100 0 510 ECU_ADDRESS 0xFFFFA171 /begin FUNCTION_LIST KF7-500.59[6] /end FUNCTION_LIST /end MEASUREMENT
/begin MEASUREMENT vAHBVS2_R#7 "A/F sensor heater vehicle speed time series data (bank2)" UBYTE COMP_0007 1 100 0 510 ECU_ADDRESS 0xFFFFA172 /begin FUNCTION_LIST KF7-500.59[6] /end FUNCTION_LIST /end MEASUREMENT
/begin MEASUREMENT vAHBVS2_R#8 "A/F sensor heater vehicle speed time series data (bank2)" UBYTE COMP_0007 1 100 0 510 ECU_ADDRESS 0xFFFFA173 /begin FUNCTION_LIST KF7-500.59[6] /end FUNCTION_LIST /end MEASUREMENT
/begin MEASUREMENT vAHBVS2_R#9 "A/F sensor heater vehicle speed time series data (bank2)" UBYTE COMP_0007 1 100 0 510 ECU_ADDRESS 0xFFFFA174 /begin FUNCTION_LIST KF7-500.59[6] /end FUNCTION_LIST /end MEASUREMENT
/begin MEASUREMENT vAHBVS2_R#10 "A/F sensor heater vehicle speed time series data (bank2)" UBYTE COMP_0007 1 100 0 510 ECU_ADDRESS 0xFFFFA175 /begin FUNCTION_LIST KF7-500.59[6] /end FUNCTION_LIST /end MEASUREMENT
/begin MEASUREMENT vAHBVS2_R#11 "A/F sensor heater vehicle speed time series data (bank2)" UBYTE COMP_0007 1 100 0 510 ECU_ADDRESS 0xFFFFA176 /begin FUNCTION_LIST KF7-500.59[6] /end FUNCTION_LIST /end MEASUREMENT
/begin MEASUREMENT vAHBVSP "A/F sensor heater vehicle speed time series data" UBYTE COMP_0007 1 100 0 510 ECU_ADDRESS 0xFFFFA177 /begin FUNCTION_LIST KF7-500.59[6] /end FUNCTION_LIST /end MEASUREMENT
/begin MEASUREMENT vAHBVSP_R#1 "A/F sensor heater vehicle speed time series data" UBYTE COMP_0007 1 100 0 510 ECU_ADDRESS 0xFFFFA177 /begin FUNCTION_LIST KF7-500.59[6] /end FUNCTION_LIST /end MEASUREMENT
/begin MEASUREMENT vAHBVSP_R#2 "A/F sensor heater vehicle speed time series data" UBYTE COMP_0007 1 100 0 510 ECU_ADDRESS 0xFFFFA178 /begin FUNCTION_LIST KF7-500.59[6] /end FUNCTION_LIST /end MEASUREMENT
/begin MEASUREMENT vAHBVSP_R#3 "A/F sensor heater vehicle speed time series data" UBYTE COMP_0007 1 100 0 510 ECU_ADDRESS 0xFFFFA179 /begin FUNCTION_LIST KF7-500.59[6] /end FUNCTION_LIST /end MEASUREMENT
/begin MEASUREMENT vAHBVSP_R#4 "A/F sensor heater vehicle speed time series data" UBYTE COMP_0007 1 100 0 510 ECU_ADDRESS 0xFFFFA17A /begin FUNCTION_LIST KF7-500.59[6] /end FUNCTION_LIST /end MEASUREMENT
/begin MEASUREMENT vAHBVSP_R#5 "A/F sensor heater vehicle speed time series data" UBYTE COMP_0007 1 100 0 510 ECU_ADDRESS 0xFFFFA17B /begin FUNCTION_LIST KF7-500.59[6] /end FUNCTION_LIST /end MEASUREMENT
/begin MEASUREMENT vAHBVSP_R#6 "A/F sensor heater vehicle speed time series data" UBYTE COMP_0007 1 100 0 510 ECU_ADDRESS 0xFFFFA17C /begin FUNCTION_LIST KF7-500.59[6] /end FUNCTION_LIST /end MEASUREMENT
/begin MEASUREMENT vAHBVSP_R#7 "A/F sensor heater vehicle speed time series data" UBYTE COMP_0007 1 100 0 510 ECU_ADDRESS 0xFFFFA17D /begin FUNCTION_LIST KF7-500.59[6] /end FUNCTION_LIST /end MEASUREMENT
/begin MEASUREMENT vAHBVSP_R#8 "A/F sensor heater vehicle speed time series data" UBYTE COMP_0007 1 100 0 510 ECU_ADDRESS 0xFFFFA17E /begin FUNCTION_LIST KF7-500.59[6] /end FUNCTION_LIST /end MEASUREMENT
/begin MEASUREMENT vAHBVSP_R#9 "A/F sensor heater vehicle speed time series data" UBYTE COMP_0007 1 100 0 510 ECU_ADDRESS 0xFFFFA17F /begin FUNCTION_LIST KF7-500.59[6] /end FUNCTION_LIST /end MEASUREMENT
/begin MEASUREMENT vAHBVSP_R#10 "A/F sensor heater vehicle speed time series data" UBYTE COMP_0007 1 100 0 510 ECU_ADDRESS 0xFFFFA180 /begin FUNCTION_LIST KF7-500.59[6] /end FUNCTION_LIST /end MEASUREMENT
/begin MEASUREMENT vAHBVSP_R#11 "A/F sensor heater vehicle speed time series data" UBYTE COMP_0007 1 100 0 510 ECU_ADDRESS 0xFFFFA181 /begin FUNCTION_LIST KF7-500.59[6] /end FUNCTION_LIST /end MEASUREMENT
/begin MEASUREMENT vAHOSAV "AFSHOS Mean" SWORD COMP_0341_S 1 100 -65.536 65.534 ECU_ADDRESS 0xFFFF27F0 /begin FUNCTION_LIST KF7-500.75[4] /end FUNCTION_LIST /end MEASUREMENT
/begin MEASUREMENT vAHOSCT "AFSHOS integration counter" UBYTE COMP_0030 1 100 0 255 ECU_ADDRESS 0xFFFF27F8 /begin FUNCTION_LIST KF7-500.75[4] /end FUNCTION_LIST /end MEASUREMENT
/begin MEASUREMENT vAHOSSM "AFSHOS Integration value" SWORD COMP_0341_S 1 100 -65.536 65.534 ECU_ADDRESS 0xFFFF27FC /begin FUNCTION_LIST KF7-500.75[4] /end FUNCTION_LIST /end MEASUREMENT
/begin MEASUREMENT vAHOSTM "Learning region timer" UBYTE COMP_0013 1 100 0 255 ECU_ADDRESS 0xFFFF2800 /begin FUNCTION_LIST KF7-500.75[4] /end FUNCTION_LIST /end MEASUREMENT
/begin MEASUREMENT vAHSMN1 "AHOSAV Minimum value" SWORD COMP_0341_S 1 100 -65.536 65.534 ECU_ADDRESS 0xFFFFA182 /begin FUNCTION_LIST KF7-500.75[4] /end FUNCTION_LIST /end MEASUREMENT
/begin MEASUREMENT vAHSMN2 "At the time of the minimum value renewal, mileage" UWORD COMP_0549_S 1 100 0 1685560.2 ECU_ADDRESS 0xFFFFA186 /begin FUNCTION_LIST KF7-500.75[4] /end FUNCTION_LIST /end MEASUREMENT
/begin MEASUREMENT vAHSMX1 "AHOSAV Maximum value" SWORD COMP_0341_S 1 100 -65.536 65.534 ECU_ADDRESS 0xFFFFA18A /begin FUNCTION_LIST KF7-500.75[4] /end FUNCTION_LIST /end MEASUREMENT
/begin MEASUREMENT vAHSMX2 "At the time of the maximum value renewal, mileage" UWORD COMP_0549_S 1 100 0 1685560.2 ECU_ADDRESS 0xFFFFA18E /begin FUNCTION_LIST KF7-500.75[4] /end FUNCTION_LIST /end MEASUREMENT
/begin MEASUREMENT vANSR8 "An answer data (After it is compressed.) to the watch IC" UBYTE COMP_0068 1 100 0 255 ECU_ADDRESS 0xFFFF2866 /begin FUNCTION_LIST KF7-505.41[2] /end FUNCTION_LIST /end MEASUREMENT
/begin MEASUREMENT vAPOFSR_S "Accelerator pedal ratio (vice-operation part)" UWORD COMP_0362_S 1 100 0 8191.875 ECU_ADDRESS 0xFFFF49A2 /begin FUNCTION_LIST KF7-505.9[3] R301.21.SafetyLevel2_1_0_2 /end FUNCTION_LIST /end MEASUREMENT
/begin MEASUREMENT vAPOSTR_S "After compensation, accelerator pedal ratio (vice-operation part)" UWORD COMP_0362_S 1 100 0 8191.875 ECU_ADDRESS 0xFFFF34E6 /begin FUNCTION_LIST KF7-505.17[3] R301.21.SafetyLevel2_1_0_2 /end FUNCTION_LIST /end MEASUREMENT
/begin MEASUREMENT vASCRX "A receiving data from the watch IC" UBYTE COMP_0004 1 100 0 255 ECU_ADDRESS 0xFFFF2889 /begin FUNCTION_LIST KF7-505.41[2] /end FUNCTION_LIST /end MEASUREMENT
/begin MEASUREMENT vASCTX "A transmitting data from the watch IC" UBYTE COMP_0004 1 100 0 255 ECU_ADDRESS 0xFFFF288A /begin FUNCTION_LIST KF7-505.41[2] /end FUNCTION_LIST /end MEASUREMENT
/begin MEASUREMENT vAVEQA "An inhalation air quantity mean for the coolant temperature convergent judgement" UBYTE COMP_0004 1 100 0 255 ECU_ADDRESS 0xFFFF289F /begin FUNCTION_LIST KF7-500.60[5] /end FUNCTION_LIST /end MEASUREMENT
/begin MEASUREMENT vAVIVL "The 60Å~n s front AVQIVL" UBYTE COMP_0004 1 100 0 255 ECU_ADDRESS 0xFFFF28A4 /begin FUNCTION_LIST KF7-500.60[5] /end FUNCTION_LIST /end MEASUREMENT
/begin MEASUREMENT vAVIVL_R#1 "The 60Å~n s front AVQIVL" UBYTE COMP_0004 1 100 0 255 ECU_ADDRESS 0xFFFF28A4 /begin FUNCTION_LIST KF7-500.60[5] /end FUNCTION_LIST /end MEASUREMENT
/begin MEASUREMENT vAVIVL_R#2 "The 60Å~n s front AVQIVL" UBYTE COMP_0004 1 100 0 255 ECU_ADDRESS 0xFFFF28A5 /begin FUNCTION_LIST KF7-500.60[5] /end FUNCTION_LIST /end MEASUREMENT
/begin MEASUREMENT vAVIVL_R#3 "The 60Å~n s front AVQIVL" UBYTE COMP_0004 1 100 0 255 ECU_ADDRESS 0xFFFF28A6 /begin FUNCTION_LIST KF7-500.60[5] /end FUNCTION_LIST /end MEASUREMENT
/begin MEASUREMENT vAVIVL_R#4 "The 60Å~n s front AVQIVL" UBYTE COMP_0004 1 100 0 255 ECU_ADDRESS 0xFFFF28A7 /begin FUNCTION_LIST KF7-500.60[5] /end FUNCTION_LIST /end MEASUREMENT
/begin MEASUREMENT vAVIVL_R#5 "The 60Å~n s front AVQIVL" UBYTE COMP_0004 1 100 0 255 ECU_ADDRESS 0xFFFF28A8 /begin FUNCTION_LIST KF7-500.60[5] /end FUNCTION_LIST /end MEASUREMENT
/begin MEASUREMENT vAVQIVL "Between 60 s, QATHMO mean" UBYTE COMP_0004 1 100 0 255 ECU_ADDRESS 0xFFFF28B4 /begin FUNCTION_LIST KF7-500.60[5] /end FUNCTION_LIST /end MEASUREMENT
/begin MEASUREMENT vBKSWTM "Brake diagnosis judgement time" UWORD COMP_0013 1 100 0 65535 ECU_ADDRESS 0xFFFFB568 /begin FUNCTION_LIST KF7-505.27[4] /end FUNCTION_LIST /end MEASUREMENT
/begin MEASUREMENT vBURMAX "BURCNT maximum value" UBYTE COMP_0016 1 100 0 255 ECU_ADDRESS 0xFFFFA2AC /begin FUNCTION_LIST KF7-505.24[1] KF7-505.26[2] /end FUNCTION_LIST /end MEASUREMENT
/begin MEASUREMENT vCANDLM "DDL data monitor" UBYTE COMP_0068 1 100 0 255 ECU_ADDRESS 0xFFFF3A77 /begin FUNCTION_LIST KF7-500.69[25] KF7-580.1[8] /end FUNCTION_LIST /end MEASUREMENT
/begin MEASUREMENT vCANDLM_R#1 "DDL data monitor" UBYTE COMP_0068 1 100 0 255 ECU_ADDRESS 0xFFFF3A77 /begin FUNCTION_LIST KF7-500.69[25] KF7-580.1[8] /end FUNCTION_LIST /end MEASUREMENT
/begin MEASUREMENT vCANDLM_R#2 "DDL data monitor" UBYTE COMP_0068 1 100 0 255 ECU_ADDRESS 0xFFFF3A78 /begin FUNCTION_LIST KF7-500.69[25] KF7-580.1[8] /end FUNCTION_LIST /end MEASUREMENT
/begin MEASUREMENT vCANICFZ "B grade message freeze flag" UWORD COMP_0068 1 100 0 65535 ECU_ADDRESS 0xFFFF3A7A /begin FUNCTION_LIST KF7-500.69[25] /end FUNCTION_LIST /end MEASUREMENT
/begin MEASUREMENT vCANICFZ0 "B grade message freeze flag (HACN0 side)" UWORD COMP_0068 1 100 0 65535 ECU_ADDRESS 0xFFFF3A7C /begin FUNCTION_LIST KF7-500.69[25] /end FUNCTION_LIST /end MEASUREMENT
/begin MEASUREMENT vCANICFZL "B grade message freeze flag (SH 7058 editions)" ULONG COMP_0068 1 100 0 4294967295 ECU_ADDRESS 0xFFFF3A80 /begin FUNCTION_LIST KF7-500.69[25] /end FUNCTION_LIST /end MEASUREMENT
/begin MEASUREMENT vCDADIEMX "AD diagnosis un-adjustment counter maximum value" UBYTE COMP_0030 1 100 0 255 ECU_ADDRESS 0xFFFFB5C0 /begin FUNCTION_LIST KF7-505.38[4] /end FUNCTION_LIST /end MEASUREMENT
/begin MEASUREMENT vCDADIFMX "AD diagnosis input fixed counter maximum value" UBYTE COMP_0030 1 100 0 255 ECU_ADDRESS 0xFFFFB5C1 /begin FUNCTION_LIST KF7-505.38[4] /end FUNCTION_LIST /end MEASUREMENT
/begin MEASUREMENT vCDADINE "AD diagnosis un-adjustment counter" UBYTE COMP_0030 1 100 0 255 ECU_ADDRESS 0xFFFF1E68 /begin FUNCTION_LIST KF7-505.38[4] /end FUNCTION_LIST /end MEASUREMENT
/begin MEASUREMENT vCDADINF "AD diagnosis input fixed counter" UBYTE COMP_0030 1 100 0 255 ECU_ADDRESS 0xFFFF1E69 /begin FUNCTION_LIST KF7-505.38[4] /end FUNCTION_LIST /end MEASUREMENT
/begin MEASUREMENT vCEXNGMX "Counter MAX value for the exercise question part diagnosis NG judgement" UBYTE COMP_0030 1 100 0 255 ECU_ADDRESS 0xFFFFA2B5 /begin FUNCTION_LIST KF7-505.40[1] /end FUNCTION_LIST /end MEASUREMENT
/begin MEASUREMENT vCLBUF "EEPROM temporary memory value data" UWORD COMP_0061 1 100 0 327675 ECU_ADDRESS 0xFFFF298A /begin FUNCTION_LIST KF7-505.22[3] /end FUNCTION_LIST /end MEASUREMENT
/begin MEASUREMENT vCNGDLY "VTC drive abnormality diagnosis judgement delay" UBYTE COMP_0008 1 100 0 25500 ECU_ADDRESS 0xFFFF11F2 /begin FUNCTION_LIST KF7-500.47B[15] /end FUNCTION_LIST /end MEASUREMENT
/begin MEASUREMENT vCNT "Diagnosis number of times counter" UBYTE COMP_0030 1 100 0 255 ECU_ADDRESS 0xFFFF29A7 /begin FUNCTION_LIST KF7-505.12[6] KF7-505.36[2] KF7-580.1[8] /end FUNCTION_LIST /end MEASUREMENT
/begin MEASUREMENT vCSYNGMIN "Timer MIN value for the SYNC watch part diagnosis NG judgement" UBYTE COMP_0014 1 100 0 2550 ECU_ADDRESS 0xFFFFA2CB /begin FUNCTION_LIST KF7-505.43[3] /end FUNCTION_LIST /end MEASUREMENT
/begin MEASUREMENT vCTCLK "Clock diagnosis NG counter" UBYTE COMP_0030 1 100 0 255 ECU_ADDRESS 0xFFFF3AE4 /begin FUNCTION_LIST KF7-505.37[1] /end FUNCTION_LIST /end MEASUREMENT
/begin MEASUREMENT vCTCMAX "Clock diagnosis NG counter MAX value" UBYTE COMP_0030 1 100 0 255 ECU_ADDRESS 0xFFFFB5E4 /begin FUNCTION_LIST KF7-505.37[1] /end FUNCTION_LIST /end MEASUREMENT
/begin MEASUREMENT vDABF "The amount of change of the actual A/F value AFSAF" SWORD COMP_0384_S 1 100 -131.072 131.068 ECU_ADDRESS 0xFFFF1224 /begin FUNCTION_LIST KF7-500.74[11] /end FUNCTION_LIST /end MEASUREMENT
/begin MEASUREMENT vDADIN "A port input voltage for the AD diagnosis" UBYTE COMP_0054 1 100 0 5100 ECU_ADDRESS 0xFFFF3AEA /begin FUNCTION_LIST KF7-505.38[4] /end FUNCTION_LIST /end MEASUREMENT
/begin MEASUREMENT vDAFMAX "Delta-A/F maximum value" SWORD COMP_0384_S 1 100 -131.072 131.068 ECU_ADDRESS 0xFFFF2A0A /begin FUNCTION_LIST KF7-500.74[11] /end FUNCTION_LIST /end MEASUREMENT
/begin MEASUREMENT vDAFMIN "Delta-A/F minimum value" SWORD COMP_0384_S 1 100 -131.072 131.068 ECU_ADDRESS 0xFFFF2A0E /begin FUNCTION_LIST KF7-500.74[11] /end FUNCTION_LIST /end MEASUREMENT
/begin MEASUREMENT vDELTPV "TPS deviation (for the parameter monitor)" UBYTE COMP_0023 1 100 0 1275 ECU_ADDRESS 0xFFFF3AF1 /begin FUNCTION_LIST KF7-505.38[4] /end FUNCTION_LIST /end MEASUREMENT
/begin MEASUREMENT vDELTWN "The amount of a change in a coolant temperature for the coolant temperature convergent judgement" UBYTE COMP_0003 1 100 0 255 ECU_ADDRESS 0xFFFF2A29 /begin FUNCTION_LIST KF7-500.60[5] /end FUNCTION_LIST /end MEASUREMENT
/begin MEASUREMENT vDGRAMAD "Diagnosis object RAM address storage RAM" UWORD COMP_0068 1 100 0 65535 ECU_ADDRESS 0xFFFF2A3C /begin FUNCTION_LIST KF7-505.12[6] KF7-505.36[2] /end FUNCTION_LIST /end MEASUREMENT
/begin MEASUREMENT vDLAPO "APO deviation" UWORD COMP_0005 1 100 0 7208.85 ECU_ADDRESS 0xFFFF2A4A /begin FUNCTION_LIST KF7-505.9[3] KF7-505.26[2] /end FUNCTION_LIST /end MEASUREMENT
/begin MEASUREMENT vDLAPOR "Accelerator pedal ratio deviation" UWORD COMP_0362_S 1 100 0 8191.875 ECU_ADDRESS 0xFFFF2A4C /begin FUNCTION_LIST KF7-505.9[3] R301.21.SafetyLevel2_1_0_2 /end FUNCTION_LIST /end MEASUREMENT
/begin MEASUREMENT vDLAPST "Accelerator open-degree deviation" UWORD COMP_0005 1 100 0 7208.85 ECU_ADDRESS 0xFFFF2A4E /begin FUNCTION_LIST KF7-505.17[3] KF7-505.26[2] R301.21.SafetyLevel2_1_0_2 /end FUNCTION_LIST /end MEASUREMENT
/begin MEASUREMENT vDLQH0AP "The APO basic volume flow-quantity ratio edition difference" UWORD COMP_0146 1 100 0 99.998480265 ECU_ADDRESS 0xFFFF2A54 /begin FUNCTION_LIST KF7-505.26[2] KF7-505.50[1] R301.21.SafetyLevel2_1_0_2 /end FUNCTION_LIST /end MEASUREMENT
/begin MEASUREMENT vDLSRVNG "Servo error judgement time" UWORD COMP_0014 1 100 0 655350 ECU_ADDRESS 0xFFFF2A5E /begin FUNCTION_LIST KF7-505.32[6] /end FUNCTION_LIST /end MEASUREMENT
/begin MEASUREMENT vDLTATE "PTD torque area conversion value deviation" UWORD COMP_0042 1 100 0 52.428 ECU_ADDRESS 0xFFFF2A60 /begin FUNCTION_LIST KF7-505.26[2] KF7-505.52[1] R301.21.SafetyLevel2_1_0_2 /end FUNCTION_LIST /end MEASUREMENT
/begin MEASUREMENT vDLTEPTD "Target engine torque deviation" UWORD COMP_0196 1 100 0 6553.5 ECU_ADDRESS 0xFFFF2A64 /begin FUNCTION_LIST KF7-505.26[2] KF7-505.51[2] /end FUNCTION_LIST /end MEASUREMENT
/begin MEASUREMENT vDLTGTV "ETC target open-degree deviation" UWORD COMP_0130 1 100 0 1802.2125 ECU_ADDRESS 0xFFFF2A66 /begin FUNCTION_LIST KF7-505.16[1] KF7-505.26[2] R301.21.SafetyLevel2_1_0_2 /end FUNCTION_LIST /end MEASUREMENT
/begin MEASUREMENT vDLTTEP "PTD requested torque deviation" UWORD COMP_0196 1 100 0 6553.5 ECU_ADDRESS 0xFFFF2A76 /begin FUNCTION_LIST KF7-505.26[2] KF7-505.53[1] R301.21.SafetyLevel2_1_0_2 /end FUNCTION_LIST /end MEASUREMENT
/begin MEASUREMENT vDLYTMP "Judgement delay time map reference value" UBYTE COMP_0008 1 100 0 25500 ECU_ADDRESS 0xFFFF1282 /begin FUNCTION_LIST KF7-500.47B[15] /end FUNCTION_LIST /end MEASUREMENT
/begin MEASUREMENT vDLYTVOL "Once, after the delay treatment, lower limit open-degree" UWORD COMP_0005 1 100 0 7208.85 ECU_ADDRESS 0xFFFF2A7E /begin FUNCTION_LIST KF7-505.15[4] /end FUNCTION_LIST /end MEASUREMENT
/begin MEASUREMENT vDLYTVOU "Once, after the delay treatment, upper limit open-degree" UWORD COMP_0005 1 100 0 7208.85 ECU_ADDRESS 0xFFFF2A80 /begin FUNCTION_LIST KF7-505.15[4] /end FUNCTION_LIST /end MEASUREMENT
/begin MEASUREMENT vDO2MAX "At the time of the diagnosis condition formation, VO2 maximum value" UBYTE COMP_0104 1 100 0 2550 ECU_ADDRESS 0xFFFFA2E2 /begin FUNCTION_LIST KF7-505.26[2] /end FUNCTION_LIST /end MEASUREMENT
/begin MEASUREMENT vDO2MAX_R#1 "At the time of the diagnosis condition formation, VO2 maximum value" UBYTE COMP_0104 1 100 0 2550 ECU_ADDRESS 0xFFFFA2E2 /begin FUNCTION_LIST KF7-505.26[2] /end FUNCTION_LIST /end MEASUREMENT
/begin MEASUREMENT vDO2MAX_R#2 "At the time of the diagnosis condition formation, VO2 maximum value" UBYTE COMP_0104 1 100 0 2550 ECU_ADDRESS 0xFFFFA2E3 /begin FUNCTION_LIST KF7-505.26[2] /end FUNCTION_LIST /end MEASUREMENT
/begin MEASUREMENT vDO2MIN "At the time of the diagnosis condition formation, VO2 minimum value" UBYTE COMP_0104 1 100 0 2550 ECU_ADDRESS 0xFFFFA2E4 /begin FUNCTION_LIST KF7-505.26[2] /end FUNCTION_LIST /end MEASUREMENT
/begin MEASUREMENT vDO2MIN_R#1 "At the time of the diagnosis condition formation, VO2 minimum value" UBYTE COMP_0104 1 100 0 2550 ECU_ADDRESS 0xFFFFA2E4 /begin FUNCTION_LIST KF7-505.26[2] /end FUNCTION_LIST /end MEASUREMENT
/begin MEASUREMENT vDO2MIN_R#2 "At the time of the diagnosis condition formation, VO2 minimum value" UBYTE COMP_0104 1 100 0 2550 ECU_ADDRESS 0xFFFFA2E5 /begin FUNCTION_LIST KF7-505.26[2] /end FUNCTION_LIST /end MEASUREMENT
/begin MEASUREMENT vDRTQSP_S "Driver requirement engine torque (vice-operation part)" SWORD COMP_0228 1 100 -3276.8 3276.7 ECU_ADDRESS 0xFFFF34EC /begin FUNCTION_LIST KF7-505.54[2] R301.21.SafetyLevel2_1_0_2 /end FUNCTION_LIST /end MEASUREMENT
/begin MEASUREMENT vDUSMIN "At the time of the diagnosis condition formation, É¢US minimum value" UWORD COMP_0023 1 100 0 327675 ECU_ADDRESS 0xFFFFA2F2 /begin FUNCTION_LIST KF7-505.26[2] /end FUNCTION_LIST /end MEASUREMENT
/begin MEASUREMENT vENGSTRT "After the start, time" ULONG COMP_0008 1 100 0 429496729500 ECU_ADDRESS 0xFFFF8990
 /begin FUNCTION_LIST KF7-505.25[3] KF7-505.30[6] R000.1.RS_Integ_1_10_2 R107.1.iss_ariss_1_0_4 /end FUNCTION_LIST
/end MEASUREMENT
/begin MEASUREMENT vERROR "The amount of operation corner deviation" UBYTE COMP_0256 1 100 -64 63.5 ECU_ADDRESS 0xFFFF12F2 /begin FUNCTION_LIST KF7-500.47B[15] /end FUNCTION_LIST /end MEASUREMENT
/begin MEASUREMENT vERROR_R#1 "The amount of operation corner deviation" UBYTE COMP_0256 1 100 -64 63.5 ECU_ADDRESS 0xFFFF12F2 /begin FUNCTION_LIST KF7-500.47B[15] /end FUNCTION_LIST /end MEASUREMENT
/begin MEASUREMENT vERROR_R#2 "The amount of operation corner deviation" UBYTE COMP_0256 1 100 -64 63.5 ECU_ADDRESS 0xFFFF12F3 /begin FUNCTION_LIST KF7-500.47B[15] /end FUNCTION_LIST /end MEASUREMENT
/begin MEASUREMENT vERROR2 "The amount of operation corner deviation" UBYTE COMP_0257 1 100 -128 127 ECU_ADDRESS 0xFFFF12F4 /begin FUNCTION_LIST KF7-500.47B[15] /end FUNCTION_LIST /end MEASUREMENT
/begin MEASUREMENT vERROR2_R#1 "The amount of operation corner deviation" UBYTE COMP_0257 1 100 -128 127 ECU_ADDRESS 0xFFFF12F4 /begin FUNCTION_LIST KF7-500.47B[15] /end FUNCTION_LIST /end MEASUREMENT
/begin MEASUREMENT vERROR2_R#2 "The amount of operation corner deviation" UBYTE COMP_0257 1 100 -128 127 ECU_ADDRESS 0xFFFF12F5 /begin FUNCTION_LIST KF7-500.47B[15] /end FUNCTION_LIST /end MEASUREMENT
/begin MEASUREMENT vEXNGCT "A counter for the exercise question part diagnosis NG judgement" UBYTE COMP_0030 1 100 0 255 ECU_ADDRESS 0xFFFF2CE4 /begin FUNCTION_LIST KF7-505.40[1] /end FUNCTION_LIST /end MEASUREMENT
/begin MEASUREMENT vFBLMT1 "At the time of the steady state, an allowable deviation 1" UWORD COMP_0005 1 100 0 7208.85 ECU_ADDRESS 0xFFFF2CF8 /begin FUNCTION_LIST KF7-505.15[4] /end FUNCTION_LIST /end MEASUREMENT
/begin MEASUREMENT vFFAHOS "At the time of the NG judgement, AFSHOS" SWORD COMP_0341_S 1 100 -65.536 65.534 ECU_ADDRESS 0xFFFFA3CC /begin FUNCTION_LIST KF7-500.75[4] /end FUNCTION_LIST /end MEASUREMENT
/begin MEASUREMENT vFFDSRM "FFD sampling period" UBYTE COMP_0053 1 100 0 255 ECU_ADDRESS 0xFFFF3CC8 /begin FUNCTION_LIST KF7-525.1[4] /end FUNCTION_LIST /end MEASUREMENT
/begin MEASUREMENT vFFDSTON "An initial number of times counter" UBYTE COMP_0016 1 100 0 255 ECU_ADDRESS 0xFFFFB5F4 /begin FUNCTION_LIST KF7-525.1[4] /end FUNCTION_LIST /end MEASUREMENT
/begin MEASUREMENT vFFDTRTM "After the trigger occurrence, timer" UWORD COMP_0049 1 100 0 65535 ECU_ADDRESS 0xFFFFB5F6 /begin FUNCTION_LIST KF7-525.1[4] KF7-525.2[6] /end FUNCTION_LIST /end MEASUREMENT
/begin MEASUREMENT vFFMILEG "At the time of the NG judgement, mileage" UWORD COMP_0549_S 1 100 0 1685560.2 ECU_ADDRESS 0xFFFFA3E6 /begin FUNCTION_LIST KF7-500.75[4] /end FUNCTION_LIST /end MEASUREMENT
/begin MEASUREMENT vFFSAV "At the time of the NG judgement, AHOSAV" SWORD COMP_0341_S 1 100 -65.536 65.534 ECU_ADDRESS 0xFFFFA3F6 /begin FUNCTION_LIST KF7-500.75[4] /end FUNCTION_LIST /end MEASUREMENT
/begin MEASUREMENT vGAFDLR "Delta-A/F (a parameter for GST) (lean rich)" UWORD COMP_0453 1 100 0 131.07 ECU_ADDRESS 0xFFFFA43A /begin FUNCTION_LIST KF7-500.74B[5] R904.1.Gst_on_can_1_0_1 /end FUNCTION_LIST /end MEASUREMENT
/begin MEASUREMENT vGAFDRL "Delta-A/F (a parameter for GST) (rich lean)" UWORD COMP_0453 1 100 0 131.07 ECU_ADDRESS 0xFFFFA43E /begin FUNCTION_LIST KF7-500.74B[5] R904.1.Gst_on_can_1_0_1 /end FUNCTION_LIST /end MEASUREMENT
/begin MEASUREMENT vGAFSMN "Front A/F sensor output voltage minimum value for the GST output" UWORD COMP_0023 1 100 0 327675 ECU_ADDRESS 0xFFFFA442 /begin FUNCTION_LIST KF7-500.74[11] R904.1.Gst_on_can_1_0_1 /end FUNCTION_LIST /end MEASUREMENT
/begin MEASUREMENT vGAFSMX "Front A/F sensor output voltage maximum value for the GST output" UWORD COMP_0023 1 100 0 327675 ECU_ADDRESS 0xFFFFA446 /begin FUNCTION_LIST KF7-500.74[11] R904.1.Gst_on_can_1_0_1 /end FUNCTION_LIST /end MEASUREMENT
/begin MEASUREMENT vGAHOSL "A lean-shift diagnosis parameter for GST" SWORD COMP_0341_S 1 100 -65.536 65.534 ECU_ADDRESS 0xFFFFA44A /begin FUNCTION_LIST KF7-500.75[4] R904.1.Gst_on_can_1_0_1 /end FUNCTION_LIST /end MEASUREMENT
/begin MEASUREMENT vGAHOSR "A rich-shift diagnosis parameter for GST" SWORD COMP_0341_S 1 100 -65.536 65.534 ECU_ADDRESS 0xFFFFA44E /begin FUNCTION_LIST KF7-500.75[4] R904.1.Gst_on_can_1_0_1 /end FUNCTION_LIST /end MEASUREMENT
/begin MEASUREMENT vGAVGAFH "A/F sensor heater electric current for the GST output" UWORD COMP_0061 1 100 0 327675 ECU_ADDRESS 0xFFFFA452 /begin FUNCTION_LIST KF7-500.59[6] /end FUNCTION_LIST /end MEASUREMENT
/begin MEASUREMENT vGDAFMAX "Delta-A/F maximum value (a parameter for GST)" UWORD COMP_0385_S 1 100 0 262.14 ECU_ADDRESS 0xFFFFA456 /begin FUNCTION_LIST KF7-500.74[11] /end FUNCTION_LIST /end MEASUREMENT
/begin MEASUREMENT vGDAFMIN "Delta-A/F minimum value (a parameter for GST)" SWORD COMP_0384_S 1 100 -131.072 131.068 ECU_ADDRESS 0xFFFFA45A /begin FUNCTION_LIST KF7-500.74[11] /end FUNCTION_LIST /end MEASUREMENT
/begin MEASUREMENT vGFAFS "Former A/F sensor output voltage value for the GST output" UWORD COMP_0023 1 100 0 327675 ECU_ADDRESS 0xFFFFA462 /begin FUNCTION_LIST KF7-500.76[8] R904.1.Gst_on_can_1_0_1 /end FUNCTION_LIST /end MEASUREMENT
/begin MEASUREMENT vGFAFSHM "Former A/F sensor breakage diagnosis NG judgement limit value (a high voltage trouble) for the GST output" UWORD COMP_0023 1 100 0 327675 ECU_ADDRESS 0xFFFFA466 /begin FUNCTION_LIST KF7-500.76[8] R904.1.Gst_on_can_1_0_1 /end FUNCTION_LIST /end MEASUREMENT
/begin MEASUREMENT vGFAFSLM "A former A/F sensor breakage slice level for the GST output" UWORD COMP_0023 1 100 0 327675 ECU_ADDRESS 0xFFFFA46A /begin FUNCTION_LIST KF7-500.76[8] R904.1.Gst_on_can_1_0_1 /end FUNCTION_LIST /end MEASUREMENT
/begin MEASUREMENT vHOSNTP "NÅ~TP compensation coefficient" UBYTE COMP_0045 1 100 0 1.9921875 ECU_ADDRESS 0xFFFF2E24 /begin FUNCTION_LIST KF7-500.74[11] /end FUNCTION_LIST /end MEASUREMENT
/begin MEASUREMENT vHOSRCV "NÅ~TP compensation coefficient" UBYTE COMP_0045 1 100 0 1.9921875 ECU_ADDRESS 0xFFFF2E26 /begin FUNCTION_LIST KF7-500.74[11] /end FUNCTION_LIST /end MEASUREMENT
/begin MEASUREMENT vHZNTP "At the time of delta-A/F maximum value computation, NÅ~TP" UWORD COMP_0434_S 1 100 0 12799.8046875 ECU_ADDRESS 0xFFFF2E3E /begin FUNCTION_LIST KF7-500.74[11] /end FUNCTION_LIST /end MEASUREMENT
/begin MEASUREMENT vICLBUF "EEPROM bit reversal temporary memory value data" UWORD COMP_0061 1 100 0 327675 ECU_ADDRESS 0xFFFF2E42 /begin FUNCTION_LIST KF7-505.22[3] /end FUNCTION_LIST /end MEASUREMENT
/begin MEASUREMENT vICNT "Diagnosis number of times counter (the bit reversal value of CNT)" UBYTE COMP_0030 1 100 0 255 ECU_ADDRESS 0xFFFF2E44 /begin FUNCTION_LIST KF7-505.12[6] KF7-505.36[2] /end FUNCTION_LIST /end MEASUREMENT
/begin MEASUREMENT vICOM2AVE "Electric current order value (after the limiter) mean" ULONG COMP_0600_S 1 100 0 32766.305493555 ECU_ADDRESS 0xFFFF3DA4 /begin FUNCTION_LIST KF7-505.33[8] /end FUNCTION_LIST /end MEASUREMENT
/begin MEASUREMENT vIDGRAMAD "Diagnosis object RAM address storage RAM (the bit reversal value of DGRAMAD)" UWORD COMP_0068 1 100 0 65535 ECU_ADDRESS 0xFFFF2E46 /begin FUNCTION_LIST KF7-505.12[6] KF7-505.36[2] /end FUNCTION_LIST /end MEASUREMENT
/begin MEASUREMENT vINLDST "Lambda control start prohibition time" UBYTE COMP_0013 1 100 0 255 ECU_ADDRESS 0xFFFF1465 /begin FUNCTION_LIST KF7-500.39[5] /end FUNCTION_LIST /end MEASUREMENT
/begin MEASUREMENT vJGLRD "A diagnosis parameter (lean/rich) for GST" UWORD COMP_0453 1 100 0 131.07 ECU_ADDRESS 0xFFFF2E6E /begin FUNCTION_LIST KF7-500.74B[5] /end FUNCTION_LIST /end MEASUREMENT
/begin MEASUREMENT vJGLRD_R#1 "A diagnosis parameter (lean/rich) for GST" UWORD COMP_0453 1 100 0 131.07 ECU_ADDRESS 0xFFFF2E6E /begin FUNCTION_LIST KF7-500.74B[5] /end FUNCTION_LIST /end MEASUREMENT
/begin MEASUREMENT vJGLRD_R#2 "A diagnosis parameter (lean/rich) for GST" UWORD COMP_0453 1 100 0 131.07 ECU_ADDRESS 0xFFFF2E70 /begin FUNCTION_LIST KF7-500.74B[5] /end FUNCTION_LIST /end MEASUREMENT
/begin MEASUREMENT vKPTYTMP "For the PTY value operation" ULONG COMP_0068 1 100 0 4294967295 ECU_ADDRESS 0xFFFF2E84 /begin FUNCTION_LIST KF7-505.35[2] /end FUNCTION_LIST /end MEASUREMENT
/begin MEASUREMENT vKSUMTMP "For the SUM value operation" ULONG COMP_0068 1 100 0 4294967295 ECU_ADDRESS 0xFFFF2E8C /begin FUNCTION_LIST KF7-505.35[2] /end FUNCTION_LIST /end MEASUREMENT
/begin MEASUREMENT vLMDCNT "Lambda control close diagnosis Rate counter" UWORD COMP_0016 1 100 0 65535 ECU_ADDRESS 0xFFFFA4CE /begin FUNCTION_LIST KF7-500.39[5] KF7-580.1[8] /end FUNCTION_LIST /end MEASUREMENT
/begin MEASUREMENT vLMTTVOL "F/B control lower limit regulation value" UWORD COMP_0005 1 100 0 7208.85 ECU_ADDRESS 0xFFFF2EB4 /begin FUNCTION_LIST KF7-505.15[4] /end FUNCTION_LIST /end MEASUREMENT
/begin MEASUREMENT vLMTTVOU "F/B control upper limit regulation value" UWORD COMP_0005 1 100 0 7208.85 ECU_ADDRESS 0xFFFF2EB6 /begin FUNCTION_LIST KF7-505.15[4] /end FUNCTION_LIST /end MEASUREMENT
/begin MEASUREMENT vMAXTWX "Coolant temperature sensor un-adjustment diagnosis parameter maximum value" UBYTE COMP_0054 1 100 0 5100 ECU_ADDRESS 0xFFFFA4D9 /begin FUNCTION_LIST KF7-505.10[2] /end FUNCTION_LIST /end MEASUREMENT
/begin MEASUREMENT vMNDAFMX "Former A/F sensor rich lean response deterioration diagnosis GDAFMAX minimum value" UWORD COMP_0385_S 1 100 0 262.14 ECU_ADDRESS 0xFFFFA784 /begin FUNCTION_LIST KF7-500.74[11] /end FUNCTION_LIST /end MEASUREMENT
/begin MEASUREMENT vMONI1MN "(One byte) for the diagnosis parameter MIN value monitor" UBYTE COMP_0068 1 100 0 255 ECU_ADDRESS 0xFFFFAA46 /begin FUNCTION_LIST KF7-505.26[2] /end FUNCTION_LIST /end MEASUREMENT
/begin MEASUREMENT vMONI1MN_R#1 "(One byte) for the diagnosis parameter MIN value monitor" UBYTE COMP_0068 1 100 0 255 ECU_ADDRESS 0xFFFFAA46 /begin FUNCTION_LIST KF7-505.26[2] /end FUNCTION_LIST /end MEASUREMENT
/begin MEASUREMENT vMONI1MN_R#2 "(One byte) for the diagnosis parameter MIN value monitor" UBYTE COMP_0068 1 100 0 255 ECU_ADDRESS 0xFFFFAA47 /begin FUNCTION_LIST KF7-505.26[2] /end FUNCTION_LIST /end MEASUREMENT
/begin MEASUREMENT vMONI1MN_R#3 "(One byte) for the diagnosis parameter MIN value monitor" UBYTE COMP_0068 1 100 0 255 ECU_ADDRESS 0xFFFFAA48 /begin FUNCTION_LIST KF7-505.26[2] /end FUNCTION_LIST /end MEASUREMENT
/begin MEASUREMENT vMONI1MN_R#4 "(One byte) for the diagnosis parameter MIN value monitor" UBYTE COMP_0068 1 100 0 255 ECU_ADDRESS 0xFFFFAA49 /begin FUNCTION_LIST KF7-505.26[2] /end FUNCTION_LIST /end MEASUREMENT
/begin MEASUREMENT vMONI1MN_R#5 "(One byte) for the diagnosis parameter MIN value monitor" UBYTE COMP_0068 1 100 0 255 ECU_ADDRESS 0xFFFFAA4A /begin FUNCTION_LIST KF7-505.26[2] /end FUNCTION_LIST /end MEASUREMENT
/begin MEASUREMENT vMONI1MN_R#6 "(One byte) for the diagnosis parameter MIN value monitor" UBYTE COMP_0068 1 100 0 255 ECU_ADDRESS 0xFFFFAA4B /begin FUNCTION_LIST KF7-505.26[2] /end FUNCTION_LIST /end MEASUREMENT
/begin MEASUREMENT vMONI1MN_R#7 "(One byte) for the diagnosis parameter MIN value monitor" UBYTE COMP_0068 1 100 0 255 ECU_ADDRESS 0xFFFFAA4C /begin FUNCTION_LIST KF7-505.26[2] /end FUNCTION_LIST /end MEASUREMENT
/begin MEASUREMENT vMONI1MN_R#8 "(One byte) for the diagnosis parameter MIN value monitor" UBYTE COMP_0068 1 100 0 255 ECU_ADDRESS 0xFFFFAA4D /begin FUNCTION_LIST KF7-505.26[2] /end FUNCTION_LIST /end MEASUREMENT
/begin MEASUREMENT vMONI1MN_R#9 "(One byte) for the diagnosis parameter MIN value monitor" UBYTE COMP_0068 1 100 0 255 ECU_ADDRESS 0xFFFFAA4E /begin FUNCTION_LIST KF7-505.26[2] /end FUNCTION_LIST /end MEASUREMENT
/begin MEASUREMENT vMONI1MN_R#10 "(One byte) for the diagnosis parameter MIN value monitor" UBYTE COMP_0068 1 100 0 255 ECU_ADDRESS 0xFFFFAA4F /begin FUNCTION_LIST KF7-505.26[2] /end FUNCTION_LIST /end MEASUREMENT
/begin MEASUREMENT vMONI1MN_R#11 "(One byte) for the diagnosis parameter MIN value monitor" UBYTE COMP_0068 1 100 0 255 ECU_ADDRESS 0xFFFFAA50 /begin FUNCTION_LIST KF7-505.26[2] /end FUNCTION_LIST /end MEASUREMENT
/begin MEASUREMENT vMONI1MN_R#12 "(One byte) for the diagnosis parameter MIN value monitor" UBYTE COMP_0068 1 100 0 255 ECU_ADDRESS 0xFFFFAA51 /begin FUNCTION_LIST KF7-505.26[2] /end FUNCTION_LIST /end MEASUREMENT
/begin MEASUREMENT vMONI1MN_R#13 "(One byte) for the diagnosis parameter MIN value monitor" UBYTE COMP_0068 1 100 0 255 ECU_ADDRESS 0xFFFFAA52 /begin FUNCTION_LIST KF7-505.26[2] /end FUNCTION_LIST /end MEASUREMENT
/begin MEASUREMENT vMONI1MN_R#14 "(One byte) for the diagnosis parameter MIN value monitor" UBYTE COMP_0068 1 100 0 255 ECU_ADDRESS 0xFFFFAA53 /begin FUNCTION_LIST KF7-505.26[2] /end FUNCTION_LIST /end MEASUREMENT
/begin MEASUREMENT vMONI1MN_R#15 "(One byte) for the diagnosis parameter MIN value monitor" UBYTE COMP_0068 1 100 0 255 ECU_ADDRESS 0xFFFFAA54 /begin FUNCTION_LIST KF7-505.26[2] /end FUNCTION_LIST /end MEASUREMENT
/begin MEASUREMENT vMONI1MN_R#16 "(One byte) for the diagnosis parameter MIN value monitor" UBYTE COMP_0068 1 100 0 255 ECU_ADDRESS 0xFFFFAA55 /begin FUNCTION_LIST KF7-505.26[2] /end FUNCTION_LIST /end MEASUREMENT
/begin MEASUREMENT vMONI1MX "(One byte) for the diagnosis parameter MAX value monitor" UBYTE COMP_0068 1 100 0 255 ECU_ADDRESS 0xFFFFAA56 /begin FUNCTION_LIST KF7-505.26[2] /end FUNCTION_LIST /end MEASUREMENT
/begin MEASUREMENT vMONI1MX_R#1 "(One byte) for the diagnosis parameter MAX value monitor" UBYTE COMP_0068 1 100 0 255 ECU_ADDRESS 0xFFFFAA56 /begin FUNCTION_LIST KF7-505.26[2] /end FUNCTION_LIST /end MEASUREMENT
/begin MEASUREMENT vMONI1MX_R#2 "(One byte) for the diagnosis parameter MAX value monitor" UBYTE COMP_0068 1 100 0 255 ECU_ADDRESS 0xFFFFAA57 /begin FUNCTION_LIST KF7-505.26[2] /end FUNCTION_LIST /end MEASUREMENT
/begin MEASUREMENT vMONI1MX_R#3 "(One byte) for the diagnosis parameter MAX value monitor" UBYTE COMP_0068 1 100 0 255 ECU_ADDRESS 0xFFFFAA58 /begin FUNCTION_LIST KF7-505.26[2] /end FUNCTION_LIST /end MEASUREMENT
/begin MEASUREMENT vMONI1MX_R#4 "(One byte) for the diagnosis parameter MAX value monitor" UBYTE COMP_0068 1 100 0 255 ECU_ADDRESS 0xFFFFAA59 /begin FUNCTION_LIST KF7-505.26[2] /end FUNCTION_LIST /end MEASUREMENT
/begin MEASUREMENT vMONI1MX_R#5 "(One byte) for the diagnosis parameter MAX value monitor" UBYTE COMP_0068 1 100 0 255 ECU_ADDRESS 0xFFFFAA5A /begin FUNCTION_LIST KF7-505.26[2] /end FUNCTION_LIST /end MEASUREMENT
/begin MEASUREMENT vMONI1MX_R#6 "(One byte) for the diagnosis parameter MAX value monitor" UBYTE COMP_0068 1 100 0 255 ECU_ADDRESS 0xFFFFAA5B /begin FUNCTION_LIST KF7-505.26[2] /end FUNCTION_LIST /end MEASUREMENT
/begin MEASUREMENT vMONI1MX_R#7 "(One byte) for the diagnosis parameter MAX value monitor" UBYTE COMP_0068 1 100 0 255 ECU_ADDRESS 0xFFFFAA5C /begin FUNCTION_LIST KF7-505.26[2] /end FUNCTION_LIST /end MEASUREMENT
/begin MEASUREMENT vMONI1MX_R#8 "(One byte) for the diagnosis parameter MAX value monitor" UBYTE COMP_0068 1 100 0 255 ECU_ADDRESS 0xFFFFAA5D /begin FUNCTION_LIST KF7-505.26[2] /end FUNCTION_LIST /end MEASUREMENT
/begin MEASUREMENT vMONI1MX_R#9 "(One byte) for the diagnosis parameter MAX value monitor" UBYTE COMP_0068 1 100 0 255 ECU_ADDRESS 0xFFFFAA5E /begin FUNCTION_LIST KF7-505.26[2] /end FUNCTION_LIST /end MEASUREMENT
/begin MEASUREMENT vMONI1MX_R#10 "(One byte) for the diagnosis parameter MAX value monitor" UBYTE COMP_0068 1 100 0 255 ECU_ADDRESS 0xFFFFAA5F /begin FUNCTION_LIST KF7-505.26[2] /end FUNCTION_LIST /end MEASUREMENT
/begin MEASUREMENT vMONI1MX_R#11 "(One byte) for the diagnosis parameter MAX value monitor" UBYTE COMP_0068 1 100 0 255 ECU_ADDRESS 0xFFFFAA60 /begin FUNCTION_LIST KF7-505.26[2] /end FUNCTION_LIST /end MEASUREMENT
/begin MEASUREMENT vMONI1MX_R#12 "(One byte) for the diagnosis parameter MAX value monitor" UBYTE COMP_0068 1 100 0 255 ECU_ADDRESS 0xFFFFAA61 /begin FUNCTION_LIST KF7-505.26[2] /end FUNCTION_LIST /end MEASUREMENT
/begin MEASUREMENT vMONI1MX_R#13 "(One byte) for the diagnosis parameter MAX value monitor" UBYTE COMP_0068 1 100 0 255 ECU_ADDRESS 0xFFFFAA62 /begin FUNCTION_LIST KF7-505.26[2] /end FUNCTION_LIST /end MEASUREMENT
/begin MEASUREMENT vMONI1MX_R#14 "(One byte) for the diagnosis parameter MAX value monitor" UBYTE COMP_0068 1 100 0 255 ECU_ADDRESS 0xFFFFAA63 /begin FUNCTION_LIST KF7-505.26[2] /end FUNCTION_LIST /end MEASUREMENT
/begin MEASUREMENT vMONI1MX_R#15 "(One byte) for the diagnosis parameter MAX value monitor" UBYTE COMP_0068 1 100 0 255 ECU_ADDRESS 0xFFFFAA64 /begin FUNCTION_LIST KF7-505.26[2] /end FUNCTION_LIST /end MEASUREMENT
/begin MEASUREMENT vMONI1MX_R#16 "(One byte) for the diagnosis parameter MAX value monitor" UBYTE COMP_0068 1 100 0 255 ECU_ADDRESS 0xFFFFAA65 /begin FUNCTION_LIST KF7-505.26[2] /end FUNCTION_LIST /end MEASUREMENT
/begin MEASUREMENT vMONI2MN "(Two bytes) for the diagnosis parameter MIN value monitor" UWORD COMP_0068 1 100 0 65535 ECU_ADDRESS 0xFFFFAA66 /begin FUNCTION_LIST KF7-505.26[2] /end FUNCTION_LIST /end MEASUREMENT
/begin MEASUREMENT vMONI2MN_R#1 "(Two bytes) for the diagnosis parameter MIN value monitor" UWORD COMP_0068 1 100 0 65535 ECU_ADDRESS 0xFFFFAA66 /begin FUNCTION_LIST KF7-505.26[2] /end FUNCTION_LIST /end MEASUREMENT
/begin MEASUREMENT vMONI2MN_R#2 "(Two bytes) for the diagnosis parameter MIN value monitor" UWORD COMP_0068 1 100 0 65535 ECU_ADDRESS 0xFFFFAA68 /begin FUNCTION_LIST KF7-505.26[2] /end FUNCTION_LIST /end MEASUREMENT
/begin MEASUREMENT vMONI2MN_R#3 "(Two bytes) for the diagnosis parameter MIN value monitor" UWORD COMP_0068 1 100 0 65535 ECU_ADDRESS 0xFFFFAA6A /begin FUNCTION_LIST KF7-505.26[2] /end FUNCTION_LIST /end MEASUREMENT
/begin MEASUREMENT vMONI2MN_R#4 "(Two bytes) for the diagnosis parameter MIN value monitor" UWORD COMP_0068 1 100 0 65535 ECU_ADDRESS 0xFFFFAA6C /begin FUNCTION_LIST KF7-505.26[2] /end FUNCTION_LIST /end MEASUREMENT
/begin MEASUREMENT vMONI2MN_R#5 "(Two bytes) for the diagnosis parameter MIN value monitor" UWORD COMP_0068 1 100 0 65535 ECU_ADDRESS 0xFFFFAA6E /begin FUNCTION_LIST KF7-505.26[2] /end FUNCTION_LIST /end MEASUREMENT
/begin MEASUREMENT vMONI2MN_R#6 "(Two bytes) for the diagnosis parameter MIN value monitor" UWORD COMP_0068 1 100 0 65535 ECU_ADDRESS 0xFFFFAA70 /begin FUNCTION_LIST KF7-505.26[2] /end FUNCTION_LIST /end MEASUREMENT
/begin MEASUREMENT vMONI2MN_R#7 "(Two bytes) for the diagnosis parameter MIN value monitor" UWORD COMP_0068 1 100 0 65535 ECU_ADDRESS 0xFFFFAA72 /begin FUNCTION_LIST KF7-505.26[2] /end FUNCTION_LIST /end MEASUREMENT
/begin MEASUREMENT vMONI2MN_R#8 "(Two bytes) for the diagnosis parameter MIN value monitor" UWORD COMP_0068 1 100 0 65535 ECU_ADDRESS 0xFFFFAA74 /begin FUNCTION_LIST KF7-505.26[2] /end FUNCTION_LIST /end MEASUREMENT
/begin MEASUREMENT vMONI2MN_R#9 "(Two bytes) for the diagnosis parameter MIN value monitor" UWORD COMP_0068 1 100 0 65535 ECU_ADDRESS 0xFFFFAA76 /begin FUNCTION_LIST KF7-505.26[2] /end FUNCTION_LIST /end MEASUREMENT
/begin MEASUREMENT vMONI2MN_R#10 "(Two bytes) for the diagnosis parameter MIN value monitor" UWORD COMP_0068 1 100 0 65535 ECU_ADDRESS 0xFFFFAA78 /begin FUNCTION_LIST KF7-505.26[2] /end FUNCTION_LIST /end MEASUREMENT
/begin MEASUREMENT vMONI2MN_R#11 "(Two bytes) for the diagnosis parameter MIN value monitor" UWORD COMP_0068 1 100 0 65535 ECU_ADDRESS 0xFFFFAA7A /begin FUNCTION_LIST KF7-505.26[2] /end FUNCTION_LIST /end MEASUREMENT
/begin MEASUREMENT vMONI2MN_R#12 "(Two bytes) for the diagnosis parameter MIN value monitor" UWORD COMP_0068 1 100 0 65535 ECU_ADDRESS 0xFFFFAA7C /begin FUNCTION_LIST KF7-505.26[2] /end FUNCTION_LIST /end MEASUREMENT
/begin MEASUREMENT vMONI2MN_R#13 "(Two bytes) for the diagnosis parameter MIN value monitor" UWORD COMP_0068 1 100 0 65535 ECU_ADDRESS 0xFFFFAA7E /begin FUNCTION_LIST KF7-505.26[2] /end FUNCTION_LIST /end MEASUREMENT
/begin MEASUREMENT vMONI2MN_R#14 "(Two bytes) for the diagnosis parameter MIN value monitor" UWORD COMP_0068 1 100 0 65535 ECU_ADDRESS 0xFFFFAA80 /begin FUNCTION_LIST KF7-505.26[2] /end FUNCTION_LIST /end MEASUREMENT
/begin MEASUREMENT vMONI2MN_R#15 "(Two bytes) for the diagnosis parameter MIN value monitor" UWORD COMP_0068 1 100 0 65535 ECU_ADDRESS 0xFFFFAA82 /begin FUNCTION_LIST KF7-505.26[2] /end FUNCTION_LIST /end MEASUREMENT
/begin MEASUREMENT vMONI2MN_R#16 "(Two bytes) for the diagnosis parameter MIN value monitor" UWORD COMP_0068 1 100 0 65535 ECU_ADDRESS 0xFFFFAA84 /begin FUNCTION_LIST KF7-505.26[2] /end FUNCTION_LIST /end MEASUREMENT
/begin MEASUREMENT vMONI2MX "(Two bytes) for the diagnosis parameter MAX value monitor" UWORD COMP_0068 1 100 0 65535 ECU_ADDRESS 0xFFFFAA86 /begin FUNCTION_LIST KF7-505.26[2] /end FUNCTION_LIST /end MEASUREMENT
/begin MEASUREMENT vMONI2MX_R#1 "(Two bytes) for the diagnosis parameter MAX value monitor" UWORD COMP_0068 1 100 0 65535 ECU_ADDRESS 0xFFFFAA86 /begin FUNCTION_LIST KF7-505.26[2] /end FUNCTION_LIST /end MEASUREMENT
/begin MEASUREMENT vMONI2MX_R#2 "(Two bytes) for the diagnosis parameter MAX value monitor" UWORD COMP_0068 1 100 0 65535 ECU_ADDRESS 0xFFFFAA88 /begin FUNCTION_LIST KF7-505.26[2] /end FUNCTION_LIST /end MEASUREMENT
/begin MEASUREMENT vMONI2MX_R#3 "(Two bytes) for the diagnosis parameter MAX value monitor" UWORD COMP_0068 1 100 0 65535 ECU_ADDRESS 0xFFFFAA8A /begin FUNCTION_LIST KF7-505.26[2] /end FUNCTION_LIST /end MEASUREMENT
/begin MEASUREMENT vMONI2MX_R#4 "(Two bytes) for the diagnosis parameter MAX value monitor" UWORD COMP_0068 1 100 0 65535 ECU_ADDRESS 0xFFFFAA8C /begin FUNCTION_LIST KF7-505.26[2] /end FUNCTION_LIST /end MEASUREMENT
/begin MEASUREMENT vMONI2MX_R#5 "(Two bytes) for the diagnosis parameter MAX value monitor" UWORD COMP_0068 1 100 0 65535 ECU_ADDRESS 0xFFFFAA8E /begin FUNCTION_LIST KF7-505.26[2] /end FUNCTION_LIST /end MEASUREMENT
/begin MEASUREMENT vMONI2MX_R#6 "(Two bytes) for the diagnosis parameter MAX value monitor" UWORD COMP_0068 1 100 0 65535 ECU_ADDRESS 0xFFFFAA90 /begin FUNCTION_LIST KF7-505.26[2] /end FUNCTION_LIST /end MEASUREMENT
/begin MEASUREMENT vMONI2MX_R#7 "(Two bytes) for the diagnosis parameter MAX value monitor" UWORD COMP_0068 1 100 0 65535 ECU_ADDRESS 0xFFFFAA92 /begin FUNCTION_LIST KF7-505.26[2] /end FUNCTION_LIST /end MEASUREMENT
/begin MEASUREMENT vMONI2MX_R#8 "(Two bytes) for the diagnosis parameter MAX value monitor" UWORD COMP_0068 1 100 0 65535 ECU_ADDRESS 0xFFFFAA94 /begin FUNCTION_LIST KF7-505.26[2] /end FUNCTION_LIST /end MEASUREMENT
/begin MEASUREMENT vMONI2MX_R#9 "(Two bytes) for the diagnosis parameter MAX value monitor" UWORD COMP_0068 1 100 0 65535 ECU_ADDRESS 0xFFFFAA96 /begin FUNCTION_LIST KF7-505.26[2] /end FUNCTION_LIST /end MEASUREMENT
/begin MEASUREMENT vMONI2MX_R#10 "(Two bytes) for the diagnosis parameter MAX value monitor" UWORD COMP_0068 1 100 0 65535 ECU_ADDRESS 0xFFFFAA98 /begin FUNCTION_LIST KF7-505.26[2] /end FUNCTION_LIST /end MEASUREMENT
/begin MEASUREMENT vMONI2MX_R#11 "(Two bytes) for the diagnosis parameter MAX value monitor" UWORD COMP_0068 1 100 0 65535 ECU_ADDRESS 0xFFFFAA9A /begin FUNCTION_LIST KF7-505.26[2] /end FUNCTION_LIST /end MEASUREMENT
/begin MEASUREMENT vMONI2MX_R#12 "(Two bytes) for the diagnosis parameter MAX value monitor" UWORD COMP_0068 1 100 0 65535 ECU_ADDRESS 0xFFFFAA9C /begin FUNCTION_LIST KF7-505.26[2] /end FUNCTION_LIST /end MEASUREMENT
/begin MEASUREMENT vMONI2MX_R#13 "(Two bytes) for the diagnosis parameter MAX value monitor" UWORD COMP_0068 1 100 0 65535 ECU_ADDRESS 0xFFFFAA9E /begin FUNCTION_LIST KF7-505.26[2] /end FUNCTION_LIST /end MEASUREMENT
/begin MEASUREMENT vMONI2MX_R#14 "(Two bytes) for the diagnosis parameter MAX value monitor" UWORD COMP_0068 1 100 0 65535 ECU_ADDRESS 0xFFFFAAA0 /begin FUNCTION_LIST KF7-505.26[2] /end FUNCTION_LIST /end MEASUREMENT
/begin MEASUREMENT vMONI2MX_R#15 "(Two bytes) for the diagnosis parameter MAX value monitor" UWORD COMP_0068 1 100 0 65535 ECU_ADDRESS 0xFFFFAAA2 /begin FUNCTION_LIST KF7-505.26[2] /end FUNCTION_LIST /end MEASUREMENT
/begin MEASUREMENT vMONI2MX_R#16 "(Two bytes) for the diagnosis parameter MAX value monitor" UWORD COMP_0068 1 100 0 65535 ECU_ADDRESS 0xFFFFAAA4 /begin FUNCTION_LIST KF7-505.26[2] /end FUNCTION_LIST /end MEASUREMENT
/begin MEASUREMENT vMXDAFMX "Former A/F sensor rich lean response deterioration diagnosis GDAFMAX maximum value" UWORD COMP_0385_S 1 100 0 262.14 ECU_ADDRESS 0xFFFFAABC /begin FUNCTION_LIST KF7-500.74[11] /end FUNCTION_LIST /end MEASUREMENT
/begin MEASUREMENT vNEUTCNT "NEUT SW On sticking diagnosis counter" UWORD COMP_0049 1 100 0 65535 ECU_ADDRESS 0xFFFFAB3C /begin FUNCTION_LIST KF7-505.23[2] KF7-505.26[2] /end FUNCTION_LIST /end MEASUREMENT
/begin MEASUREMENT vNEUTMAX "NEUTCNT maximum value" UWORD COMP_0049 1 100 0 65535 ECU_ADDRESS 0xFFFFAB3E /begin FUNCTION_LIST KF7-505.26[2] /end FUNCTION_LIST /end MEASUREMENT
/begin MEASUREMENT vNGBAF "At the time of the former A/F sensor rich lean response deterioration diagnosis NG judgement, AFSAF time series data" UWORD COMP_0453 1 100 0 131.07 ECU_ADDRESS 0xFFFFAB40 /begin FUNCTION_LIST KF7-500.74[11] /end FUNCTION_LIST /end MEASUREMENT
/begin MEASUREMENT vNGBDAF "At the time of the former A/F sensor rich lean response deterioration diagnosis NG judgement, DABF time series data" SWORD COMP_0384_S 1 100 -131.072 131.068 ECU_ADDRESS 0xFFFFABE0 /begin FUNCTION_LIST KF7-500.74[11] /end FUNCTION_LIST /end MEASUREMENT
/begin MEASUREMENT vNGBDMX "At the time of the former A/F sensor rich lean response deterioration diagnosis NG judgement, GDAFMAX time series data" UWORD COMP_0385_S 1 100 0 262.14 ECU_ADDRESS 0xFFFFAC80 /begin FUNCTION_LIST KF7-500.74[11] /end FUNCTION_LIST /end MEASUREMENT
/begin MEASUREMENT vNGBNTP "At the time of the former A/F sensor rich lean response deterioration diagnosis NG judgement, NTP backup data" UWORD COMP_0434_S 1 100 0 12799.8046875 ECU_ADDRESS 0xFFFFAC84 /begin FUNCTION_LIST KF7-500.74[11] /end FUNCTION_LIST /end MEASUREMENT
/begin MEASUREMENT vNGBRPM "At the time of the former A/F sensor rich lean response deterioration diagnosis NG judgement, MNRPM time series data" UBYTE COMP_0000 1 100 0 6375 ECU_ADDRESS 0xFFFFAC88 /begin FUNCTION_LIST KF7-500.74[11] /end FUNCTION_LIST /end MEASUREMENT
/begin MEASUREMENT vNGBTP "At the time of the former A/F sensor rich lean response deterioration diagnosis NG judgement, TP time series data" UWORD COMP_0144 1 100 0 31.999495335 ECU_ADDRESS 0xFFFFACDA /begin FUNCTION_LIST KF7-500.74[11] /end FUNCTION_LIST /end MEASUREMENT
/begin MEASUREMENT vNGBVSP "At the time of the former A/F sensor rich lean response deterioration diagnosis NG judgement, VSP time series data" UBYTE COMP_0007 1 100 0 510 ECU_ADDRESS 0xFFFFAD7B /begin FUNCTION_LIST KF7-500.74[11] /end FUNCTION_LIST /end MEASUREMENT
/begin MEASUREMENT vNGDMAX "At the time of the NG judgement, delta-A/F maximum value" SWORD COMP_0384_S 1 100 -131.072 131.068 ECU_ADDRESS 0xFFFFADCC /begin FUNCTION_LIST KF7-500.74[11] /end FUNCTION_LIST /end MEASUREMENT
/begin MEASUREMENT vNGDMIN "At the time of the NG judgement, delta-A/F minimum value" SWORD COMP_0384_S 1 100 -131.072 131.068 ECU_ADDRESS 0xFFFFADD0 /begin FUNCTION_LIST KF7-500.74[11] /end FUNCTION_LIST /end MEASUREMENT
/begin MEASUREMENT vNGHZNTP "At the time of the NG judgement, at the time of delta-A/F maximum value computation, NÅ~TP" UWORD COMP_0434_S 1 100 0 12799.8046875 ECU_ADDRESS 0xFFFFADD4 /begin FUNCTION_LIST KF7-500.74[11] /end FUNCTION_LIST /end MEASUREMENT
/begin MEASUREMENT vNGRVNTP "At the time of the NG judgement, NÅ~TP maximum value" UWORD COMP_0434_S 1 100 0 12799.8046875 ECU_ADDRESS 0xFFFFADDA /begin FUNCTION_LIST KF7-500.74[11] /end FUNCTION_LIST /end MEASUREMENT
/begin MEASUREMENT vNMDAFMX "The former A/F sensor rich lean response deterioration diagnosis parameter acquisition number of times" UWORD COMP_0068 1 100 0 65535 ECU_ADDRESS 0xFFFFAE02 /begin FUNCTION_LIST KF7-500.74[11] /end FUNCTION_LIST /end MEASUREMENT
/begin MEASUREMENT vNTPLMAX "In F/C, NÅ~TP maximum value" UWORD COMP_0434_S 1 100 0 12799.8046875 ECU_ADDRESS 0xFFFF3028 /begin FUNCTION_LIST KF7-500.74[11] /end FUNCTION_LIST /end MEASUREMENT
/begin MEASUREMENT vNTPMAX "In F/C, NÅ~TP maximum value" UWORD COMP_0434_S 1 100 0 12799.8046875 ECU_ADDRESS 0xFFFF302C /begin FUNCTION_LIST KF7-500.74[11] /end FUNCTION_LIST /end MEASUREMENT
/begin MEASUREMENT vNTPMIN "In F/C, NÅ~TP minimum value" UWORD COMP_0434_S 1 100 0 12799.8046875 ECU_ADDRESS 0xFFFF3030 /begin FUNCTION_LIST KF7-500.74[11] /end FUNCTION_LIST /end MEASUREMENT
/begin MEASUREMENT vNTPST "At the time of the F/C start, NÅ~TP" UWORD COMP_0434_S 1 100 0 12799.8046875 ECU_ADDRESS 0xFFFF3034 /begin FUNCTION_LIST KF7-500.74[11] /end FUNCTION_LIST /end MEASUREMENT
/begin MEASUREMENT vO2AVMIN "Unusual voltage NG continuation time (minimum value)" UBYTE COMP_0008 1 100 0 25500 ECU_ADDRESS 0xFFFFAE66 /begin FUNCTION_LIST KF7-505.26[2] /end FUNCTION_LIST /end MEASUREMENT
/begin MEASUREMENT vO2AVMIN_R#1 "Unusual voltage NG continuation time (minimum value)" UBYTE COMP_0008 1 100 0 25500 ECU_ADDRESS 0xFFFFAE66 /begin FUNCTION_LIST KF7-505.26[2] /end FUNCTION_LIST /end MEASUREMENT
/begin MEASUREMENT vO2AVMIN_R#2 "Unusual voltage NG continuation time (minimum value)" UBYTE COMP_0008 1 100 0 25500 ECU_ADDRESS 0xFFFFAE67 /begin FUNCTION_LIST KF7-505.26[2] /end FUNCTION_LIST /end MEASUREMENT
/begin MEASUREMENT vO2JNMIN "Breakage diagnosis NG continuation time (minimum value)" UBYTE COMP_0013 1 100 0 255 ECU_ADDRESS 0xFFFFAE68 /begin FUNCTION_LIST KF7-505.26[2] /end FUNCTION_LIST /end MEASUREMENT
/begin MEASUREMENT vO2JNMIN_R#1 "Breakage diagnosis NG continuation time (minimum value)" UBYTE COMP_0013 1 100 0 255 ECU_ADDRESS 0xFFFFAE68 /begin FUNCTION_LIST KF7-505.26[2] /end FUNCTION_LIST /end MEASUREMENT
/begin MEASUREMENT vO2JNMIN_R#2 "Breakage diagnosis NG continuation time (minimum value)" UBYTE COMP_0013 1 100 0 255 ECU_ADDRESS 0xFFFFAE69 /begin FUNCTION_LIST KF7-505.26[2] /end FUNCTION_LIST /end MEASUREMENT
/begin MEASUREMENT vOERROR2 "The amount of operation corner deviation" UBYTE COMP_0257 1 100 -128 127 ECU_ADDRESS 0xFFFF1616 /begin FUNCTION_LIST KF7-500.47B[15] /end FUNCTION_LIST /end MEASUREMENT
/begin MEASUREMENT vOERROR2_R#1 "The amount of operation corner deviation" UBYTE COMP_0257 1 100 -128 127 ECU_ADDRESS 0xFFFF1616 /begin FUNCTION_LIST KF7-500.47B[15] /end FUNCTION_LIST /end MEASUREMENT
/begin MEASUREMENT vOERROR2_R#2 "The amount of operation corner deviation" UBYTE COMP_0257 1 100 -128 127 ECU_ADDRESS 0xFFFF1617 /begin FUNCTION_LIST KF7-500.47B[15] /end FUNCTION_LIST /end MEASUREMENT
/begin MEASUREMENT vOKDMAX "At the time of OK judgement, delta-A/F maximum value" SWORD COMP_0384_S 1 100 -131.072 131.068 ECU_ADDRESS 0xFFFFAE70 /begin FUNCTION_LIST KF7-500.74[11] /end FUNCTION_LIST /end MEASUREMENT
/begin MEASUREMENT vOKDMIN "At the time of OK judgement, delta-A/F minimum value" SWORD COMP_0384_S 1 100 -131.072 131.068 ECU_ADDRESS 0xFFFFAE74 /begin FUNCTION_LIST KF7-500.74[11] /end FUNCTION_LIST /end MEASUREMENT
/begin MEASUREMENT vOKHZNTP "At the time of OK judgement, at the time of delta-A/F maximum value computation, NÅ~TP" UWORD COMP_0434_S 1 100 0 12799.8046875 ECU_ADDRESS 0xFFFFAE78 /begin FUNCTION_LIST KF7-500.74[11] /end FUNCTION_LIST /end MEASUREMENT
/begin MEASUREMENT vOKRVNTP "At the time of OK judgement, NÅ~TP maximum value" UWORD COMP_0434_S 1 100 0 12799.8046875 ECU_ADDRESS 0xFFFFAE7C /begin FUNCTION_LIST KF7-500.74[11] /end FUNCTION_LIST /end MEASUREMENT
/begin MEASUREMENT vOVLTPO "The amount of lower limit regulation under" UWORD COMP_0005 1 100 0 7208.85 ECU_ADDRESS 0xFFFF305A /begin FUNCTION_LIST KF7-505.15[4] /end FUNCTION_LIST /end MEASUREMENT
/begin MEASUREMENT vOVUTPO "The amount of upper limit regulation overcoat" UWORD COMP_0005 1 100 0 7208.85 ECU_ADDRESS 0xFFFF305E /begin FUNCTION_LIST KF7-505.15[4] /end FUNCTION_LIST /end MEASUREMENT
/begin MEASUREMENT vPMCPRES1 "Parameter monitor RAM" UBYTE COMP_0016 1 100 0 255 ECU_ADDRESS 0xFFFFAEBC /begin FUNCTION_LIST KF7-500.51[3] /end FUNCTION_LIST /end MEASUREMENT
/begin MEASUREMENT vPMTPRES1 "Parameter monitor RAM" UBYTE COMP_0013 1 100 0 255 ECU_ADDRESS 0xFFFFAEC3 /begin FUNCTION_LIST KF7-500.51[3] /end FUNCTION_LIST /end MEASUREMENT
/begin MEASUREMENT vPMTPRES2 "Parameter monitor RAM" UBYTE COMP_0013 1 100 0 255 ECU_ADDRESS 0xFFFFAEC4 /begin FUNCTION_LIST KF7-500.51[3] /end FUNCTION_LIST /end MEASUREMENT
/begin MEASUREMENT vPMVPRES "Parameter monitor RAM" UWORD COMP_0486 1 100 0 5119.921875 ECU_ADDRESS 0xFFFFAEC8 /begin FUNCTION_LIST KF7-500.51[3] /end FUNCTION_LIST /end MEASUREMENT
/begin MEASUREMENT vQATHMO "QA unit conversion value for the thermostat diagnosis" UBYTE COMP_0004 1 100 0 255 ECU_ADDRESS 0xFFFF16B8 /begin FUNCTION_LIST KF7-500.60[5] /end FUNCTION_LIST /end MEASUREMENT
/begin MEASUREMENT vQATHMR "After compensation for the thermostat diagnosis, QA" UBYTE COMP_0004 1 100 0 255 ECU_ADDRESS 0xFFFF30D8 /begin FUNCTION_LIST KF7-500.60[5] /end FUNCTION_LIST /end MEASUREMENT
/begin MEASUREMENT vQUST8 "A question data from the watch IC" UBYTE COMP_0068 1 100 0 255 ECU_ADDRESS 0xFFFF30E0 /begin FUNCTION_LIST KF7-505.41[2] /end FUNCTION_LIST /end MEASUREMENT
/begin MEASUREMENT vRANGDDLY "High speed RAM diagnosis NG delay (going down counter)" UBYTE COMP_0014 1 100 0 2550 ECU_ADDRESS 0xFFFF30E8 /begin FUNCTION_LIST KF7-505.36[2] /end FUNCTION_LIST /end MEASUREMENT
/begin MEASUREMENT vRANGUDLY "High speed RAM diagnosis NG delay (rise counter)" UBYTE COMP_0014 1 100 0 2550 ECU_ADDRESS 0xFFFF30E9 /begin FUNCTION_LIST KF7-505.36[2] /end FUNCTION_LIST /end MEASUREMENT
/begin MEASUREMENT vRCVNTP "At the time of the F/C recover, NÅ~TP maximum value" UWORD COMP_0434_S 1 100 0 12799.8046875 ECU_ADDRESS 0xFFFF30FC /begin FUNCTION_LIST KF7-500.74[11] /end FUNCTION_LIST /end MEASUREMENT
/begin MEASUREMENT vRLDGCNT "Relay diagnosis counter" UBYTE COMP_0068 1 100 0 255 ECU_ADDRESS 0xFFFF3E54 /begin FUNCTION_LIST KF7-505.31[5] /end FUNCTION_LIST /end MEASUREMENT
/begin MEASUREMENT vSFTTVOL "After it deals with a time shift, lower limit open-degree" UWORD COMP_0005 1 100 0 7208.85 ECU_ADDRESS 0xFFFF31C8 /begin FUNCTION_LIST KF7-505.15[4] /end FUNCTION_LIST /end MEASUREMENT
/begin MEASUREMENT vSFTTVOU "After it deals with a time shift, upper limit open-degree" UWORD COMP_0005 1 100 0 7208.85 ECU_ADDRESS 0xFFFF31CA /begin FUNCTION_LIST KF7-505.15[4] /end FUNCTION_LIST /end MEASUREMENT
/begin MEASUREMENT vSM2DAFM "Former A/F sensor rich lean response deterioration diagnosis GDAFMAX square peace" ULONG COMP_0373 1 100 0 42949672.95 ECU_ADDRESS 0xFFFFB018 /begin FUNCTION_LIST KF7-500.74[11] /end FUNCTION_LIST /end MEASUREMENT
/begin MEASUREMENT vSMDAFMX "Former A/F sensor rich lean response deterioration diagnosis GDAFMAX integration value" ULONG COMP_0385_S 1 100 0 17179869.18 ECU_ADDRESS 0xFFFFB11C /begin FUNCTION_LIST KF7-500.74[11] /end FUNCTION_LIST /end MEASUREMENT
/begin MEASUREMENT vSSFMAX "SSFCNT maximum value" UBYTE COMP_0016 1 100 0 255 ECU_ADDRESS 0xFFFFB22F /begin FUNCTION_LIST KF7-505.26[2] /end FUNCTION_LIST /end MEASUREMENT
/begin MEASUREMENT vSTVOOV "Regulation overcoat integration value" UWORD COMP_0296 1 100 0 72.0885 ECU_ADDRESS 0xFFFF321E /begin FUNCTION_LIST KF7-505.15[4] KF7-505.26[2] /end FUNCTION_LIST /end MEASUREMENT
/begin MEASUREMENT vSTVOOV2 "Lower limit regulation overcoat integration value" UWORD COMP_0296 1 100 0 72.0885 ECU_ADDRESS 0xFFFF3220 /begin FUNCTION_LIST KF7-505.15[4] KF7-505.26[2] /end FUNCTION_LIST /end MEASUREMENT
/begin MEASUREMENT vSUQATH "After the start, QATHMO integration value" UWORD COMP_0013 1 100 0 65535 ECU_ADDRESS 0xFFFF17E0 /begin FUNCTION_LIST KF7-500.60[5] /end FUNCTION_LIST /end MEASUREMENT
/begin MEASUREMENT vSUQIVL "Between 60 s, QATHMO integration value" UWORD COMP_0004 1 100 0 65535 ECU_ADDRESS 0xFFFF3254 /begin FUNCTION_LIST KF7-500.60[5] /end FUNCTION_LIST /end MEASUREMENT
/begin MEASUREMENT vT12M "2mS JOB diagnosis counter (TASKD1)" UBYTE COMP_0014 1 100 0 2550 ECU_ADDRESS 0xFFFF1F1A /begin FUNCTION_LIST KF7-505.19[1] /end FUNCTION_LIST /end MEASUREMENT
/begin MEASUREMENT vT14M "4mS JOB diagnosis counter (TASKD1)" UBYTE COMP_0014 1 100 0 2550 ECU_ADDRESS 0xFFFF1F1B /begin FUNCTION_LIST KF7-505.19[1] /end FUNCTION_LIST /end MEASUREMENT
/begin MEASUREMENT vT210MB "10mS BGJ diagnosis counter (TASKD2)" UBYTE COMP_0030 1 100 0 255 ECU_ADDRESS 0xFFFF17E2 /begin FUNCTION_LIST KF7-505.19[1] /end FUNCTION_LIST /end MEASUREMENT
/begin MEASUREMENT vT210MJ "10mS JOB diagnosis counter (TASKD2)" UBYTE COMP_0030 1 100 0 255 ECU_ADDRESS 0xFFFF1F1C /begin FUNCTION_LIST KF7-505.19[1] /end FUNCTION_LIST /end MEASUREMENT
/begin MEASUREMENT vT22M "2mS JOB diagnosis counter (TASKD2)" UBYTE COMP_0030 1 100 0 255 ECU_ADDRESS 0xFFFF1D2C /begin FUNCTION_LIST KF7-505.19[1] /end FUNCTION_LIST /end MEASUREMENT
/begin MEASUREMENT vT24M "4mS JOB diagnosis counter (TASKD2)" UBYTE COMP_0030 1 100 0 255 ECU_ADDRESS 0xFFFF1DCC /begin FUNCTION_LIST KF7-505.19[1] /end FUNCTION_LIST /end MEASUREMENT
/begin MEASUREMENT vTANCNT "Intake air temperature diagnosis complete counter" UWORD COMP_0016 1 100 0 65535 ECU_ADDRESS 0xFFFFB23C /begin FUNCTION_LIST KF7-500.44[3] KF7-580.1[8] /end FUNCTION_LIST /end MEASUREMENT
/begin MEASUREMENT vTCLK "IC3 output diagnosis clock period" UWORD COMP_0159_S 1 100 0 209712 ECU_ADDRESS 0xFFFF4084 /begin FUNCTION_LIST KF7-505.37[1] /end FUNCTION_LIST /end MEASUREMENT
/begin MEASUREMENT vTCLK1 "IC3 output diagnosis clock periodic previous value" UWORD COMP_0159_S 1 100 0 209712 ECU_ADDRESS 0xFFFF3F40 /begin FUNCTION_LIST KF7-505.37[1] /end FUNCTION_LIST /end MEASUREMENT
/begin MEASUREMENT vTCLK2 "IC3 output diagnosis clock period, this time, value" UWORD COMP_0159_S 1 100 0 209712 ECU_ADDRESS 0xFFFF3F42 /begin FUNCTION_LIST KF7-505.37[1] /end FUNCTION_LIST /end MEASUREMENT
/begin MEASUREMENT vTCLMAX "IC3 output diagnosis clock period MAX value" UWORD COMP_0159_S 1 100 0 209712 ECU_ADDRESS 0xFFFFB64E /begin FUNCTION_LIST KF7-505.37[1] /end FUNCTION_LIST /end MEASUREMENT
/begin MEASUREMENT vTCLMIN "IC3 output diagnosis clock period MIN value" UWORD COMP_0159_S 1 100 0 209712 ECU_ADDRESS 0xFFFFB650 /begin FUNCTION_LIST KF7-505.37[1] /end FUNCTION_LIST /end MEASUREMENT
/begin MEASUREMENT vTDGMIN "Timer MIN value for the operation result collation function diagnosis NG judgement" UBYTE COMP_0014 1 100 0 2550 ECU_ADDRESS 0xFFFFB241 /begin FUNCTION_LIST KF7-505.42[2] /end FUNCTION_LIST /end MEASUREMENT
/begin MEASUREMENT vTGTVOSPR "At the time of the return spring abnormality diagnosis, target throttle open-degree order value" UWORD COMP_0005 1 100 0 7208.85 ECU_ADDRESS 0xFFFF3F4C /begin FUNCTION_LIST KF7-505.33[8] /end FUNCTION_LIST /end MEASUREMENT
/begin MEASUREMENT vTHMOCNT "Thermostat diagnosis RATE counter" UWORD COMP_0016 1 100 0 65535 ECU_ADDRESS 0xFFFFB264 /begin FUNCTION_LIST KF7-500.60[5] KF7-580.1[8] /end FUNCTION_LIST /end MEASUREMENT
/begin MEASUREMENT vTHQACR "QA A/C compensation value for the thermostat diagnosis" UBYTE COMP_0004 1 100 0 255 ECU_ADDRESS 0xFFFF3326 /begin FUNCTION_LIST KF7-500.60[5] /end FUNCTION_LIST /end MEASUREMENT
/begin MEASUREMENT vTHQATH "A fever quantity judgement value" UBYTE COMP_0004 1 100 0 255 ECU_ADDRESS 0xFFFF3327 /begin FUNCTION_LIST KF7-500.60[5] /end FUNCTION_LIST /end MEASUREMENT
/begin MEASUREMENT vTHVSPR "QA vehicle speed compensation value for the thermostat diagnosis" UBYTE COMP_0009 1 100 0 199.21875 ECU_ADDRESS 0xFFFF3329 /begin FUNCTION_LIST KF7-500.60[5] /end FUNCTION_LIST /end MEASUREMENT
/begin MEASUREMENT vTIMTHM "Coolant temperature convergent judgement timer" UBYTE COMP_0013 1 100 0 255 ECU_ADDRESS 0xFFFF332F /begin FUNCTION_LIST KF7-500.60[5] /end FUNCTION_LIST /end MEASUREMENT
/begin MEASUREMENT vTK1J2MX "2mS JOB diagnosis counter (TASKD1) MAX value" UBYTE COMP_0014 1 100 0 2550 ECU_ADDRESS 0xFFFFB652 /begin FUNCTION_LIST KF7-505.19[1] /end FUNCTION_LIST /end MEASUREMENT
/begin MEASUREMENT vTK1J4MX "4mS JOB diagnosis counter (TASKD1) MAX value" UBYTE COMP_0014 1 100 0 2550 ECU_ADDRESS 0xFFFFB653 /begin FUNCTION_LIST KF7-505.19[1] /end FUNCTION_LIST /end MEASUREMENT
/begin MEASUREMENT vTK2B10X "10mS BGJ diagnosis counter (TASKD2) MAX value" UBYTE COMP_0030 1 100 0 255 ECU_ADDRESS 0xFFFFB542 /begin FUNCTION_LIST KF7-505.19[1] /end FUNCTION_LIST /end MEASUREMENT
/begin MEASUREMENT vTK2J10X "10mS JOB diagnosis counter (TASKD2) MAX value" UBYTE COMP_0030 1 100 0 255 ECU_ADDRESS 0xFFFFB543 /begin FUNCTION_LIST KF7-505.19[1] /end FUNCTION_LIST /end MEASUREMENT
/begin MEASUREMENT vTK2J2MX "2mS JOB diagnosis counter (TASKD2) MAX value" UBYTE COMP_0030 1 100 0 255 ECU_ADDRESS 0xFFFFB544 /begin FUNCTION_LIST KF7-505.19[1] /end FUNCTION_LIST /end MEASUREMENT
/begin MEASUREMENT vTK2J4MX "4mS JOB diagnosis counter (TASKD2) MAX value" UBYTE COMP_0030 1 100 0 255 ECU_ADDRESS 0xFFFFB545 /begin FUNCTION_LIST KF7-505.19[1] /end FUNCTION_LIST /end MEASUREMENT
/begin MEASUREMENT vTMSRVNG2 "Servo error diagnosis timer 2" UWORD COMP_0014 1 100 0 655350 ECU_ADDRESS 0xFFFF337A /begin FUNCTION_LIST KF7-505.26[2] KF7-505.32[6] /end FUNCTION_LIST /end MEASUREMENT
/begin MEASUREMENT vTOQATH "Monitor start QATHMO integration value" UWORD COMP_0004 1 100 0 65535 ECU_ADDRESS 0xFFFF3382 /begin FUNCTION_LIST KF7-500.60[5] /end FUNCTION_LIST /end MEASUREMENT
/begin MEASUREMENT vTPO1_S "Throttle open-degree" UWORD COMP_0005 1 100 0 7208.85 ECU_ADDRESS 0xFFFF37C6 /begin FUNCTION_LIST KF7-525.2S[10] /end FUNCTION_LIST /end MEASUREMENT
/begin MEASUREMENT vTPOAVE "Throttle open-degree 1 mean" UWORD COMP_0164_S 1 100 -14.08205 98.55623125 ECU_ADDRESS 0xFFFF3F72 /begin FUNCTION_LIST KF7-505.33[8] /end FUNCTION_LIST /end MEASUREMENT
/begin MEASUREMENT vTPOAVEold "The value before 10mS of TPOAVE" UWORD COMP_0168_S 1 100 0 112.63828125 ECU_ADDRESS 0xFFFF3F74 /begin FUNCTION_LIST KF7-505.33[8] /end FUNCTION_LIST /end MEASUREMENT
/begin MEASUREMENT vTPS1V_S "Throttle sensor 1 voltage" UWORD COMP_0061 1 100 0 327675 ECU_ADDRESS 0xFFFF35F6 /begin FUNCTION_LIST KF7-505.38[4] /end FUNCTION_LIST /end MEASUREMENT
/begin MEASUREMENT vTRGCHG "A target angle change rate for the drive abnormality diagnosis" UBYTE COMP_0048 1 100 0 127.5 ECU_ADDRESS 0xFFFF19B3 /begin FUNCTION_LIST KF7-500.47B[15] /end FUNCTION_LIST /end MEASUREMENT
/begin MEASUREMENT vTRGLVL "FFD writing level" UBYTE COMP_0004 1 100 0 255 ECU_ADDRESS 0xFFFFB655 /begin FUNCTION_LIST KF7-525.1[4] /end FUNCTION_LIST /end MEASUREMENT
/begin MEASUREMENT vTRGTIM "After a change in a target operation angle, progress time" UBYTE COMP_0008 1 100 0 25500 ECU_ADDRESS 0xFFFF19BA /begin FUNCTION_LIST KF7-500.47B[15] /end FUNCTION_LIST /end MEASUREMENT
/begin MEASUREMENT vTRGTIM_R#1 "After a change in a target operation angle, progress time" UBYTE COMP_0008 1 100 0 25500 ECU_ADDRESS 0xFFFF19BA /begin FUNCTION_LIST KF7-500.47B[15] /end FUNCTION_LIST /end MEASUREMENT
/begin MEASUREMENT vTRGTIM_R#2 "After a change in a target operation angle, progress time" UBYTE COMP_0008 1 100 0 25500 ECU_ADDRESS 0xFFFF19BB /begin FUNCTION_LIST KF7-500.47B[15] /end FUNCTION_LIST /end MEASUREMENT
/begin MEASUREMENT vTTHIVL "Coolant temperature convergent judgement section coefficient counter" UBYTE COMP_0004 1 100 0 255 ECU_ADDRESS 0xFFFF340C /begin FUNCTION_LIST KF7-500.60[5] /end FUNCTION_LIST /end MEASUREMENT
/begin MEASUREMENT vTTWMIN "TTWXNG Minimum value" UBYTE COMP_0014 1 100 0 2550 ECU_ADDRESS 0xFFFFB2AF /begin FUNCTION_LIST KF7-505.10[2] /end FUNCTION_LIST /end MEASUREMENT
/begin MEASUREMENT vTVAPMIN "VAPO un-adjustment judgement time (minimum value)" UBYTE COMP_0014 1 100 0 2550 ECU_ADDRESS 0xFFFFB2B0 /begin FUNCTION_LIST KF7-505.26[2] /end FUNCTION_LIST /end MEASUREMENT
/begin MEASUREMENT vTVSPNG2 "Vehicle speed sensor NG judgement delay timer" UBYTE COMP_0013 1 100 0 255 ECU_ADDRESS 0xFFFF3425 /begin FUNCTION_LIST KF7-505.26[2] /end FUNCTION_LIST /end MEASUREMENT
/begin MEASUREMENT vTWNST "60Å~n s front reference coolant temperature" UBYTE COMP_0035 1 100 -50 205 ECU_ADDRESS 0xFFFF3432 /begin FUNCTION_LIST KF7-500.60[5] /end FUNCTION_LIST /end MEASUREMENT
/begin MEASUREMENT vTWNST_R#1 "60Å~n s front reference coolant temperature" UBYTE COMP_0035 1 100 -50 205 ECU_ADDRESS 0xFFFF3432 /begin FUNCTION_LIST KF7-500.60[5] /end FUNCTION_LIST /end MEASUREMENT
/begin MEASUREMENT vTWNST_R#2 "60Å~n s front reference coolant temperature" UBYTE COMP_0035 1 100 -50 205 ECU_ADDRESS 0xFFFF3433 /begin FUNCTION_LIST KF7-500.60[5] /end FUNCTION_LIST /end MEASUREMENT
/begin MEASUREMENT vTWNST_R#3 "60Å~n s front reference coolant temperature" UBYTE COMP_0035 1 100 -50 205 ECU_ADDRESS 0xFFFF3434 /begin FUNCTION_LIST KF7-500.60[5] /end FUNCTION_LIST /end MEASUREMENT
/begin MEASUREMENT vTWNST_R#4 "60Å~n s front reference coolant temperature" UBYTE COMP_0035 1 100 -50 205 ECU_ADDRESS 0xFFFF3435 /begin FUNCTION_LIST KF7-500.60[5] /end FUNCTION_LIST /end MEASUREMENT
/begin MEASUREMENT vTWNST_R#5 "60Å~n s front reference coolant temperature" UBYTE COMP_0035 1 100 -50 205 ECU_ADDRESS 0xFFFF3436 /begin FUNCTION_LIST KF7-500.60[5] /end FUNCTION_LIST /end MEASUREMENT
/begin MEASUREMENT vTWNTMN "At the time of the start, coolant temperature, at least, value" UBYTE COMP_0035 1 100 -50 205 ECU_ADDRESS 0xFFFF1A44 /begin FUNCTION_LIST KF7-500.60[5] /end FUNCTION_LIST /end MEASUREMENT
/begin MEASUREMENT vTWNTMX "At the time of the start, coolant temperature maximum value" UBYTE COMP_0035 1 100 -50 205 ECU_ADDRESS 0xFFFF1A45 /begin FUNCTION_LIST KF7-500.60[5] /end FUNCTION_LIST /end MEASUREMENT
/begin MEASUREMENT vTWTHST "Coolant temperature reference value for the convergent judgement" UBYTE COMP_0035 1 100 -50 205 ECU_ADDRESS 0xFFFF3437 /begin FUNCTION_LIST KF7-500.60[5] /end FUNCTION_LIST /end MEASUREMENT
/begin MEASUREMENT vUSMAX "At the time of the diagnosis condition formation, US maximum value" UWORD COMP_0023 1 100 0 327675 ECU_ADDRESS 0xFFFFB2BE /begin FUNCTION_LIST KF7-505.26[2] /end FUNCTION_LIST /end MEASUREMENT
/begin MEASUREMENT vUSMIN "At the time of the diagnosis condition formation, US minimum value" UWORD COMP_0023 1 100 0 327675 ECU_ADDRESS 0xFFFFB2C0 /begin FUNCTION_LIST KF7-505.26[2] /end FUNCTION_LIST /end MEASUREMENT
/begin MEASUREMENT vVAPMAX "|VAPO-VAPO_S| maximum value" UWORD COMP_0005 1 100 0 7208.85 ECU_ADDRESS 0xFFFFB2C2 /begin FUNCTION_LIST KF7-505.26[2] /end FUNCTION_LIST /end MEASUREMENT
/begin MEASUREMENT vVBRCHK "Relay trouble VB judgement voltage" UBYTE COMP_0033 1 100 0 20400 ECU_ADDRESS 0xFFFF3FB8 /begin FUNCTION_LIST KF7-505.31[5] /end FUNCTION_LIST /end MEASUREMENT
/begin MEASUREMENT vVPRCHK "Relay trouble judgement voltage" UBYTE COMP_0033 1 100 0 20400 ECU_ADDRESS 0xFFFF3FE8 /begin FUNCTION_LIST KF7-505.31[5] /end FUNCTION_LIST /end MEASUREMENT
/begin MEASUREMENT vVSPGAPM "Vehicle speed sensor error (for the parameter monitor)" UWORD COMP_0436 1 100 0 6553.5 ECU_ADDRESS 0xFFFFB2DC /begin FUNCTION_LIST KF7-505.26[2] KF7-505.49[3] /end FUNCTION_LIST /end MEASUREMENT
/begin MEASUREMENT vVTCNOW2 "An incumbent VTC angle" UBYTE COMP_0257 1 100 -128 127 ECU_ADDRESS 0xFFFF1B70 /begin FUNCTION_LIST KF7-500.47B[15] KF7-580.1[8] /end FUNCTION_LIST /end MEASUREMENT
/begin MEASUREMENT vVTCNOW2_R#1 "An incumbent VTC angle" UBYTE COMP_0257 1 100 -128 127 ECU_ADDRESS 0xFFFF1B70 /begin FUNCTION_LIST KF7-500.47B[15] KF7-580.1[8] /end FUNCTION_LIST /end MEASUREMENT
/begin MEASUREMENT vVTCNOW2_R#2 "An incumbent VTC angle" UBYTE COMP_0257 1 100 -128 127 ECU_ADDRESS 0xFFFF1B71 /begin FUNCTION_LIST KF7-500.47B[15] KF7-580.1[8] /end FUNCTION_LIST /end MEASUREMENT
/begin MEASUREMENT vVTCSOL "The judgement counter whose solenoid diagnosis is unusual" UBYTE COMP_0030 1 100 0 255 ECU_ADDRESS 0xFFFF34B7 /begin FUNCTION_LIST KF7-500.47B[15] /end FUNCTION_LIST /end MEASUREMENT
/begin MEASUREMENT vVTCSOL_R#1 "The judgement counter whose solenoid diagnosis is unusual" UBYTE COMP_0030 1 100 0 255 ECU_ADDRESS 0xFFFF34B7 /begin FUNCTION_LIST KF7-500.47B[15] /end FUNCTION_LIST /end MEASUREMENT
/begin MEASUREMENT vVTCSOL_R#2 "The judgement counter whose solenoid diagnosis is unusual" UBYTE COMP_0030 1 100 0 255 ECU_ADDRESS 0xFFFF34B8 /begin FUNCTION_LIST KF7-500.47B[15] /end FUNCTION_LIST /end MEASUREMENT
/begin MEASUREMENT vVTCTRG2 "VTC target angle (for the P-gain)" UBYTE COMP_0257 1 100 -128 127 ECU_ADDRESS 0xFFFF1048 /begin FUNCTION_LIST KF7-500.47B[15] KF7-580.1[8] /end FUNCTION_LIST /end MEASUREMENT
/begin MEASUREMENT vWDTNGCM "vWDTNGC memory" UBYTE COMP_0030 1 100 0 255 ECU_ADDRESS 0xFFFF400D /begin FUNCTION_LIST KF7-505.18[3] /end FUNCTION_LIST /end MEASUREMENT
/begin MEASUREMENT wvAPOFSR_S "Accelerator pedal ratio (vice-operation part)" UWORD COMP_0362_S 1 100 0 8191.875 ECU_ADDRESS 0xFFFF48A0 /begin FUNCTION_LIST KF7-505.9[3] /end FUNCTION_LIST /end MEASUREMENT
/begin MEASUREMENT wvENGSTRT "After the start, time" ULONG COMP_0008 1 100 0 429496729500 ECU_ADDRESS 0xFFFF8904 /begin FUNCTION_LIST KF7-505.25[3] KF7-505.30[6] /end FUNCTION_LIST /end MEASUREMENT
/begin MEASUREMENT vTRIPRTS "RAM value vTRIPRTS" UBYTE COMP_0068 1 100 0 255 ECU_ADDRESS 0xFFFFB7D0 /begin FUNCTION_LIST KF7-505.31[5] KF7-505.33[8] /end FUNCTION_LIST /end MEASUREMENT
/begin COMPU_METHOD COMP_0205_S "fixed axis Long" RAT_FUNC "%8.2" "Long" COEFFS 0 1 0 0 0 1 /end COMPU_METHOD
/begin COMPU_METHOD COMP_0068 "1-" RAT_FUNC "%8.2" "-" COEFFS 0 1 0 0 0 1 /end COMPU_METHOD
/begin COMPU_METHOD COMP_0004 "1Å|" RAT_FUNC "%8.2" "Å|" COEFFS 0 1 0 0 0 1 /end COMPU_METHOD
/begin COMPU_METHOD COMP_0061 "5mv" RAT_FUNC "%8.2" "mv" COEFFS 0 1 0 0 0 5 /end COMPU_METHOD
/begin COMPU_METHOD COMP_0023 "5mV" RAT_FUNC "%8.2" "mV" COEFFS 0 1 0 0 0 5 /end COMPU_METHOD
/begin COMPU_METHOD COMP_0045 "1/128-" RAT_FUNC "%8.4" "-" COEFFS 0 1 0 0 0 0.0078125 /end COMPU_METHOD
/begin COMPU_METHOD COMP_0001 "1/8ms" RAT_FUNC "%8.2" "ms" COEFFS 0 1 0 0 0 0.125 /end COMPU_METHOD
/begin COMPU_METHOD COMP_0020 "50rpm" RAT_FUNC "%8.2" "rpm" COEFFS 0 1 0 0 0 50 /end COMPU_METHOD
/begin COMPU_METHOD COMP_0003 "1Åé" RAT_FUNC "%8.2" "Åé" COEFFS 0 1 0 0 0 1 /end COMPU_METHOD
/begin COMPU_METHOD COMP_0453 "0.002-" RAT_FUNC "%8.4" "-" COEFFS 0 1 0 0 0 0.002 /end COMPU_METHOD
/begin COMPU_METHOD COMP_0014 "10ms" RAT_FUNC "%8.2" "ms" COEFFS 0 1 0 0 0 10 /end COMPU_METHOD
/begin COMPU_METHOD COMP_0006 "12.5rpm" RAT_FUNC "%8.2" "rpm" COEFFS 0 1 0 0 0 12.5 /end COMPU_METHOD
/begin COMPU_METHOD COMP_0008 "100ms" RAT_FUNC "%8.2" "ms" COEFFS 0 1 0 0 0 100 /end COMPU_METHOD
/begin COMPU_METHOD COMP_0196 "0.1Nm" RAT_FUNC "%8.2" "Nm" COEFFS 0 1 0 0 0 0.1 /end COMPU_METHOD
/begin COMPU_METHOD COMP_0009 "100/128%" RAT_FUNC "%8.2" "%" COEFFS 0 1 0 0 0 0.78125 /end COMPU_METHOD
/begin COMPU_METHOD COMP_0013 "1s" RAT_FUNC "%8.2" "s" COEFFS 0 1 0 0 0 1 /end COMPU_METHOD
/begin COMPU_METHOD COMP_0000 "25rpm" RAT_FUNC "%8.2" "rpm" COEFFS 0 1 0 0 0 25 /end COMPU_METHOD
/begin COMPU_METHOD COMP_0047 "0.5%" RAT_FUNC "%8.2" "%" COEFFS 0 1 0 0 0 0.5 /end COMPU_METHOD
/begin COMPU_METHOD COMP_0486 "20/256mv" RAT_FUNC "%8.3" "mv" COEFFS 0 1 0 0 0 0.078125 /end COMPU_METHOD
/begin COMPU_METHOD COMP_0436 "0.1km/h" RAT_FUNC "%8.2" "km/h" COEFFS 0 1 0 0 0 0.1 /end COMPU_METHOD
/begin COMPU_METHOD COMP_0007 "2km/h" RAT_FUNC "%8.2" "km/h" COEFFS 0 1 0 0 0 2 /end COMPU_METHOD
/begin COMPU_METHOD COMP_0033 "80mV" RAT_FUNC "%8.2" "mV" COEFFS 0 1 0 0 0 80 /end COMPU_METHOD
/begin COMPU_METHOD COMP_0049 "1sec" RAT_FUNC "%8.2" "sec" COEFFS 0 1 0 0 0 1 /end COMPU_METHOD
/begin COMPU_METHOD COMP_0130 "0.0275deg" RAT_FUNC "%8.3" "deg" COEFFS 0 1 0 0 0 0.0275 /end COMPU_METHOD
/begin COMPU_METHOD COMP_0030 "1âÒ" RAT_FUNC "%8.2" "âÒ" COEFFS 0 1 0 0 0 1 /end COMPU_METHOD
/begin COMPU_METHOD COMP_0341_S "0.002-" RAT_FUNC "%8.4" "-" COEFFS 0 1 0 0 0 0.002 /end COMPU_METHOD
/begin COMPU_METHOD COMP_0342_S "1/8*25ms*rpm" RAT_FUNC "%8.2" "ms*rpm" COEFFS 0 1 0 0 0 3.125 /end COMPU_METHOD
/begin COMPU_METHOD COMP_0443 "1rpm" RAT_FUNC "%8.2" "rpm" COEFFS 0 1 0 0 0 1 /end COMPU_METHOD
/begin COMPU_METHOD COMP_0005 "0.11deg" RAT_FUNC "%8.2" "deg" COEFFS 0 1 0 0 0 0.11 /end COMPU_METHOD
/begin COMPU_METHOD COMP_0362_S "0.125%" RAT_FUNC "%8.2" "%" COEFFS 0 1 0 0 0 0.125 /end COMPU_METHOD
/begin COMPU_METHOD COMP_0048 "64/128degCA" RAT_FUNC "%8.2" "degCA" COEFFS 0 1 0 0 0 0.5 /end COMPU_METHOD
/begin COMPU_METHOD COMP_0016 "1count" RAT_FUNC "%8.2" "count" COEFFS 0 1 0 0 0 1 /end COMPU_METHOD
/begin COMPU_METHOD COMP_0054 "20mV" RAT_FUNC "%8.2" "mV" COEFFS 0 1 0 0 0 20 /end COMPU_METHOD
/begin COMPU_METHOD COMP_0419 "0.1%" RAT_FUNC "%8.2" "%" COEFFS 0 1 0 0 0 0.1 /end COMPU_METHOD
/begin COMPU_METHOD COMP_0373 "1/100-" RAT_FUNC "%8.3" "-" COEFFS 0 1 0 0 0 0.01 /end COMPU_METHOD
/begin COMPU_METHOD COMP_0105 "0.1s" RAT_FUNC "%8.2" "s" COEFFS 0 1 0 0 0 0.1 /end COMPU_METHOD
/begin COMPU_METHOD COMP_0050 "5/64mV" RAT_FUNC "%8.3" "mV" COEFFS 0 1 0 0 0 0.078125 /end COMPU_METHOD
/begin COMPU_METHOD COMP_0035 "X-50Åé" RAT_FUNC "%8.2" "Åé" COEFFS 0 1 50 0 0 1 /end COMPU_METHOD
/begin COMPU_METHOD COMP_0228 "0.1Nm" RAT_FUNC "%8.2" "Nm" COEFFS 0 1 0 0 0 0.1 /end COMPU_METHOD
/begin COMPU_METHOD COMP_0384_S "0.004-" RAT_FUNC "%8.4" "-" COEFFS 0 1 0 0 0 0.004 /end COMPU_METHOD
/begin COMPU_METHOD COMP_0385_S "0.004-" RAT_FUNC "%8.4" "-" COEFFS 0 1 0 0 0 0.004 /end COMPU_METHOD
/begin COMPU_METHOD COMP_0096 "10s" RAT_FUNC "%8.2" "s" COEFFS 0 1 0 0 0 10 /end COMPU_METHOD
/begin COMPU_METHOD COMP_0104 "10mV" RAT_FUNC "%8.2" "mV" COEFFS 0 1 0 0 0 10 /end COMPU_METHOD
/begin COMPU_METHOD COMP_0256 "64/128degCA" RAT_FUNC "%8.2" "degCA" COEFFS 0 1 64 0 0 0.5 /end COMPU_METHOD
/begin COMPU_METHOD COMP_0408_S "0.1S" RAT_FUNC "%8.2" "S" COEFFS 0 1 0 0 0 0.1 /end COMPU_METHOD
/begin COMPU_METHOD COMP_0191 "1REV" RAT_FUNC "%8.2" "REV" COEFFS 0 1 0 0 0 1 /end COMPU_METHOD
/begin COMPU_METHOD COMP_0146 "100/256/256%" RAT_FUNC "%8.4" "%" COEFFS 0 1 0 0 0 0.001525879 /end COMPU_METHOD
/begin COMPU_METHOD COMP_0434_S "25*1/128rpm*ms" RAT_FUNC "%8.2" "rpm*ms" COEFFS 0 1 0 0 0 0.1953125 /end COMPU_METHOD
/begin COMPU_METHOD COMP_0144 "1/2048ms" RAT_FUNC "%8.5" "ms" COEFFS 0 1 0 0 0 0.000488281 /end COMPU_METHOD
/begin COMPU_METHOD COMP_0295 "100msec" RAT_FUNC "%8.2" "msec" COEFFS 0 1 0 0 0 100 /end COMPU_METHOD
/begin COMPU_METHOD COMP_0053 "1ms" RAT_FUNC "%8.2" "ms" COEFFS 0 1 0 0 0 1 /end COMPU_METHOD
/begin COMPU_METHOD COMP_0042 "0.0008cm**2" RAT_FUNC "%8.5" "cm**2" COEFFS 0 1 0 0 0 0.0008 /end COMPU_METHOD
/begin COMPU_METHOD COMP_0268_S "fixed axis km/h" RAT_FUNC "%8.2" "km/h" COEFFS 0 1 0 0 0 8 /end COMPU_METHOD
/begin COMPU_METHOD COMP_0523_S "fixed axis Åé" RAT_FUNC "%8.2" "Åé" COEFFS 0 1 20 0 0 10 /end COMPU_METHOD
/begin COMPU_METHOD COMP_0283 "1flag" RAT_FUNC "%8.2" "flag" COEFFS 0 1 0 0 0 1 /end COMPU_METHOD
/begin COMPU_METHOD COMP_0201_S "1s1s" RAT_FUNC "%8.2" "1s" COEFFS 0 1 0 0 0 1 /end COMPU_METHOD
/begin COMPU_METHOD COMP_0202_S "100ms100ms" RAT_FUNC "%8.2" "100ms" COEFFS 0 1 0 0 0 1 /end COMPU_METHOD
/begin COMPU_METHOD COMP_0203_S "10ms10ms" RAT_FUNC "%8.2" "10ms" COEFFS 0 1 0 0 0 1 /end COMPU_METHOD
/begin COMPU_METHOD COMP_0549_S "kmkm" RAT_FUNC "%8.2" "km" COEFFS 0 1 0 0 0 25.72 /end COMPU_METHOD
/begin COMPU_METHOD COMP_0257 "128/128degCA" RAT_FUNC "%8.2" "degCA" COEFFS 0 1 128 0 0 1 /end COMPU_METHOD
/begin COMPU_METHOD COMP_0600_S "AA" RAT_FUNC "%8.6" "A" COEFFS 0 1 0 0 0 0.000007629 /end COMPU_METHOD
/begin COMPU_METHOD COMP_0296 "0.0011deg•s" RAT_FUNC "%8.4" "deg•s" COEFFS 0 1 0 0 0 0.0011 /end COMPU_METHOD
/begin COMPU_METHOD COMP_0159_S "É secÉ sec" RAT_FUNC "%8.2" "É sec" COEFFS 0 1 0 0 0 3.2 /end COMPU_METHOD
/begin COMPU_METHOD COMP_0164_S "degdeg" RAT_FUNC "%8.4" "deg" COEFFS 0 1 14.08205 0 0 0.00171875 /end COMPU_METHOD
/begin COMPU_METHOD COMP_0168_S "degdeg" RAT_FUNC "%8.4" "deg" COEFFS 0 1 0 0 0 0.00171875 /end COMPU_METHOD
/* RECORD_LAYOUT ------------------------------------------------------ */
/begin RECORD_LAYOUT REC_UBYTE_C FNC_VALUES 1 UBYTE COLUMN_DIR DIRECT /end RECORD_LAYOUT
/begin RECORD_LAYOUT REC_UWORD_C FNC_VALUES 1 UWORD COLUMN_DIR DIRECT /end RECORD_LAYOUT
/begin RECORD_LAYOUT REC_SWORD_C FNC_VALUES 1 SWORD COLUMN_DIR DIRECT /end RECORD_LAYOUT
/begin RECORD_LAYOUT REC_AXIS_UBYTE AXIS_PTS_X 1 UBYTE INDEX_INCR DIRECT /end RECORD_LAYOUT
/begin RECORD_LAYOUT REC_AXIS_UWORD AXIS_PTS_X 1 UWORD INDEX_INCR DIRECT /end RECORD_LAYOUT
/end MODULE
/end PROJECT
