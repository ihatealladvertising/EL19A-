ASAP2_VERSION 1 3_BETA
/begin PROJECT TK_X91_EUR_VC ""
/begin HEADER "" /* key HEADER ++ "comment" Ç… Par.scomment */ PROJECT_NO TK_X91_EUR_VC /* key PROJECT_NO ++ project number Ç… car_eng_desti_lot */ VERSION "7V4YHZEB2" /* key VERSION ++ version number Ç… mProgver */ /end HEADER
/begin MODULE DIM ""
/begin MOD_COMMON "" DEPOSIT ABSOLUTE BYTE_ORDER MSB_FIRST /* ﬁ≤ƒµ∞¿ﬁ∞Ç™ÿÃﬂ⁄∞ΩÇ≥ÇÍÇÈ */ /end MOD_COMMON
/begin FUNCTION R208.2.VSINT_1_1_2 "Vehicle speed interface" /end FUNCTION
/begin FUNCTION R208.3.GRBOX_1_2_2 "gearbox" /end FUNCTION
/begin FUNCTION R208.4.STFLW_1_2_2 "State-flow" /end FUNCTION
/begin FUNCTION R208.5.SETPT_1_1_0 "Requested speed management" /end FUNCTION
/begin FUNCTION R208.6.SERVO_1_2_2 "Servo-control with force interface" /end FUNCTION
/begin FUNCTION R208.7.OUTMX_1_1_3 "Formatting mux outputs" /end FUNCTION
/begin FUNCTION R208.8.DACAX_1_1_5 "Abnormal deactivation management and associated diagnosis" /end FUNCTION
/begin FUNCTION R208.9.SAFETYX_1_3_2 "Additional safety through wired open brake and wired minimum travel clutch" /end FUNCTION
/begin FUNCTION R208.10.dgn_ccadd_1_3_2 "Diagnostic add-on of cruise control activations and shut-offs" /end FUNCTION
/begin FUNCTION R301.1.Torque_realization_1_0_3 "Renault Torque Realisation (RSMn#3)" /end FUNCTION
/begin FUNCTION R301.2.MapBreakpoint_1_1_2 "Breakpoint table modification for tuning purpose (RSMn#4)" /end FUNCTION
/begin FUNCTION R301.3.FanAftPwl_1_0_4 "Radiator Fan Activation after Keyoff (RSMn#7)" /end FUNCTION
/begin FUNCTION R301.4.AfFeedback_1_0_1 "A/F feedback control modification for tuning purpose (RSMn#6)" /end FUNCTION
/begin FUNCTION R301.5.FuelCut_1_2_2 "Fuel Cut control modification of base software (RSMn#9)" /end FUNCTION
/begin FUNCTION R301.6.IscAirflow_1_4_5 "ISC Airflow modification (RSMn#11/ #42/ #43)" /end FUNCTION
/begin FUNCTION R301.7.KHOT_1_0_2 "Correction Factor for Fuel Addition at High Coolant Temperature/ KHOT (RSMn#14)" /end FUNCTION
/begin FUNCTION R301.8.Inverse_filter_1_1_3 "Inverse filter type shaking restraint control (RSMn#16)" /end FUNCTION
/begin FUNCTION R301.9.Target_Equivalent_Ratio_1_0_2 "Target equivalence ratio (for MPI) TFBYA (RSMn#17)" /end FUNCTION
/begin FUNCTION R301.10.TITM_1_0_2 "TITM : Basic injection timing modification of base software (RSMn#18)" /end FUNCTION
/begin FUNCTION R301.11.INJDiag_1_1_2 "Electrical diagnosis for MPI injectors and associated failsafe (RSMn#19)" /end FUNCTION
/begin FUNCTION R301.12.ClutchSwDiag_1_0_1 "Clutch Switch Diagnosis (RSMn#21)" /end FUNCTION
/begin FUNCTION R301.13.FFDforDiagOnCAN_1_1_3 "FFD evolutions for Diag on CAN (RSMn#34)" /end FUNCTION
/begin FUNCTION R301.14.CanisterPurge_1_0_3 "Canister purge inhibition (RSMn#24)" /end FUNCTION
/begin FUNCTION R301.15.PurgeValveVB_shortDiag_1_0_2 "Purge Control Valve VB-short Diagnosis (RSMn#23)" /end FUNCTION
/begin FUNCTION R301.16.FrontO2H_VB_shortDiag_1_0_2 "Front O2 Heater VB-short Diagnosis (RSMn#23)" /end FUNCTION
/begin FUNCTION R301.17.RearO2H_VB_shortDiag_1_0_2 "Rear O2 Heater VB-short Diagnosis (RSMn#23)" /end FUNCTION
/begin FUNCTION R301.18.VB_short_Protection_1_0_2 "VB Short Protection for EVAP/ FO2H/ AFH/ RO2H/ INJ (RSMn#23)" /end FUNCTION
/begin FUNCTION R301.19.ISC_PID_cont_1_0_2 "ISC PID controller (RSMn#31)" /end FUNCTION
/begin FUNCTION R301.20.AmbientComp_1_0_2 "Ambient Temperature and Pressure compensation (RSMn#33)" /end FUNCTION
/begin CHARACTERISTIC mACANTSTD " turn-on delay for fACANTSTT" VALUE 0x000081C1 REC_UBYTE_C 0 COMP_0014 0 2550 /begin FUNCTION_LIST R301.6.IscAirflow_1_4_5 /end FUNCTION_LIST /end CHARACTERISTIC
/begin CHARACTERISTIC mACOUTD " turn-off delay for fACOUTD" VALUE 0x000081D9 REC_UBYTE_C 0 COMP_0014 0 2550 /begin FUNCTION_LIST R301.6.IscAirflow_1_4_5 /end FUNCTION_LIST /end CHARACTERISTIC
/begin CHARACTERISTIC mACSTTD " turn-on delay for fACSTT" VALUE 0x000081E3 REC_UBYTE_C 0 COMP_0014 0 2550 /begin FUNCTION_LIST R301.6.IscAirflow_1_4_5 /end FUNCTION_LIST /end CHARACTERISTIC
/begin CHARACTERISTIC mACSWD " turn-on delay for fACSWD" VALUE 0x000081E4 REC_UBYTE_C 0 COMP_0008 0 25500 /begin FUNCTION_LIST R301.6.IscAirflow_1_4_5 /end FUNCTION_LIST /end CHARACTERISTIC
/begin CHARACTERISTIC mBRKCODLY "Admissible delay of incoherence between brake information due to CAN communication" VALUE 0x000082C7 REC_UBYTE_C 0 COMP_0371_S 0 10.2 DISPLAY_IDENTIFIER Cxx_brk_fail_co_dly /begin FUNCTION_LIST R208.9.SAFETYX_1_3_2 /end FUNCTION_LIST /end CHARACTERISTIC
/begin CHARACTERISTIC mBRKCPDLY "Admissible delay of incoherence between brake information due to CAN communication" VALUE 0x000082C8 REC_UBYTE_C 0 COMP_0371_S 0 10.2 DISPLAY_IDENTIFIER Cxx_brk_fail_ccp_dly /begin FUNCTION_LIST R208.9.SAFETYX_1_3_2 /end FUNCTION_LIST /end CHARACTERISTIC
/begin CHARACTERISTIC mBRKLKDLY "Filter time to enable the wire brake connection status" VALUE 0x000082CA REC_UBYTE_C 0 COMP_0344_S 0 2.55 DISPLAY_IDENTIFIER Cxx_wf_brk_lk_ena_dly /begin FUNCTION_LIST R208.9.SAFETYX_1_3_2 /end FUNCTION_LIST /end CHARACTERISTIC
/begin CHARACTERISTIC mBRKLKTHD "Minimum battery voltage to enable the cruise control and speed limiter option detection" VALUE 0x000082CB REC_UBYTE_C 0 COMP_0033 0 20400 DISPLAY_IDENTIFIER Cxx_wf_brk_lk_vb_thd /begin FUNCTION_LIST R208.9.SAFETYX_1_3_2 /end FUNCTION_LIST /end CHARACTERISTIC
/begin CHARACTERISTIC mBRKRMDLY "Delay to confirm activated brake for safety needs" VALUE 0x000082CC REC_UBYTE_C 0 COMP_0371_S 0 10.2 DISPLAY_IDENTIFIER Cxx_wf_brk_rams_dly /begin FUNCTION_LIST R208.9.SAFETYX_1_3_2 /end FUNCTION_LIST /end CHARACTERISTIC
/begin CHARACTERISTIC mCCCMTFD "Force decrement/s for comfortable cut-off of cruise control" VALUE 0x000090A0 REC_UWORD_C 0 COMP_0373_S 0 131070 DISPLAY_IDENTIFIER Cxx_cru_cmf_cut_forc_dec /begin FUNCTION_LIST R208.6.SERVO_1_2_2 /end FUNCTION_LIST /end CHARACTERISTIC
/begin CHARACTERISTIC mCCEPMTHR "Threshold to stop root cause and mileage EEPROM write-on-the-flight" VALUE 0x00009754 REC_ULONG_C 0 COMP_0068 0 4294967295 DISPLAY_IDENTIFIER Cxx_cru_dgn_eprm_imd_writ_thr /begin FUNCTION_LIST R208.10.dgn_ccadd_1_3_2 /end FUNCTION_LIST /end CHARACTERISTIC
/begin CHARACTERISTIC mCCMNFC "Minimum saturation value of the force request (lesser than the minimum force feasible by the engine)" VALUE 0x000090A2 REC_UWORD_C 0 COMP_0374_S -20000 111070 DISPLAY_IDENTIFIER Cxx_cru_min_forc /begin FUNCTION_LIST R208.6.SERVO_1_2_2 /end FUNCTION_LIST /end CHARACTERISTIC
/begin CHARACTERISTIC mCCSLACPF "Acceleration digital filtering parameter" VALUE 0x000082F7 REC_UBYTE_C 0 COMP_0063 0 0.99609375 DISPLAY_IDENTIFIER Cxx_cru_sl_fil_acel_fac /begin FUNCTION_LIST R208.2.VSINT_1_1_2 /end FUNCTION_LIST /end CHARACTERISTIC
/begin CHARACTERISTIC mCCSLVSPF "Speed digital filtering parameter" VALUE 0x000082FB REC_UBYTE_C 0 COMP_0063 0 0.99609375 DISPLAY_IDENTIFIER Cxx_cru_sl_fil_vs_fac /begin FUNCTION_LIST R208.2.VSINT_1_1_2 /end FUNCTION_LIST /end CHARACTERISTIC
/begin CHARACTERISTIC mCCSLWND "Filtering delay before transmission of a CRU/SL warning" VALUE 0x000082FC REC_UBYTE_C 0 COMP_0105 0 25.5 DISPLAY_IDENTIFIER Cxx_cru_sl_warn_dly /begin FUNCTION_LIST R208.7.OUTMX_1_1_3 /end FUNCTION_LIST /end CHARACTERISTIC
/begin CHARACTERISTIC mCLSWDGT "Gear shift threshold for clutch switch diagnosis" VALUE 0x00008331 REC_UBYTE_C 0 COMP_0068 0 255 /begin FUNCTION_LIST R301.12.ClutchSwDiag_1_0_1 /end FUNCTION_LIST /end CHARACTERISTIC
/begin CHARACTERISTIC mCLSWDVT "Vehicle speed threshold for clutch switch diagnosis" VALUE 0x000090B2 REC_UWORD_C 0 COMP_0375_S 0 655.35 /begin FUNCTION_LIST R301.12.ClutchSwDiag_1_0_1 /end FUNCTION_LIST /end CHARACTERISTIC
/begin CHARACTERISTIC mCLUCODLY "Admissible delay of incoherence between clutch information due to CAN communication" VALUE 0x00008333 REC_UBYTE_C 0 COMP_0371_S 0 10.2 DISPLAY_IDENTIFIER Cxx_bgin_clu_fail_co_dly /begin FUNCTION_LIST R208.9.SAFETYX_1_3_2 /end FUNCTION_LIST /end CHARACTERISTIC
/begin CHARACTERISTIC mCLUCPDLY "Admissible delay of incoherence between clutch information due to CAN communication" VALUE 0x00008334 REC_UBYTE_C 0 COMP_0371_S 0 10.2 DISPLAY_IDENTIFIER Cxx_bgin_clu_fail_ccp_dly /begin FUNCTION_LIST R208.9.SAFETYX_1_3_2 /end FUNCTION_LIST /end CHARACTERISTIC
/begin CHARACTERISTIC mCLUNDLYS "Minimum time to detect a clutch information absence" VALUE 0x00008335 REC_UBYTE_C 0 COMP_0371_S 0 10.2 DISPLAY_IDENTIFIER Cxx_cru_clu_navl_dly /begin FUNCTION_LIST R208.8.DACAX_1_1_5 /end FUNCTION_LIST /end CHARACTERISTIC
/begin CHARACTERISTIC mCLURMDLY "Delay to confirm activated clutch for safety needs" VALUE 0x00008336 REC_UBYTE_C 0 COMP_0371_S 0 10.2 DISPLAY_IDENTIFIER Cxx_wf_bgin_clu_rams_dly /begin FUNCTION_LIST R208.9.SAFETYX_1_3_2 /end FUNCTION_LIST /end CHARACTERISTIC
/begin CHARACTERISTIC mCMFCUTFI "Force increment /s for comfortable cut-off of speed limiter" VALUE 0x000090B4 REC_UWORD_C 0 COMP_0373_S 0 131070 DISPLAY_IDENTIFIER Cxx_sl_cmf_cut_forc_inc /begin FUNCTION_LIST R208.6.SERVO_1_2_2 /end FUNCTION_LIST /end CHARACTERISTIC
/begin CHARACTERISTIC mCRUFRDLY "Delay for cruise control comfortable deactivation before safety failure detection" VALUE 0x0000836B REC_UBYTE_C 0 COMP_0377_S 0 30.6 DISPLAY_IDENTIFIER Cxx_cru_forc_sp_dly /begin FUNCTION_LIST R208.9.SAFETYX_1_3_2 /end FUNCTION_LIST /end CHARACTERISTIC
/begin CHARACTERISTIC mCRUFRTHD "Threshold for the maximum force request out of cruise control conditions" VALUE 0x000090C2 REC_UWORD_C 0 COMP_0374_S -20000 111070 DISPLAY_IDENTIFIER Cxx_cru_forc_sp_thd /begin FUNCTION_LIST R208.9.SAFETYX_1_3_2 /end FUNCTION_LIST /end CHARACTERISTIC
/begin CHARACTERISTIC mCRURFVAG "Acceleration gradient coefficient to calculate the speed reference" VALUE 0x0000818D REC_SBYTE_C 0 COMP_0378_S -0.128 0.127 DISPLAY_IDENTIFIER Cxx_cru_ref_vs_acel_grd /begin FUNCTION_LIST R208.6.SERVO_1_2_2 /end FUNCTION_LIST /end CHARACTERISTIC
/begin CHARACTERISTIC mCRURFVAO "Acceleration gradient offset to calculate the speed reference for cruise control" VALUE 0x0000836C REC_UBYTE_C 0 COMP_0379_S 0 6.375 DISPLAY_IDENTIFIER Cxx_cru_ref_vs_acel_ofs /begin FUNCTION_LIST R208.6.SERVO_1_2_2 /end FUNCTION_LIST /end CHARACTERISTIC
/begin CHARACTERISTIC mCRURFVDG "Deceleration gradient coefficient to calculate the speed reference" VALUE 0x0000818E REC_SBYTE_C 0 COMP_0378_S -0.128 0.127 DISPLAY_IDENTIFIER Cxx_cru_ref_vs_decl_grd /begin FUNCTION_LIST R208.6.SERVO_1_2_2 /end FUNCTION_LIST /end CHARACTERISTIC
/begin CHARACTERISTIC mCRURFVDO "Deceleration gradient offset to calculate the speed reference    for cruise control" VALUE 0x0000836D REC_UBYTE_C 0 COMP_0379_S 0 6.375 DISPLAY_IDENTIFIER Cxx_cru_ref_vs_decl_ofs /begin FUNCTION_LIST R208.6.SERVO_1_2_2 /end FUNCTION_LIST /end CHARACTERISTIC
/begin CHARACTERISTIC mCRUSPAG "Acceleration gradient coefficient to calculate the speed reference from the objective speed" VALUE 0x0000818F REC_SBYTE_C 0 COMP_0378_S -0.128 0.127 DISPLAY_IDENTIFIER Cxx_cru_sp_acel_grd /begin FUNCTION_LIST R208.6.SERVO_1_2_2 /end FUNCTION_LIST /end CHARACTERISTIC
/begin CHARACTERISTIC mCRUSPDG "Deceleration gradient coefficient to calculate the speed reference from the objective speed" VALUE 0x00008190 REC_SBYTE_C 0 COMP_0378_S -0.128 0.127 DISPLAY_IDENTIFIER Cxx_cru_sp_decl_grd /begin FUNCTION_LIST R208.6.SERVO_1_2_2 /end FUNCTION_LIST /end CHARACTERISTIC
/begin CHARACTERISTIC mCRUSPMXI "Force gradient for comfortable cruise control activation" VALUE 0x000090C4 REC_UWORD_C 0 COMP_0373_S 0 131070 DISPLAY_IDENTIFIER Cxx_cru_sp_max_forc_inc /begin FUNCTION_LIST R208.6.SERVO_1_2_2 /end FUNCTION_LIST /end CHARACTERISTIC
/begin CHARACTERISTIC mCSIETH "Difference between vehicle speed and requested speed to declare CC/SL ineffective" VALUE 0x00008373 REC_UBYTE_C 0 COMP_0436 0 25.5 DISPLAY_IDENTIFIER Cxx_cru_sl_no_efv_vs_thd /begin FUNCTION_LIST R208.2.VSINT_1_1_2 R208.7.OUTMX_1_1_3 /end FUNCTION_LIST /end CHARACTERISTIC
/begin CHARACTERISTIC mCSIETHM "Difference between vehicle speed and requested speed to declare CC/SL ineffective in mph" VALUE 0x00008374 REC_UBYTE_C 0 COMP_0381_S 0 25.5 DISPLAY_IDENTIFIER Cxx_cru_sl_no_efv_vs_thd_mph /begin FUNCTION_LIST R208.2.VSINT_1_1_2 /end FUNCTION_LIST /end CHARACTERISTIC
/begin CHARACTERISTIC mCSLCIDR "Delay-less fuel cut engine speed Renault specific" VALUE 0x00008377 REC_UBYTE_C 0 COMP_0020 0 12750 /begin FUNCTION_LIST R301.5.FuelCut_1_2_2 /end FUNCTION_LIST /end CHARACTERISTIC
/begin CHARACTERISTIC mCSVIMAX "CC/SL maximal speed setpoint" VALUE 0x0000838A REC_UBYTE_C 0 COMP_0429 0 255 DISPLAY_IDENTIFIER Cxx_cru_sl_max_vs /begin FUNCTION_LIST R208.2.VSINT_1_1_2 R208.5.SETPT_1_1_0 /end FUNCTION_LIST /end CHARACTERISTIC
/begin CHARACTERISTIC mCSVIMAXM "CC/SL maximal speed setpoint in mph" VALUE 0x0000838B REC_UBYTE_C 0 COMP_0382_S 0 255 DISPLAY_IDENTIFIER Cxx_cru_sl_max_vs_mph /begin FUNCTION_LIST R208.2.VSINT_1_1_2 /end FUNCTION_LIST /end CHARACTERISTIC
/begin CHARACTERISTIC mCSVIMIN "CC/SL minimal speed setpoint" VALUE 0x0000838C REC_UBYTE_C 0 COMP_0429 0 255 DISPLAY_IDENTIFIER Cxx_cru_sl_min_vs /begin FUNCTION_LIST R208.2.VSINT_1_1_2 R208.5.SETPT_1_1_0 /end FUNCTION_LIST /end CHARACTERISTIC
/begin CHARACTERISTIC mCSVIMINM "CC/SL minimal speed setpoint in mph" VALUE 0x0000838D REC_UBYTE_C 0 COMP_0382_S 0 255 DISPLAY_IDENTIFIER Cxx_cru_sl_min_vs_mph /begin FUNCTION_LIST R208.2.VSINT_1_1_2 /end FUNCTION_LIST /end CHARACTERISTIC
/begin CHARACTERISTIC mDCLFRBRU "Minimum deceleration value to detect sudden braking" VALUE 0x000083D9 REC_UBYTE_C 0 COMP_0387_S 0 25.5 DISPLAY_IDENTIFIER dclfrbru /begin FUNCTION_LIST R208.8.DACAX_1_1_5 /end FUNCTION_LIST /end CHARACTERISTIC
/begin CHARACTERISTIC mDCLFREIN "Minimum deceleration value to detect braking" VALUE 0x000083DA REC_UBYTE_C 0 COMP_0387_S 0 25.5 DISPLAY_IDENTIFIER dclfrein /begin FUNCTION_LIST R208.8.DACAX_1_1_5 /end FUNCTION_LIST /end CHARACTERISTIC
/begin CHARACTERISTIC mDECIJH "Decrement value for CINJHIn" VALUE 0x00008407 REC_UBYTE_C 0 COMP_0016 0 255 /begin FUNCTION_LIST R301.11.INJDiag_1_1_2 /end FUNCTION_LIST /end CHARACTERISTIC
/begin CHARACTERISTIC mDECIJH2 "Decrement value for CINJH2 n" VALUE 0x00008408 REC_UBYTE_C 0 COMP_0016 0 255 /begin FUNCTION_LIST R301.11.INJDiag_1_1_2 /end FUNCTION_LIST /end CHARACTERISTIC
/begin CHARACTERISTIC mDECIJL "Decrement value for CINJLOn" VALUE 0x00008409 REC_UBYTE_C 0 COMP_0016 0 255 /begin FUNCTION_LIST R301.11.INJDiag_1_1_2 /end FUNCTION_LIST /end CHARACTERISTIC
/begin CHARACTERISTIC mDECIJL2 "Decrement value for CINJL2 n" VALUE 0x0000840A REC_UBYTE_C 0 COMP_0016 0 255 /begin FUNCTION_LIST R301.11.INJDiag_1_1_2 /end FUNCTION_LIST /end CHARACTERISTIC
/begin CHARACTERISTIC mDISCCTP "CTP transiency compensation decrease rate" VALUE 0x00008445 REC_UBYTE_C 0 COMP_0097 0 3.984375 /begin FUNCTION_LIST R301.6.IscAirflow_1_4_5 /end FUNCTION_LIST /end CHARACTERISTIC
/begin CHARACTERISTIC mDISCSS_R "Time ISC compensation reduction value 2 of starting (enlarged)" VALUE 0x0000844D REC_UBYTE_C 0 COMP_0393_S 0 3.984375 /begin FUNCTION_LIST R301.6.IscAirflow_1_4_5 /end FUNCTION_LIST /end CHARACTERISTIC
/begin CHARACTERISTIC mDMPNREF "Average engine speed acceleration calculation damping rate" VALUE 0x0000848B REC_UBYTE_C 0 COMP_0063 0 0.99609375 /begin FUNCTION_LIST R301.19.ISC_PID_cont_1_0_2 /end FUNCTION_LIST /end CHARACTERISTIC
/begin CHARACTERISTIC mDSABDLYS "Frame absence duration to declare unavailable displayed vehicle speed" VALUE 0x000084C1 REC_UBYTE_C 0 COMP_0371_S 0 10.2 DISPLAY_IDENTIFIER Cxx_cru_abst_dspl_vs_dly /begin FUNCTION_LIST R208.2.VSINT_1_1_2 /end FUNCTION_LIST /end CHARACTERISTIC
/begin CHARACTERISTIC mDSPNGFAC "Factor to detect bad received displayed vehicle speed" VALUE 0x000084C8 REC_UBYTE_C 0 COMP_0361_S 0 0.255 DISPLAY_IDENTIFIER Cxx_mux_dspl_vs_secu_fac /begin FUNCTION_LIST R208.2.VSINT_1_1_2 /end FUNCTION_LIST /end CHARACTERISTIC
/begin CHARACTERISTIC mDSPNGMIN "Minimum speed to test the speed coherence" VALUE 0x000084C9 REC_UBYTE_C 0 COMP_0429 0 255 DISPLAY_IDENTIFIER Cxx_mux_dspl_vs_secu_min /begin FUNCTION_LIST R208.2.VSINT_1_1_2 /end FUNCTION_LIST /end CHARACTERISTIC
/begin CHARACTERISTIC mDSPNGOFS "Offset to detect bad received displayed vehicle speed" VALUE 0x000084CA REC_UBYTE_C 0 COMP_0401_S 0 51 DISPLAY_IDENTIFIER Cxx_mux_dspl_vs_secu_ofs /begin FUNCTION_LIST R208.2.VSINT_1_1_2 /end FUNCTION_LIST /end CHARACTERISTIC
/begin CHARACTERISTIC mDSPNGTHD "Threshold to detect bad received displayed vehicle speed" VALUE 0x000084CB REC_UBYTE_C 0 COMP_0401_S 0 51 DISPLAY_IDENTIFIER Cxx_mux_dspl_vs_secu_thd /begin FUNCTION_LIST R208.2.VSINT_1_1_2 /end FUNCTION_LIST /end CHARACTERISTIC
/begin CHARACTERISTIC mDTDIACT1 "Torque down activation threshold 1" VALUE 0x00008F00 REC_SWORD_C 0 COMP_0228 -3276.8 3276.7 /begin FUNCTION_LIST R301.1.Torque_realization_1_0_3 /end FUNCTION_LIST /end CHARACTERISTIC
/begin CHARACTERISTIC mDTDIACT2 "Torque down activation threshold 2" VALUE 0x00008F02 REC_SWORD_C 0 COMP_0228 -3276.8 3276.7 /begin FUNCTION_LIST R301.1.Torque_realization_1_0_3 /end FUNCTION_LIST /end CHARACTERISTIC
/begin CHARACTERISTIC mDTDISTP1 "Torque down deactivation threshold 1" VALUE 0x00008F04 REC_SWORD_C 0 COMP_0228 -3276.8 3276.7 /begin FUNCTION_LIST R301.1.Torque_realization_1_0_3 /end FUNCTION_LIST /end CHARACTERISTIC
/begin CHARACTERISTIC mDTDISTP2 "Torque down deactivation threshold 2" VALUE 0x00008F06 REC_SWORD_C 0 COMP_0228 -3276.8 3276.7 /begin FUNCTION_LIST R301.1.Torque_realization_1_0_3 /end FUNCTION_LIST /end CHARACTERISTIC
/begin CHARACTERISTIC mDVIFREIN "Difference between requested speed and vehicle speed to detect braking" VALUE 0x00008514 REC_UBYTE_C 0 COMP_0429 0 255 DISPLAY_IDENTIFIER dvifrein /begin FUNCTION_LIST R208.8.DACAX_1_1_5 /end FUNCTION_LIST /end CHARACTERISTIC
/begin CHARACTERISTIC mFCPRDT1 "Time for the pre retard start time delay 1" VALUE 0x000085E8 REC_UBYTE_C 0 COMP_0014 0 2550 /begin FUNCTION_LIST R301.5.FuelCut_1_2_2 /end FUNCTION_LIST /end CHARACTERISTIC
/begin CHARACTERISTIC mFCPRDT2 "Time for the pre retard start time delay 2" VALUE 0x000085E9 REC_UBYTE_C 0 COMP_0014 0 2550 /begin FUNCTION_LIST R301.5.FuelCut_1_2_2 /end FUNCTION_LIST /end CHARACTERISTIC
/begin CHARACTERISTIC mFCPRDT3 "Time for the pre retard start time delay 3" VALUE 0x000085EA REC_UBYTE_C 0 COMP_0014 0 2550 /begin FUNCTION_LIST R301.5.FuelCut_1_2_2 /end FUNCTION_LIST /end CHARACTERISTIC
/begin CHARACTERISTIC mFCPRDT4 "Time for the pre retard start time delay 4" VALUE 0x000085EB REC_UBYTE_C 0 COMP_0014 0 2550 /begin FUNCTION_LIST R301.5.FuelCut_1_2_2 /end FUNCTION_LIST /end CHARACTERISTIC
/begin CHARACTERISTIC mFCPRDT5 "Time for the pre retard start time delay 5" VALUE 0x000085EC REC_UBYTE_C 0 COMP_0014 0 2550 /begin FUNCTION_LIST R301.5.FuelCut_1_2_2 /end FUNCTION_LIST /end CHARACTERISTIC
/begin CHARACTERISTIC mFCPRDT6 "Time for the pre retard start time delay 6" VALUE 0x000085ED REC_UBYTE_C 0 COMP_0014 0 2550 /begin FUNCTION_LIST R301.5.FuelCut_1_2_2 /end FUNCTION_LIST /end CHARACTERISTIC
/begin CHARACTERISTIC mFCPRDT7 "Time for the pre retard start time delay 7" VALUE 0x000085EE REC_UBYTE_C 0 COMP_0014 0 2550 /begin FUNCTION_LIST R301.5.FuelCut_1_2_2 /end FUNCTION_LIST /end CHARACTERISTIC
/begin CHARACTERISTIC mFCSTART "Fuel cut inhibition delay after start" VALUE 0x000085EF REC_UBYTE_C 0 COMP_0008 0 25500 /begin FUNCTION_LIST R301.5.FuelCut_1_2_2 /end FUNCTION_LIST /end CHARACTERISTIC
/begin CHARACTERISTIC mFCVSP3 "Fuel cut judgment vehicle speed" VALUE 0x000085F6 REC_UBYTE_C 0 COMP_0007 0 510 /begin FUNCTION_LIST R301.5.FuelCut_1_2_2 /end FUNCTION_LIST /end CHARACTERISTIC
/begin CHARACTERISTIC mFDSTAK1 "Torque down time limit 1" VALUE 0x0000919C REC_UWORD_C 0 COMP_0016 0 65535 /begin FUNCTION_LIST R301.1.Torque_realization_1_0_3 /end FUNCTION_LIST /end CHARACTERISTIC
/begin CHARACTERISTIC mFDSTAK2 "Torque down time limit 2" VALUE 0x0000919E REC_UWORD_C 0 COMP_0016 0 65535 /begin FUNCTION_LIST R301.1.Torque_realization_1_0_3 /end FUNCTION_LIST /end CHARACTERISTIC
/begin CHARACTERISTIC mFDTSTAKD "dT for torque down time limit measurement" VALUE 0x000091A4 REC_UWORD_C 0 COMP_0409_S 0 6553.5 /begin FUNCTION_LIST R301.1.Torque_realization_1_0_3 /end FUNCTION_LIST /end CHARACTERISTIC
/begin CHARACTERISTIC mFKTAIHRN "F/B P-Part control bottom dead band" VALUE 0x00008605 REC_UBYTE_C 0 COMP_0064 0 398.4375 /begin FUNCTION_LIST R301.19.ISC_PID_cont_1_0_2 /end FUNCTION_LIST /end CHARACTERISTIC
/begin CHARACTERISTIC mFKTAILRN "F/B P-Part control top dead band" VALUE 0x00008607 REC_UBYTE_C 0 COMP_0064 0 398.4375 /begin FUNCTION_LIST R301.19.ISC_PID_cont_1_0_2 /end FUNCTION_LIST /end CHARACTERISTIC
/begin CHARACTERISTIC mGDPALVIM "Value of requested speed step when accel or decel switch pressed continuously in mph" VALUE 0x0000865E REC_UBYTE_C 0 COMP_0382_S 0 255 DISPLAY_IDENTIFIER Cxx_cru_sl_long_step_mph /begin FUNCTION_LIST R208.2.VSINT_1_1_2 /end FUNCTION_LIST /end CHARACTERISTIC
/begin CHARACTERISTIC mGDPALVIT "Value of requested speed step when accel or decel switch pressed continuously" VALUE 0x0000865F REC_UBYTE_C 0 COMP_0429 0 255 DISPLAY_IDENTIFIER gdpalvit /begin FUNCTION_LIST R208.2.VSINT_1_1_2 R208.5.SETPT_1_1_0 /end FUNCTION_LIST /end CHARACTERISTIC
/begin CHARACTERISTIC mGEARMTT "Gear shift recognition delay" VALUE 0x00008664 REC_UBYTE_C 0 COMP_0008 0 25500 /begin FUNCTION_LIST R301.12.ClutchSwDiag_1_0_1 /end FUNCTION_LIST /end CHARACTERISTIC
/begin CHARACTERISTIC mHYSKHTA "Upper water temperature increase decision intake-air temperature condition hysteresis" VALUE 0x000086BB REC_UBYTE_C 0 COMP_0421_S 0 255 /begin FUNCTION_LIST R301.7.KHOT_1_0_2 /end FUNCTION_LIST /end CHARACTERISTIC
/begin CHARACTERISTIC mIDLTM "Idle lambda control delay" VALUE 0x000086F6 REC_UBYTE_C 0 COMP_0008 0 25500 /begin FUNCTION_LIST R301.4.AfFeedback_1_0_1 /end FUNCTION_LIST /end CHARACTERISTIC
/begin CHARACTERISTIC mIDLTM2 "After the start, rich-shift delay" VALUE 0x000086F7 REC_UBYTE_C 0 COMP_0008 0 25500 /begin FUNCTION_LIST R301.4.AfFeedback_1_0_1 /end FUNCTION_LIST /end CHARACTERISTIC
/begin CHARACTERISTIC mIGARN1 "I-gain 1" VALUE 0x000096C4 REC_SLONG_C 0 COMP_0423_S -8192.0058720256 8192.0058682109 /begin FUNCTION_LIST R301.19.ISC_PID_cont_1_0_2 /end FUNCTION_LIST /end CHARACTERISTIC
/begin CHARACTERISTIC mIGARN2 "I-gain 2" VALUE 0x000096C8 REC_SLONG_C 0 COMP_0423_S -8192.0058720256 8192.0058682109 /begin FUNCTION_LIST R301.19.ISC_PID_cont_1_0_2 /end FUNCTION_LIST /end CHARACTERISTIC
/begin CHARACTERISTIC mIGARN3 "I-gain 3" VALUE 0x000096CC REC_SLONG_C 0 COMP_0423_S -8192.0058720256 8192.0058682109 /begin FUNCTION_LIST R301.19.ISC_PID_cont_1_0_2 /end FUNCTION_LIST /end CHARACTERISTIC
/begin CHARACTERISTIC mIGARN4 "I-gain 4" VALUE 0x000096D0 REC_SLONG_C 0 COMP_0423_S -8192.0058720256 8192.0058682109 /begin FUNCTION_LIST R301.19.ISC_PID_cont_1_0_2 /end FUNCTION_LIST /end CHARACTERISTIC
/begin CHARACTERISTIC mINCIJH "Increment value for CINJHIn" VALUE 0x00008718 REC_UBYTE_C 0 COMP_0016 0 255 /begin FUNCTION_LIST R301.11.INJDiag_1_1_2 /end FUNCTION_LIST /end CHARACTERISTIC
/begin CHARACTERISTIC mINCIJH2 "Increment value for CINJH2 n" VALUE 0x00008719 REC_UBYTE_C 0 COMP_0016 0 255 /begin FUNCTION_LIST R301.11.INJDiag_1_1_2 /end FUNCTION_LIST /end CHARACTERISTIC
/begin CHARACTERISTIC mINCIJL "Increment value for CINJLOn" VALUE 0x0000871A REC_UBYTE_C 0 COMP_0016 0 255 /begin FUNCTION_LIST R301.11.INJDiag_1_1_2 /end FUNCTION_LIST /end CHARACTERISTIC
/begin CHARACTERISTIC mINCIJL2 "Increment value for CINJL2 n" VALUE 0x0000871B REC_UBYTE_C 0 COMP_0016 0 255 /begin FUNCTION_LIST R301.11.INJDiag_1_1_2 /end FUNCTION_LIST /end CHARACTERISTIC
/begin CHARACTERISTIC mINJFPTM "Time delay for the fuel pump status judgement" VALUE 0x00008731 REC_UBYTE_C 0 COMP_0014 0 2550 /begin FUNCTION_LIST R301.11.INJDiag_1_1_2 /end FUNCTION_LIST /end CHARACTERISTIC
/begin CHARACTERISTIC mINJHCTL "Output pulse condition for injector diagnosis" VALUE 0x000092E6 REC_UWORD_C 0 COMP_0426_S 0 655350 /begin FUNCTION_LIST R301.11.INJDiag_1_1_2 /end FUNCTION_LIST /end CHARACTERISTIC
/begin CHARACTERISTIC mINJIDY1 "Injector Off status detection delay" VALUE 0x000092E8 REC_UWORD_C 0 COMP_0073 0 209712 /begin FUNCTION_LIST R301.11.INJDiag_1_1_2 /end FUNCTION_LIST /end CHARACTERISTIC
/begin CHARACTERISTIC mINJIDY2 "Injector diagnosis failure detection delay" VALUE 0x000092EA REC_UWORD_C 0 COMP_0073 0 209712 /begin FUNCTION_LIST R301.11.INJDiag_1_1_2 /end FUNCTION_LIST /end CHARACTERISTIC
/begin CHARACTERISTIC mINJVBL "Battery voltage condition for injector diagnosis" VALUE 0x00008733 REC_UBYTE_C 0 COMP_0033 0 20400 /begin FUNCTION_LIST R301.11.INJDiag_1_1_2 /end FUNCTION_LIST /end CHARACTERISTIC
/begin CHARACTERISTIC mINTEGLV "Speed limiter integral gain" VALUE 0x000092EC REC_UWORD_C 0 COMP_0427_S 0 1953.0937305 DISPLAY_IDENTIFIER integlv /begin FUNCTION_LIST R208.6.SERVO_1_2_2 /end FUNCTION_LIST /end CHARACTERISTIC
/begin CHARACTERISTIC mINTEGRV "Cruise control integral gain" VALUE 0x000092EE REC_UWORD_C 0 COMP_0427_S 0 1953.0937305 DISPLAY_IDENTIFIER integrv /begin FUNCTION_LIST R208.6.SERVO_1_2_2 /end FUNCTION_LIST /end CHARACTERISTIC
/begin CHARACTERISTIC mINTHH2 "Threshold for injector circuit high failure at engine stop" VALUE 0x00008739 REC_UBYTE_C 0 COMP_0016 0 255 /begin FUNCTION_LIST R301.11.INJDiag_1_1_2 /end FUNCTION_LIST /end CHARACTERISTIC
/begin CHARACTERISTIC mINTHHI "Threshold for injector circuit high failure" VALUE 0x0000873A REC_UBYTE_C 0 COMP_0016 0 255 /begin FUNCTION_LIST R301.11.INJDiag_1_1_2 /end FUNCTION_LIST /end CHARACTERISTIC
/begin CHARACTERISTIC mINTHL2 "Threshold for injector circuit low failure at engine stop" VALUE 0x0000873B REC_UBYTE_C 0 COMP_0016 0 255 /begin FUNCTION_LIST R301.11.INJDiag_1_1_2 /end FUNCTION_LIST /end CHARACTERISTIC
/begin CHARACTERISTIC mINTHLO "Threshold for injector circuit low failure" VALUE 0x0000873C REC_UBYTE_C 0 COMP_0016 0 255 /begin FUNCTION_LIST R301.11.INJDiag_1_1_2 /end FUNCTION_LIST /end CHARACTERISTIC
/begin CHARACTERISTIC mINTMAXLV "Maximum value of the integral correction for speed limiter" VALUE 0x00008F0C REC_SWORD_C 0 COMP_0428_S -62.5000448 62.49813745 DISPLAY_IDENTIFIER intmaxlv /begin FUNCTION_LIST R208.6.SERVO_1_2_2 /end FUNCTION_LIST /end CHARACTERISTIC
/begin CHARACTERISTIC mINTMAXRV "Maximum value of the integral correction for cruise control" VALUE 0x00008F0E REC_SWORD_C 0 COMP_0428_S -62.5000448 62.49813745 DISPLAY_IDENTIFIER intmaxrv /begin FUNCTION_LIST R208.6.SERVO_1_2_2 /end FUNCTION_LIST /end CHARACTERISTIC
/begin CHARACTERISTIC mINTMINLV "Minimum value of the integral correction for speed limiter" VALUE 0x00008F10 REC_SWORD_C 0 COMP_0428_S -62.5000448 62.49813745 DISPLAY_IDENTIFIER intminlv /begin FUNCTION_LIST R208.6.SERVO_1_2_2 /end FUNCTION_LIST /end CHARACTERISTIC
/begin CHARACTERISTIC mINTMINRV "Minimum value of the integral correction for cruise control" VALUE 0x00008F12 REC_SWORD_C 0 COMP_0428_S -62.5000448 62.49813745 DISPLAY_IDENTIFIER intminrv /begin FUNCTION_LIST R208.6.SERVO_1_2_2 /end FUNCTION_LIST /end CHARACTERISTIC
/begin CHARACTERISTIC mKHOTMNEA "The number of upper water temperature increase decision rotation (high TA)" VALUE 0x0000879D REC_UBYTE_C 0 COMP_0000 0 6375 /begin FUNCTION_LIST R301.7.KHOT_1_0_2 /end FUNCTION_LIST /end CHARACTERISTIC
/begin CHARACTERISTIC mKHOTTA "Upper water temperature increase decision intake-air temperature" VALUE 0x0000879E REC_UBYTE_C 0 COMP_0430_S -50 205 /begin FUNCTION_LIST R301.7.KHOT_1_0_2 /end FUNCTION_LIST /end CHARACTERISTIC
/begin CHARACTERISTIC mLIHDLYS "Sufficient time to confirm limphome mode in automatic gearbox." VALUE 0x00008814 REC_UBYTE_C 0 COMP_0371_S 0 10.2 DISPLAY_IDENTIFIER Cxx_lih_dly /begin FUNCTION_LIST R208.3.GRBOX_1_2_2 /end FUNCTION_LIST /end CHARACTERISTIC
/begin CHARACTERISTIC mO2HCTD "A former O2 heater off delay" VALUE 0x0000890C REC_UBYTE_C 0 COMP_0008 0 25500 /begin FUNCTION_LIST R301.18.VB_short_Protection_1_0_2 /end FUNCTION_LIST /end CHARACTERISTIC
/begin CHARACTERISTIC mOVHSTT "Over-heat decision duration" VALUE 0x0000896A REC_UBYTE_C 0 COMP_0013 0 255 /begin FUNCTION_LIST R301.5.FuelCut_1_2_2 /end FUNCTION_LIST /end CHARACTERISTIC
/begin CHARACTERISTIC mPGARN1 "P-gain 1" VALUE 0x0000942E REC_UWORD_C 0 COMP_0438_S 0 1.999970916 /begin FUNCTION_LIST R301.19.ISC_PID_cont_1_0_2 /end FUNCTION_LIST /end CHARACTERISTIC
/begin CHARACTERISTIC mPGARN3 "P-gain 3" VALUE 0x00009430 REC_UWORD_C 0 COMP_0438_S 0 1.999970916 /begin FUNCTION_LIST R301.19.ISC_PID_cont_1_0_2 /end FUNCTION_LIST /end CHARACTERISTIC
/begin CHARACTERISTIC mPROPGLV "Speed limiter l proportional gain" VALUE 0x0000943C REC_UWORD_C 0 COMP_0442_S 0 124.99818225 DISPLAY_IDENTIFIER propglv /begin FUNCTION_LIST R208.6.SERVO_1_2_2 /end FUNCTION_LIST /end CHARACTERISTIC
/begin CHARACTERISTIC mPROPGRV "Cruise control proportional gain" VALUE 0x0000943E REC_UWORD_C 0 COMP_0442_S 0 124.99818225 DISPLAY_IDENTIFIER propgrv /begin FUNCTION_LIST R208.6.SERVO_1_2_2 /end FUNCTION_LIST /end CHARACTERISTIC
/begin CHARACTERISTIC mPTPALVIM "Value of requested speed step when accel or decel switch pressed during a short time in mph" VALUE 0x000089F4 REC_UBYTE_C 0 COMP_0382_S 0 255 DISPLAY_IDENTIFIER Cxx_cru_sl_smal_step_mph /begin FUNCTION_LIST R208.2.VSINT_1_1_2 /end FUNCTION_LIST /end CHARACTERISTIC
/begin CHARACTERISTIC mPTPALVIT "Value of requested speed step when accel or decel switch pressed during a short time" VALUE 0x000089F5 REC_UBYTE_C 0 COMP_0429 0 255 DISPLAY_IDENTIFIER ptpalvit /begin FUNCTION_LIST R208.2.VSINT_1_1_2 R208.5.SETPT_1_1_0 /end FUNCTION_LIST /end CHARACTERISTIC
/begin CHARACTERISTIC mQMAX1R "AAC/V maximum air flow (6&8cylinders)" VALUE 0x00009468 REC_UWORD_C 0 COMP_0051 0 65535 /begin FUNCTION_LIST R301.6.IscAirflow_1_4_5 R301.19.ISC_PID_cont_1_0_2 /end FUNCTION_LIST /end CHARACTERISTIC
/begin CHARACTERISTIC mQUTMINVI "Minimum vehicle speed/requested speed ratio to disconnect cruise control" VALUE 0x00008A27 REC_UBYTE_C 0 COMP_0027 0 255 DISPLAY_IDENTIFIER qutminvi /begin FUNCTION_LIST R208.2.VSINT_1_1_2 /end FUNCTION_LIST /end CHARACTERISTIC
/begin CHARACTERISTIC mRALACCD " turn-on delay for fRALACC" VALUE 0x00008A29 REC_UBYTE_C 0 COMP_0008 0 25500 /begin FUNCTION_LIST R301.6.IscAirflow_1_4_5 /end FUNCTION_LIST /end CHARACTERISTIC
/begin CHARACTERISTIC mRFPVACT "Mailbox ventilation movement time" VALUE 0x000094A2 REC_UWORD_C 0 COMP_0049 0 65535 /begin FUNCTION_LIST R301.3.FanAftPwl_1_0_4 /end FUNCTION_LIST /end CHARACTERISTIC
/begin CHARACTERISTIC mRFPVTW "Coolant temperature monitor continuous coolant temperature" VALUE 0x00008A72 REC_UBYTE_C 0 COMP_0430_S -50 205 /begin FUNCTION_LIST R301.3.FanAftPwl_1_0_4 /end FUNCTION_LIST /end CHARACTERISTIC
/begin CHARACTERISTIC mRFPVTWL "Mailbox ventilation non-movement coolant temperature" VALUE 0x00008A73 REC_UBYTE_C 0 COMP_0430_S -50 205 /begin FUNCTION_LIST R301.3.FanAftPwl_1_0_4 /end FUNCTION_LIST /end CHARACTERISTIC
/begin CHARACTERISTIC mRFPVTWN "Water temp watching cancel W temp" VALUE 0x00008A74 REC_UBYTE_C 0 COMP_0430_S -50 205 /begin FUNCTION_LIST R301.3.FanAftPwl_1_0_4 /end FUNCTION_LIST /end CHARACTERISTIC
/begin CHARACTERISTIC mRFTWTM "Coolant temperature monitor time" VALUE 0x000094A4 REC_UWORD_C 0 COMP_0049 0 65535 /begin FUNCTION_LIST R301.3.FanAftPwl_1_0_4 /end FUNCTION_LIST /end CHARACTERISTIC
/begin CHARACTERISTIC mRGTIM1 "Real gearshift recognition timer initial value 1" VALUE 0x00008A90 REC_UBYTE_C 0 COMP_0014 0 2550 /begin FUNCTION_LIST R301.5.FuelCut_1_2_2 /end FUNCTION_LIST /end CHARACTERISTIC
/begin CHARACTERISTIC mRGTIM10 "Real gearshift recognition timer initial value 10" VALUE 0x00008A91 REC_UBYTE_C 0 COMP_0014 0 2550 /begin FUNCTION_LIST R301.5.FuelCut_1_2_2 /end FUNCTION_LIST /end CHARACTERISTIC
/begin CHARACTERISTIC mRGTIM2 "Real gearshift recognition timer initial value 2" VALUE 0x00008A92 REC_UBYTE_C 0 COMP_0014 0 2550 /begin FUNCTION_LIST R301.5.FuelCut_1_2_2 /end FUNCTION_LIST /end CHARACTERISTIC
/begin CHARACTERISTIC mRGTIM3 "Real gearshift recognition timer initial value 3" VALUE 0x00008A93 REC_UBYTE_C 0 COMP_0014 0 2550 /begin FUNCTION_LIST R301.5.FuelCut_1_2_2 /end FUNCTION_LIST /end CHARACTERISTIC
/begin CHARACTERISTIC mRGTIM4 "Real gearshift recognition timer initial value 4" VALUE 0x00008A94 REC_UBYTE_C 0 COMP_0014 0 2550 /begin FUNCTION_LIST R301.5.FuelCut_1_2_2 /end FUNCTION_LIST /end CHARACTERISTIC
/begin CHARACTERISTIC mRGTIM5 "Real gearshift recognition timer initial value 5" VALUE 0x00008A95 REC_UBYTE_C 0 COMP_0014 0 2550 /begin FUNCTION_LIST R301.5.FuelCut_1_2_2 /end FUNCTION_LIST /end CHARACTERISTIC
/begin CHARACTERISTIC mRGTIM6 "Real gearshift recognition timer initial value 6" VALUE 0x00008A96 REC_UBYTE_C 0 COMP_0014 0 2550 /begin FUNCTION_LIST R301.5.FuelCut_1_2_2 /end FUNCTION_LIST /end CHARACTERISTIC
/begin CHARACTERISTIC mRGTIM7 "Real gearshift recognition timer initial value 7" VALUE 0x00008A97 REC_UBYTE_C 0 COMP_0014 0 2550 /begin FUNCTION_LIST R301.5.FuelCut_1_2_2 /end FUNCTION_LIST /end CHARACTERISTIC
/begin CHARACTERISTIC mRGTIM8 "Real gearshift recognition timer initial value 8" VALUE 0x00008A98 REC_UBYTE_C 0 COMP_0014 0 2550 /begin FUNCTION_LIST R301.5.FuelCut_1_2_2 /end FUNCTION_LIST /end CHARACTERISTIC
/begin CHARACTERISTIC mRGTIM9 "Real gearshift recognition timer initial value 9" VALUE 0x00008A99 REC_UBYTE_C 0 COMP_0014 0 2550 /begin FUNCTION_LIST R301.5.FuelCut_1_2_2 /end FUNCTION_LIST /end CHARACTERISTIC
/begin CHARACTERISTIC mRNDFDEC "vRNDF decreace rate at ISC open loop" VALUE 0x000094D2 REC_UWORD_C 0 COMP_0457_S 0 65535 /begin FUNCTION_LIST R301.19.ISC_PID_cont_1_0_2 /end FUNCTION_LIST /end CHARACTERISTIC
/begin CHARACTERISTIC mRNIFMAX "vRNIF maximum limitation" VALUE 0x00009710 REC_SLONG_C 0 COMP_0458_S -8192.0058720256 8192.0058682109 /begin FUNCTION_LIST R301.19.ISC_PID_cont_1_0_2 /end FUNCTION_LIST /end CHARACTERISTIC
/begin CHARACTERISTIC mRNIFMIN "vRNIF minimum limitation" VALUE 0x00009714 REC_SLONG_C 0 COMP_0458_S -8192.0058720256 8192.0058682109 /begin FUNCTION_LIST R301.19.ISC_PID_cont_1_0_2 /end FUNCTION_LIST /end CHARACTERISTIC
/begin CHARACTERISTIC mRNPFDEC "vRNPF decreace rate at ISC open loop" VALUE 0x000094D4 REC_UWORD_C 0 COMP_0457_S 0 65535 /begin FUNCTION_LIST R301.19.ISC_PID_cont_1_0_2 /end FUNCTION_LIST /end CHARACTERISTIC
/begin CHARACTERISTIC mRNPFMAX "QFBI P-part maximum limitter" VALUE 0x000094D6 REC_UWORD_C 0 COMP_0051 0 65535 /begin FUNCTION_LIST R301.19.ISC_PID_cont_1_0_2 /end FUNCTION_LIST /end CHARACTERISTIC
/begin CHARACTERISTIC mRNPFMIN "QFBI P-part minimum limitter" VALUE 0x00008F48 REC_SWORD_C 0 COMP_0277 -32768 32767 /begin FUNCTION_LIST R301.19.ISC_PID_cont_1_0_2 /end FUNCTION_LIST /end CHARACTERISTIC
/begin CHARACTERISTIC mSERVLST "Speed threshold to activate servoing in case of speed limiter" VALUE 0x000081B2 REC_SBYTE_C 0 COMP_0464_S -128 127 DISPLAY_IDENTIFIER servlst /begin FUNCTION_LIST R208.6.SERVO_1_2_2 /end FUNCTION_LIST /end CHARACTERISTIC
/begin CHARACTERISTIC mSERVRST "Speed threshold to activate servo-control in case of cruise control" VALUE 0x000081B3 REC_SBYTE_C 0 COMP_0464_S -128 127 DISPLAY_IDENTIFIER servrst /begin FUNCTION_LIST R208.6.SERVO_1_2_2 /end FUNCTION_LIST /end CHARACTERISTIC
/begin CHARACTERISTIC mSLMXFC "Maximum saturation value of the force request (greater than the maximum force feasible by the engine)" VALUE 0x00009506 REC_UWORD_C 0 COMP_0374_S -20000 111070 DISPLAY_IDENTIFIER Cxx_sl_max_forc /begin FUNCTION_LIST R208.6.SERVO_1_2_2 /end FUNCTION_LIST /end CHARACTERISTIC
/begin CHARACTERISTIC mSLSPMXFD "Force gradient for comfortable speed limiter activation" VALUE 0x00009512 REC_UWORD_C 0 COMP_0373_S 0 131070 DISPLAY_IDENTIFIER Cxx_sl_sp_max_forc_dec /begin FUNCTION_LIST R208.6.SERVO_1_2_2 /end FUNCTION_LIST /end CHARACTERISTIC
/begin CHARACTERISTIC mTCLUDL "Cut-in delay switching delay after Clutched" VALUE 0x00008B99 REC_UBYTE_C 0 COMP_0008 0 25500 /begin FUNCTION_LIST R301.5.FuelCut_1_2_2 /end FUNCTION_LIST /end CHARACTERISTIC
/begin CHARACTERISTIC mTGTVOCOV "Throttle valve maximum position" VALUE 0x0000958E REC_UWORD_C 0 COMP_0130 0 1802.2125 /begin FUNCTION_LIST R301.13.FFDforDiagOnCAN_1_1_3 R901.1.Diag_on_can_app_1_6_2 /end FUNCTION_LIST /end CHARACTERISTIC
/begin CHARACTERISTIC mTLCDL4 "During lockup, at the time of the slowdown, cut-in delay (a low coolant temperature)" VALUE 0x00008BFC REC_UBYTE_C 0 COMP_0014 0 2550 /begin FUNCTION_LIST R301.5.FuelCut_1_2_2 /end FUNCTION_LIST /end CHARACTERISTIC
/begin CHARACTERISTIC mTLCDL42 "During lockup, at the time of the slowdown, cut-in delay (a low coolant temperature, half-cylinder)" VALUE 0x00008BFD REC_UBYTE_C 0 COMP_0014 0 2550 /begin FUNCTION_LIST R301.5.FuelCut_1_2_2 /end FUNCTION_LIST /end CHARACTERISTIC
/begin CHARACTERISTIC mTLCDN42 "During lockup, at the time of the slowdown, cut-in delay (high rotation, half-cylinder)" VALUE 0x00008BFF REC_UBYTE_C 0 COMP_0014 0 2550 /begin FUNCTION_LIST R301.5.FuelCut_1_2_2 /end FUNCTION_LIST /end CHARACTERISTIC
/begin CHARACTERISTIC mTLCDNH4 "During lockup, at the time of the slowdown, cut-in delay (high rotation)" VALUE 0x00008C01 REC_UBYTE_C 0 COMP_0014 0 2550 /begin FUNCTION_LIST R301.5.FuelCut_1_2_2 /end FUNCTION_LIST /end CHARACTERISTIC
/begin CHARACTERISTIC mTLFCD4 "During lockup, at the time of the slowdown, cut-in delay (low rotation)" VALUE 0x00008C04 REC_UBYTE_C 0 COMP_0014 0 2550 /begin FUNCTION_LIST R301.5.FuelCut_1_2_2 /end FUNCTION_LIST /end CHARACTERISTIC
/begin CHARACTERISTIC mTLFCD42 "During lockup, at the time of the slowdown, cut-in delay (low rotation, half-cylinder)" VALUE 0x00008C05 REC_UBYTE_C 0 COMP_0014 0 2550 /begin FUNCTION_LIST R301.5.FuelCut_1_2_2 /end FUNCTION_LIST /end CHARACTERISTIC
/begin CHARACTERISTIC mTLFCDL "Cut-in delay at the time of the slowdown between lock-ups (low rotation 2)" VALUE 0x00008C06 REC_UBYTE_C 0 COMP_0014 0 2550 /begin FUNCTION_LIST R301.5.FuelCut_1_2_2 /end FUNCTION_LIST /end CHARACTERISTIC
/begin CHARACTERISTIC mTLFCDL2 "Cut-in delay at the time of the slowdown between lock-ups (low rotation, half-cylinder 2)" VALUE 0x00008C07 REC_UBYTE_C 0 COMP_0014 0 2550 /begin FUNCTION_LIST R301.5.FuelCut_1_2_2 /end FUNCTION_LIST /end CHARACTERISTIC
/begin CHARACTERISTIC mTMCLSWDL "Control effective -- invalid change Clutch SW condition delay" VALUE 0x00008C28 REC_UBYTE_C 0 COMP_0014 0 2550 /begin FUNCTION_LIST R301.8.Inverse_filter_1_1_3 /end FUNCTION_LIST /end CHARACTERISTIC
/begin CHARACTERISTIC mTNFCD4 "Cut-in delay switching rotation" VALUE 0x00008CB5 REC_UBYTE_C 0 COMP_0020 0 12750 /begin FUNCTION_LIST R301.5.FuelCut_1_2_2 /end FUNCTION_LIST /end CHARACTERISTIC
/begin CHARACTERISTIC mTNFCDL "Cut-in delay change rotation 2" VALUE 0x00008CB6 REC_UBYTE_C 0 COMP_0020 0 12750 /begin FUNCTION_LIST R301.5.FuelCut_1_2_2 /end FUNCTION_LIST /end CHARACTERISTIC
/begin CHARACTERISTIC mTOGLCTR "Maximum number of activation/deactivation before a calibrated delay to consider toggling" VALUE 0x00008CBF REC_UBYTE_C 0 COMP_0068 0 255 DISPLAY_IDENTIFIER Cxx_togl_thr /begin FUNCTION_LIST R208.10.dgn_ccadd_1_3_2 /end FUNCTION_LIST /end CHARACTERISTIC
/begin CHARACTERISTIC mTOGLTMR "Delay to consider toggling phenomena" VALUE 0x00008CC0 REC_UBYTE_C 0 COMP_0344_S 0 2.55 DISPLAY_IDENTIFIER Cxx_togl_dly /begin FUNCTION_LIST R208.10.dgn_ccadd_1_3_2 /end FUNCTION_LIST /end CHARACTERISTIC
/begin CHARACTERISTIC mTPSAPFRS "Minimum time to detect a brake pedal press" VALUE 0x00008CDA REC_UBYTE_C 0 COMP_0371_S 0 10.2 DISPLAY_IDENTIFIER tpsapfre /begin FUNCTION_LIST R208.8.DACAX_1_1_5 /end FUNCTION_LIST /end CHARACTERISTIC
/begin CHARACTERISTIC mTPSFRBRS "Minimum time to detect a sudden braking" VALUE 0x00008CDB REC_UBYTE_C 0 COMP_0371_S 0 10.2 DISPLAY_IDENTIFIER tpsfrbru /begin FUNCTION_LIST R208.8.DACAX_1_1_5 /end FUNCTION_LIST /end CHARACTERISTIC
/begin CHARACTERISTIC mTQGBCSD "Idle speed Airflow when AGB communication default" VALUE 0x0000960E REC_UWORD_C 0 COMP_0473_S 0 6553.5 /begin FUNCTION_LIST R301.6.IscAirflow_1_4_5 /end FUNCTION_LIST /end CHARACTERISTIC
/begin CHARACTERISTIC mTVOCOV "Throttle valve maximum position for TVO" VALUE 0x00008D05 REC_UBYTE_C 0 COMP_0002 0 89.25 /begin FUNCTION_LIST R301.13.FFDforDiagOnCAN_1_1_3 R901.1.Diag_on_can_app_1_6_2 /end FUNCTION_LIST /end CHARACTERISTIC
/begin CHARACTERISTIC mTWFCD4 "Cut-in delay switching coolant temperature" VALUE 0x00008D2A REC_UBYTE_C 0 COMP_0035 -50 205 /begin FUNCTION_LIST R301.5.FuelCut_1_2_2 /end FUNCTION_LIST /end CHARACTERISTIC
/begin CHARACTERISTIC mVEHMASS "Vehicle mass" VALUE 0x00008DC2 REC_UBYTE_C 0 COMP_0475_S 450 3000 DISPLAY_IDENTIFIER vehmass /begin FUNCTION_LIST R208.6.SERVO_1_2_2 /end FUNCTION_LIST /end CHARACTERISTIC
/begin CHARACTERISTIC mVSABDLYS "Frame absence  duration to   declare invalid vehicle  speed" VALUE 0x00008DF4 REC_UBYTE_C 0 COMP_0371_S 0 10.2 DISPLAY_IDENTIFIER Cxx_cru_abst_vs_dly /begin FUNCTION_LIST R208.2.VSINT_1_1_2 /end FUNCTION_LIST /end CHARACTERISTIC
/begin CHARACTERISTIC mVSNKDLYS "Invalid value duration to declare invalid vehicle speed" VALUE 0x00008E01 REC_UBYTE_C 0 COMP_0371_S 0 10.2 DISPLAY_IDENTIFIER Cxx_cru_nok_vs_dly /begin FUNCTION_LIST R208.2.VSINT_1_1_2 /end FUNCTION_LIST /end CHARACTERISTIC
/begin CHARACTERISTIC mVSPCT2R "High vehicle-speed fuel cut iudging delay (reverse)" VALUE 0x00008E0B REC_UBYTE_C 0 COMP_0007 0 510 /begin FUNCTION_LIST R301.5.FuelCut_1_2_2 /end FUNCTION_LIST /end CHARACTERISTIC
/begin CHARACTERISTIC mVSPRC2R "All cylinder recovery vehicle speed (reverse)" VALUE 0x00008E18 REC_UBYTE_C 0 COMP_0007 0 510 /begin FUNCTION_LIST R301.5.FuelCut_1_2_2 /end FUNCTION_LIST /end CHARACTERISTIC
/begin CHARACTERISTIC mMKTR_RSA "Flat compensation coefficient map" MAP 0x0000A2FE REC_UBYTE_C 0 COMP_0045 0 1.9921875
 /begin AXIS_DESCR COM_AXIS NO_INPUT_QUANTITY COMP_0020 16 0 12750 AXIS_PTS_REF mTADVTRSN /end AXIS_DESCR
 /begin AXIS_DESCR COM_AXIS NO_INPUT_QUANTITY COMP_0032 16 0 0.99609375 AXIS_PTS_REF mQKTRM /end AXIS_DESCR
 /begin FUNCTION_LIST R301.2.MapBreakpoint_1_1_2 /end FUNCTION_LIST
/end CHARACTERISTIC
/begin CHARACTERISTIC mMTFA_RSA "Target air-fuel ratio map for Renault" MAP 0x0000A6DE REC_UBYTE_C 0 COMP_0045 0 1.9921875
 /begin AXIS_DESCR COM_AXIS NO_INPUT_QUANTITY COMP_0020 16 0 12750 AXIS_PTS_REF mTADVTRSN /end AXIS_DESCR
 /begin AXIS_DESCR COM_AXIS NO_INPUT_QUANTITY COMP_0045 16 0 1.9921875 AXIS_PTS_REF mICTF_RSA /end AXIS_DESCR
 /begin FUNCTION_LIST R301.2.MapBreakpoint_1_1_2 R301.9.Target_Equivalent_Ratio_1_0_2 /end FUNCTION_LIST
/end CHARACTERISTIC
/begin CHARACTERISTIC mMVH6_RSA "VTC target operation angle computed map - High Tw - for Renault" MAP 0x0000A81E REC_UBYTE_C 0 COMP_0256 -64 63.5
 /begin AXIS_DESCR COM_AXIS NO_INPUT_QUANTITY COMP_0020 16 0 12750 AXIS_PTS_REF mTADVTRSN /end AXIS_DESCR
 /begin AXIS_DESCR COM_AXIS NO_INPUT_QUANTITY COMP_0045 16 0 1.9921875 AXIS_PTS_REF mICTV_RSA /end AXIS_DESCR
 /begin FUNCTION_LIST R301.2.MapBreakpoint_1_1_2 /end FUNCTION_LIST
/end CHARACTERISTIC
/begin CHARACTERISTIC mMVT6_RSA "VTC target operation angle computed map for Renault" MAP 0x0000A91E REC_UBYTE_C 0 COMP_0256 -64 63.5
 /begin AXIS_DESCR COM_AXIS NO_INPUT_QUANTITY COMP_0020 16 0 12750 AXIS_PTS_REF mTADVTRSN /end AXIS_DESCR
 /begin AXIS_DESCR COM_AXIS NO_INPUT_QUANTITY COMP_0045 16 0 1.9921875 AXIS_PTS_REF mICTV_RSA /end AXIS_DESCR
 /begin FUNCTION_LIST R301.2.MapBreakpoint_1_1_2 /end FUNCTION_LIST
/end CHARACTERISTIC
/begin CHARACTERISTIC mMINJTMR "Injection end timing map" MAP 0x00009DDE REC_UBYTE_C 0 COMP_0055 0 1020
 /begin AXIS_DESCR COM_AXIS NO_INPUT_QUANTITY COMP_0000 8 0 6375 AXIS_PTS_REF mTINJTMNE /end AXIS_DESCR
 /begin AXIS_DESCR COM_AXIS NO_INPUT_QUANTITY COMP_0009 8 0 199.21875 AXIS_PTS_REF mTINJTMTP /end AXIS_DESCR
 /begin FUNCTION_LIST R301.10.TITM_1_0_2 /end FUNCTION_LIST
/end CHARACTERISTIC
/begin CHARACTERISTIC mPAMBCOV "Atmospheric pressure unity change table" CURVE 0x0000E2EC REC_UWORD_C 0 COMP_0491_S 0 65535
 /begin AXIS_DESCR COM_AXIS NO_INPUT_QUANTITY COMP_0050 16 0 5119.921875 AXIS_PTS_REF mPAMBBRK /end AXIS_DESCR
 /begin FUNCTION_LIST R301.13.FFDforDiagOnCAN_1_1_3 R901.1.Diag_on_can_app_1_6_2 /end FUNCTION_LIST
/end CHARACTERISTIC
/begin CHARACTERISTIC mTBAEROFM "Cartography of resistive effort function of vehicle speed" CURVE 0x0000CE5A REC_UBYTE_C 0 COMP_0492_S 0 6375
 /begin AXIS_DESCR COM_AXIS NO_INPUT_QUANTITY COMP_0429 16 0 255 AXIS_PTS_REF mTBAEROBP /end AXIS_DESCR
 DISPLAY_IDENTIFIER tbaerofm /begin FUNCTION_LIST R208.6.SERVO_1_2_2 /end FUNCTION_LIST /end CHARACTERISTIC
/begin CHARACTERISTIC mTDKAS_R "After the start. decrease rate table" CURVE 0x0000CF86 REC_UBYTE_C 0 COMP_0111 1.00392156862745 256
 /begin AXIS_DESCR FIX_AXIS NO_INPUT_QUANTITY COMP_0495_S 16 -30 120 FIX_AXIS_PAR_DIST 0 1 16 /end AXIS_DESCR
 /begin FUNCTION_LIST R301.2.MapBreakpoint_1_1_2 /end FUNCTION_LIST
/end CHARACTERISTIC
/begin CHARACTERISTIC mTISCSS_R "At the time of the start. ISC compensation value 2 table" CURVE 0x0000D2C2 REC_UBYTE_C 0 COMP_0276 0 1020
 /begin AXIS_DESCR FIX_AXIS NO_INPUT_QUANTITY COMP_0495_S 16 -30 120 FIX_AXIS_PAR_DIST 0 1 16 /end AXIS_DESCR
 /begin FUNCTION_LIST R301.2.MapBreakpoint_1_1_2 R301.6.IscAirflow_1_4_5 /end FUNCTION_LIST
/end CHARACTERISTIC
/begin CHARACTERISTIC mTISCST_R "At the time of the start. ISC compensation value 1 table" CURVE 0x0000D2DA REC_UBYTE_C 0 COMP_0276 0 1020
 /begin AXIS_DESCR FIX_AXIS NO_INPUT_QUANTITY COMP_0495_S 16 -30 120 FIX_AXIS_PAR_DIST 0 1 16 /end AXIS_DESCR
 /begin FUNCTION_LIST R301.2.MapBreakpoint_1_1_2 R301.6.IscAirflow_1_4_5 /end FUNCTION_LIST
/end CHARACTERISTIC
/begin CHARACTERISTIC mTKASS_R "After the start. increase water temperature compensation" CURVE 0x0000D352 REC_UBYTE_C 0 COMP_0066 0 3.984375
 /begin AXIS_DESCR FIX_AXIS NO_INPUT_QUANTITY COMP_0495_S 16 -30 120 FIX_AXIS_PAR_DIST 0 1 16 /end AXIS_DESCR
 /begin FUNCTION_LIST R301.2.MapBreakpoint_1_1_2 /end FUNCTION_LIST
/end CHARACTERISTIC
/begin CHARACTERISTIC mTKAS_R "After the start. increase table" CURVE 0x0000D362 REC_UBYTE_C 0 COMP_0066 0 3.984375
 /begin AXIS_DESCR FIX_AXIS NO_INPUT_QUANTITY COMP_0495_S 16 -30 120 FIX_AXIS_PAR_DIST 0 1 16 /end AXIS_DESCR
 /begin FUNCTION_LIST R301.2.MapBreakpoint_1_1_2 /end FUNCTION_LIST
/end CHARACTERISTIC
/begin CHARACTERISTIC mTKHTBT1 "KHOTBT table" CURVE 0x0000EAC2 REC_UWORD_C 0 COMP_0456 0 1.999970916
 /begin AXIS_DESCR COM_AXIS NO_INPUT_QUANTITY COMP_0497_S 16 -128 127.99609375 AXIS_PTS_REF mTKHTBC /end AXIS_DESCR
 /begin FUNCTION_LIST R301.7.KHOT_1_0_2 /end FUNCTION_LIST
/end CHARACTERISTIC
/begin CHARACTERISTIC mTQAGBCOR "Minimum Offset on Ldle speed Airflow f coolant temperature when AGB in Drive position" CURVE 0x0000ECD2 REC_UWORD_C 0 COMP_0499_S 0 6553.5
 /begin AXIS_DESCR COM_AXIS NO_INPUT_QUANTITY COMP_0500_S 16 -40 119.99754221 AXIS_PTS_REF mTQAGBCBP /end AXIS_DESCR
 /begin FUNCTION_LIST R301.6.IscAirflow_1_4_5 /end FUNCTION_LIST
/end CHARACTERISTIC
/begin CHARACTERISTIC mTQAGBCRR "Minimum Offset on Idle speed Airflow f coolant temperature when AGB in Rear position" CURVE 0x0000ECF2 REC_UWORD_C 0 COMP_0499_S 0 6553.5
 /begin AXIS_DESCR COM_AXIS NO_INPUT_QUANTITY COMP_0500_S 16 -40 119.99754221 AXIS_PTS_REF mTQAGBCBP /end AXIS_DESCR
 /begin FUNCTION_LIST R301.6.IscAirflow_1_4_5 /end FUNCTION_LIST
/end CHARACTERISTIC
/begin CHARACTERISTIC mTQAGBDRG "Minimum Offset on Idle speed Airflow f coolant temperature when AGB in Drag reduction phase" CURVE 0x0000ED12 REC_UWORD_C 0 COMP_0473_S 0 6553.5
 /begin AXIS_DESCR COM_AXIS NO_INPUT_QUANTITY COMP_0500_S 16 -40 119.99754221 AXIS_PTS_REF mTQAGBCBP /end AXIS_DESCR
 /begin FUNCTION_LIST R301.6.IscAirflow_1_4_5 /end FUNCTION_LIST
/end CHARACTERISTIC
/begin CHARACTERISTIC mTQAGBDRN "Minimum Offset on Idle speed Airflow f coolant temperature when AGB in Drag reduction phase and neutral position" CURVE 0x0000ED32 REC_UWORD_C 0 COMP_0473_S 0 6553.5
 /begin AXIS_DESCR COM_AXIS NO_INPUT_QUANTITY COMP_0500_S 16 -40 119.99754221 AXIS_PTS_REF mTQAGBCBP /end AXIS_DESCR
 /begin FUNCTION_LIST R301.6.IscAirflow_1_4_5 /end FUNCTION_LIST
/end CHARACTERISTIC
/begin CHARACTERISTIC mTQBCV1R "A negative pressure air flow-quantity TBL (6&8cly)" CURVE 0x0000ED82 REC_UWORD_C 0 COMP_0051 0 65535
 /begin AXIS_DESCR FIX_AXIS NO_INPUT_QUANTITY COMP_0271_S 16 0 6000 FIX_AXIS_PAR_DIST 0 1 16 /end AXIS_DESCR
 /begin FUNCTION_LIST R301.6.IscAirflow_1_4_5 /end FUNCTION_LIST
/end CHARACTERISTIC
/begin CHARACTERISTIC mTTST_R1 "At the time of the start. injection pulse width table" CURVE 0x0000DBC2 REC_UBYTE_C 0 COMP_0053 0 255
 /begin AXIS_DESCR FIX_AXIS NO_INPUT_QUANTITY COMP_0495_S 16 -30 120 FIX_AXIS_PAR_DIST 0 1 16 /end AXIS_DESCR
 /begin FUNCTION_LIST R301.2.MapBreakpoint_1_1_2 /end FUNCTION_LIST
/end CHARACTERISTIC
/begin CHARACTERISTIC mTTST_R2 "At the time of the start. injection pulse width table" CURVE 0x0000DBD2 REC_UBYTE_C 0 COMP_0053 0 255
 /begin AXIS_DESCR FIX_AXIS NO_INPUT_QUANTITY COMP_0495_S 16 -30 120 FIX_AXIS_PAR_DIST 0 1 16 /end AXIS_DESCR
 /begin FUNCTION_LIST R301.2.MapBreakpoint_1_1_2 /end FUNCTION_LIST
/end CHARACTERISTIC
/begin CHARACTERISTIC mTTST_R3 "At the time of the start. injection pulse width table" CURVE 0x0000DBE2 REC_UBYTE_C 0 COMP_0053 0 255
 /begin AXIS_DESCR FIX_AXIS NO_INPUT_QUANTITY COMP_0495_S 16 -30 120 FIX_AXIS_PAR_DIST 0 1 16 /end AXIS_DESCR
 /begin FUNCTION_LIST R301.2.MapBreakpoint_1_1_2 /end FUNCTION_LIST
/end CHARACTERISTIC
/begin CHARACTERISTIC mTTST_R4 "At the time of the start. injection pulse width table" CURVE 0x0000DBF2 REC_UBYTE_C 0 COMP_0053 0 255
 /begin AXIS_DESCR FIX_AXIS NO_INPUT_QUANTITY COMP_0495_S 16 -30 120 FIX_AXIS_PAR_DIST 0 1 16 /end AXIS_DESCR
 /begin FUNCTION_LIST R301.2.MapBreakpoint_1_1_2 /end FUNCTION_LIST
/end CHARACTERISTIC
/begin CHARACTERISTIC mTTST_R5 "At the time of the start. injection pulse width table" CURVE 0x0000DC02 REC_UBYTE_C 0 COMP_0053 0 255
 /begin AXIS_DESCR FIX_AXIS NO_INPUT_QUANTITY COMP_0495_S 16 -30 120 FIX_AXIS_PAR_DIST 0 1 16 /end AXIS_DESCR
 /begin FUNCTION_LIST R301.2.MapBreakpoint_1_1_2 /end FUNCTION_LIST
/end CHARACTERISTIC
/begin CHARACTERISTIC mTAGBCD1 "Time constant table for reverse switch filtering (on)" CURVE 0x0000CE12 REC_UBYTE_C 0 COMP_0014 0 2550
 /begin AXIS_DESCR COM_AXIS NO_INPUT_QUANTITY COMP_0511_S 8 -40 119.375 AXIS_PTS_REF mTAGBCDBP /end AXIS_DESCR
 /begin FUNCTION_LIST R301.6.IscAirflow_1_4_5 /end FUNCTION_LIST
/end CHARACTERISTIC
/begin CHARACTERISTIC mTAGBCD2 "Time constant table for reverse switch filtering (off)" CURVE 0x0000CE1A REC_UBYTE_C 0 COMP_0014 0 2550
 /begin AXIS_DESCR COM_AXIS NO_INPUT_QUANTITY COMP_0511_S 8 -40 119.375 AXIS_PTS_REF mTAGBCDBP /end AXIS_DESCR
 /begin FUNCTION_LIST R301.6.IscAirflow_1_4_5 /end FUNCTION_LIST
/end CHARACTERISTIC
/begin CHARACTERISTIC mTALTCORD "Correction f alternator load when AGB in drive position detected" CURVE 0x0000E56A REC_UWORD_C 0 COMP_0499_S 0 6553.5
 /begin AXIS_DESCR COM_AXIS NO_INPUT_QUANTITY COMP_0365_S 8 0 655350 AXIS_PTS_REF mTQALTPBP /end AXIS_DESCR
 /begin FUNCTION_LIST R301.6.IscAirflow_1_4_5 /end FUNCTION_LIST
/end CHARACTERISTIC
/begin CHARACTERISTIC mTALTCORN "Correction f alternator load when AGB in nutral position detected" CURVE 0x0000E57A REC_UWORD_C 0 COMP_0499_S 0 6553.5
 /begin AXIS_DESCR COM_AXIS NO_INPUT_QUANTITY COMP_0365_S 8 0 655350 AXIS_PTS_REF mTQALTPBP /end AXIS_DESCR
 /begin FUNCTION_LIST R301.6.IscAirflow_1_4_5 /end FUNCTION_LIST
/end CHARACTERISTIC
/begin CHARACTERISTIC mTDAGBDYN "Delay to maintain dynamic compensation for AGBCOR at a constant value" CURVE 0x0000CF16 REC_UBYTE_C 0 COMP_0183 0 5100
 /begin AXIS_DESCR COM_AXIS NO_INPUT_QUANTITY COMP_0515_S 8 -40 119.375 AXIS_PTS_REF mTDAGBDBP /end AXIS_DESCR
 /begin FUNCTION_LIST R301.6.IscAirflow_1_4_5 /end FUNCTION_LIST
/end CHARACTERISTIC
/begin CHARACTERISTIC mTDAGBDYR "Delay to maintain dynamic compensation for AGBCOR at a constant value for reverse" CURVE 0x0000CF1E REC_UBYTE_C 0 COMP_0183 0 5100
 /begin AXIS_DESCR COM_AXIS NO_INPUT_QUANTITY COMP_0515_S 8 -40 119.375 AXIS_PTS_REF mTDAGBDBP /end AXIS_DESCR
 /begin FUNCTION_LIST R301.6.IscAirflow_1_4_5 /end FUNCTION_LIST
/end CHARACTERISTIC
/begin CHARACTERISTIC mTDCGBDYN "Table of decrease value of dynamic compensation for AGBCOR" CURVE 0x0000CF4E REC_UBYTE_C 0 COMP_0473_S 0 25.5
 /begin AXIS_DESCR COM_AXIS NO_INPUT_QUANTITY COMP_0515_S 8 -40 119.375 AXIS_PTS_REF mTDCGBDBP /end AXIS_DESCR
 /begin FUNCTION_LIST R301.6.IscAirflow_1_4_5 /end FUNCTION_LIST
/end CHARACTERISTIC
/begin CHARACTERISTIC mTDCGBDYR "Table of decrease value of dynamic compensation for AGBCOR for reverse" CURVE 0x0000CF56 REC_UBYTE_C 0 COMP_0473_S 0 25.5
 /begin AXIS_DESCR COM_AXIS NO_INPUT_QUANTITY COMP_0515_S 8 -40 119.375 AXIS_PTS_REF mTDCGBDBP /end AXIS_DESCR
 /begin FUNCTION_LIST R301.6.IscAirflow_1_4_5 /end FUNCTION_LIST
/end CHARACTERISTIC
/begin CHARACTERISTIC mTDRAGFT1 "Time constant table for dreg switch filtering (on)" CURVE 0x0000CFB2 REC_UBYTE_C 0 COMP_0014 0 2550
 /begin AXIS_DESCR COM_AXIS NO_INPUT_QUANTITY COMP_0515_S 8 -40 119.375 AXIS_PTS_REF mTDRAGFBP /end AXIS_DESCR
 /begin FUNCTION_LIST R301.6.IscAirflow_1_4_5 /end FUNCTION_LIST
/end CHARACTERISTIC
/begin CHARACTERISTIC mTDRAGFT2 "Time constant table for dreg switch filtering (off)" CURVE 0x0000CFBA REC_UBYTE_C 0 COMP_0014 0 2550
 /begin AXIS_DESCR COM_AXIS NO_INPUT_QUANTITY COMP_0515_S 8 -40 119.375 AXIS_PTS_REF mTDRAGFBP /end AXIS_DESCR
 /begin FUNCTION_LIST R301.6.IscAirflow_1_4_5 /end FUNCTION_LIST
/end CHARACTERISTIC
/begin CHARACTERISTIC mTISCCTP "CTP transiency compensation initial value table" CURVE 0x0000D2A2 REC_UBYTE_C 0 COMP_0051 0 255
 /begin AXIS_DESCR COM_AXIS NO_INPUT_QUANTITY COMP_0519_S 8 0 25500 AXIS_PTS_REF mTISCCTPB /end AXIS_DESCR
 /begin FUNCTION_LIST R301.6.IscAirflow_1_4_5 /end FUNCTION_LIST
/end CHARACTERISTIC
/begin CHARACTERISTIC mTKREGR "Target air-fuel ratio regular compensation rate (The rate of target equivalence-ratio regular compensation)" CURVE 0x0000D4AA REC_UBYTE_C 0 COMP_0044 0 1.9921875
 /begin AXIS_DESCR COM_AXIS NO_INPUT_QUANTITY COMP_0000 8 0 6375 AXIS_PTS_REF mTKREGNE /end AXIS_DESCR
 /begin FUNCTION_LIST R301.2.MapBreakpoint_1_1_2 R301.9.Target_Equivalent_Ratio_1_0_2 /end FUNCTION_LIST
/end CHARACTERISTIC
/begin CHARACTERISTIC mTNEUTFT1 "Time constant table for neutral switch filtering (on)" CURVE 0x0000D60C REC_UBYTE_C 0 COMP_0014 0 2550
 /begin AXIS_DESCR COM_AXIS NO_INPUT_QUANTITY COMP_0511_S 8 -40 119.375 AXIS_PTS_REF mTNEUTFBP /end AXIS_DESCR
 /begin FUNCTION_LIST R301.6.IscAirflow_1_4_5 /end FUNCTION_LIST
/end CHARACTERISTIC
/begin CHARACTERISTIC mTNEUTFT2 "Time constant table for neutral switch filtering (off)" CURVE 0x0000D614 REC_UBYTE_C 0 COMP_0014 0 2550
 /begin AXIS_DESCR COM_AXIS NO_INPUT_QUANTITY COMP_0511_S 8 -40 119.375 AXIS_PTS_REF mTNEUTFBP /end AXIS_DESCR
 /begin FUNCTION_LIST R301.6.IscAirflow_1_4_5 /end FUNCTION_LIST
/end CHARACTERISTIC
/begin CHARACTERISTIC mTPGARN2 "P-gain 2 table" CURVE 0x0000EBE2 REC_UWORD_C 0 COMP_0438_S 0 1.999970916
 /begin AXIS_DESCR COM_AXIS NO_INPUT_QUANTITY COMP_0515_S 8 -40 40919.375 AXIS_PTS_REF mTTWPGARN2 /end AXIS_DESCR
 /begin FUNCTION_LIST R301.19.ISC_PID_cont_1_0_2 /end FUNCTION_LIST
/end CHARACTERISTIC
/begin CHARACTERISTIC mTPGARN4 "P-gain 4 table" CURVE 0x0000EBF2 REC_UWORD_C 0 COMP_0438_S 0 1.999970916
 /begin AXIS_DESCR COM_AXIS NO_INPUT_QUANTITY COMP_0515_S 8 -40 40919.375 AXIS_PTS_REF mTTWPGARN4 /end AXIS_DESCR
 /begin FUNCTION_LIST R301.19.ISC_PID_cont_1_0_2 /end FUNCTION_LIST
/end CHARACTERISTIC
/begin CHARACTERISTIC mTQALTNEC "Coef to modify correction f engine speed" CURVE 0x0000D760 REC_UBYTE_C 0 COMP_0388 0 25.5
 /begin AXIS_DESCR COM_AXIS NO_INPUT_QUANTITY COMP_0000 8 0 6375 AXIS_PTS_REF mTQALTNBP /end AXIS_DESCR
 /begin FUNCTION_LIST R301.6.IscAirflow_1_4_5 /end FUNCTION_LIST
/end CHARACTERISTIC
/begin CHARACTERISTIC mTQGBDY0R "Initial value of dynamic compensation for AGBCOR in reverse position" CURVE 0x0000EDD2 REC_UWORD_C 0 COMP_0473_S 0 6553.5
 /begin AXIS_DESCR COM_AXIS NO_INPUT_QUANTITY COMP_0500_S 8 -40 119.99754221 AXIS_PTS_REF mTQGBD0BP /end AXIS_DESCR
 /begin FUNCTION_LIST R301.6.IscAirflow_1_4_5 /end FUNCTION_LIST
/end CHARACTERISTIC
/begin CHARACTERISTIC mTQGBDYN0 "Initial value of dynamic compensation for AGBCOR" CURVE 0x0000EDE2 REC_UWORD_C 0 COMP_0473_S 0 6553.5
 /begin AXIS_DESCR COM_AXIS NO_INPUT_QUANTITY COMP_0500_S 8 -40 119.99754221 AXIS_PTS_REF mTQGBD0BP /end AXIS_DESCR
 /begin FUNCTION_LIST R301.6.IscAirflow_1_4_5 /end FUNCTION_LIST
/end CHARACTERISTIC
/begin CHARACTERISTIC mTQLSPSDLY "Power steering ISC compensation inhibition delay table" CURVE 0x0000D7CC REC_UBYTE_C 0 COMP_0008 0 25500
 /begin AXIS_DESCR COM_AXIS NO_INPUT_QUANTITY COMP_0430_S 8 -50 205 AXIS_PTS_REF mDQLSPSDLY /end AXIS_DESCR
 /begin FUNCTION_LIST R301.6.IscAirflow_1_4_5 /end FUNCTION_LIST
/end CHARACTERISTIC
/begin CHARACTERISTIC mTRNDFN "QFBI D-part value table (Negative acceleration)" CURVE 0x0000F036 REC_UWORD_C 0 COMP_0524_S -32768 32767
 /begin AXIS_DESCR COM_AXIS NO_INPUT_QUANTITY COMP_0476 8 0 12799.8046875 AXIS_PTS_REF mTRNDFAX /end AXIS_DESCR
 /begin FUNCTION_LIST R301.19.ISC_PID_cont_1_0_2 /end FUNCTION_LIST
/end CHARACTERISTIC
/begin CHARACTERISTIC mTRNDFP "QFBI D-part value table (Positive acceleration)" CURVE 0x0000F046 REC_UWORD_C 0 COMP_0524_S -32768 32767
 /begin AXIS_DESCR COM_AXIS NO_INPUT_QUANTITY COMP_0476 8 0 12799.8046875 AXIS_PTS_REF mTRNDFAX /end AXIS_DESCR
 /begin FUNCTION_LIST R301.19.ISC_PID_cont_1_0_2 /end FUNCTION_LIST
/end CHARACTERISTIC
/begin CHARACTERISTIC mTTQGBPWM "Calibration for the Gain used to format the correction applied in the calculation of torque consumed by AGB (constant intervals)" CURVE 0x0000DB36 REC_UBYTE_C 0 COMP_0527_S 0 25.5
 /begin AXIS_DESCR FIX_AXIS NO_INPUT_QUANTITY COMP_0528_S 8 600 1300 FIX_AXIS_PAR_DIST 0 1 8 /end AXIS_DESCR
 /begin FUNCTION_LIST R301.6.IscAirflow_1_4_5 /end FUNCTION_LIST
/end CHARACTERISTIC
/begin CHARACTERISTIC mINV_N_L "Inverse filter constant for L/U condition" MAP 0x0000B118 REC_UWORD_C 0 COMP_0068 0 65535
 /begin AXIS_DESCR FIX_AXIS NO_INPUT_QUANTITY COMP_0205_S 5 0 4 FIX_AXIS_PAR_DIST 0 1 5 /end AXIS_DESCR
 /begin AXIS_DESCR FIX_AXIS NO_INPUT_QUANTITY COMP_0276_S 9 1 9 FIX_AXIS_PAR_DIST 0 1 9 /end AXIS_DESCR
 /begin FUNCTION_LIST R301.8.Inverse_filter_1_1_3 /end FUNCTION_LIST
/end CHARACTERISTIC
/begin CHARACTERISTIC mNINV_N_L "The number of inverse filter constant shifts for L/U condition" MAP 0x000097AD REC_SBYTE_C 0 COMP_0263 -128 127
 /begin AXIS_DESCR FIX_AXIS NO_INPUT_QUANTITY COMP_0205_S 5 0 4 FIX_AXIS_PAR_DIST 0 1 5 /end AXIS_DESCR
 /begin AXIS_DESCR FIX_AXIS NO_INPUT_QUANTITY COMP_0276_S 9 1 9 FIX_AXIS_PAR_DIST 0 1 9 /end AXIS_DESCR
 /begin FUNCTION_LIST R301.8.Inverse_filter_1_1_3 /end FUNCTION_LIST
/end CHARACTERISTIC
/begin CHARACTERISTIC mfCSSWCHRP "The CC/SL failure due to main switch incoherence is irreversible" VALUE 0x000082F8 REC_UBYTE_C 0 COMP_0283 0 1 BIT_MASK 0x0080 DISPLAY_IDENTIFIER Cbx_cru_sl_swi_chr_prmt /begin FUNCTION_LIST R208.8.DACAX_1_1_5 /end FUNCTION_LIST /end CHARACTERISTIC
/begin CHARACTERISTIC mRSCTRL "Calibration flags for Renault specific controls" VALUE 0x00008AD6 REC_UBYTE_C 0 COMP_0283 0 255 /begin FUNCTION_LIST R301.1.Torque_realization_1_0_3 /end FUNCTION_LIST /end CHARACTERISTIC
/begin CHARACTERISTIC mfRSTQRAV "RSA Torque realization available flag" VALUE 0x00008AD6 REC_UBYTE_C 0 COMP_0283 0 1 BIT_MASK 0x0080 /begin FUNCTION_LIST R301.1.Torque_realization_1_0_3 /end FUNCTION_LIST /end CHARACTERISTIC
/begin CHARACTERISTIC mfATRETFC "Simultaneous fuelcut/regard activation flag" VALUE 0x00008AD6 REC_UBYTE_C 0 COMP_0283 0 1 BIT_MASK 0x0040 /begin FUNCTION_LIST R301.1.Torque_realization_1_0_3 /end FUNCTION_LIST /end CHARACTERISTIC
/begin CHARACTERISTIC mDGNSW[72] "Flag mDGNSW[72]" VALUE 0x00010254 REC_UBYTE_C 0 COMP_0283 0 255 /begin FUNCTION_LIST R301.12.ClutchSwDiag_1_0_1 /end FUNCTION_LIST /end CHARACTERISTIC
/begin CHARACTERISTIC mfCLSW "0:Not DGN  1:DGN" VALUE 0x00010254 REC_UBYTE_C 0 COMP_0283 0 1 BIT_MASK 0x0010 /begin FUNCTION_LIST R301.12.ClutchSwDiag_1_0_1 /end FUNCTION_LIST /end CHARACTERISTIC
/* AXIS -------------------------------------------------------------------- */
/begin AXIS_PTS mTADVTRSN "50rpm" 0x0000CDFE NO_INPUT_QUANTITY REC_AXIS_UBYTE 0 COMP_0020 16 0 12750 /end AXIS_PTS
/begin AXIS_PTS mQKTRM "1/256Å|" 0x0000CC88 NO_INPUT_QUANTITY REC_AXIS_UBYTE 0 COMP_0032 16 0 0.99609375 /end AXIS_PTS
/begin AXIS_PTS mICTF_RSA "1/128-" 0x0000CA09 NO_INPUT_QUANTITY REC_AXIS_UBYTE 0 COMP_0045 16 0 1.9921875 /end AXIS_PTS
/begin AXIS_PTS mICTV_RSA "1/128-" 0x0000CA19 NO_INPUT_QUANTITY REC_AXIS_UBYTE 0 COMP_0045 16 0 1.9921875 /end AXIS_PTS
/begin AXIS_PTS mTINJTMNE "25rpm" 0x0000D272 NO_INPUT_QUANTITY REC_AXIS_UBYTE 0 COMP_0000 8 0 6375 /end AXIS_PTS
/begin AXIS_PTS mTINJTMTP "100/128%" 0x0000D27A NO_INPUT_QUANTITY REC_AXIS_UBYTE 0 COMP_0009 8 0 199.21875 /end AXIS_PTS
/begin AXIS_PTS mPAMBBRK "20/256mV" 0x0000E2CC NO_INPUT_QUANTITY REC_AXIS_UWORD 0 COMP_0050 16 0 5119.921875 /end AXIS_PTS
/begin AXIS_PTS mTBAEROBP "1km/h" 0x0000CE4A NO_INPUT_QUANTITY REC_AXIS_UBYTE 0 COMP_0429 16 0 255 /end AXIS_PTS
/begin AXIS_PTS mTKHTBC "1/256deg" 0x0000EAA2 NO_INPUT_QUANTITY REC_AXIS_UWORD 0 COMP_0497_S 16 -128 127.99609375 /end AXIS_PTS
/begin AXIS_PTS mTQAGBCBP "0.625/256X-40degC" 0x0000ECB2 NO_INPUT_QUANTITY REC_AXIS_UWORD 0 COMP_0500_S 16 -40 119.99754221 /end AXIS_PTS
/begin AXIS_PTS mTAGBCDBP "0.625deg" 0x0000CE22 NO_INPUT_QUANTITY REC_AXIS_UBYTE 0 COMP_0511_S 8 -40 119.375 /end AXIS_PTS
/begin AXIS_PTS mTQALTPBP "10W" 0x0000ED72 NO_INPUT_QUANTITY REC_AXIS_UWORD 0 COMP_0365_S 8 0 655350 /end AXIS_PTS
/begin AXIS_PTS mTDAGBDBP "0.625degC" 0x0000CF0E NO_INPUT_QUANTITY REC_AXIS_UBYTE 0 COMP_0515_S 8 -40 119.375 /end AXIS_PTS
/begin AXIS_PTS mTDCGBDBP "0.625degC" 0x0000CF46 NO_INPUT_QUANTITY REC_AXIS_UBYTE 0 COMP_0515_S 8 -40 119.375 /end AXIS_PTS
/begin AXIS_PTS mTDRAGFBP "0.625degC" 0x0000CFAA NO_INPUT_QUANTITY REC_AXIS_UBYTE 0 COMP_0515_S 8 -40 119.375 /end AXIS_PTS
/begin AXIS_PTS mTISCCTPB "100W" 0x0000D2AA NO_INPUT_QUANTITY REC_AXIS_UBYTE 0 COMP_0519_S 8 0 25500 /end AXIS_PTS
/begin AXIS_PTS mTKREGNE "25rpm" 0x0000D4A2 NO_INPUT_QUANTITY REC_AXIS_UBYTE 0 COMP_0000 8 0 6375 /end AXIS_PTS
/begin AXIS_PTS mTNEUTFBP "0.625deg" 0x0000D604 NO_INPUT_QUANTITY REC_AXIS_UBYTE 0 COMP_0511_S 8 -40 119.375 /end AXIS_PTS
/begin AXIS_PTS mTTWPGARN2 "0.625X-40degC" 0x0000F4FE NO_INPUT_QUANTITY REC_AXIS_UWORD 0 COMP_0515_S 8 -40 40919.375 /end AXIS_PTS
/begin AXIS_PTS mTTWPGARN4 "0.625X-40degC" 0x0000F50E NO_INPUT_QUANTITY REC_AXIS_UWORD 0 COMP_0515_S 8 -40 40919.375 /end AXIS_PTS
/begin AXIS_PTS mTQALTNBP "25rpm" 0x0000D758 NO_INPUT_QUANTITY REC_AXIS_UBYTE 0 COMP_0000 8 0 6375 /end AXIS_PTS
/begin AXIS_PTS mTQGBD0BP "0.625/256X-40degC" 0x0000EDC2 NO_INPUT_QUANTITY REC_AXIS_UWORD 0 COMP_0500_S 8 -40 119.99754221 /end AXIS_PTS
/begin AXIS_PTS mDQLSPSDLY "1degC" 0x0000C936 NO_INPUT_QUANTITY REC_AXIS_UBYTE 0 COMP_0430_S 8 -50 205 /end AXIS_PTS
/begin AXIS_PTS mTRNDFAX "12.5/64rpm" 0x0000F026 NO_INPUT_QUANTITY REC_AXIS_UWORD 0 COMP_0476 8 0 12799.8046875 /end AXIS_PTS
/begin MEASUREMENT fDRVFB "0:â^ì]ê´ëŒçÙÉ…∫›êßå‰íÜÇ≈Ç»Ç¢  1:â^ì]ê´ëŒçÙÉ…∫›êßå‰íÜ" UBYTE COMP_0283 1 100 0 1 BIT_MASK 0x0002 ECU_ADDRESS 0xFFFF2AA6 /begin FUNCTION_LIST R301.4.AfFeedback_1_0_1 /end FUNCTION_LIST /end MEASUREMENT
/begin MEASUREMENT fCCADDENA "The CC diagnostic add-on is enabled" UBYTE COMP_0283 1 100 0 1 BIT_MASK 0x0010 ECU_ADDRESS 0xFFFF49D9 DISPLAY_IDENTIFIER Vbx_cru_diag_add_on_ena /begin FUNCTION_LIST R208.10.dgn_ccadd_1_3_2 /end FUNCTION_LIST /end MEASUREMENT
/begin MEASUREMENT fEVCRUSO "Event : store the cruise control deactivation due to main switch action" UBYTE COMP_0283 1 100 0 1 BIT_MASK 0x0008 ECU_ADDRESS 0xFFFF4277 DISPLAY_IDENTIFIER Event_cru_stg_off /begin FUNCTION_LIST R208.4.STFLW_1_2_2 R208.10.dgn_ccadd_1_3_2 /end FUNCTION_LIST /end MEASUREMENT
/begin MEASUREMENT fEVCRUSS "Event : store the last cause of cruise control deactivation due to SUSPEND switch press" UBYTE COMP_0283 1 100 0 1 BIT_MASK 0x0004 ECU_ADDRESS 0xFFFF4277 DISPLAY_IDENTIFIER Event_cru_stg_susp /begin FUNCTION_LIST R208.4.STFLW_1_2_2 R208.10.dgn_ccadd_1_3_2 /end FUNCTION_LIST /end MEASUREMENT
/begin MEASUREMENT fPFCRU "Present failure of cruise control" UBYTE COMP_0283 1 100 0 1 BIT_MASK 0x0004 ECU_ADDRESS 0xFFFF4278 DISPLAY_IDENTIFIER Vbx_cru_pf_det
 /begin FUNCTION_LIST R208.4.STFLW_1_2_2 R208.7.OUTMX_1_1_3 R208.8.DACAX_1_1_5 R208.10.dgn_ccadd_1_3_2 R901.1.Diag_on_can_app_1_6_2 /end FUNCTION_LIST
/end MEASUREMENT
/begin MEASUREMENT fCCNSXACT "Cruise control is in the active state" UBYTE COMP_0283 1 100 0 1 BIT_MASK 0x0080 ECU_ADDRESS 0xFFFF4288 DISPLAY_IDENTIFIER Vbx_cru_act /begin FUNCTION_LIST R208.6.SERVO_1_2_2 /end FUNCTION_LIST /end MEASUREMENT
/begin MEASUREMENT fCCSLCFSW "Concatenation of the CC/SL switches failures" UBYTE COMP_0283 1 100 0 1 BIT_MASK 0x0020 ECU_ADDRESS 0xFFFF4288 DISPLAY_IDENTIFIER Vbx_cru_sl_swi_cf_det /begin FUNCTION_LIST R208.4.STFLW_1_2_2 R208.8.DACAX_1_1_5 /end FUNCTION_LIST /end MEASUREMENT
/begin MEASUREMENT fCCSLWRN "Cruise control and speed limiter warning (overspeed)" UBYTE COMP_0283 1 100 0 1 BIT_MASK 0x0004 ECU_ADDRESS 0xFFFF4288 DISPLAY_IDENTIFIER Vbx_cru_sl_warn /begin FUNCTION_LIST R208.7.OUTMX_1_1_3 /end FUNCTION_LIST /end MEASUREMENT
/begin MEASUREMENT fCNXRVLV "CC or SL option detected" UBYTE COMP_0283 1 100 0 1 BIT_MASK 0x0004 ECU_ADDRESS 0xFFFF428C DISPLAY_IDENTIFIER Vbx_cru_sl_lk_stt /begin FUNCTION_LIST R208.8.DACAX_1_1_5 /end FUNCTION_LIST /end MEASUREMENT
/begin MEASUREMENT fCRUCMPBR "CC safety failure due to brake clutch information" UBYTE COMP_0283 1 100 0 1 BIT_MASK 0x0002 ECU_ADDRESS 0xFFFF428E DISPLAY_IDENTIFIER Vbx_cru_cmp_open_brk /begin FUNCTION_LIST R208.9.SAFETYX_1_3_2 /end FUNCTION_LIST /end MEASUREMENT
/begin MEASUREMENT fCRUCMPCL "CC safety failure due to wired clutch information" UBYTE COMP_0283 1 100 0 1 BIT_MASK 0x0001 ECU_ADDRESS 0xFFFF428E DISPLAY_IDENTIFIER Vbx_cru_cmp_bgin_clu /begin FUNCTION_LIST R208.9.SAFETYX_1_3_2 /end FUNCTION_LIST /end MEASUREMENT
/begin MEASUREMENT fCRUCMPFR "CC safety failure due to force setpoint presence" UBYTE COMP_0283 1 100 0 1 BIT_MASK 0x0080 ECU_ADDRESS 0xFFFF428F DISPLAY_IDENTIFIER Vbx_cru_cmp_forc_pres /begin FUNCTION_LIST R208.9.SAFETYX_1_3_2 /end FUNCTION_LIST /end MEASUREMENT
/begin MEASUREMENT fCRUIVSEN "Enabling the initialization of the CC servo-control speed reference" UBYTE COMP_0283 1 100 0 1 BIT_MASK 0x0020 ECU_ADDRESS 0xFFFF428F DISPLAY_IDENTIFIER Vbx_cru_ini_vs_ref_ena /begin FUNCTION_LIST R208.5.SETPT_1_1_0 /end FUNCTION_LIST /end MEASUREMENT
/begin MEASUREMENT fDFBRKCMP "Incoherence between brake information detected failure" UBYTE COMP_0283 1 100 0 1 BIT_MASK 0x0010 ECU_ADDRESS 0xFFFF4293 DISPLAY_IDENTIFIER Vbx_df_brk_pdl_cmp /begin FUNCTION_LIST R208.9.SAFETYX_1_3_2 R902.1.SafetyDiagManager_1_3_6 /end FUNCTION_LIST /end MEASUREMENT
/begin MEASUREMENT fDFCLSW "failure of clutch switch" UBYTE COMP_0283 1 100 0 1 BIT_MASK 0x0008 ECU_ADDRESS 0xFFFF4293 /begin FUNCTION_LIST R301.12.ClutchSwDiag_1_0_1 R902.1.SafetyDiagManager_1_3_6 /end FUNCTION_LIST /end MEASUREMENT
/begin MEASUREMENT fDFCLUCMP "Incoherence between clutch information detected failure" UBYTE COMP_0283 1 100 0 1 BIT_MASK 0x0004 ECU_ADDRESS 0xFFFF4293 DISPLAY_IDENTIFIER Vbx_df_bgin_clu_cmp /begin FUNCTION_LIST R208.9.SAFETYX_1_3_2 R902.1.SafetyDiagManager_1_3_6 /end FUNCTION_LIST /end MEASUREMENT
/begin MEASUREMENT fDFCRUCMP "CC safety detected failure" UBYTE COMP_0283 1 100 0 1 BIT_MASK 0x0002 ECU_ADDRESS 0xFFFF4293 DISPLAY_IDENTIFIER Vbx_df_cru_cmp /begin FUNCTION_LIST R208.9.SAFETYX_1_3_2 R902.1.SafetyDiagManager_1_3_6 /end FUNCTION_LIST /end MEASUREMENT
/begin MEASUREMENT fDFCSTOT "CC/SL not available due to a detected failure" UBYTE COMP_0283 1 100 0 1 BIT_MASK 0x0040 ECU_ADDRESS 0xFFFF4294 DISPLAY_IDENTIFIER Vbx_df_cru_sl_tot /begin FUNCTION_LIST R208.8.DACAX_1_1_5 R902.1.SafetyDiagManager_1_3_6 /end FUNCTION_LIST /end MEASUREMENT
/begin MEASUREMENT fEVCRUIS "This event produced by cru    implies the copy of the current vehicle speed in the speed setpoint" UBYTE COMP_0283 1 100 0 1 BIT_MASK 0x0004 ECU_ADDRESS 0xFFFF42A3 DISPLAY_IDENTIFIER Event_cru_ini_sp /begin FUNCTION_LIST R208.4.STFLW_1_2_2 R208.5.SETPT_1_1_0 R208.6.SERVO_1_2_2 /end FUNCTION_LIST /end MEASUREMENT
/begin MEASUREMENT fEVCRUIVS "This event initializes the CC servo-control speed reference" UBYTE COMP_0283 1 100 0 1 BIT_MASK 0x0002 ECU_ADDRESS 0xFFFF42A3 DISPLAY_IDENTIFIER Event_cru_ini_vs_ref /begin FUNCTION_LIST R208.5.SETPT_1_1_0 R208.6.SERVO_1_2_2 /end FUNCTION_LIST /end MEASUREMENT
/begin MEASUREMENT fEVCRUON "Off to on cruise control main switch transition" UBYTE COMP_0283 1 100 0 1 BIT_MASK 0x0001 ECU_ADDRESS 0xFFFF42A3 DISPLAY_IDENTIFIER Event_cru_on /begin FUNCTION_LIST R208.4.STFLW_1_2_2 /end FUNCTION_LIST /end MEASUREMENT
/begin MEASUREMENT fEVCRUSD "Event : store the last cause of cruise control deactivation" UBYTE COMP_0283 1 100 0 1 BIT_MASK 0x0080 ECU_ADDRESS 0xFFFF42A4 DISPLAY_IDENTIFIER Event_cru_stg_dsb /begin FUNCTION_LIST R208.4.STFLW_1_2_2 /end FUNCTION_LIST /end MEASUREMENT
/begin MEASUREMENT fEVCRUVRI "Event of reference speed initialization for cruise control" UBYTE COMP_0283 1 100 0 1 BIT_MASK 0x0040 ECU_ADDRESS 0xFFFF42A4 DISPLAY_IDENTIFIER Event_cru_vs_ref_ini /begin FUNCTION_LIST R208.6.SERVO_1_2_2 /end FUNCTION_LIST /end MEASUREMENT
/begin MEASUREMENT fEVCSACDC "Event : the switch SET+ or SET- for cruise control and speed limiter has been pressed" UBYTE COMP_0283 1 100 0 1 BIT_MASK 0x0010 ECU_ADDRESS 0xFFFF42A4 DISPLAY_IDENTIFIER Event_cru_sl_acel_decl /begin FUNCTION_LIST R208.5.SETPT_1_1_0 /end FUNCTION_LIST /end MEASUREMENT
/begin MEASUREMENT fEVCSSD "Event : store the last cause of cruise control or speed limiter deactivation" UBYTE COMP_0283 1 100 0 1 BIT_MASK 0x0080 ECU_ADDRESS 0xFFFF42A5 DISPLAY_IDENTIFIER Event_cru_sl_stg_dsb /begin FUNCTION_LIST R208.4.STFLW_1_2_2 /end FUNCTION_LIST /end MEASUREMENT
/begin MEASUREMENT fEVSLIS "This event   produced by sl    implies the copy of the current vehicle speed in the speed setpoint" UBYTE COMP_0283 1 100 0 1 BIT_MASK 0x0008 ECU_ADDRESS 0xFFFF42A6 DISPLAY_IDENTIFIER Event_sl_ini_sp /begin FUNCTION_LIST R208.4.STFLW_1_2_2 R208.5.SETPT_1_1_0 /end FUNCTION_LIST /end MEASUREMENT
/begin MEASUREMENT fEVSLON "Off to on speed limiter main switch transition" UBYTE COMP_0283 1 100 0 1 BIT_MASK 0x0004 ECU_ADDRESS 0xFFFF42A6 DISPLAY_IDENTIFIER Event_sl_on /begin FUNCTION_LIST R208.4.STFLW_1_2_2 /end FUNCTION_LIST /end MEASUREMENT
/begin MEASUREMENT fEVSLSD "Event : store the last cause of speed limiter deactivation" UBYTE COMP_0283 1 100 0 1 BIT_MASK 0x0002 ECU_ADDRESS 0xFFFF42A6 DISPLAY_IDENTIFIER Event_sl_stg_dsb /begin FUNCTION_LIST R208.4.STFLW_1_2_2 /end FUNCTION_LIST /end MEASUREMENT
/begin MEASUREMENT fEVSLSO "Event : store the speed limiter deactivation due to main switch action" UBYTE COMP_0283 1 100 0 1 BIT_MASK 0x0001 ECU_ADDRESS 0xFFFF42A6 DISPLAY_IDENTIFIER Event_sl_stg_off /begin FUNCTION_LIST R208.4.STFLW_1_2_2 /end FUNCTION_LIST /end MEASUREMENT
/begin MEASUREMENT fEVSLSS "Event : store the last cause of speed limiter deactivation due to SUSPEND switch press" UBYTE COMP_0283 1 100 0 1 BIT_MASK 0x0080 ECU_ADDRESS 0xFFFF42A7 DISPLAY_IDENTIFIER Event_sl_stg_susp /begin FUNCTION_LIST R208.4.STFLW_1_2_2 /end FUNCTION_LIST /end MEASUREMENT
/begin MEASUREMENT fFHANIGAI "Vehicle speed outside the speed acceptance domain of CC/SL" UBYTE COMP_0283 1 100 0 1 BIT_MASK 0x0004 ECU_ADDRESS 0xFFFF42B6 DISPLAY_IDENTIFIER Vbx_cru_sl_oor_vs /begin FUNCTION_LIST R208.2.VSINT_1_1_2 R208.4.STFLW_1_2_2 /end FUNCTION_LIST /end MEASUREMENT
/begin MEASUREMENT fMFVSCMP "NO. coherence between displayed speed and real speed : memorized failure" UBYTE COMP_0283 1 100 0 1 BIT_MASK 0x0008 ECU_ADDRESS 0xFFFF42D4 DISPLAY_IDENTIFIER Sbx_mf_cru_vs_cmp /begin FUNCTION_LIST R208.10.dgn_ccadd_1_3_2 R902.1.SafetyDiagManager_1_3_6 /end FUNCTION_LIST /end MEASUREMENT
/begin MEASUREMENT fNGVSCMP "NO. coherence between displayed speed and real speed (excluding CC/SL option detection)" UBYTE COMP_0283 1 100 0 1 BIT_MASK 0x0010 ECU_ADDRESS 0xFFFF42D8 /begin FUNCTION_LIST R208.2.VSINT_1_1_2 R208.10.dgn_ccadd_1_3_2 /end FUNCTION_LIST /end MEASUREMENT
/begin MEASUREMENT fOVHMEM "Overheat experience flag" UBYTE COMP_0283 1 100 0 1 BIT_MASK 0x0008 ECU_ADDRESS 0xFFFF42DC /begin FUNCTION_LIST R301.5.FuelCut_1_2_2 /end FUNCTION_LIST /end MEASUREMENT
/begin MEASUREMENT fPFSL "Present failure of speed limiter" UBYTE COMP_0283 1 100 0 1 BIT_MASK 0x0040 ECU_ADDRESS 0xFFFF42DF DISPLAY_IDENTIFIER Vbx_sl_pf_det /begin FUNCTION_LIST R208.4.STFLW_1_2_2 R208.7.OUTMX_1_1_3 R208.8.DACAX_1_1_5 /end FUNCTION_LIST /end MEASUREMENT
/begin MEASUREMENT fSLMSTR "Arbitrated powertrain setpoint equal to Speed Limiter setpoint" UBYTE COMP_0283 1 100 0 1 BIT_MASK 0x0010 ECU_ADDRESS 0xFFFF42ED DISPLAY_IDENTIFIER Lvmaitre /begin FUNCTION_LIST R208.6.SERVO_1_2_2 R208.7.OUTMX_1_1_3 /end FUNCTION_LIST /end MEASUREMENT
/begin MEASUREMENT fVSNNOK "Valid vehicle speed (1= valid)   =/Vbx_vs_nok" UBYTE COMP_0283 1 100 0 1 BIT_MASK 0x0010 ECU_ADDRESS 0xFFFF42F9 DISPLAY_IDENTIFIER Vbx_vs_ok /begin FUNCTION_LIST R208.2.VSINT_1_1_2 /end FUNCTION_LIST /end MEASUREMENT
/begin MEASUREMENT fCCMLGCAL "CC calculation permission flag" UBYTE COMP_0283 1 100 0 1 BIT_MASK 0x0080 ECU_ADDRESS 0xFFFF4314 /begin FUNCTION_LIST R208.10.dgn_ccadd_1_3_2 /end FUNCTION_LIST /end MEASUREMENT
/begin MEASUREMENT fVSNOK "Invalid or absent vehicle speed" UBYTE COMP_0283 1 100 0 1 BIT_MASK 0x0040 ECU_ADDRESS 0xFFFF4348 DISPLAY_IDENTIFIER Vbx_vs_nok
 /begin FUNCTION_LIST R208.2.VSINT_1_1_2 R208.8.DACAX_1_1_5 R208.10.dgn_ccadd_1_3_2 /end FUNCTION_LIST
/end MEASUREMENT
/begin MEASUREMENT fCCCMFCT "Comfortable stop of the speed regulation" UBYTE COMP_0283 1 100 0 1 BIT_MASK 0x0020 ECU_ADDRESS 0xFFFF435E DISPLAY_IDENTIFIER Vbx_cru_cmf_cut /begin FUNCTION_LIST R208.4.STFLW_1_2_2 R208.6.SERVO_1_2_2 R208.8.DACAX_1_1_5 /end FUNCTION_LIST /end MEASUREMENT
/begin MEASUREMENT fCCDSB "Engine control req for CC system deactivation" UBYTE COMP_0283 1 100 0 1 BIT_MASK 0x0010 ECU_ADDRESS 0xFFFF435E DISPLAY_IDENTIFIER Vbx_cru_eng_dsb
 /begin FUNCTION_LIST R208.8.DACAX_1_1_5 R208.10.dgn_ccadd_1_3_2 R901.1.Diag_on_can_app_1_6_2 R902.2.DiagMiscell_1_3_5 /end FUNCTION_LIST
/end MEASUREMENT
/begin MEASUREMENT fCCDSBSYS "Engine control req for CC system deactivation" UBYTE COMP_0283 1 100 0 1 BIT_MASK 0x0008 ECU_ADDRESS 0xFFFF435E DISPLAY_IDENTIFIER Vbx_cru_eng_dsb_sys
 /begin FUNCTION_LIST R208.4.STFLW_1_2_2 R208.10.dgn_ccadd_1_3_2 R901.1.Diag_on_can_app_1_6_2 R902.2.DiagMiscell_1_3_5 /end FUNCTION_LIST
/end MEASUREMENT
/begin MEASUREMENT fCCSLDSB "Request of CC/SL/ACC inhibition on accel pedal failure" UBYTE COMP_0283 1 100 0 1 BIT_MASK 0x0002 ECU_ADDRESS 0xFFFF435E /begin FUNCTION_LIST R208.4.STFLW_1_2_2 R208.8.DACAX_1_1_5 /end FUNCTION_LIST /end MEASUREMENT
/begin MEASUREMENT fCCSLPSN "Gearbox is on the neutral position" UBYTE COMP_0283 1 100 0 1 BIT_MASK 0x0001 ECU_ADDRESS 0xFFFF435E DISPLAY_IDENTIFIER Vbx_gear_neut_psn
 /begin FUNCTION_LIST R208.3.GRBOX_1_2_2 R208.4.STFLW_1_2_2 R208.10.dgn_ccadd_1_3_2 /end FUNCTION_LIST
/end MEASUREMENT
/begin MEASUREMENT fCCSLPSR "Gearbox is on the reverse position" UBYTE COMP_0283 1 100 0 1 BIT_MASK 0x0080 ECU_ADDRESS 0xFFFF435F DISPLAY_IDENTIFIER Vbx_gear_rvr_psn
 /begin FUNCTION_LIST R208.3.GRBOX_1_2_2 R208.4.STFLW_1_2_2 R208.10.dgn_ccadd_1_3_2 /end FUNCTION_LIST
/end MEASUREMENT
/begin MEASUREMENT fCGKMHMPH "The displayed speed unit has changed during CC/SL activation" UBYTE COMP_0283 1 100 0 1 BIT_MASK 0x0002 ECU_ADDRESS 0xFFFF4360 DISPLAY_IDENTIFIER Vbx_cru_sl_kmh_mph_cge
 /begin FUNCTION_LIST R208.2.VSINT_1_1_2 R208.8.DACAX_1_1_5 R208.10.dgn_ccadd_1_3_2 /end FUNCTION_LIST
/end MEASUREMENT
/begin MEASUREMENT fCLUSWNF "Filtered unavailable clutch pedal status information" UBYTE COMP_0283 1 100 0 1 BIT_MASK 0x0080 ECU_ADDRESS 0xFFFF4361 DISPLAY_IDENTIFIER Vbx_cru_clu_navl_fil /begin FUNCTION_LIST R208.8.DACAX_1_1_5 R208.10.dgn_ccadd_1_3_2 /end FUNCTION_LIST /end MEASUREMENT
/begin MEASUREMENT fDFVSCMP "NO. coherence between displayed speed and real speed" UBYTE COMP_0283 1 100 0 1 BIT_MASK 0x0020 ECU_ADDRESS 0xFFFF4363 DISPLAY_IDENTIFIER Vbx_df_cru_vs_cmp
 /begin FUNCTION_LIST R208.2.VSINT_1_1_2 R208.10.dgn_ccadd_1_3_2 R902.1.SafetyDiagManager_1_3_6 /end FUNCTION_LIST
/end MEASUREMENT
/begin MEASUREMENT fDSPABDLY "Displayed vehicle speed received on the CAN network not present after a filtering time" UBYTE COMP_0283 1 100 0 1 BIT_MASK 0x0008 ECU_ADDRESS 0xFFFF4363
 /begin FUNCTION_LIST R208.2.VSINT_1_1_2 R208.8.DACAX_1_1_5 R208.10.dgn_ccadd_1_3_2 /end FUNCTION_LIST
/end MEASUREMENT
/begin MEASUREMENT fDSPNKDLY "Displayed vehicle speed received on the CAN network not available after a filtering time" UBYTE COMP_0283 1 100 0 1 BIT_MASK 0x0004 ECU_ADDRESS 0xFFFF4363 DISPLAY_IDENTIFIER Vbx_mux_dspl_vs_navl_fil
 /begin FUNCTION_LIST R208.2.VSINT_1_1_2 R208.8.DACAX_1_1_5 R208.10.dgn_ccadd_1_3_2 /end FUNCTION_LIST
/end MEASUREMENT
/begin MEASUREMENT fETAMXCLF "Filtered clutch pedal status information absence" UBYTE COMP_0283 1 100 0 1 BIT_MASK 0x0040 ECU_ADDRESS 0xFFFF4364 DISPLAY_IDENTIFIER Vbx_cru_clu_abst_fil /begin FUNCTION_LIST R208.8.DACAX_1_1_5 R208.10.dgn_ccadd_1_3_2 /end FUNCTION_LIST /end MEASUREMENT
/begin MEASUREMENT fFDACNRV "Vehicle speed is too small in comparison on the requested speed to enter in speed regulation" UBYTE COMP_0283 1 100 0 1 BIT_MASK 0x0004 ECU_ADDRESS 0xFFFF4364 DISPLAY_IDENTIFIER Vbx_cru_smal_vs_sp_rat
 /begin FUNCTION_LIST R208.2.VSINT_1_1_2 R208.4.STFLW_1_2_2 R208.10.dgn_ccadd_1_3_2 /end FUNCTION_LIST
/end MEASUREMENT
/begin MEASUREMENT fGEARLIH "The gear input is in Limp home (message = limp home or confirmed absent)" UBYTE COMP_0283 1 100 0 1 BIT_MASK 0x0020 ECU_ADDRESS 0xFFFF4366 DISPLAY_IDENTIFIER Vbx_gear_lih
 /begin FUNCTION_LIST R208.3.GRBOX_1_2_2 R208.8.DACAX_1_1_5 R208.10.dgn_ccadd_1_3_2 /end FUNCTION_LIST
/end MEASUREMENT
/begin MEASUREMENT fOVHJUG "Overheat condition flag" UBYTE COMP_0283 1 100 0 1 BIT_MASK 0x0040 ECU_ADDRESS 0xFFFF4368 /begin FUNCTION_LIST R301.5.FuelCut_1_2_2 R902.2.DiagMiscell_1_3_5 /end FUNCTION_LIST /end MEASUREMENT
/begin MEASUREMENT fSLDSB "Engine control req for SL system deactivation" UBYTE COMP_0283 1 100 0 1 BIT_MASK 0x0080 ECU_ADDRESS 0xFFFF4369 DISPLAY_IDENTIFIER Vbx_sl_eng_dsb
 /begin FUNCTION_LIST R208.8.DACAX_1_1_5 R901.1.Diag_on_can_app_1_6_2 R902.2.DiagMiscell_1_3_5 /end FUNCTION_LIST
/end MEASUREMENT
/begin MEASUREMENT fSLDSBSYS "Engine control req for SL system deactivation" UBYTE COMP_0283 1 100 0 1 BIT_MASK 0x0040 ECU_ADDRESS 0xFFFF4369 DISPLAY_IDENTIFIER Vbx_sl_eng_dsb_sys
 /begin FUNCTION_LIST R208.4.STFLW_1_2_2 R901.1.Diag_on_can_app_1_6_2 R902.2.DiagMiscell_1_3_5 /end FUNCTION_LIST
/end MEASUREMENT
/begin MEASUREMENT fSTSWA "The START button has been pressed" UBYTE COMP_0283 1 100 0 1 BIT_MASK 0x0010 ECU_ADDRESS 0xFFFF4369 DISPLAY_IDENTIFIER Vbx_sta_swi_act /begin FUNCTION_LIST R208.4.STFLW_1_2_2 R208.10.dgn_ccadd_1_3_2 /end FUNCTION_LIST /end MEASUREMENT
/begin MEASUREMENT fSVCLON "Control loop active" UBYTE COMP_0283 1 100 0 1 BIT_MASK 0x0008 ECU_ADDRESS 0xFFFF4369 DISPLAY_IDENTIFIER Vbx_cru_sl_svkl_act /begin FUNCTION_LIST R208.6.SERVO_1_2_2 /end FUNCTION_LIST /end MEASUREMENT
/begin MEASUREMENT fACSWD "Delayed air conditioning switch" UBYTE COMP_0283 1 100 0 1 BIT_MASK 0x0040 ECU_ADDRESS 0xFFFF8A86 /begin FUNCTION_LIST R301.6.IscAirflow_1_4_5 /end FUNCTION_LIST /end MEASUREMENT
/begin MEASUREMENT fGBDRAGF "Filtered drag switch information" UBYTE COMP_0283 1 100 0 1 BIT_MASK 0x0004 ECU_ADDRESS 0xFFFF2459 /begin FUNCTION_LIST R301.6.IscAirflow_1_4_5 /end FUNCTION_LIST /end MEASUREMENT
/begin MEASUREMENT fNEUTF "Filtered neutral switch information" UBYTE COMP_0283 1 100 0 1 BIT_MASK 0x0001 ECU_ADDRESS 0xFFFF2459 /begin FUNCTION_LIST R301.6.IscAirflow_1_4_5 /end FUNCTION_LIST /end MEASUREMENT
/begin MEASUREMENT fREVSWF "Filtered reverse switch information" UBYTE COMP_0283 1 100 0 1 BIT_MASK 0x0020 ECU_ADDRESS 0xFFFF245A /begin FUNCTION_LIST R301.6.IscAirflow_1_4_5 /end FUNCTION_LIST /end MEASUREMENT
/begin MEASUREMENT fACCUTR "Specific air conditioning compressor inhibition flag" UBYTE COMP_0283 1 100 0 1 BIT_MASK 0x0001 ECU_ADDRESS 0xFFFF2461 /begin FUNCTION_LIST R301.6.IscAirflow_1_4_5 /end FUNCTION_LIST /end MEASUREMENT
/begin MEASUREMENT fACOUTD "Delayed air conditioning compressor output" UBYTE COMP_0283 1 100 0 1 BIT_MASK 0x0004 ECU_ADDRESS 0xFFFF2462 /begin FUNCTION_LIST R301.6.IscAirflow_1_4_5 /end FUNCTION_LIST /end MEASUREMENT
/begin MEASUREMENT fFCIGSW "switch for F/C or ignition" UBYTE COMP_0283 1 100 0 1 BIT_MASK 0x0002 ECU_ADDRESS 0xFFFF2477 /begin FUNCTION_LIST R301.1.Torque_realization_1_0_3 /end FUNCTION_LIST /end MEASUREMENT
/begin MEASUREMENT fFTDSTAK "Flag for torque down control" UBYTE COMP_0283 1 100 0 1 BIT_MASK 0x0020 ECU_ADDRESS 0xFFFF2483 /begin FUNCTION_LIST R301.1.Torque_realization_1_0_3 /end FUNCTION_LIST /end MEASUREMENT
/begin MEASUREMENT fFTDSTAK1 "Flag for torque down control1" UBYTE COMP_0283 1 100 0 1 BIT_MASK 0x0010 ECU_ADDRESS 0xFFFF2483 /begin FUNCTION_LIST R301.1.Torque_realization_1_0_3 /end FUNCTION_LIST /end MEASUREMENT
/begin MEASUREMENT fFTDSTAK2 "Flag for torque down control2" UBYTE COMP_0283 1 100 0 1 BIT_MASK 0x0008 ECU_ADDRESS 0xFFFF2483 /begin FUNCTION_LIST R301.1.Torque_realization_1_0_3 /end FUNCTION_LIST /end MEASUREMENT
/begin MEASUREMENT fACANTSTT "Anticipated air conditioning compressor clutching" UBYTE COMP_0283 1 100 0 1 BIT_MASK 0x0080 ECU_ADDRESS 0xFFFF24CA /begin FUNCTION_LIST R301.6.IscAirflow_1_4_5 /end FUNCTION_LIST /end MEASUREMENT
/begin MEASUREMENT fCRSHEND "A crash occured and the diagnostic add-on strategy is frozen" UBYTE COMP_0283 1 100 0 1 BIT_MASK 0x0040 ECU_ADDRESS 0xFFFFB7E6 DISPLAY_IDENTIFIER Vbx_crsh_end_rec_eprm /begin FUNCTION_LIST R208.10.dgn_ccadd_1_3_2 /end FUNCTION_LIST /end MEASUREMENT
/begin MEASUREMENT fCNXBRKNC "Boolean for brake connection" UBYTE COMP_0283 1 100 0 1 BIT_MASK 0x0040 ECU_ADDRESS 0xFFFFB7EB DISPLAY_IDENTIFIER Vbx_wf_brk_lk_stt /begin FUNCTION_LIST R208.9.SAFETYX_1_3_2 R901.1.Diag_on_can_app_1_6_2 /end FUNCTION_LIST /end MEASUREMENT
/begin MEASUREMENT tQLSPSDLY "Power steering ISC compensation inhibition delay timer" UBYTE COMP_0202_S 1 100 0 255 ECU_ADDRESS 0xFFFF44B2 /begin FUNCTION_LIST R301.6.IscAirflow_1_4_5 /end FUNCTION_LIST /end MEASUREMENT
/begin MEASUREMENT tACSWD "Air conditioning switch delay" UBYTE COMP_0202_S 1 100 0 255 ECU_ADDRESS 0xFFFF2522 /begin FUNCTION_LIST R301.6.IscAirflow_1_4_5 /end FUNCTION_LIST /end MEASUREMENT
/begin MEASUREMENT tRALACCD "Idle speed acceleration required by the air conditioning system delay" UBYTE COMP_0202_S 1 100 0 255 ECU_ADDRESS 0xFFFF2581 /begin FUNCTION_LIST R301.6.IscAirflow_1_4_5 /end FUNCTION_LIST /end MEASUREMENT
/begin MEASUREMENT tACANTSTD "Anticipated air conditioning compressor clutching delay" UBYTE COMP_0203_S 1 100 0 255 ECU_ADDRESS 0xFFFF25C5 /begin FUNCTION_LIST R301.6.IscAirflow_1_4_5 /end FUNCTION_LIST /end MEASUREMENT
/begin MEASUREMENT tACOUTD "Air conditioning compressor output delay" UBYTE COMP_0203_S 1 100 0 255 ECU_ADDRESS 0xFFFF25C6 /begin FUNCTION_LIST R301.6.IscAirflow_1_4_5 /end FUNCTION_LIST /end MEASUREMENT
/begin MEASUREMENT tACSTTD "Air conditioning compressor output synchronized with compressor state delay" UBYTE COMP_0203_S 1 100 0 255 ECU_ADDRESS 0xFFFF25C7 /begin FUNCTION_LIST R301.6.IscAirflow_1_4_5 /end FUNCTION_LIST /end MEASUREMENT
/begin MEASUREMENT tRGTIM "Real gearshift recognition timer" UBYTE COMP_0203_S 1 100 0 255 ECU_ADDRESS 0xFFFF262C /begin FUNCTION_LIST R301.5.FuelCut_1_2_2 /end FUNCTION_LIST /end MEASUREMENT
/begin MEASUREMENT tTMCLSWDL "Control effective -- invalid change Clutch SW condition delay timer" UBYTE COMP_0203_S 1 100 0 255 ECU_ADDRESS 0xFFFF2657 /begin FUNCTION_LIST R301.8.Inverse_filter_1_1_3 /end FUNCTION_LIST /end MEASUREMENT
/begin MEASUREMENT vADLTNREF "Average engine speed acceleration" SWORD COMP_0545_S 1 100 -6400 6399.8046875 ECU_ADDRESS 0xFFFF10FC /begin FUNCTION_LIST R301.19.ISC_PID_cont_1_0_2 /end FUNCTION_LIST /end MEASUREMENT
/begin MEASUREMENT vAFFRVMXN "Cruise control and speed limiter status : parameter sent to the cluster by CAN for display" UBYTE COMP_0068 1 100 0 255 ECU_ADDRESS 0xFFFF27B2 DISPLAY_IDENTIFIER Vxx_mux_cru_sl_stt_ip_nom /begin FUNCTION_LIST R208.7.OUTMX_1_1_3 R208.9.SAFETYX_1_3_2 /end FUNCTION_LIST /end MEASUREMENT
/begin MEASUREMENT vAGBCD1 "Time constant for reverse switch filtering (on)" UBYTE COMP_0014 1 100 0 2550 ECU_ADDRESS 0xFFFF27E0 /begin FUNCTION_LIST R301.6.IscAirflow_1_4_5 /end FUNCTION_LIST /end MEASUREMENT
/begin MEASUREMENT vAGBCD2 "Time constant for reverse switch filtering (off)" UBYTE COMP_0014 1 100 0 2550 ECU_ADDRESS 0xFFFF27E1 /begin FUNCTION_LIST R301.6.IscAirflow_1_4_5 /end FUNCTION_LIST /end MEASUREMENT
/begin MEASUREMENT vBDRAT "Base torque down ratio" UWORD COMP_0063 1 100 0 255.99609375 ECU_ADDRESS 0xFFFF11BE /begin FUNCTION_LIST R301.1.Torque_realization_1_0_3 /end FUNCTION_LIST /end MEASUREMENT
/begin MEASUREMENT vCCFAL "Carrier of all the failures which cause CC failure" UBYTE COMP_0068 1 100 0 255 ECU_ADDRESS 0xFFFFB732 DISPLAY_IDENTIFIER Vxx_cru_fail
 /begin FUNCTION_LIST R208.8.DACAX_1_1_5 R301.13.FFDforDiagOnCAN_1_1_3 R901.1.Diag_on_can_app_1_6_2 /end FUNCTION_LIST
/end MEASUREMENT
/begin MEASUREMENT vCCFALZ "Previous carrier of all the failures which cause CC failure" UBYTE COMP_0068 1 100 0 255 ECU_ADDRESS 0xFFFF295C DISPLAY_IDENTIFIER Vxx_cru_fail_prev /begin FUNCTION_LIST R208.8.DACAX_1_1_5 /end FUNCTION_LIST /end MEASUREMENT
/begin MEASUREMENT vCCMLGBF "Buffer of the 20 last" UBYTE COMP_0068 1 100 0 255 ECU_ADDRESS 0xFFFFB570 DISPLAY_IDENTIFIER Sxx_cru_dsb_dist_buf /begin FUNCTION_LIST R208.10.dgn_ccadd_1_3_2 /end FUNCTION_LIST /end MEASUREMENT
/begin MEASUREMENT vCCMLGBF_C#1_R#1 "Buffer of the 20 last" UBYTE COMP_0068 1 100 0 255 ECU_ADDRESS 0xFFFFB570 DISPLAY_IDENTIFIER Sxx_cru_dsb_dist_buf /begin FUNCTION_LIST R208.10.dgn_ccadd_1_3_2 /end FUNCTION_LIST /end MEASUREMENT
/begin MEASUREMENT vCCMLGBF_C#1_R#2 "Buffer of the 20 last" UBYTE COMP_0068 1 100 0 255 ECU_ADDRESS 0xFFFFB571 DISPLAY_IDENTIFIER Sxx_cru_dsb_dist_buf /begin FUNCTION_LIST R208.10.dgn_ccadd_1_3_2 /end FUNCTION_LIST /end MEASUREMENT
/begin MEASUREMENT vCCMLGBF_C#1_R#3 "Buffer of the 20 last" UBYTE COMP_0068 1 100 0 255 ECU_ADDRESS 0xFFFFB572 DISPLAY_IDENTIFIER Sxx_cru_dsb_dist_buf /begin FUNCTION_LIST R208.10.dgn_ccadd_1_3_2 /end FUNCTION_LIST /end MEASUREMENT
/begin MEASUREMENT vCCMLGBF_C#1_R#4 "Buffer of the 20 last" UBYTE COMP_0068 1 100 0 255 ECU_ADDRESS 0xFFFFB573 DISPLAY_IDENTIFIER Sxx_cru_dsb_dist_buf /begin FUNCTION_LIST R208.10.dgn_ccadd_1_3_2 /end FUNCTION_LIST /end MEASUREMENT
/begin MEASUREMENT vCCMLGBF_C#2_R#1 "Buffer of the 20 last" UBYTE COMP_0068 1 100 0 255 ECU_ADDRESS 0xFFFFB574 DISPLAY_IDENTIFIER Sxx_cru_dsb_dist_buf /begin FUNCTION_LIST R208.10.dgn_ccadd_1_3_2 /end FUNCTION_LIST /end MEASUREMENT
/begin MEASUREMENT vCCMLGBF_C#2_R#2 "Buffer of the 20 last" UBYTE COMP_0068 1 100 0 255 ECU_ADDRESS 0xFFFFB575 DISPLAY_IDENTIFIER Sxx_cru_dsb_dist_buf /begin FUNCTION_LIST R208.10.dgn_ccadd_1_3_2 /end FUNCTION_LIST /end MEASUREMENT
/begin MEASUREMENT vCCMLGBF_C#2_R#3 "Buffer of the 20 last" UBYTE COMP_0068 1 100 0 255 ECU_ADDRESS 0xFFFFB576 DISPLAY_IDENTIFIER Sxx_cru_dsb_dist_buf /begin FUNCTION_LIST R208.10.dgn_ccadd_1_3_2 /end FUNCTION_LIST /end MEASUREMENT
/begin MEASUREMENT vCCMLGBF_C#2_R#4 "Buffer of the 20 last" UBYTE COMP_0068 1 100 0 255 ECU_ADDRESS 0xFFFFB577 DISPLAY_IDENTIFIER Sxx_cru_dsb_dist_buf /begin FUNCTION_LIST R208.10.dgn_ccadd_1_3_2 /end FUNCTION_LIST /end MEASUREMENT
/begin MEASUREMENT vCCMLGBF_C#3_R#1 "Buffer of the 20 last" UBYTE COMP_0068 1 100 0 255 ECU_ADDRESS 0xFFFFB578 DISPLAY_IDENTIFIER Sxx_cru_dsb_dist_buf /begin FUNCTION_LIST R208.10.dgn_ccadd_1_3_2 /end FUNCTION_LIST /end MEASUREMENT
/begin MEASUREMENT vCCMLGBF_C#3_R#2 "Buffer of the 20 last" UBYTE COMP_0068 1 100 0 255 ECU_ADDRESS 0xFFFFB579 DISPLAY_IDENTIFIER Sxx_cru_dsb_dist_buf /begin FUNCTION_LIST R208.10.dgn_ccadd_1_3_2 /end FUNCTION_LIST /end MEASUREMENT
/begin MEASUREMENT vCCMLGBF_C#3_R#3 "Buffer of the 20 last" UBYTE COMP_0068 1 100 0 255 ECU_ADDRESS 0xFFFFB57A DISPLAY_IDENTIFIER Sxx_cru_dsb_dist_buf /begin FUNCTION_LIST R208.10.dgn_ccadd_1_3_2 /end FUNCTION_LIST /end MEASUREMENT
/begin MEASUREMENT vCCMLGBF_C#3_R#4 "Buffer of the 20 last" UBYTE COMP_0068 1 100 0 255 ECU_ADDRESS 0xFFFFB57B DISPLAY_IDENTIFIER Sxx_cru_dsb_dist_buf /begin FUNCTION_LIST R208.10.dgn_ccadd_1_3_2 /end FUNCTION_LIST /end MEASUREMENT
/begin MEASUREMENT vCCMLGBF_C#4_R#1 "Buffer of the 20 last" UBYTE COMP_0068 1 100 0 255 ECU_ADDRESS 0xFFFFB57C DISPLAY_IDENTIFIER Sxx_cru_dsb_dist_buf /begin FUNCTION_LIST R208.10.dgn_ccadd_1_3_2 /end FUNCTION_LIST /end MEASUREMENT
/begin MEASUREMENT vCCMLGBF_C#4_R#2 "Buffer of the 20 last" UBYTE COMP_0068 1 100 0 255 ECU_ADDRESS 0xFFFFB57D DISPLAY_IDENTIFIER Sxx_cru_dsb_dist_buf /begin FUNCTION_LIST R208.10.dgn_ccadd_1_3_2 /end FUNCTION_LIST /end MEASUREMENT
/begin MEASUREMENT vCCMLGBF_C#4_R#3 "Buffer of the 20 last" UBYTE COMP_0068 1 100 0 255 ECU_ADDRESS 0xFFFFB57E DISPLAY_IDENTIFIER Sxx_cru_dsb_dist_buf /begin FUNCTION_LIST R208.10.dgn_ccadd_1_3_2 /end FUNCTION_LIST /end MEASUREMENT
/begin MEASUREMENT vCCMLGBF_C#4_R#4 "Buffer of the 20 last" UBYTE COMP_0068 1 100 0 255 ECU_ADDRESS 0xFFFFB57F DISPLAY_IDENTIFIER Sxx_cru_dsb_dist_buf /begin FUNCTION_LIST R208.10.dgn_ccadd_1_3_2 /end FUNCTION_LIST /end MEASUREMENT
/begin MEASUREMENT vCCMLGBF_C#5_R#1 "Buffer of the 20 last" UBYTE COMP_0068 1 100 0 255 ECU_ADDRESS 0xFFFFB580 DISPLAY_IDENTIFIER Sxx_cru_dsb_dist_buf /begin FUNCTION_LIST R208.10.dgn_ccadd_1_3_2 /end FUNCTION_LIST /end MEASUREMENT
/begin MEASUREMENT vCCMLGBF_C#5_R#2 "Buffer of the 20 last" UBYTE COMP_0068 1 100 0 255 ECU_ADDRESS 0xFFFFB581 DISPLAY_IDENTIFIER Sxx_cru_dsb_dist_buf /begin FUNCTION_LIST R208.10.dgn_ccadd_1_3_2 /end FUNCTION_LIST /end MEASUREMENT
/begin MEASUREMENT vCCMLGBF_C#5_R#3 "Buffer of the 20 last" UBYTE COMP_0068 1 100 0 255 ECU_ADDRESS 0xFFFFB582 DISPLAY_IDENTIFIER Sxx_cru_dsb_dist_buf /begin FUNCTION_LIST R208.10.dgn_ccadd_1_3_2 /end FUNCTION_LIST /end MEASUREMENT
/begin MEASUREMENT vCCMLGBF_C#5_R#4 "Buffer of the 20 last" UBYTE COMP_0068 1 100 0 255 ECU_ADDRESS 0xFFFFB583 DISPLAY_IDENTIFIER Sxx_cru_dsb_dist_buf /begin FUNCTION_LIST R208.10.dgn_ccadd_1_3_2 /end FUNCTION_LIST /end MEASUREMENT
/begin MEASUREMENT vCCMLGBF_C#6_R#1 "Buffer of the 20 last" UBYTE COMP_0068 1 100 0 255 ECU_ADDRESS 0xFFFFB584 DISPLAY_IDENTIFIER Sxx_cru_dsb_dist_buf /begin FUNCTION_LIST R208.10.dgn_ccadd_1_3_2 /end FUNCTION_LIST /end MEASUREMENT
/begin MEASUREMENT vCCMLGBF_C#6_R#2 "Buffer of the 20 last" UBYTE COMP_0068 1 100 0 255 ECU_ADDRESS 0xFFFFB585 DISPLAY_IDENTIFIER Sxx_cru_dsb_dist_buf /begin FUNCTION_LIST R208.10.dgn_ccadd_1_3_2 /end FUNCTION_LIST /end MEASUREMENT
/begin MEASUREMENT vCCMLGBF_C#6_R#3 "Buffer of the 20 last" UBYTE COMP_0068 1 100 0 255 ECU_ADDRESS 0xFFFFB586 DISPLAY_IDENTIFIER Sxx_cru_dsb_dist_buf /begin FUNCTION_LIST R208.10.dgn_ccadd_1_3_2 /end FUNCTION_LIST /end MEASUREMENT
/begin MEASUREMENT vCCMLGBF_C#6_R#4 "Buffer of the 20 last" UBYTE COMP_0068 1 100 0 255 ECU_ADDRESS 0xFFFFB587 DISPLAY_IDENTIFIER Sxx_cru_dsb_dist_buf /begin FUNCTION_LIST R208.10.dgn_ccadd_1_3_2 /end FUNCTION_LIST /end MEASUREMENT
/begin MEASUREMENT vCCMLGBF_C#7_R#1 "Buffer of the 20 last" UBYTE COMP_0068 1 100 0 255 ECU_ADDRESS 0xFFFFB588 DISPLAY_IDENTIFIER Sxx_cru_dsb_dist_buf /begin FUNCTION_LIST R208.10.dgn_ccadd_1_3_2 /end FUNCTION_LIST /end MEASUREMENT
/begin MEASUREMENT vCCMLGBF_C#7_R#2 "Buffer of the 20 last" UBYTE COMP_0068 1 100 0 255 ECU_ADDRESS 0xFFFFB589 DISPLAY_IDENTIFIER Sxx_cru_dsb_dist_buf /begin FUNCTION_LIST R208.10.dgn_ccadd_1_3_2 /end FUNCTION_LIST /end MEASUREMENT
/begin MEASUREMENT vCCMLGBF_C#7_R#3 "Buffer of the 20 last" UBYTE COMP_0068 1 100 0 255 ECU_ADDRESS 0xFFFFB58A DISPLAY_IDENTIFIER Sxx_cru_dsb_dist_buf /begin FUNCTION_LIST R208.10.dgn_ccadd_1_3_2 /end FUNCTION_LIST /end MEASUREMENT
/begin MEASUREMENT vCCMLGBF_C#7_R#4 "Buffer of the 20 last" UBYTE COMP_0068 1 100 0 255 ECU_ADDRESS 0xFFFFB58B DISPLAY_IDENTIFIER Sxx_cru_dsb_dist_buf /begin FUNCTION_LIST R208.10.dgn_ccadd_1_3_2 /end FUNCTION_LIST /end MEASUREMENT
/begin MEASUREMENT vCCMLGBF_C#8_R#1 "Buffer of the 20 last" UBYTE COMP_0068 1 100 0 255 ECU_ADDRESS 0xFFFFB58C DISPLAY_IDENTIFIER Sxx_cru_dsb_dist_buf /begin FUNCTION_LIST R208.10.dgn_ccadd_1_3_2 /end FUNCTION_LIST /end MEASUREMENT
/begin MEASUREMENT vCCMLGBF_C#8_R#2 "Buffer of the 20 last" UBYTE COMP_0068 1 100 0 255 ECU_ADDRESS 0xFFFFB58D DISPLAY_IDENTIFIER Sxx_cru_dsb_dist_buf /begin FUNCTION_LIST R208.10.dgn_ccadd_1_3_2 /end FUNCTION_LIST /end MEASUREMENT
/begin MEASUREMENT vCCMLGBF_C#8_R#3 "Buffer of the 20 last" UBYTE COMP_0068 1 100 0 255 ECU_ADDRESS 0xFFFFB58E DISPLAY_IDENTIFIER Sxx_cru_dsb_dist_buf /begin FUNCTION_LIST R208.10.dgn_ccadd_1_3_2 /end FUNCTION_LIST /end MEASUREMENT
/begin MEASUREMENT vCCMLGBF_C#8_R#4 "Buffer of the 20 last" UBYTE COMP_0068 1 100 0 255 ECU_ADDRESS 0xFFFFB58F DISPLAY_IDENTIFIER Sxx_cru_dsb_dist_buf /begin FUNCTION_LIST R208.10.dgn_ccadd_1_3_2 /end FUNCTION_LIST /end MEASUREMENT
/begin MEASUREMENT vCCMLGBF_C#9_R#1 "Buffer of the 20 last" UBYTE COMP_0068 1 100 0 255 ECU_ADDRESS 0xFFFFB590 DISPLAY_IDENTIFIER Sxx_cru_dsb_dist_buf /begin FUNCTION_LIST R208.10.dgn_ccadd_1_3_2 /end FUNCTION_LIST /end MEASUREMENT
/begin MEASUREMENT vCCMLGBF_C#9_R#2 "Buffer of the 20 last" UBYTE COMP_0068 1 100 0 255 ECU_ADDRESS 0xFFFFB591 DISPLAY_IDENTIFIER Sxx_cru_dsb_dist_buf /begin FUNCTION_LIST R208.10.dgn_ccadd_1_3_2 /end FUNCTION_LIST /end MEASUREMENT
/begin MEASUREMENT vCCMLGBF_C#9_R#3 "Buffer of the 20 last" UBYTE COMP_0068 1 100 0 255 ECU_ADDRESS 0xFFFFB592 DISPLAY_IDENTIFIER Sxx_cru_dsb_dist_buf /begin FUNCTION_LIST R208.10.dgn_ccadd_1_3_2 /end FUNCTION_LIST /end MEASUREMENT
/begin MEASUREMENT vCCMLGBF_C#9_R#4 "Buffer of the 20 last" UBYTE COMP_0068 1 100 0 255 ECU_ADDRESS 0xFFFFB593 DISPLAY_IDENTIFIER Sxx_cru_dsb_dist_buf /begin FUNCTION_LIST R208.10.dgn_ccadd_1_3_2 /end FUNCTION_LIST /end MEASUREMENT
/begin MEASUREMENT vCCMLGBF_C#10_R#1 "Buffer of the 20 last" UBYTE COMP_0068 1 100 0 255 ECU_ADDRESS 0xFFFFB594 DISPLAY_IDENTIFIER Sxx_cru_dsb_dist_buf /begin FUNCTION_LIST R208.10.dgn_ccadd_1_3_2 /end FUNCTION_LIST /end MEASUREMENT
/begin MEASUREMENT vCCMLGBF_C#10_R#2 "Buffer of the 20 last" UBYTE COMP_0068 1 100 0 255 ECU_ADDRESS 0xFFFFB595 DISPLAY_IDENTIFIER Sxx_cru_dsb_dist_buf /begin FUNCTION_LIST R208.10.dgn_ccadd_1_3_2 /end FUNCTION_LIST /end MEASUREMENT
/begin MEASUREMENT vCCMLGBF_C#10_R#3 "Buffer of the 20 last" UBYTE COMP_0068 1 100 0 255 ECU_ADDRESS 0xFFFFB596 DISPLAY_IDENTIFIER Sxx_cru_dsb_dist_buf /begin FUNCTION_LIST R208.10.dgn_ccadd_1_3_2 /end FUNCTION_LIST /end MEASUREMENT
/begin MEASUREMENT vCCMLGBF_C#10_R#4 "Buffer of the 20 last" UBYTE COMP_0068 1 100 0 255 ECU_ADDRESS 0xFFFFB597 DISPLAY_IDENTIFIER Sxx_cru_dsb_dist_buf /begin FUNCTION_LIST R208.10.dgn_ccadd_1_3_2 /end FUNCTION_LIST /end MEASUREMENT
/begin MEASUREMENT vCCMLGBF_C#11_R#1 "Buffer of the 20 last" UBYTE COMP_0068 1 100 0 255 ECU_ADDRESS 0xFFFFB598 DISPLAY_IDENTIFIER Sxx_cru_dsb_dist_buf /begin FUNCTION_LIST R208.10.dgn_ccadd_1_3_2 /end FUNCTION_LIST /end MEASUREMENT
/begin MEASUREMENT vCCMLGBF_C#11_R#2 "Buffer of the 20 last" UBYTE COMP_0068 1 100 0 255 ECU_ADDRESS 0xFFFFB599 DISPLAY_IDENTIFIER Sxx_cru_dsb_dist_buf /begin FUNCTION_LIST R208.10.dgn_ccadd_1_3_2 /end FUNCTION_LIST /end MEASUREMENT
/begin MEASUREMENT vCCMLGBF_C#11_R#3 "Buffer of the 20 last" UBYTE COMP_0068 1 100 0 255 ECU_ADDRESS 0xFFFFB59A DISPLAY_IDENTIFIER Sxx_cru_dsb_dist_buf /begin FUNCTION_LIST R208.10.dgn_ccadd_1_3_2 /end FUNCTION_LIST /end MEASUREMENT
/begin MEASUREMENT vCCMLGBF_C#11_R#4 "Buffer of the 20 last" UBYTE COMP_0068 1 100 0 255 ECU_ADDRESS 0xFFFFB59B DISPLAY_IDENTIFIER Sxx_cru_dsb_dist_buf /begin FUNCTION_LIST R208.10.dgn_ccadd_1_3_2 /end FUNCTION_LIST /end MEASUREMENT
/begin MEASUREMENT vCCMLGBF_C#12_R#1 "Buffer of the 20 last" UBYTE COMP_0068 1 100 0 255 ECU_ADDRESS 0xFFFFB59C DISPLAY_IDENTIFIER Sxx_cru_dsb_dist_buf /begin FUNCTION_LIST R208.10.dgn_ccadd_1_3_2 /end FUNCTION_LIST /end MEASUREMENT
/begin MEASUREMENT vCCMLGBF_C#12_R#2 "Buffer of the 20 last" UBYTE COMP_0068 1 100 0 255 ECU_ADDRESS 0xFFFFB59D DISPLAY_IDENTIFIER Sxx_cru_dsb_dist_buf /begin FUNCTION_LIST R208.10.dgn_ccadd_1_3_2 /end FUNCTION_LIST /end MEASUREMENT
/begin MEASUREMENT vCCMLGBF_C#12_R#3 "Buffer of the 20 last" UBYTE COMP_0068 1 100 0 255 ECU_ADDRESS 0xFFFFB59E DISPLAY_IDENTIFIER Sxx_cru_dsb_dist_buf /begin FUNCTION_LIST R208.10.dgn_ccadd_1_3_2 /end FUNCTION_LIST /end MEASUREMENT
/begin MEASUREMENT vCCMLGBF_C#12_R#4 "Buffer of the 20 last" UBYTE COMP_0068 1 100 0 255 ECU_ADDRESS 0xFFFFB59F DISPLAY_IDENTIFIER Sxx_cru_dsb_dist_buf /begin FUNCTION_LIST R208.10.dgn_ccadd_1_3_2 /end FUNCTION_LIST /end MEASUREMENT
/begin MEASUREMENT vCCMLGBF_C#13_R#1 "Buffer of the 20 last" UBYTE COMP_0068 1 100 0 255 ECU_ADDRESS 0xFFFFB5A0 DISPLAY_IDENTIFIER Sxx_cru_dsb_dist_buf /begin FUNCTION_LIST R208.10.dgn_ccadd_1_3_2 /end FUNCTION_LIST /end MEASUREMENT
/begin MEASUREMENT vCCMLGBF_C#13_R#2 "Buffer of the 20 last" UBYTE COMP_0068 1 100 0 255 ECU_ADDRESS 0xFFFFB5A1 DISPLAY_IDENTIFIER Sxx_cru_dsb_dist_buf /begin FUNCTION_LIST R208.10.dgn_ccadd_1_3_2 /end FUNCTION_LIST /end MEASUREMENT
/begin MEASUREMENT vCCMLGBF_C#13_R#3 "Buffer of the 20 last" UBYTE COMP_0068 1 100 0 255 ECU_ADDRESS 0xFFFFB5A2 DISPLAY_IDENTIFIER Sxx_cru_dsb_dist_buf /begin FUNCTION_LIST R208.10.dgn_ccadd_1_3_2 /end FUNCTION_LIST /end MEASUREMENT
/begin MEASUREMENT vCCMLGBF_C#13_R#4 "Buffer of the 20 last" UBYTE COMP_0068 1 100 0 255 ECU_ADDRESS 0xFFFFB5A3 DISPLAY_IDENTIFIER Sxx_cru_dsb_dist_buf /begin FUNCTION_LIST R208.10.dgn_ccadd_1_3_2 /end FUNCTION_LIST /end MEASUREMENT
/begin MEASUREMENT vCCMLGBF_C#14_R#1 "Buffer of the 20 last" UBYTE COMP_0068 1 100 0 255 ECU_ADDRESS 0xFFFFB5A4 DISPLAY_IDENTIFIER Sxx_cru_dsb_dist_buf /begin FUNCTION_LIST R208.10.dgn_ccadd_1_3_2 /end FUNCTION_LIST /end MEASUREMENT
/begin MEASUREMENT vCCMLGBF_C#14_R#2 "Buffer of the 20 last" UBYTE COMP_0068 1 100 0 255 ECU_ADDRESS 0xFFFFB5A5 DISPLAY_IDENTIFIER Sxx_cru_dsb_dist_buf /begin FUNCTION_LIST R208.10.dgn_ccadd_1_3_2 /end FUNCTION_LIST /end MEASUREMENT
/begin MEASUREMENT vCCMLGBF_C#14_R#3 "Buffer of the 20 last" UBYTE COMP_0068 1 100 0 255 ECU_ADDRESS 0xFFFFB5A6 DISPLAY_IDENTIFIER Sxx_cru_dsb_dist_buf /begin FUNCTION_LIST R208.10.dgn_ccadd_1_3_2 /end FUNCTION_LIST /end MEASUREMENT
/begin MEASUREMENT vCCMLGBF_C#14_R#4 "Buffer of the 20 last" UBYTE COMP_0068 1 100 0 255 ECU_ADDRESS 0xFFFFB5A7 DISPLAY_IDENTIFIER Sxx_cru_dsb_dist_buf /begin FUNCTION_LIST R208.10.dgn_ccadd_1_3_2 /end FUNCTION_LIST /end MEASUREMENT
/begin MEASUREMENT vCCMLGBF_C#15_R#1 "Buffer of the 20 last" UBYTE COMP_0068 1 100 0 255 ECU_ADDRESS 0xFFFFB5A8 DISPLAY_IDENTIFIER Sxx_cru_dsb_dist_buf /begin FUNCTION_LIST R208.10.dgn_ccadd_1_3_2 /end FUNCTION_LIST /end MEASUREMENT
/begin MEASUREMENT vCCMLGBF_C#15_R#2 "Buffer of the 20 last" UBYTE COMP_0068 1 100 0 255 ECU_ADDRESS 0xFFFFB5A9 DISPLAY_IDENTIFIER Sxx_cru_dsb_dist_buf /begin FUNCTION_LIST R208.10.dgn_ccadd_1_3_2 /end FUNCTION_LIST /end MEASUREMENT
/begin MEASUREMENT vCCMLGBF_C#15_R#3 "Buffer of the 20 last" UBYTE COMP_0068 1 100 0 255 ECU_ADDRESS 0xFFFFB5AA DISPLAY_IDENTIFIER Sxx_cru_dsb_dist_buf /begin FUNCTION_LIST R208.10.dgn_ccadd_1_3_2 /end FUNCTION_LIST /end MEASUREMENT
/begin MEASUREMENT vCCMLGBF_C#15_R#4 "Buffer of the 20 last" UBYTE COMP_0068 1 100 0 255 ECU_ADDRESS 0xFFFFB5AB DISPLAY_IDENTIFIER Sxx_cru_dsb_dist_buf /begin FUNCTION_LIST R208.10.dgn_ccadd_1_3_2 /end FUNCTION_LIST /end MEASUREMENT
/begin MEASUREMENT vCCMLGBF_C#16_R#1 "Buffer of the 20 last" UBYTE COMP_0068 1 100 0 255 ECU_ADDRESS 0xFFFFB5AC DISPLAY_IDENTIFIER Sxx_cru_dsb_dist_buf /begin FUNCTION_LIST R208.10.dgn_ccadd_1_3_2 /end FUNCTION_LIST /end MEASUREMENT
/begin MEASUREMENT vCCMLGBF_C#16_R#2 "Buffer of the 20 last" UBYTE COMP_0068 1 100 0 255 ECU_ADDRESS 0xFFFFB5AD DISPLAY_IDENTIFIER Sxx_cru_dsb_dist_buf /begin FUNCTION_LIST R208.10.dgn_ccadd_1_3_2 /end FUNCTION_LIST /end MEASUREMENT
/begin MEASUREMENT vCCMLGBF_C#16_R#3 "Buffer of the 20 last" UBYTE COMP_0068 1 100 0 255 ECU_ADDRESS 0xFFFFB5AE DISPLAY_IDENTIFIER Sxx_cru_dsb_dist_buf /begin FUNCTION_LIST R208.10.dgn_ccadd_1_3_2 /end FUNCTION_LIST /end MEASUREMENT
/begin MEASUREMENT vCCMLGBF_C#16_R#4 "Buffer of the 20 last" UBYTE COMP_0068 1 100 0 255 ECU_ADDRESS 0xFFFFB5AF DISPLAY_IDENTIFIER Sxx_cru_dsb_dist_buf /begin FUNCTION_LIST R208.10.dgn_ccadd_1_3_2 /end FUNCTION_LIST /end MEASUREMENT
/begin MEASUREMENT vCCMLGBF_C#17_R#1 "Buffer of the 20 last" UBYTE COMP_0068 1 100 0 255 ECU_ADDRESS 0xFFFFB5B0 DISPLAY_IDENTIFIER Sxx_cru_dsb_dist_buf /begin FUNCTION_LIST R208.10.dgn_ccadd_1_3_2 /end FUNCTION_LIST /end MEASUREMENT
/begin MEASUREMENT vCCMLGBF_C#17_R#2 "Buffer of the 20 last" UBYTE COMP_0068 1 100 0 255 ECU_ADDRESS 0xFFFFB5B1 DISPLAY_IDENTIFIER Sxx_cru_dsb_dist_buf /begin FUNCTION_LIST R208.10.dgn_ccadd_1_3_2 /end FUNCTION_LIST /end MEASUREMENT
/begin MEASUREMENT vCCMLGBF_C#17_R#3 "Buffer of the 20 last" UBYTE COMP_0068 1 100 0 255 ECU_ADDRESS 0xFFFFB5B2 DISPLAY_IDENTIFIER Sxx_cru_dsb_dist_buf /begin FUNCTION_LIST R208.10.dgn_ccadd_1_3_2 /end FUNCTION_LIST /end MEASUREMENT
/begin MEASUREMENT vCCMLGBF_C#17_R#4 "Buffer of the 20 last" UBYTE COMP_0068 1 100 0 255 ECU_ADDRESS 0xFFFFB5B3 DISPLAY_IDENTIFIER Sxx_cru_dsb_dist_buf /begin FUNCTION_LIST R208.10.dgn_ccadd_1_3_2 /end FUNCTION_LIST /end MEASUREMENT
/begin MEASUREMENT vCCMLGBF_C#18_R#1 "Buffer of the 20 last" UBYTE COMP_0068 1 100 0 255 ECU_ADDRESS 0xFFFFB5B4 DISPLAY_IDENTIFIER Sxx_cru_dsb_dist_buf /begin FUNCTION_LIST R208.10.dgn_ccadd_1_3_2 /end FUNCTION_LIST /end MEASUREMENT
/begin MEASUREMENT vCCMLGBF_C#18_R#2 "Buffer of the 20 last" UBYTE COMP_0068 1 100 0 255 ECU_ADDRESS 0xFFFFB5B5 DISPLAY_IDENTIFIER Sxx_cru_dsb_dist_buf /begin FUNCTION_LIST R208.10.dgn_ccadd_1_3_2 /end FUNCTION_LIST /end MEASUREMENT
/begin MEASUREMENT vCCMLGBF_C#18_R#3 "Buffer of the 20 last" UBYTE COMP_0068 1 100 0 255 ECU_ADDRESS 0xFFFFB5B6 DISPLAY_IDENTIFIER Sxx_cru_dsb_dist_buf /begin FUNCTION_LIST R208.10.dgn_ccadd_1_3_2 /end FUNCTION_LIST /end MEASUREMENT
/begin MEASUREMENT vCCMLGBF_C#18_R#4 "Buffer of the 20 last" UBYTE COMP_0068 1 100 0 255 ECU_ADDRESS 0xFFFFB5B7 DISPLAY_IDENTIFIER Sxx_cru_dsb_dist_buf /begin FUNCTION_LIST R208.10.dgn_ccadd_1_3_2 /end FUNCTION_LIST /end MEASUREMENT
/begin MEASUREMENT vCCMLGBF_C#19_R#1 "Buffer of the 20 last" UBYTE COMP_0068 1 100 0 255 ECU_ADDRESS 0xFFFFB5B8 DISPLAY_IDENTIFIER Sxx_cru_dsb_dist_buf /begin FUNCTION_LIST R208.10.dgn_ccadd_1_3_2 /end FUNCTION_LIST /end MEASUREMENT
/begin MEASUREMENT vCCMLGBF_C#19_R#2 "Buffer of the 20 last" UBYTE COMP_0068 1 100 0 255 ECU_ADDRESS 0xFFFFB5B9 DISPLAY_IDENTIFIER Sxx_cru_dsb_dist_buf /begin FUNCTION_LIST R208.10.dgn_ccadd_1_3_2 /end FUNCTION_LIST /end MEASUREMENT
/begin MEASUREMENT vCCMLGBF_C#19_R#3 "Buffer of the 20 last" UBYTE COMP_0068 1 100 0 255 ECU_ADDRESS 0xFFFFB5BA DISPLAY_IDENTIFIER Sxx_cru_dsb_dist_buf /begin FUNCTION_LIST R208.10.dgn_ccadd_1_3_2 /end FUNCTION_LIST /end MEASUREMENT
/begin MEASUREMENT vCCMLGBF_C#19_R#4 "Buffer of the 20 last" UBYTE COMP_0068 1 100 0 255 ECU_ADDRESS 0xFFFFB5BB DISPLAY_IDENTIFIER Sxx_cru_dsb_dist_buf /begin FUNCTION_LIST R208.10.dgn_ccadd_1_3_2 /end FUNCTION_LIST /end MEASUREMENT
/begin MEASUREMENT vCCMLGBF_C#20_R#1 "Buffer of the 20 last" UBYTE COMP_0068 1 100 0 255 ECU_ADDRESS 0xFFFFB5BC DISPLAY_IDENTIFIER Sxx_cru_dsb_dist_buf /begin FUNCTION_LIST R208.10.dgn_ccadd_1_3_2 /end FUNCTION_LIST /end MEASUREMENT
/begin MEASUREMENT vCCMLGBF_C#20_R#2 "Buffer of the 20 last" UBYTE COMP_0068 1 100 0 255 ECU_ADDRESS 0xFFFFB5BD DISPLAY_IDENTIFIER Sxx_cru_dsb_dist_buf /begin FUNCTION_LIST R208.10.dgn_ccadd_1_3_2 /end FUNCTION_LIST /end MEASUREMENT
/begin MEASUREMENT vCCMLGBF_C#20_R#3 "Buffer of the 20 last" UBYTE COMP_0068 1 100 0 255 ECU_ADDRESS 0xFFFFB5BE DISPLAY_IDENTIFIER Sxx_cru_dsb_dist_buf /begin FUNCTION_LIST R208.10.dgn_ccadd_1_3_2 /end FUNCTION_LIST /end MEASUREMENT
/begin MEASUREMENT vCCMLGBF_C#20_R#4 "Buffer of the 20 last" UBYTE COMP_0068 1 100 0 255 ECU_ADDRESS 0xFFFFB5BF DISPLAY_IDENTIFIER Sxx_cru_dsb_dist_buf /begin FUNCTION_LIST R208.10.dgn_ccadd_1_3_2 /end FUNCTION_LIST /end MEASUREMENT
/begin MEASUREMENT vCCSLACEL "Filtered vehicle acceleration for cruise control and speed limiter" UBYTE COMP_0561_S 1 100 -12 13.5 ECU_ADDRESS 0xFFFF295D DISPLAY_IDENTIFIER Vxx_cru_sl_acel /begin FUNCTION_LIST R208.2.VSINT_1_1_2 R208.8.DACAX_1_1_5 /end FUNCTION_LIST /end MEASUREMENT
/begin MEASUREMENT vCCSLACLR "Vehicle acceleration before filtering for cruise control and speed limiter" UBYTE COMP_0561_S 1 100 -12 13.5 ECU_ADDRESS 0xFFFF295E /begin FUNCTION_LIST R208.2.VSINT_1_1_2 /end FUNCTION_LIST /end MEASUREMENT
/begin MEASUREMENT vCCSLDACN "Compilation of all the cru/sl normal causes of deactivation." UBYTE COMP_0068 1 100 0 255 ECU_ADDRESS 0xFFFF41BA DISPLAY_IDENTIFIER Vxx_cru_sl_dacn
 /begin FUNCTION_LIST R208.4.STFLW_1_2_2 R208.10.dgn_ccadd_1_3_2 R901.1.Diag_on_can_app_1_6_2 /end FUNCTION_LIST
/end MEASUREMENT
/begin MEASUREMENT vCCSLDACP "Previous compilation of all the cru/sl normal causes of deactivation" UBYTE COMP_0068 1 100 0 255 ECU_ADDRESS 0xFFFF295F DISPLAY_IDENTIFIER Vxx_cru_sl_dacn_prev /begin FUNCTION_LIST R208.4.STFLW_1_2_2 /end FUNCTION_LIST /end MEASUREMENT
/begin MEASUREMENT vCCSLDFI "Initial resistive force (function of the vehicle speed)" UBYTE COMP_0492_S 1 100 0 6375 ECU_ADDRESS 0xFFFF2960 DISPLAY_IDENTIFIER Vxx_cru_sl_dyn_forc_ini /begin FUNCTION_LIST R208.6.SERVO_1_2_2 /end FUNCTION_LIST /end MEASUREMENT
/begin MEASUREMENT vCCSLDNF "Resistive force (function of the vehicle speed)" UBYTE COMP_0492_S 1 100 0 6375 ECU_ADDRESS 0xFFFF2961 DISPLAY_IDENTIFIER Vxx_dyn_forc /begin FUNCTION_LIST R208.6.SERVO_1_2_2 /end FUNCTION_LIST /end MEASUREMENT
/begin MEASUREMENT vCCSLDSYP "Previous compilation of all the cru/sl normal deactivations due to system causes." UBYTE COMP_0068 1 100 0 255 ECU_ADDRESS 0xFFFF2962 DISPLAY_IDENTIFIER Vxx_cru_sl_dacn_sys_prev /begin FUNCTION_LIST R208.4.STFLW_1_2_2 /end FUNCTION_LIST /end MEASUREMENT
/begin MEASUREMENT vCCSLDSYS "Compilation of all the cru/sl normal deactivations due to system causes. Saved in E? PROM." UBYTE COMP_0068 1 100 0 255 ECU_ADDRESS 0xFFFFB733 DISPLAY_IDENTIFIER Vxx_cru_sl_dacn_sys /begin FUNCTION_LIST R208.4.STFLW_1_2_2 R901.1.Diag_on_can_app_1_6_2 /end FUNCTION_LIST /end MEASUREMENT
/begin MEASUREMENT vCCSLFAL "Carrier of all the failures which cause CC/SL failure" UBYTE COMP_0068 1 100 0 255 ECU_ADDRESS 0xFFFFB734 DISPLAY_IDENTIFIER Vxx_cru_sl_fail
 /begin FUNCTION_LIST R208.8.DACAX_1_1_5 R301.13.FFDforDiagOnCAN_1_1_3 R901.1.Diag_on_can_app_1_6_2 /end FUNCTION_LIST
/end MEASUREMENT
/begin MEASUREMENT vCCSLFALZ "Previous carrier of all the failures which cause CC/SL failure" UBYTE COMP_0068 1 100 0 255 ECU_ADDRESS 0xFFFF2965 DISPLAY_IDENTIFIER Vxx_cru_sl_fail_prev /begin FUNCTION_LIST R208.8.DACAX_1_1_5 /end FUNCTION_LIST /end MEASUREMENT
/begin MEASUREMENT vCCSLIBF "Buffer of the 16 last" UBYTE COMP_0068 1 100 0 255 ECU_ADDRESS 0xFFFF9FF4 DISPLAY_IDENTIFIER Sxx_sli_buf /begin FUNCTION_LIST R208.10.dgn_ccadd_1_3_2 /end FUNCTION_LIST /end MEASUREMENT
/begin MEASUREMENT vCCSLIBF_C#1_R#1 "Buffer of the 16 last" UBYTE COMP_0068 1 100 0 255 ECU_ADDRESS 0xFFFF9FF4 DISPLAY_IDENTIFIER Sxx_sli_buf /begin FUNCTION_LIST R208.10.dgn_ccadd_1_3_2 /end FUNCTION_LIST /end MEASUREMENT
/begin MEASUREMENT vCCSLIBF_C#2_R#1 "Buffer of the 16 last" UBYTE COMP_0068 1 100 0 255 ECU_ADDRESS 0xFFFF9FF5 DISPLAY_IDENTIFIER Sxx_sli_buf /begin FUNCTION_LIST R208.10.dgn_ccadd_1_3_2 /end FUNCTION_LIST /end MEASUREMENT
/begin MEASUREMENT vCCSLIBF_C#3_R#1 "Buffer of the 16 last" UBYTE COMP_0068 1 100 0 255 ECU_ADDRESS 0xFFFF9FF6 DISPLAY_IDENTIFIER Sxx_sli_buf /begin FUNCTION_LIST R208.10.dgn_ccadd_1_3_2 /end FUNCTION_LIST /end MEASUREMENT
/begin MEASUREMENT vCCSLIBF_C#4_R#1 "Buffer of the 16 last" UBYTE COMP_0068 1 100 0 255 ECU_ADDRESS 0xFFFF9FF7 DISPLAY_IDENTIFIER Sxx_sli_buf /begin FUNCTION_LIST R208.10.dgn_ccadd_1_3_2 /end FUNCTION_LIST /end MEASUREMENT
/begin MEASUREMENT vCCSLIBF_C#5_R#1 "Buffer of the 16 last" UBYTE COMP_0068 1 100 0 255 ECU_ADDRESS 0xFFFF9FF8 DISPLAY_IDENTIFIER Sxx_sli_buf /begin FUNCTION_LIST R208.10.dgn_ccadd_1_3_2 /end FUNCTION_LIST /end MEASUREMENT
/begin MEASUREMENT vCCSLIBF_C#6_R#1 "Buffer of the 16 last" UBYTE COMP_0068 1 100 0 255 ECU_ADDRESS 0xFFFF9FF9 DISPLAY_IDENTIFIER Sxx_sli_buf /begin FUNCTION_LIST R208.10.dgn_ccadd_1_3_2 /end FUNCTION_LIST /end MEASUREMENT
/begin MEASUREMENT vCCSLIBF_C#7_R#1 "Buffer of the 16 last" UBYTE COMP_0068 1 100 0 255 ECU_ADDRESS 0xFFFF9FFA DISPLAY_IDENTIFIER Sxx_sli_buf /begin FUNCTION_LIST R208.10.dgn_ccadd_1_3_2 /end FUNCTION_LIST /end MEASUREMENT
/begin MEASUREMENT vCCSLIBF_C#8_R#1 "Buffer of the 16 last" UBYTE COMP_0068 1 100 0 255 ECU_ADDRESS 0xFFFF9FFB DISPLAY_IDENTIFIER Sxx_sli_buf /begin FUNCTION_LIST R208.10.dgn_ccadd_1_3_2 /end FUNCTION_LIST /end MEASUREMENT
/begin MEASUREMENT vCCSLIBF_C#9_R#1 "Buffer of the 16 last" UBYTE COMP_0068 1 100 0 255 ECU_ADDRESS 0xFFFF9FFC DISPLAY_IDENTIFIER Sxx_sli_buf /begin FUNCTION_LIST R208.10.dgn_ccadd_1_3_2 /end FUNCTION_LIST /end MEASUREMENT
/begin MEASUREMENT vCCSLIBF_C#10_R#1 "Buffer of the 16 last" UBYTE COMP_0068 1 100 0 255 ECU_ADDRESS 0xFFFF9FFD DISPLAY_IDENTIFIER Sxx_sli_buf /begin FUNCTION_LIST R208.10.dgn_ccadd_1_3_2 /end FUNCTION_LIST /end MEASUREMENT
/begin MEASUREMENT vCCSLIBF_C#11_R#1 "Buffer of the 16 last" UBYTE COMP_0068 1 100 0 255 ECU_ADDRESS 0xFFFF9FFE DISPLAY_IDENTIFIER Sxx_sli_buf /begin FUNCTION_LIST R208.10.dgn_ccadd_1_3_2 /end FUNCTION_LIST /end MEASUREMENT
/begin MEASUREMENT vCCSLIBF_C#12_R#1 "Buffer of the 16 last" UBYTE COMP_0068 1 100 0 255 ECU_ADDRESS 0xFFFF9FFF DISPLAY_IDENTIFIER Sxx_sli_buf /begin FUNCTION_LIST R208.10.dgn_ccadd_1_3_2 /end FUNCTION_LIST /end MEASUREMENT
/begin MEASUREMENT vCCSLIBF_C#13_R#1 "Buffer of the 16 last" UBYTE COMP_0068 1 100 0 255 ECU_ADDRESS 0xFFFFA000 DISPLAY_IDENTIFIER Sxx_sli_buf /begin FUNCTION_LIST R208.10.dgn_ccadd_1_3_2 /end FUNCTION_LIST /end MEASUREMENT
/begin MEASUREMENT vCCSLIBF_C#14_R#1 "Buffer of the 16 last" UBYTE COMP_0068 1 100 0 255 ECU_ADDRESS 0xFFFFA001 DISPLAY_IDENTIFIER Sxx_sli_buf /begin FUNCTION_LIST R208.10.dgn_ccadd_1_3_2 /end FUNCTION_LIST /end MEASUREMENT
/begin MEASUREMENT vCCSLIBF_C#15_R#1 "Buffer of the 16 last" UBYTE COMP_0068 1 100 0 255 ECU_ADDRESS 0xFFFFA002 DISPLAY_IDENTIFIER Sxx_sli_buf /begin FUNCTION_LIST R208.10.dgn_ccadd_1_3_2 /end FUNCTION_LIST /end MEASUREMENT
/begin MEASUREMENT vCCSLIBF_C#16_R#1 "Buffer of the 16 last" UBYTE COMP_0068 1 100 0 255 ECU_ADDRESS 0xFFFFA003 DISPLAY_IDENTIFIER Sxx_sli_buf /begin FUNCTION_LIST R208.10.dgn_ccadd_1_3_2 /end FUNCTION_LIST /end MEASUREMENT
/begin MEASUREMENT vCCSLIBF_C#17_R#1 "Buffer of the 16 last" UBYTE COMP_0068 1 100 0 255 ECU_ADDRESS 0xFFFFA004 DISPLAY_IDENTIFIER Sxx_sli_buf /begin FUNCTION_LIST R208.10.dgn_ccadd_1_3_2 /end FUNCTION_LIST /end MEASUREMENT
/begin MEASUREMENT vCCSLIBF_C#18_R#1 "Buffer of the 16 last" UBYTE COMP_0068 1 100 0 255 ECU_ADDRESS 0xFFFFA005 DISPLAY_IDENTIFIER Sxx_sli_buf /begin FUNCTION_LIST R208.10.dgn_ccadd_1_3_2 /end FUNCTION_LIST /end MEASUREMENT
/begin MEASUREMENT vCCSLIBF_C#19_R#1 "Buffer of the 16 last" UBYTE COMP_0068 1 100 0 255 ECU_ADDRESS 0xFFFFA006 DISPLAY_IDENTIFIER Sxx_sli_buf /begin FUNCTION_LIST R208.10.dgn_ccadd_1_3_2 /end FUNCTION_LIST /end MEASUREMENT
/begin MEASUREMENT vCCSLIBF_C#20_R#1 "Buffer of the 16 last" UBYTE COMP_0068 1 100 0 255 ECU_ADDRESS 0xFFFFA007 DISPLAY_IDENTIFIER Sxx_sli_buf /begin FUNCTION_LIST R208.10.dgn_ccadd_1_3_2 /end FUNCTION_LIST /end MEASUREMENT
/begin MEASUREMENT vCCSLIBF_C#21_R#1 "Buffer of the 16 last" UBYTE COMP_0068 1 100 0 255 ECU_ADDRESS 0xFFFFA008 DISPLAY_IDENTIFIER Sxx_sli_buf /begin FUNCTION_LIST R208.10.dgn_ccadd_1_3_2 /end FUNCTION_LIST /end MEASUREMENT
/begin MEASUREMENT vCCSLIBF_C#22_R#1 "Buffer of the 16 last" UBYTE COMP_0068 1 100 0 255 ECU_ADDRESS 0xFFFFA009 DISPLAY_IDENTIFIER Sxx_sli_buf /begin FUNCTION_LIST R208.10.dgn_ccadd_1_3_2 /end FUNCTION_LIST /end MEASUREMENT
/begin MEASUREMENT vCCSLIETH "Difference between vehicle speed and requested speed to declare CC/SL ineffective" UBYTE COMP_0388 1 100 0 25.5 ECU_ADDRESS 0xFFFF2966 DISPLAY_IDENTIFIER Vxx_cru_sl_no_efv_vs_thd /begin FUNCTION_LIST R208.2.VSINT_1_1_2 R208.7.OUTMX_1_1_3 /end FUNCTION_LIST /end MEASUREMENT
/begin MEASUREMENT vCCSLIRAM "Work buffer of the 16 last" UBYTE COMP_0068 1 100 0 255 ECU_ADDRESS 0xFFFF3A86 DISPLAY_IDENTIFIER Vxx_sli_buf /begin FUNCTION_LIST R208.10.dgn_ccadd_1_3_2 /end FUNCTION_LIST /end MEASUREMENT
/begin MEASUREMENT vCCSLIRAM_C#1_R#1 "Work buffer of the 16 last" UBYTE COMP_0068 1 100 0 255 ECU_ADDRESS 0xFFFF3A86 DISPLAY_IDENTIFIER Vxx_sli_buf /begin FUNCTION_LIST R208.10.dgn_ccadd_1_3_2 /end FUNCTION_LIST /end MEASUREMENT
/begin MEASUREMENT vCCSLIRAM_C#2_R#1 "Work buffer of the 16 last" UBYTE COMP_0068 1 100 0 255 ECU_ADDRESS 0xFFFF3A87 DISPLAY_IDENTIFIER Vxx_sli_buf /begin FUNCTION_LIST R208.10.dgn_ccadd_1_3_2 /end FUNCTION_LIST /end MEASUREMENT
/begin MEASUREMENT vCCSLIRAM_C#3_R#1 "Work buffer of the 16 last" UBYTE COMP_0068 1 100 0 255 ECU_ADDRESS 0xFFFF3A88 DISPLAY_IDENTIFIER Vxx_sli_buf /begin FUNCTION_LIST R208.10.dgn_ccadd_1_3_2 /end FUNCTION_LIST /end MEASUREMENT
/begin MEASUREMENT vCCSLIRAM_C#4_R#1 "Work buffer of the 16 last" UBYTE COMP_0068 1 100 0 255 ECU_ADDRESS 0xFFFF3A89 DISPLAY_IDENTIFIER Vxx_sli_buf /begin FUNCTION_LIST R208.10.dgn_ccadd_1_3_2 /end FUNCTION_LIST /end MEASUREMENT
/begin MEASUREMENT vCCSLIRAM_C#5_R#1 "Work buffer of the 16 last" UBYTE COMP_0068 1 100 0 255 ECU_ADDRESS 0xFFFF3A8A DISPLAY_IDENTIFIER Vxx_sli_buf /begin FUNCTION_LIST R208.10.dgn_ccadd_1_3_2 /end FUNCTION_LIST /end MEASUREMENT
/begin MEASUREMENT vCCSLIRAM_C#6_R#1 "Work buffer of the 16 last" UBYTE COMP_0068 1 100 0 255 ECU_ADDRESS 0xFFFF3A8B DISPLAY_IDENTIFIER Vxx_sli_buf /begin FUNCTION_LIST R208.10.dgn_ccadd_1_3_2 /end FUNCTION_LIST /end MEASUREMENT
/begin MEASUREMENT vCCSLIRAM_C#7_R#1 "Work buffer of the 16 last" UBYTE COMP_0068 1 100 0 255 ECU_ADDRESS 0xFFFF3A8C DISPLAY_IDENTIFIER Vxx_sli_buf /begin FUNCTION_LIST R208.10.dgn_ccadd_1_3_2 /end FUNCTION_LIST /end MEASUREMENT
/begin MEASUREMENT vCCSLIRAM_C#8_R#1 "Work buffer of the 16 last" UBYTE COMP_0068 1 100 0 255 ECU_ADDRESS 0xFFFF3A8D DISPLAY_IDENTIFIER Vxx_sli_buf /begin FUNCTION_LIST R208.10.dgn_ccadd_1_3_2 /end FUNCTION_LIST /end MEASUREMENT
/begin MEASUREMENT vCCSLIRAM_C#9_R#1 "Work buffer of the 16 last" UBYTE COMP_0068 1 100 0 255 ECU_ADDRESS 0xFFFF3A8E DISPLAY_IDENTIFIER Vxx_sli_buf /begin FUNCTION_LIST R208.10.dgn_ccadd_1_3_2 /end FUNCTION_LIST /end MEASUREMENT
/begin MEASUREMENT vCCSLIRAM_C#10_R#1 "Work buffer of the 16 last" UBYTE COMP_0068 1 100 0 255 ECU_ADDRESS 0xFFFF3A8F DISPLAY_IDENTIFIER Vxx_sli_buf /begin FUNCTION_LIST R208.10.dgn_ccadd_1_3_2 /end FUNCTION_LIST /end MEASUREMENT
/begin MEASUREMENT vCCSLIRAM_C#11_R#1 "Work buffer of the 16 last" UBYTE COMP_0068 1 100 0 255 ECU_ADDRESS 0xFFFF3A90 DISPLAY_IDENTIFIER Vxx_sli_buf /begin FUNCTION_LIST R208.10.dgn_ccadd_1_3_2 /end FUNCTION_LIST /end MEASUREMENT
/begin MEASUREMENT vCCSLIRAM_C#12_R#1 "Work buffer of the 16 last" UBYTE COMP_0068 1 100 0 255 ECU_ADDRESS 0xFFFF3A91 DISPLAY_IDENTIFIER Vxx_sli_buf /begin FUNCTION_LIST R208.10.dgn_ccadd_1_3_2 /end FUNCTION_LIST /end MEASUREMENT
/begin MEASUREMENT vCCSLIRAM_C#13_R#1 "Work buffer of the 16 last" UBYTE COMP_0068 1 100 0 255 ECU_ADDRESS 0xFFFF3A92 DISPLAY_IDENTIFIER Vxx_sli_buf /begin FUNCTION_LIST R208.10.dgn_ccadd_1_3_2 /end FUNCTION_LIST /end MEASUREMENT
/begin MEASUREMENT vCCSLIRAM_C#14_R#1 "Work buffer of the 16 last" UBYTE COMP_0068 1 100 0 255 ECU_ADDRESS 0xFFFF3A93 DISPLAY_IDENTIFIER Vxx_sli_buf /begin FUNCTION_LIST R208.10.dgn_ccadd_1_3_2 /end FUNCTION_LIST /end MEASUREMENT
/begin MEASUREMENT vCCSLIRAM_C#15_R#1 "Work buffer of the 16 last" UBYTE COMP_0068 1 100 0 255 ECU_ADDRESS 0xFFFF3A94 DISPLAY_IDENTIFIER Vxx_sli_buf /begin FUNCTION_LIST R208.10.dgn_ccadd_1_3_2 /end FUNCTION_LIST /end MEASUREMENT
/begin MEASUREMENT vCCSLIRAM_C#16_R#1 "Work buffer of the 16 last" UBYTE COMP_0068 1 100 0 255 ECU_ADDRESS 0xFFFF3A95 DISPLAY_IDENTIFIER Vxx_sli_buf /begin FUNCTION_LIST R208.10.dgn_ccadd_1_3_2 /end FUNCTION_LIST /end MEASUREMENT
/begin MEASUREMENT vCCSLIRAM_C#17_R#1 "Work buffer of the 16 last" UBYTE COMP_0068 1 100 0 255 ECU_ADDRESS 0xFFFF3A96 DISPLAY_IDENTIFIER Vxx_sli_buf /begin FUNCTION_LIST R208.10.dgn_ccadd_1_3_2 /end FUNCTION_LIST /end MEASUREMENT
/begin MEASUREMENT vCCSLIRAM_C#18_R#1 "Work buffer of the 16 last" UBYTE COMP_0068 1 100 0 255 ECU_ADDRESS 0xFFFF3A97 DISPLAY_IDENTIFIER Vxx_sli_buf /begin FUNCTION_LIST R208.10.dgn_ccadd_1_3_2 /end FUNCTION_LIST /end MEASUREMENT
/begin MEASUREMENT vCCSLIRAM_C#19_R#1 "Work buffer of the 16 last" UBYTE COMP_0068 1 100 0 255 ECU_ADDRESS 0xFFFF3A98 DISPLAY_IDENTIFIER Vxx_sli_buf /begin FUNCTION_LIST R208.10.dgn_ccadd_1_3_2 /end FUNCTION_LIST /end MEASUREMENT
/begin MEASUREMENT vCCSLIRAM_C#20_R#1 "Work buffer of the 16 last" UBYTE COMP_0068 1 100 0 255 ECU_ADDRESS 0xFFFF3A99 DISPLAY_IDENTIFIER Vxx_sli_buf /begin FUNCTION_LIST R208.10.dgn_ccadd_1_3_2 /end FUNCTION_LIST /end MEASUREMENT
/begin MEASUREMENT vCCSLIRAM_C#21_R#1 "Work buffer of the 16 last" UBYTE COMP_0068 1 100 0 255 ECU_ADDRESS 0xFFFF3A9A DISPLAY_IDENTIFIER Vxx_sli_buf /begin FUNCTION_LIST R208.10.dgn_ccadd_1_3_2 /end FUNCTION_LIST /end MEASUREMENT
/begin MEASUREMENT vCCSLIRAM_C#22_R#1 "Work buffer of the 16 last" UBYTE COMP_0068 1 100 0 255 ECU_ADDRESS 0xFFFF3A9B DISPLAY_IDENTIFIER Vxx_sli_buf /begin FUNCTION_LIST R208.10.dgn_ccadd_1_3_2 /end FUNCTION_LIST /end MEASUREMENT
/begin MEASUREMENT vCCSLLSTP "Value of requested speed step when accel or decel switch pressed continuously" UBYTE COMP_0068 1 100 0 255 ECU_ADDRESS 0xFFFF2967 DISPLAY_IDENTIFIER Vxx_cru_sl_long_step /begin FUNCTION_LIST R208.2.VSINT_1_1_2 R208.5.SETPT_1_1_0 /end FUNCTION_LIST /end MEASUREMENT
/begin MEASUREMENT vCCSLMNVS "CC/SL minimal speed setpoint" UBYTE COMP_0068 1 100 0 255 ECU_ADDRESS 0xFFFF2968 DISPLAY_IDENTIFIER Vxx_cru_sl_min_vs /begin FUNCTION_LIST R208.2.VSINT_1_1_2 R208.5.SETPT_1_1_0 /end FUNCTION_LIST /end MEASUREMENT
/begin MEASUREMENT vCCSLMXVS "CC/SL maximal speed setpoint" UBYTE COMP_0068 1 100 0 255 ECU_ADDRESS 0xFFFF2969 DISPLAY_IDENTIFIER Vxx_cru_sl_max_vs /begin FUNCTION_LIST R208.2.VSINT_1_1_2 R208.5.SETPT_1_1_0 /end FUNCTION_LIST /end MEASUREMENT
/begin MEASUREMENT vCCSLSSTP "Value of requested speed step when accel or decel switch pressed during a short time" UBYTE COMP_0068 1 100 0 255 ECU_ADDRESS 0xFFFF296A DISPLAY_IDENTIFIER Vxx_cru_sl_smal_step /begin FUNCTION_LIST R208.2.VSINT_1_1_2 R208.5.SETPT_1_1_0 /end FUNCTION_LIST /end MEASUREMENT
/begin MEASUREMENT vCCSLVREF "Filtered speed at the corrector input" UWORD COMP_0375_S 1 100 0 655.35 ECU_ADDRESS 0xFFFF41C0 DISPLAY_IDENTIFIER Vxx_cru_sl_fil_vs_ref /begin FUNCTION_LIST R208.6.SERVO_1_2_2 /end FUNCTION_LIST /end MEASUREMENT
/begin MEASUREMENT vCCSLVRO "Reference speed increment" UWORD COMP_0532_S 1 100 0 655.35 ECU_ADDRESS 0xFFFF41C2 DISPLAY_IDENTIFIER Vxx_cru_vs_ref_ofs /begin FUNCTION_LIST R208.6.SERVO_1_2_2 /end FUNCTION_LIST /end MEASUREMENT
/begin MEASUREMENT vCCSLVSP "Vehicle speed filtered by the cruise control/speed limiter strategy" UWORD COMP_0375_S 1 100 0 655.35 ECU_ADDRESS 0xFFFF41C4 DISPLAY_IDENTIFIER Vxx_cru_sl_vs
 /begin FUNCTION_LIST R208.2.VSINT_1_1_2 R208.4.STFLW_1_2_2 R208.5.SETPT_1_1_0 R208.7.OUTMX_1_1_3 R208.8.DACAX_1_1_5 R208.10.dgn_ccadd_1_3_2 /end FUNCTION_LIST
/end MEASUREMENT
/begin MEASUREMENT vCCSLVSPD "Vehicle speed for cruise control diagnostic add-on" UBYTE COMP_0068 1 100 0 255 ECU_ADDRESS 0xFFFF3AA0 DISPLAY_IDENTIFIER Vxx_cru_sl_vs_diag /begin FUNCTION_LIST R208.10.dgn_ccadd_1_3_2 /end FUNCTION_LIST /end MEASUREMENT
/begin MEASUREMENT vCCSLVSPK "Vehicle speed filtered by the cruise control/speed limiter strategy in km/h" UWORD COMP_0375_S 1 100 0 655.35 ECU_ADDRESS 0xFFFF296C DISPLAY_IDENTIFIER Vxx_cru_sl_vs_kmh /begin FUNCTION_LIST R208.2.VSINT_1_1_2 R208.6.SERVO_1_2_2 /end FUNCTION_LIST /end MEASUREMENT
/begin MEASUREMENT vCCSLVSPR "Raw vehicle speed for cruise control and speed limiter strategy" UWORD COMP_0373 1 100 0 655.35 ECU_ADDRESS 0xFFFF296E DISPLAY_IDENTIFIER Vxx_cru_sl_raw_vs /begin FUNCTION_LIST R208.2.VSINT_1_1_2 /end FUNCTION_LIST /end MEASUREMENT
/begin MEASUREMENT vCCSNAPST "Snapshot data of root cause when CC shut-off occurs" UBYTE COMP_0068 1 100 0 255 ECU_ADDRESS 0xFFFF41C6 /begin FUNCTION_LIST R208.10.dgn_ccadd_1_3_2 /end FUNCTION_LIST /end MEASUREMENT
/begin MEASUREMENT vCCSNAPST_C#1_R#1 "Snapshot data of root cause when CC shut-off occurs" UBYTE COMP_0068 1 100 0 255 ECU_ADDRESS 0xFFFF41C6 /begin FUNCTION_LIST R208.10.dgn_ccadd_1_3_2 /end FUNCTION_LIST /end MEASUREMENT
/begin MEASUREMENT vCCSNAPST_C#2_R#1 "Snapshot data of root cause when CC shut-off occurs" UBYTE COMP_0068 1 100 0 255 ECU_ADDRESS 0xFFFF41C7 /begin FUNCTION_LIST R208.10.dgn_ccadd_1_3_2 /end FUNCTION_LIST /end MEASUREMENT
/begin MEASUREMENT vCCSNAPST_C#3_R#1 "Snapshot data of root cause when CC shut-off occurs" UBYTE COMP_0068 1 100 0 255 ECU_ADDRESS 0xFFFF41C8 /begin FUNCTION_LIST R208.10.dgn_ccadd_1_3_2 /end FUNCTION_LIST /end MEASUREMENT
/begin MEASUREMENT vCCSNAPST_C#4_R#1 "Snapshot data of root cause when CC shut-off occurs" UBYTE COMP_0068 1 100 0 255 ECU_ADDRESS 0xFFFF41C9 /begin FUNCTION_LIST R208.10.dgn_ccadd_1_3_2 /end FUNCTION_LIST /end MEASUREMENT
/begin MEASUREMENT vCCSNAPST_C#5_R#1 "Snapshot data of root cause when CC shut-off occurs" UBYTE COMP_0068 1 100 0 255 ECU_ADDRESS 0xFFFF41CA /begin FUNCTION_LIST R208.10.dgn_ccadd_1_3_2 /end FUNCTION_LIST /end MEASUREMENT
/begin MEASUREMENT vCCSNAPST_C#6_R#1 "Snapshot data of root cause when CC shut-off occurs" UBYTE COMP_0068 1 100 0 255 ECU_ADDRESS 0xFFFF41CB /begin FUNCTION_LIST R208.10.dgn_ccadd_1_3_2 /end FUNCTION_LIST /end MEASUREMENT
/begin MEASUREMENT vCCSNAPST_C#7_R#1 "Snapshot data of root cause when CC shut-off occurs" UBYTE COMP_0068 1 100 0 255 ECU_ADDRESS 0xFFFF41CC /begin FUNCTION_LIST R208.10.dgn_ccadd_1_3_2 /end FUNCTION_LIST /end MEASUREMENT
/begin MEASUREMENT vCCSNAPST_C#8_R#1 "Snapshot data of root cause when CC shut-off occurs" UBYTE COMP_0068 1 100 0 255 ECU_ADDRESS 0xFFFF41CD /begin FUNCTION_LIST R208.10.dgn_ccadd_1_3_2 /end FUNCTION_LIST /end MEASUREMENT
/begin MEASUREMENT vCCSNAPST_C#9_R#1 "Snapshot data of root cause when CC shut-off occurs" UBYTE COMP_0068 1 100 0 255 ECU_ADDRESS 0xFFFF41CE /begin FUNCTION_LIST R208.10.dgn_ccadd_1_3_2 /end FUNCTION_LIST /end MEASUREMENT
/begin MEASUREMENT vCCSNAPST_C#10_R#1 "Snapshot data of root cause when CC shut-off occurs" UBYTE COMP_0068 1 100 0 255 ECU_ADDRESS 0xFFFF41CF /begin FUNCTION_LIST R208.10.dgn_ccadd_1_3_2 /end FUNCTION_LIST /end MEASUREMENT
/begin MEASUREMENT vCCSNAPST_C#11_R#1 "Snapshot data of root cause when CC shut-off occurs" UBYTE COMP_0068 1 100 0 255 ECU_ADDRESS 0xFFFF41D0 /begin FUNCTION_LIST R208.10.dgn_ccadd_1_3_2 /end FUNCTION_LIST /end MEASUREMENT
/begin MEASUREMENT vCCSNAPST_C#12_R#1 "Snapshot data of root cause when CC shut-off occurs" UBYTE COMP_0068 1 100 0 255 ECU_ADDRESS 0xFFFF41D1 /begin FUNCTION_LIST R208.10.dgn_ccadd_1_3_2 /end FUNCTION_LIST /end MEASUREMENT
/begin MEASUREMENT vCCSNAPST_C#13_R#1 "Snapshot data of root cause when CC shut-off occurs" UBYTE COMP_0068 1 100 0 255 ECU_ADDRESS 0xFFFF41D2 /begin FUNCTION_LIST R208.10.dgn_ccadd_1_3_2 /end FUNCTION_LIST /end MEASUREMENT
/begin MEASUREMENT vCCSNAPST_C#14_R#1 "Snapshot data of root cause when CC shut-off occurs" UBYTE COMP_0068 1 100 0 255 ECU_ADDRESS 0xFFFF41D3 /begin FUNCTION_LIST R208.10.dgn_ccadd_1_3_2 /end FUNCTION_LIST /end MEASUREMENT
/begin MEASUREMENT vCCSNAPST_C#15_R#1 "Snapshot data of root cause when CC shut-off occurs" UBYTE COMP_0068 1 100 0 255 ECU_ADDRESS 0xFFFF41D4 /begin FUNCTION_LIST R208.10.dgn_ccadd_1_3_2 /end FUNCTION_LIST /end MEASUREMENT
/begin MEASUREMENT vCCSNAPST_C#16_R#1 "Snapshot data of root cause when CC shut-off occurs" UBYTE COMP_0068 1 100 0 255 ECU_ADDRESS 0xFFFF41D5 /begin FUNCTION_LIST R208.10.dgn_ccadd_1_3_2 /end FUNCTION_LIST /end MEASUREMENT
/begin MEASUREMENT vCCSNAPST_C#17_R#1 "Snapshot data of root cause when CC shut-off occurs" UBYTE COMP_0068 1 100 0 255 ECU_ADDRESS 0xFFFF41D6 /begin FUNCTION_LIST R208.10.dgn_ccadd_1_3_2 /end FUNCTION_LIST /end MEASUREMENT
/begin MEASUREMENT vCCSNAPST_C#18_R#1 "Snapshot data of root cause when CC shut-off occurs" UBYTE COMP_0068 1 100 0 255 ECU_ADDRESS 0xFFFF41D7 /begin FUNCTION_LIST R208.10.dgn_ccadd_1_3_2 /end FUNCTION_LIST /end MEASUREMENT
/begin MEASUREMENT vCCSNAPST_C#19_R#1 "Snapshot data of root cause when CC shut-off occurs" UBYTE COMP_0068 1 100 0 255 ECU_ADDRESS 0xFFFF41D8 /begin FUNCTION_LIST R208.10.dgn_ccadd_1_3_2 /end FUNCTION_LIST /end MEASUREMENT
/begin MEASUREMENT vCCSNAPST_C#20_R#1 "Snapshot data of root cause when CC shut-off occurs" UBYTE COMP_0068 1 100 0 255 ECU_ADDRESS 0xFFFF41D9 /begin FUNCTION_LIST R208.10.dgn_ccadd_1_3_2 /end FUNCTION_LIST /end MEASUREMENT
/begin MEASUREMENT vCCSNAPST_C#21_R#1 "Snapshot data of root cause when CC shut-off occurs" UBYTE COMP_0068 1 100 0 255 ECU_ADDRESS 0xFFFF41DA /begin FUNCTION_LIST R208.10.dgn_ccadd_1_3_2 /end FUNCTION_LIST /end MEASUREMENT
/begin MEASUREMENT vCCSNAPST_C#22_R#1 "Snapshot data of root cause when CC shut-off occurs" UBYTE COMP_0068 1 100 0 255 ECU_ADDRESS 0xFFFF41DB /begin FUNCTION_LIST R208.10.dgn_ccadd_1_3_2 /end FUNCTION_LIST /end MEASUREMENT
/begin MEASUREMENT vCCSNAPST_C#23_R#1 "Snapshot data of root cause when CC shut-off occurs" UBYTE COMP_0068 1 100 0 255 ECU_ADDRESS 0xFFFF41DC /begin FUNCTION_LIST R208.10.dgn_ccadd_1_3_2 /end FUNCTION_LIST /end MEASUREMENT
/begin MEASUREMENT vCCSNAPST_C#24_R#1 "Snapshot data of root cause when CC shut-off occurs" UBYTE COMP_0068 1 100 0 255 ECU_ADDRESS 0xFFFF41DD /begin FUNCTION_LIST R208.10.dgn_ccadd_1_3_2 /end FUNCTION_LIST /end MEASUREMENT
/begin MEASUREMENT vCCSNAPST_C#25_R#1 "Snapshot data of root cause when CC shut-off occurs" UBYTE COMP_0068 1 100 0 255 ECU_ADDRESS 0xFFFF41DE /begin FUNCTION_LIST R208.10.dgn_ccadd_1_3_2 /end FUNCTION_LIST /end MEASUREMENT
/begin MEASUREMENT vCCSNAPST_C#26_R#1 "Snapshot data of root cause when CC shut-off occurs" UBYTE COMP_0068 1 100 0 255 ECU_ADDRESS 0xFFFF41DF /begin FUNCTION_LIST R208.10.dgn_ccadd_1_3_2 /end FUNCTION_LIST /end MEASUREMENT
/begin MEASUREMENT vCCSNAPST_C#27_R#1 "Snapshot data of root cause when CC shut-off occurs" UBYTE COMP_0068 1 100 0 255 ECU_ADDRESS 0xFFFF41E0 /begin FUNCTION_LIST R208.10.dgn_ccadd_1_3_2 /end FUNCTION_LIST /end MEASUREMENT
/begin MEASUREMENT vCCSNAPST_C#28_R#1 "Snapshot data of root cause when CC shut-off occurs" UBYTE COMP_0068 1 100 0 255 ECU_ADDRESS 0xFFFF41E1 /begin FUNCTION_LIST R208.10.dgn_ccadd_1_3_2 /end FUNCTION_LIST /end MEASUREMENT
/begin MEASUREMENT vCCSNAPST_C#29_R#1 "Snapshot data of root cause when CC shut-off occurs" UBYTE COMP_0068 1 100 0 255 ECU_ADDRESS 0xFFFF41E2 /begin FUNCTION_LIST R208.10.dgn_ccadd_1_3_2 /end FUNCTION_LIST /end MEASUREMENT
/begin MEASUREMENT vCCSNAPST_C#30_R#1 "Snapshot data of root cause when CC shut-off occurs" UBYTE COMP_0068 1 100 0 255 ECU_ADDRESS 0xFFFF41E3 /begin FUNCTION_LIST R208.10.dgn_ccadd_1_3_2 /end FUNCTION_LIST /end MEASUREMENT
/begin MEASUREMENT vCCSNAPST_C#31_R#1 "Snapshot data of root cause when CC shut-off occurs" UBYTE COMP_0068 1 100 0 255 ECU_ADDRESS 0xFFFF41E4 /begin FUNCTION_LIST R208.10.dgn_ccadd_1_3_2 /end FUNCTION_LIST /end MEASUREMENT
/begin MEASUREMENT vCCSNAPST_C#32_R#1 "Snapshot data of root cause when CC shut-off occurs" UBYTE COMP_0068 1 100 0 255 ECU_ADDRESS 0xFFFF41E5 /begin FUNCTION_LIST R208.10.dgn_ccadd_1_3_2 /end FUNCTION_LIST /end MEASUREMENT
/begin MEASUREMENT vCCSNAPST_C#33_R#1 "Snapshot data of root cause when CC shut-off occurs" UBYTE COMP_0068 1 100 0 255 ECU_ADDRESS 0xFFFF41E6 /begin FUNCTION_LIST R208.10.dgn_ccadd_1_3_2 /end FUNCTION_LIST /end MEASUREMENT
/begin MEASUREMENT vCCSNAPST_C#34_R#1 "Snapshot data of root cause when CC shut-off occurs" UBYTE COMP_0068 1 100 0 255 ECU_ADDRESS 0xFFFF41E7 /begin FUNCTION_LIST R208.10.dgn_ccadd_1_3_2 /end FUNCTION_LIST /end MEASUREMENT
/begin MEASUREMENT vCCVREF "Filtered speed at the corrector input for CC" UWORD COMP_0375_S 1 100 0 655.35 ECU_ADDRESS 0xFFFF2970 DISPLAY_IDENTIFIER Vxx_cru_fil_vs_ref /begin FUNCTION_LIST R208.6.SERVO_1_2_2 /end FUNCTION_LIST /end MEASUREMENT
/begin MEASUREMENT vCEVCF "Purge control valve diagnosis failure counter" UBYTE COMP_0016 1 100 0 255 ECU_ADDRESS 0xFFFF11D4 /begin FUNCTION_LIST R301.15.PurgeValveVB_shortDiag_1_0_2 /end FUNCTION_LIST /end MEASUREMENT
/begin MEASUREMENT vCINJH21 "Circuit high failure counter2 for #1 injector" UBYTE COMP_0016 1 100 0 255 ECU_ADDRESS 0xFFFF2977 /begin FUNCTION_LIST R301.11.INJDiag_1_1_2 /end FUNCTION_LIST /end MEASUREMENT
/begin MEASUREMENT vCINJH22 "Circuit high failure counter2 for #2 injector" UBYTE COMP_0016 1 100 0 255 ECU_ADDRESS 0xFFFF2978 /begin FUNCTION_LIST R301.11.INJDiag_1_1_2 /end FUNCTION_LIST /end MEASUREMENT
/begin MEASUREMENT vCINJH23 "Circuit high failure counter2 for #3 injector" UBYTE COMP_0016 1 100 0 255 ECU_ADDRESS 0xFFFF2979 /begin FUNCTION_LIST R301.11.INJDiag_1_1_2 /end FUNCTION_LIST /end MEASUREMENT
/begin MEASUREMENT vCINJH24 "Circuit high failure counter2 for #4 injector" UBYTE COMP_0016 1 100 0 255 ECU_ADDRESS 0xFFFF297A /begin FUNCTION_LIST R301.11.INJDiag_1_1_2 /end FUNCTION_LIST /end MEASUREMENT
/begin MEASUREMENT vCINJH25 "Circuit high failure counter2 for #5 injector" UBYTE COMP_0016 1 100 0 255 ECU_ADDRESS 0xFFFF297B /begin FUNCTION_LIST R301.11.INJDiag_1_1_2 /end FUNCTION_LIST /end MEASUREMENT
/begin MEASUREMENT vCINJH26 "Circuit high failure counter2 for #6 injector" UBYTE COMP_0016 1 100 0 255 ECU_ADDRESS 0xFFFF297C /begin FUNCTION_LIST R301.11.INJDiag_1_1_2 /end FUNCTION_LIST /end MEASUREMENT
/begin MEASUREMENT vCINJHI1 "Circuit high failure counter for #1 injector" UBYTE COMP_0016 1 100 0 255 ECU_ADDRESS 0xFFFF4048 /begin FUNCTION_LIST R301.11.INJDiag_1_1_2 /end FUNCTION_LIST /end MEASUREMENT
/begin MEASUREMENT vCINJHI2 "Circuit high failure counter for #2 injector" UBYTE COMP_0016 1 100 0 255 ECU_ADDRESS 0xFFFF4049 /begin FUNCTION_LIST R301.11.INJDiag_1_1_2 /end FUNCTION_LIST /end MEASUREMENT
/begin MEASUREMENT vCINJHI3 "Circuit high failure counter for #3 injector" UBYTE COMP_0016 1 100 0 255 ECU_ADDRESS 0xFFFF404A /begin FUNCTION_LIST R301.11.INJDiag_1_1_2 /end FUNCTION_LIST /end MEASUREMENT
/begin MEASUREMENT vCINJHI4 "Circuit high failure counter for #4 injector" UBYTE COMP_0016 1 100 0 255 ECU_ADDRESS 0xFFFF404B /begin FUNCTION_LIST R301.11.INJDiag_1_1_2 /end FUNCTION_LIST /end MEASUREMENT
/begin MEASUREMENT vCINJHI5 "Circuit high failure counter for #5 injector" UBYTE COMP_0016 1 100 0 255 ECU_ADDRESS 0xFFFF404C /begin FUNCTION_LIST R301.11.INJDiag_1_1_2 /end FUNCTION_LIST /end MEASUREMENT
/begin MEASUREMENT vCINJHI6 "Circuit high failure counter for #6 injector" UBYTE COMP_0016 1 100 0 255 ECU_ADDRESS 0xFFFF404D /begin FUNCTION_LIST R301.11.INJDiag_1_1_2 /end FUNCTION_LIST /end MEASUREMENT
/begin MEASUREMENT vCINJL21 "Circuit low failure counter2 for #1 injector" UBYTE COMP_0016 1 100 0 255 ECU_ADDRESS 0xFFFF297D /begin FUNCTION_LIST R301.11.INJDiag_1_1_2 /end FUNCTION_LIST /end MEASUREMENT
/begin MEASUREMENT vCINJL22 "Circuit low failure counter2 for #2 injector" UBYTE COMP_0016 1 100 0 255 ECU_ADDRESS 0xFFFF297E /begin FUNCTION_LIST R301.11.INJDiag_1_1_2 /end FUNCTION_LIST /end MEASUREMENT
/begin MEASUREMENT vCINJL23 "Circuit low failure counter2 for #3 injector" UBYTE COMP_0016 1 100 0 255 ECU_ADDRESS 0xFFFF297F /begin FUNCTION_LIST R301.11.INJDiag_1_1_2 /end FUNCTION_LIST /end MEASUREMENT
/begin MEASUREMENT vCINJL24 "Circuit low failure counter2 for #4 injector" UBYTE COMP_0016 1 100 0 255 ECU_ADDRESS 0xFFFF2980 /begin FUNCTION_LIST R301.11.INJDiag_1_1_2 /end FUNCTION_LIST /end MEASUREMENT
/begin MEASUREMENT vCINJL25 "Circuit low failure counter2 for #5 injector" UBYTE COMP_0016 1 100 0 255 ECU_ADDRESS 0xFFFF2981 /begin FUNCTION_LIST R301.11.INJDiag_1_1_2 /end FUNCTION_LIST /end MEASUREMENT
/begin MEASUREMENT vCINJL26 "Circuit low failure counter2 for #6 injector" UBYTE COMP_0016 1 100 0 255 ECU_ADDRESS 0xFFFF2982 /begin FUNCTION_LIST R301.11.INJDiag_1_1_2 /end FUNCTION_LIST /end MEASUREMENT
/begin MEASUREMENT vCINJLO1 "Circuit low failure counter for #1 injector" UBYTE COMP_0016 1 100 0 255 ECU_ADDRESS 0xFFFF2983 /begin FUNCTION_LIST R301.11.INJDiag_1_1_2 /end FUNCTION_LIST /end MEASUREMENT
/begin MEASUREMENT vCINJLO2 "Circuit low failure counter for #2 injector" UBYTE COMP_0016 1 100 0 255 ECU_ADDRESS 0xFFFF2984 /begin FUNCTION_LIST R301.11.INJDiag_1_1_2 /end FUNCTION_LIST /end MEASUREMENT
/begin MEASUREMENT vCINJLO3 "Circuit low failure counter for #3 injector" UBYTE COMP_0016 1 100 0 255 ECU_ADDRESS 0xFFFF2985 /begin FUNCTION_LIST R301.11.INJDiag_1_1_2 /end FUNCTION_LIST /end MEASUREMENT
/begin MEASUREMENT vCINJLO4 "Circuit low failure counter for #4 injector" UBYTE COMP_0016 1 100 0 255 ECU_ADDRESS 0xFFFF2986 /begin FUNCTION_LIST R301.11.INJDiag_1_1_2 /end FUNCTION_LIST /end MEASUREMENT
/begin MEASUREMENT vCINJLO5 "Circuit low failure counter for #5 injector" UBYTE COMP_0016 1 100 0 255 ECU_ADDRESS 0xFFFF2987 /begin FUNCTION_LIST R301.11.INJDiag_1_1_2 /end FUNCTION_LIST /end MEASUREMENT
/begin MEASUREMENT vCINJLO6 "Circuit low failure counter for #6 injector" UBYTE COMP_0016 1 100 0 255 ECU_ADDRESS 0xFFFF2988 /begin FUNCTION_LIST R301.11.INJDiag_1_1_2 /end FUNCTION_LIST /end MEASUREMENT
/begin MEASUREMENT vCLUCTR "Clutch SW counter" UBYTE COMP_0068 1 100 0 255 ECU_ADDRESS 0xFFFF299D /begin FUNCTION_LIST R301.12.ClutchSwDiag_1_0_1 /end FUNCTION_LIST /end MEASUREMENT
/begin MEASUREMENT vCO2HF1 "Front O2 H diag failure counter" UBYTE COMP_0016 1 100 0 255 ECU_ADDRESS 0xFFFF11FE /begin FUNCTION_LIST R301.16.FrontO2H_VB_shortDiag_1_0_2 /end FUNCTION_LIST /end MEASUREMENT
/begin MEASUREMENT vCO2HR1 "Rear O2 H diag failure counter" UBYTE COMP_0016 1 100 0 255 ECU_ADDRESS 0xFFFF11FF /begin FUNCTION_LIST R301.17.RearO2H_VB_shortDiag_1_0_2 /end FUNCTION_LIST /end MEASUREMENT
/begin MEASUREMENT vCRSHTMR "Last shut-off / activation counter" UBYTE COMP_0013 1 100 0 255 ECU_ADDRESS 0xFFFFB5D8 DISPLAY_IDENTIFIER Vxx_crsh_dly_ctr /begin FUNCTION_LIST R208.10.dgn_ccadd_1_3_2 /end FUNCTION_LIST /end MEASUREMENT
/begin MEASUREMENT vCRUCMPDZ "Previous carrier for safety failure diagnosis" UBYTE COMP_0068 1 100 0 255 ECU_ADDRESS 0xFFFF29D2 DISPLAY_IDENTIFIER Vxx_cru_cmp_diag_prev /begin FUNCTION_LIST R208.9.SAFETYX_1_3_2 /end FUNCTION_LIST /end MEASUREMENT
/begin MEASUREMENT vCRUCON "Cruise control state" UBYTE COMP_0068 1 100 0 255 ECU_ADDRESS 0xFFFF40E8 DISPLAY_IDENTIFIER Vsx_cru_stt
 /begin FUNCTION_LIST R208.2.VSINT_1_1_2 R208.4.STFLW_1_2_2 R208.5.SETPT_1_1_0 R208.6.SERVO_1_2_2 R208.7.OUTMX_1_1_3 R208.8.DACAX_1_1_5 R208.9.SAFETYX_1_3_2 R208.10.dgn_ccadd_1_3_2 /end FUNCTION_LIST
/end MEASUREMENT
/begin MEASUREMENT vDCAGBDYN "Decrease value of dynamic compensation for AGBCOR" UBYTE COMP_0473_S 1 100 0 25.5 ECU_ADDRESS 0xFFFF2A15 /begin FUNCTION_LIST R301.6.IscAirflow_1_4_5 /end FUNCTION_LIST /end MEASUREMENT
/begin MEASUREMENT vDISST2_R "Amount 2 of ISC compensation at the time of starting (enlarged)" UWORD COMP_0097 1 100 0 1023.984375 ECU_ADDRESS 0xFFFF1270 /begin FUNCTION_LIST R301.6.IscAirflow_1_4_5 /end FUNCTION_LIST /end MEASUREMENT
/begin MEASUREMENT vDLTNREF "Engine speed acceleration (REF-REF term)" SWORD COMP_0545_S 1 100 -6400 6399.8046875 ECU_ADDRESS 0xFFFF127A /begin FUNCTION_LIST R301.19.ISC_PID_cont_1_0_2 /end FUNCTION_LIST /end MEASUREMENT
/begin MEASUREMENT vDQAGBDYN "Timer of dynamic compensation for AGBCOR" UBYTE COMP_0183 1 100 0 5100 ECU_ADDRESS 0xFFFF2A91 /begin FUNCTION_LIST R301.6.IscAirflow_1_4_5 /end FUNCTION_LIST /end MEASUREMENT
/begin MEASUREMENT vDQAGBINT "Initial value of dynamic compensation for AGBCOR" UWORD COMP_0473_S 1 100 0 6553.5 ECU_ADDRESS 0xFFFF2A92 /begin FUNCTION_LIST R301.6.IscAirflow_1_4_5 /end FUNCTION_LIST /end MEASUREMENT
/begin MEASUREMENT vDRAGFT1 "Time constant for drag switch filtering (on)" UBYTE COMP_0014 1 100 0 2550 ECU_ADDRESS 0xFFFF2A9C /begin FUNCTION_LIST R301.6.IscAirflow_1_4_5 /end FUNCTION_LIST /end MEASUREMENT
/begin MEASUREMENT vDRAGFT2 "Time constant for drag switch filtering (off)" UBYTE COMP_0014 1 100 0 2550 ECU_ADDRESS 0xFFFF2A9D /begin FUNCTION_LIST R301.6.IscAirflow_1_4_5 /end FUNCTION_LIST /end MEASUREMENT
/begin MEASUREMENT vETARVMXN "Cruise control and speed limiter status : parameter sent to the gearbox on the CAN network" UBYTE COMP_0068 1 100 0 255 ECU_ADDRESS 0xFFFF2B6C DISPLAY_IDENTIFIER Vxx_mux_cru_sl_stt_nom /begin FUNCTION_LIST R208.7.OUTMX_1_1_3 R208.9.SAFETYX_1_3_2 /end FUNCTION_LIST /end MEASUREMENT
/begin MEASUREMENT vFFADSTRS "FFD CCSL - Steering wheel push buttons voltage" UWORD COMP_0537_S 1 100 0 65.535 ECU_ADDRESS 0xFFFFA3C4 /begin FUNCTION_LIST R301.13.FFDforDiagOnCAN_1_1_3 R901.1.Diag_on_can_app_1_6_2 /end FUNCTION_LIST /end MEASUREMENT
/begin MEASUREMENT vFFADVD "FFD advance timng (for Diag on CAN)" UWORD COMP_0595_S 1 100 -655.34 655.36 ECU_ADDRESS 0xFFFFA3C8 /begin FUNCTION_LIST R301.13.FFDforDiagOnCAN_1_1_3 R901.1.Diag_on_can_app_1_6_2 /end FUNCTION_LIST /end MEASUREMENT
/begin MEASUREMENT vFFAFFRVM "FFD CCSL - Status" UBYTE COMP_0068 1 100 0 255 ECU_ADDRESS 0xFFFFA3CA /begin FUNCTION_LIST R301.13.FFDforDiagOnCAN_1_1_3 R901.1.Diag_on_can_app_1_6_2 /end FUNCTION_LIST /end MEASUREMENT
/begin MEASUREMENT vFFAPS1V "FFD Accelerator pedal voltage - track 1" UWORD COMP_0537_S 1 100 0 65.535 ECU_ADDRESS 0xFFFFA3D0 /begin FUNCTION_LIST R301.13.FFDforDiagOnCAN_1_1_3 R901.1.Diag_on_can_app_1_6_2 /end FUNCTION_LIST /end MEASUREMENT
/begin MEASUREMENT vFFAPS2V "FFD Accelerator pedal voltage - track 2" UWORD COMP_0537_S 1 100 0 65.535 ECU_ADDRESS 0xFFFFA3D2 /begin FUNCTION_LIST R301.13.FFDforDiagOnCAN_1_1_3 R901.1.Diag_on_can_app_1_6_2 /end FUNCTION_LIST /end MEASUREMENT
/begin MEASUREMENT vFFAVCC "FFD Sensors supply voltage 1" UWORD COMP_0537_S 1 100 0 65.535 ECU_ADDRESS 0xFFFFA3D4 /begin FUNCTION_LIST R301.13.FFDforDiagOnCAN_1_1_3 R901.1.Diag_on_can_app_1_6_2 /end FUNCTION_LIST /end MEASUREMENT
/begin MEASUREMENT vFFCCFAL "FFD CCSL? Status of the reversible failures not due to CC which cause CC failure" UBYTE COMP_0068 1 100 0 255 ECU_ADDRESS 0xFFFFA3D6 /begin FUNCTION_LIST R301.13.FFDforDiagOnCAN_1_1_3 R901.1.Diag_on_can_app_1_6_2 /end FUNCTION_LIST /end MEASUREMENT
/begin MEASUREMENT vFFCCSLFA "FFD CCSL - Status of the reversible failures not due to CCSL which cause CCSL failure" UBYTE COMP_0068 1 100 0 255 ECU_ADDRESS 0xFFFFA3D7 /begin FUNCTION_LIST R301.13.FFDforDiagOnCAN_1_1_3 R901.1.Diag_on_can_app_1_6_2 /end FUNCTION_LIST /end MEASUREMENT
/begin MEASUREMENT vFFCOMDTM "FFD CCSL - Steering wheel push buttons state" UBYTE COMP_0068 1 100 0 255 ECU_ADDRESS 0xFFFFA3D8 /begin FUNCTION_LIST R301.13.FFDforDiagOnCAN_1_1_3 R901.1.Diag_on_can_app_1_6_2 /end FUNCTION_LIST /end MEASUREMENT
/begin MEASUREMENT vFFCRUCMP "FFD CCSL - Status of the failures which cause irreversible CC safety failure" UBYTE COMP_0068 1 100 0 255 ECU_ADDRESS 0xFFFFA3D9 /begin FUNCTION_LIST R301.13.FFDforDiagOnCAN_1_1_3 R901.1.Diag_on_can_app_1_6_2 /end FUNCTION_LIST /end MEASUREMENT
/begin MEASUREMENT vFFETAMOT "FFD Engine states" UBYTE COMP_0068 1 100 0 255 ECU_ADDRESS 0xFFFFA3E1 /begin FUNCTION_LIST R301.13.FFDforDiagOnCAN_1_1_3 R901.1.Diag_on_can_app_1_6_2 /end FUNCTION_LIST /end MEASUREMENT
/begin MEASUREMENT vFFFCCYL "FFD Fuel cut cylinder" UBYTE COMP_0068 1 100 0 255 ECU_ADDRESS 0xFFFFA3E2 /begin FUNCTION_LIST R301.13.FFDforDiagOnCAN_1_1_3 R901.1.Diag_on_can_app_1_6_2 /end FUNCTION_LIST /end MEASUREMENT
/begin MEASUREMENT vFFIGNSW "FFD Key state" UBYTE COMP_0068 1 100 0 255 ECU_ADDRESS 0xFFFFA3E3 /begin FUNCTION_LIST R301.13.FFDforDiagOnCAN_1_1_3 R901.1.Diag_on_can_app_1_6_2 /end FUNCTION_LIST /end MEASUREMENT
/begin MEASUREMENT vFFITACD "FFD Cylinder intake filling up efficiency" UWORD COMP_0217 1 100 0 3.999941832 ECU_ADDRESS 0xFFFFA3E4 /begin FUNCTION_LIST R301.13.FFDforDiagOnCAN_1_1_3 R901.1.Diag_on_can_app_1_6_2 /end FUNCTION_LIST /end MEASUREMENT
/begin MEASUREMENT vFFPAMB "FFD Atmospheric pressure (for Diag on CAN)" UWORD COMP_0491_S 1 100 0 65535 ECU_ADDRESS 0xFFFFA3EA /begin FUNCTION_LIST R301.13.FFDforDiagOnCAN_1_1_3 R901.1.Diag_on_can_app_1_6_2 /end FUNCTION_LIST /end MEASUREMENT
/begin MEASUREMENT vFFPDPRES "FFD Freon pressure sensor voltage" UWORD COMP_0537_S 1 100 0 65.535 ECU_ADDRESS 0xFFFFA3EC /begin FUNCTION_LIST R301.13.FFDforDiagOnCAN_1_1_3 R901.1.Diag_on_can_app_1_6_2 /end FUNCTION_LIST /end MEASUREMENT
/begin MEASUREMENT vFFPRSCLI "FFD Freon pressure" UWORD COMP_0420_S 1 100 0 6553.5 ECU_ADDRESS 0xFFFFA3EE /begin FUNCTION_LIST R301.13.FFDforDiagOnCAN_1_1_3 R901.1.Diag_on_can_app_1_6_2 /end FUNCTION_LIST /end MEASUREMENT
/begin MEASUREMENT vFFRAPOFS "FFD Accelerator pedal position" UWORD COMP_0575_S 1 100 -327.67 327.68 ECU_ADDRESS 0xFFFFA3F0 /begin FUNCTION_LIST R301.13.FFDforDiagOnCAN_1_1_3 R901.1.Diag_on_can_app_1_6_2 /end FUNCTION_LIST /end MEASUREMENT
/begin MEASUREMENT vFFRTENG "FFD Estimated effective engine torque" UWORD COMP_0345_S 1 100 -400 1647.96875 ECU_ADDRESS 0xFFFFA3F2 /begin FUNCTION_LIST R301.13.FFDforDiagOnCAN_1_1_3 R901.1.Diag_on_can_app_1_6_2 /end FUNCTION_LIST /end MEASUREMENT
/begin MEASUREMENT vFFRTTEP "FFD Final indicated torque target" UWORD COMP_0470_S 1 100 0 2047.96875 ECU_ADDRESS 0xFFFFA3F4 /begin FUNCTION_LIST R301.13.FFDforDiagOnCAN_1_1_3 R901.1.Diag_on_can_app_1_6_2 /end FUNCTION_LIST /end MEASUREMENT
/begin MEASUREMENT vFFTAND "F.F. data buffer intake air temperature (for DiagOnCAN)" UWORD COMP_0573_S 1 100 -273 6280.5 ECU_ADDRESS 0xFFFFA3FC /begin FUNCTION_LIST R301.13.FFDforDiagOnCAN_1_1_3 R901.1.Diag_on_can_app_1_6_2 /end FUNCTION_LIST /end MEASUREMENT
/begin MEASUREMENT vFFTGTVOD "FFD Throttle valve opening (for Diag on CAN)" UWORD COMP_0575_S 1 100 -327.67 327.68 ECU_ADDRESS 0xFFFFA400 /begin FUNCTION_LIST R301.13.FFDforDiagOnCAN_1_1_3 R901.1.Diag_on_can_app_1_6_2 /end FUNCTION_LIST /end MEASUREMENT
/begin MEASUREMENT vFFTIPS "FFD At the time of the sequential injection, output pulse width" UWORD COMP_0578_S 1 100 0 262140 ECU_ADDRESS 0xFFFFA402 /begin FUNCTION_LIST R301.13.FFDforDiagOnCAN_1_1_3 R901.1.Diag_on_can_app_1_6_2 /end FUNCTION_LIST /end MEASUREMENT
/begin MEASUREMENT vFFTIPS_R#1 "FFD At the time of the sequential injection, output pulse width" UWORD COMP_0578_S 1 100 0 262140 ECU_ADDRESS 0xFFFFA402 /begin FUNCTION_LIST R301.13.FFDforDiagOnCAN_1_1_3 R901.1.Diag_on_can_app_1_6_2 /end FUNCTION_LIST /end MEASUREMENT
/begin MEASUREMENT vFFTIPS_R#2 "FFD At the time of the sequential injection, output pulse width" UWORD COMP_0578_S 1 100 0 262140 ECU_ADDRESS 0xFFFFA404 /begin FUNCTION_LIST R301.13.FFDforDiagOnCAN_1_1_3 R901.1.Diag_on_can_app_1_6_2 /end FUNCTION_LIST /end MEASUREMENT
/begin MEASUREMENT vFFTVOD "F.F. buffer throttle open-degree (for DiagOnCAN)" UWORD COMP_0575_S 1 100 -327.67 327.68 ECU_ADDRESS 0xFFFFA408 /begin FUNCTION_LIST R301.13.FFDforDiagOnCAN_1_1_3 R901.1.Diag_on_can_app_1_6_2 /end FUNCTION_LIST /end MEASUREMENT
/begin MEASUREMENT vFFTWND "F.F. data buffer engine cooling coolant temperature (for DiagOnCAN)" UWORD COMP_0573_S 1 100 -273 6280.5 ECU_ADDRESS 0xFFFFA40A /begin FUNCTION_LIST R301.13.FFDforDiagOnCAN_1_1_3 R901.1.Diag_on_can_app_1_6_2 /end FUNCTION_LIST /end MEASUREMENT
/begin MEASUREMENT vFFVITESM "FFD Displayed vehicle speed unit" UBYTE COMP_0068 1 100 0 255 ECU_ADDRESS 0xFFFFA40C /begin FUNCTION_LIST R301.13.FFDforDiagOnCAN_1_1_3 R901.1.Diag_on_can_app_1_6_2 /end FUNCTION_LIST /end MEASUREMENT
/begin MEASUREMENT vFFVITESP "FFD Displayed vehicle speed received on the CAN network" UBYTE COMP_0068 1 100 0 255 ECU_ADDRESS 0xFFFFA40D /begin FUNCTION_LIST R301.13.FFDforDiagOnCAN_1_1_3 R901.1.Diag_on_can_app_1_6_2 /end FUNCTION_LIST /end MEASUREMENT
/begin MEASUREMENT vFFVSPD "F.F. data buffer vehicle speed occasion (for DiagOnCAN)" UWORD COMP_0375_S 1 100 0 655.35 ECU_ADDRESS 0xFFFFA40E /begin FUNCTION_LIST R301.13.FFDforDiagOnCAN_1_1_3 R901.1.Diag_on_can_app_1_6_2 /end FUNCTION_LIST /end MEASUREMENT
/begin MEASUREMENT vFFVTCNOW "FFD An incumbent VTC operation" UWORD COMP_0595_S 1 100 -655.34 655.36 ECU_ADDRESS 0xFFFFA410 /begin FUNCTION_LIST R301.13.FFDforDiagOnCAN_1_1_3 R901.1.Diag_on_can_app_1_6_2 /end FUNCTION_LIST /end MEASUREMENT
/begin MEASUREMENT vFFVTCNOW_R#1 "FFD An incumbent VTC operation" UWORD COMP_0595_S 1 100 -655.34 655.36 ECU_ADDRESS 0xFFFFA410 /begin FUNCTION_LIST R301.13.FFDforDiagOnCAN_1_1_3 R901.1.Diag_on_can_app_1_6_2 /end FUNCTION_LIST /end MEASUREMENT
/begin MEASUREMENT vFFVTCNOW_R#2 "FFD An incumbent VTC operation" UWORD COMP_0595_S 1 100 -655.34 655.36 ECU_ADDRESS 0xFFFFA412 /begin FUNCTION_LIST R301.13.FFDforDiagOnCAN_1_1_3 R901.1.Diag_on_can_app_1_6_2 /end FUNCTION_LIST /end MEASUREMENT
/begin MEASUREMENT vFFVTCTRG "FFD VTC target operation angle" UWORD COMP_0595_S 1 100 -655.34 655.36 ECU_ADDRESS 0xFFFFA414 /begin FUNCTION_LIST R301.13.FFDforDiagOnCAN_1_1_3 R901.1.Diag_on_can_app_1_6_2 /end FUNCTION_LIST /end MEASUREMENT
/begin MEASUREMENT vFFXXGEAR "FFD Current gear engaged" UBYTE COMP_0068 1 100 0 255 ECU_ADDRESS 0xFFFFA416 /begin FUNCTION_LIST R301.13.FFDforDiagOnCAN_1_1_3 R901.1.Diag_on_can_app_1_6_2 /end FUNCTION_LIST /end MEASUREMENT
/begin MEASUREMENT vGEARCTR "Gear position counter" UBYTE COMP_0068 1 100 0 255 ECU_ADDRESS 0xFFFF2E05 /begin FUNCTION_LIST R301.12.ClutchSwDiag_1_0_1 /end FUNCTION_LIST /end MEASUREMENT
/begin MEASUREMENT vIGAINRN "vRINF I-Part gain" SLONG COMP_0423_S 1 100 -8192.0058720256 8192.0058682109 ECU_ADDRESS 0xFFFF143C /begin FUNCTION_LIST R301.19.ISC_PID_cont_1_0_2 /end FUNCTION_LIST /end MEASUREMENT
/begin MEASUREMENT vINJOFF "Injector status flag" UBYTE COMP_0283 1 100 0 255 ECU_ADDRESS 0xFFFF4069 /begin FUNCTION_LIST R301.11.INJDiag_1_1_2 /end FUNCTION_LIST /end MEASUREMENT
/begin MEASUREMENT vISCCTP "Load compensation (transiency compensation) PTC compensation" UWORD COMP_0444 1 100 0 255.99609375 ECU_ADDRESS 0xFFFF147C /begin FUNCTION_LIST R301.6.IscAirflow_1_4_5 /end FUNCTION_LIST /end MEASUREMENT
/begin MEASUREMENT vISCSST_R "ISC compensation value 2 at the time of starting (enlarged)" UBYTE COMP_0276 1 100 0 1020 ECU_ADDRESS 0xFFFF149B /begin FUNCTION_LIST R301.6.IscAirflow_1_4_5 /end FUNCTION_LIST /end MEASUREMENT
/begin MEASUREMENT vISCST1_R "Amount 1 of ISC compensation at the time of starting (enlarged)" UWORD COMP_0097 1 100 0 1023.984375 ECU_ADDRESS 0xFFFF14A2 /begin FUNCTION_LIST R301.6.IscAirflow_1_4_5 /end FUNCTION_LIST /end MEASUREMENT
/begin MEASUREMENT vISCSTT_R "ISC compensation value 1 at the time of starting (enlarged)" UBYTE COMP_0276 1 100 0 1020 ECU_ADDRESS 0xFFFF14A9 /begin FUNCTION_LIST R301.6.IscAirflow_1_4_5 /end FUNCTION_LIST /end MEASUREMENT
/begin MEASUREMENT vISCST_R "The amount of ISC compensation at the time of starting (enlarged)" UWORD COMP_0293 1 100 0 131070 ECU_ADDRESS 0xFFFF149E /begin FUNCTION_LIST R301.6.IscAirflow_1_4_5 /end FUNCTION_LIST /end MEASUREMENT
/begin MEASUREMENT vKHOTBT "Upper exhaust temp increase compensation rate" UBYTE COMP_0045 1 100 0 1.9921875 ECU_ADDRESS 0xFFFF14D0 /begin FUNCTION_LIST R301.7.KHOT_1_0_2 /end FUNCTION_LIST /end MEASUREMENT
/begin MEASUREMENT vMLGBFREL "Each element buffer of the 20 last" UBYTE COMP_0068 1 100 0 255 ECU_ADDRESS 0xFFFFB63A /begin FUNCTION_LIST R208.10.dgn_ccadd_1_3_2 /end FUNCTION_LIST /end MEASUREMENT
/begin MEASUREMENT vMLGBFREL_C#1_R#1 "Each element buffer of the 20 last" UBYTE COMP_0068 1 100 0 255 ECU_ADDRESS 0xFFFFB63A /begin FUNCTION_LIST R208.10.dgn_ccadd_1_3_2 /end FUNCTION_LIST /end MEASUREMENT
/begin MEASUREMENT vMLGBFREL_C#2_R#1 "Each element buffer of the 20 last" UBYTE COMP_0068 1 100 0 255 ECU_ADDRESS 0xFFFFB63B /begin FUNCTION_LIST R208.10.dgn_ccadd_1_3_2 /end FUNCTION_LIST /end MEASUREMENT
/begin MEASUREMENT vMLGBFREL_C#3_R#1 "Each element buffer of the 20 last" UBYTE COMP_0068 1 100 0 255 ECU_ADDRESS 0xFFFFB63C /begin FUNCTION_LIST R208.10.dgn_ccadd_1_3_2 /end FUNCTION_LIST /end MEASUREMENT
/begin MEASUREMENT vMLGBFREL_C#4_R#1 "Each element buffer of the 20 last" UBYTE COMP_0068 1 100 0 255 ECU_ADDRESS 0xFFFFB63D /begin FUNCTION_LIST R208.10.dgn_ccadd_1_3_2 /end FUNCTION_LIST /end MEASUREMENT
/begin MEASUREMENT vMLGBFREL_C#5_R#1 "Each element buffer of the 20 last" UBYTE COMP_0068 1 100 0 255 ECU_ADDRESS 0xFFFFB63E /begin FUNCTION_LIST R208.10.dgn_ccadd_1_3_2 /end FUNCTION_LIST /end MEASUREMENT
/begin MEASUREMENT vMLGBFRNG "Buffer of the 20 last" UBYTE COMP_0068 1 100 0 255 ECU_ADDRESS 0xFFFFA018 /begin FUNCTION_LIST R208.10.dgn_ccadd_1_3_2 /end FUNCTION_LIST /end MEASUREMENT
/begin MEASUREMENT vMLGBFRNG_C#1_R#1 "Buffer of the 20 last" UBYTE COMP_0068 1 100 0 255 ECU_ADDRESS 0xFFFFA018 /begin FUNCTION_LIST R208.10.dgn_ccadd_1_3_2 /end FUNCTION_LIST /end MEASUREMENT
/begin MEASUREMENT vMLGBFRNG_C#2_R#1 "Buffer of the 20 last" UBYTE COMP_0068 1 100 0 255 ECU_ADDRESS 0xFFFFA019 /begin FUNCTION_LIST R208.10.dgn_ccadd_1_3_2 /end FUNCTION_LIST /end MEASUREMENT
/begin MEASUREMENT vMLGBFRNG_C#3_R#1 "Buffer of the 20 last" UBYTE COMP_0068 1 100 0 255 ECU_ADDRESS 0xFFFFA01A /begin FUNCTION_LIST R208.10.dgn_ccadd_1_3_2 /end FUNCTION_LIST /end MEASUREMENT
/begin MEASUREMENT vMLGBFRNG_C#4_R#1 "Buffer of the 20 last" UBYTE COMP_0068 1 100 0 255 ECU_ADDRESS 0xFFFFA01B /begin FUNCTION_LIST R208.10.dgn_ccadd_1_3_2 /end FUNCTION_LIST /end MEASUREMENT
/begin MEASUREMENT vMLGBFRNG_C#5_R#1 "Buffer of the 20 last" UBYTE COMP_0068 1 100 0 255 ECU_ADDRESS 0xFFFFA01C /begin FUNCTION_LIST R208.10.dgn_ccadd_1_3_2 /end FUNCTION_LIST /end MEASUREMENT
/begin MEASUREMENT vMLGBFRNG_C#6_R#1 "Buffer of the 20 last" UBYTE COMP_0068 1 100 0 255 ECU_ADDRESS 0xFFFFA01D /begin FUNCTION_LIST R208.10.dgn_ccadd_1_3_2 /end FUNCTION_LIST /end MEASUREMENT
/begin MEASUREMENT vMLGBFRNG_C#7_R#1 "Buffer of the 20 last" UBYTE COMP_0068 1 100 0 255 ECU_ADDRESS 0xFFFFA01E /begin FUNCTION_LIST R208.10.dgn_ccadd_1_3_2 /end FUNCTION_LIST /end MEASUREMENT
/begin MEASUREMENT vMLGBFRNG_C#8_R#1 "Buffer of the 20 last" UBYTE COMP_0068 1 100 0 255 ECU_ADDRESS 0xFFFFA01F /begin FUNCTION_LIST R208.10.dgn_ccadd_1_3_2 /end FUNCTION_LIST /end MEASUREMENT
/begin MEASUREMENT vMLGBFRNG_C#9_R#1 "Buffer of the 20 last" UBYTE COMP_0068 1 100 0 255 ECU_ADDRESS 0xFFFFA020 /begin FUNCTION_LIST R208.10.dgn_ccadd_1_3_2 /end FUNCTION_LIST /end MEASUREMENT
/begin MEASUREMENT vMLGBFRNG_C#10_R#1 "Buffer of the 20 last" UBYTE COMP_0068 1 100 0 255 ECU_ADDRESS 0xFFFFA021 /begin FUNCTION_LIST R208.10.dgn_ccadd_1_3_2 /end FUNCTION_LIST /end MEASUREMENT
/begin MEASUREMENT vMLGBFRNG_C#11_R#1 "Buffer of the 20 last" UBYTE COMP_0068 1 100 0 255 ECU_ADDRESS 0xFFFFA022 /begin FUNCTION_LIST R208.10.dgn_ccadd_1_3_2 /end FUNCTION_LIST /end MEASUREMENT
/begin MEASUREMENT vMLGBFRNG_C#12_R#1 "Buffer of the 20 last" UBYTE COMP_0068 1 100 0 255 ECU_ADDRESS 0xFFFFA023 /begin FUNCTION_LIST R208.10.dgn_ccadd_1_3_2 /end FUNCTION_LIST /end MEASUREMENT
/begin MEASUREMENT vMLGBFRNG_C#13_R#1 "Buffer of the 20 last" UBYTE COMP_0068 1 100 0 255 ECU_ADDRESS 0xFFFFA024 /begin FUNCTION_LIST R208.10.dgn_ccadd_1_3_2 /end FUNCTION_LIST /end MEASUREMENT
/begin MEASUREMENT vMLGBFRNG_C#14_R#1 "Buffer of the 20 last" UBYTE COMP_0068 1 100 0 255 ECU_ADDRESS 0xFFFFA025 /begin FUNCTION_LIST R208.10.dgn_ccadd_1_3_2 /end FUNCTION_LIST /end MEASUREMENT
/begin MEASUREMENT vMLGBFRNG_C#15_R#1 "Buffer of the 20 last" UBYTE COMP_0068 1 100 0 255 ECU_ADDRESS 0xFFFFA026 /begin FUNCTION_LIST R208.10.dgn_ccadd_1_3_2 /end FUNCTION_LIST /end MEASUREMENT
/begin MEASUREMENT vMLGBFRNG_C#16_R#1 "Buffer of the 20 last" UBYTE COMP_0068 1 100 0 255 ECU_ADDRESS 0xFFFFA027 /begin FUNCTION_LIST R208.10.dgn_ccadd_1_3_2 /end FUNCTION_LIST /end MEASUREMENT
/begin MEASUREMENT vMLGBFRNG_C#17_R#1 "Buffer of the 20 last" UBYTE COMP_0068 1 100 0 255 ECU_ADDRESS 0xFFFFA028 /begin FUNCTION_LIST R208.10.dgn_ccadd_1_3_2 /end FUNCTION_LIST /end MEASUREMENT
/begin MEASUREMENT vMLGBFRNG_C#18_R#1 "Buffer of the 20 last" UBYTE COMP_0068 1 100 0 255 ECU_ADDRESS 0xFFFFA029 /begin FUNCTION_LIST R208.10.dgn_ccadd_1_3_2 /end FUNCTION_LIST /end MEASUREMENT
/begin MEASUREMENT vMLGBFRNG_C#19_R#1 "Buffer of the 20 last" UBYTE COMP_0068 1 100 0 255 ECU_ADDRESS 0xFFFFA02A /begin FUNCTION_LIST R208.10.dgn_ccadd_1_3_2 /end FUNCTION_LIST /end MEASUREMENT
/begin MEASUREMENT vMLGBFRNG_C#20_R#1 "Buffer of the 20 last" UBYTE COMP_0068 1 100 0 255 ECU_ADDRESS 0xFFFFA02B /begin FUNCTION_LIST R208.10.dgn_ccadd_1_3_2 /end FUNCTION_LIST /end MEASUREMENT
/begin MEASUREMENT vMLGBFRNG_C#21_R#1 "Buffer of the 20 last" UBYTE COMP_0068 1 100 0 255 ECU_ADDRESS 0xFFFFA02C /begin FUNCTION_LIST R208.10.dgn_ccadd_1_3_2 /end FUNCTION_LIST /end MEASUREMENT
/begin MEASUREMENT vMLGBFRNG_C#22_R#1 "Buffer of the 20 last" UBYTE COMP_0068 1 100 0 255 ECU_ADDRESS 0xFFFFA02D /begin FUNCTION_LIST R208.10.dgn_ccadd_1_3_2 /end FUNCTION_LIST /end MEASUREMENT
/begin MEASUREMENT vMLGBFRNG_C#23_R#1 "Buffer of the 20 last" UBYTE COMP_0068 1 100 0 255 ECU_ADDRESS 0xFFFFA02E /begin FUNCTION_LIST R208.10.dgn_ccadd_1_3_2 /end FUNCTION_LIST /end MEASUREMENT
/begin MEASUREMENT vMLGBFRNG_C#24_R#1 "Buffer of the 20 last" UBYTE COMP_0068 1 100 0 255 ECU_ADDRESS 0xFFFFA02F /begin FUNCTION_LIST R208.10.dgn_ccadd_1_3_2 /end FUNCTION_LIST /end MEASUREMENT
/begin MEASUREMENT vMLGBFRNG_C#25_R#1 "Buffer of the 20 last" UBYTE COMP_0068 1 100 0 255 ECU_ADDRESS 0xFFFFA030 /begin FUNCTION_LIST R208.10.dgn_ccadd_1_3_2 /end FUNCTION_LIST /end MEASUREMENT
/begin MEASUREMENT vMLGBFRNG_C#26_R#1 "Buffer of the 20 last" UBYTE COMP_0068 1 100 0 255 ECU_ADDRESS 0xFFFFA031 /begin FUNCTION_LIST R208.10.dgn_ccadd_1_3_2 /end FUNCTION_LIST /end MEASUREMENT
/begin MEASUREMENT vMLGBFRNG_C#27_R#1 "Buffer of the 20 last" UBYTE COMP_0068 1 100 0 255 ECU_ADDRESS 0xFFFFA032 /begin FUNCTION_LIST R208.10.dgn_ccadd_1_3_2 /end FUNCTION_LIST /end MEASUREMENT
/begin MEASUREMENT vMLGBFRNG_C#28_R#1 "Buffer of the 20 last" UBYTE COMP_0068 1 100 0 255 ECU_ADDRESS 0xFFFFA033 /begin FUNCTION_LIST R208.10.dgn_ccadd_1_3_2 /end FUNCTION_LIST /end MEASUREMENT
/begin MEASUREMENT vMLGBFRNG_C#29_R#1 "Buffer of the 20 last" UBYTE COMP_0068 1 100 0 255 ECU_ADDRESS 0xFFFFA034 /begin FUNCTION_LIST R208.10.dgn_ccadd_1_3_2 /end FUNCTION_LIST /end MEASUREMENT
/begin MEASUREMENT vMLGBFRNG_C#30_R#1 "Buffer of the 20 last" UBYTE COMP_0068 1 100 0 255 ECU_ADDRESS 0xFFFFA035 /begin FUNCTION_LIST R208.10.dgn_ccadd_1_3_2 /end FUNCTION_LIST /end MEASUREMENT
/begin MEASUREMENT vMLGBFRNG_C#31_R#1 "Buffer of the 20 last" UBYTE COMP_0068 1 100 0 255 ECU_ADDRESS 0xFFFFA036 /begin FUNCTION_LIST R208.10.dgn_ccadd_1_3_2 /end FUNCTION_LIST /end MEASUREMENT
/begin MEASUREMENT vMLGBFRNG_C#32_R#1 "Buffer of the 20 last" UBYTE COMP_0068 1 100 0 255 ECU_ADDRESS 0xFFFFA037 /begin FUNCTION_LIST R208.10.dgn_ccadd_1_3_2 /end FUNCTION_LIST /end MEASUREMENT
/begin MEASUREMENT vMLGBFRNG_C#33_R#1 "Buffer of the 20 last" UBYTE COMP_0068 1 100 0 255 ECU_ADDRESS 0xFFFFA038 /begin FUNCTION_LIST R208.10.dgn_ccadd_1_3_2 /end FUNCTION_LIST /end MEASUREMENT
/begin MEASUREMENT vMLGBFRNG_C#34_R#1 "Buffer of the 20 last" UBYTE COMP_0068 1 100 0 255 ECU_ADDRESS 0xFFFFA039 /begin FUNCTION_LIST R208.10.dgn_ccadd_1_3_2 /end FUNCTION_LIST /end MEASUREMENT
/begin MEASUREMENT vMLGBFRNG_C#35_R#1 "Buffer of the 20 last" UBYTE COMP_0068 1 100 0 255 ECU_ADDRESS 0xFFFFA03A /begin FUNCTION_LIST R208.10.dgn_ccadd_1_3_2 /end FUNCTION_LIST /end MEASUREMENT
/begin MEASUREMENT vMLGBFRNG_C#36_R#1 "Buffer of the 20 last" UBYTE COMP_0068 1 100 0 255 ECU_ADDRESS 0xFFFFA03B /begin FUNCTION_LIST R208.10.dgn_ccadd_1_3_2 /end FUNCTION_LIST /end MEASUREMENT
/begin MEASUREMENT vMLGBFRNG_C#37_R#1 "Buffer of the 20 last" UBYTE COMP_0068 1 100 0 255 ECU_ADDRESS 0xFFFFA03C /begin FUNCTION_LIST R208.10.dgn_ccadd_1_3_2 /end FUNCTION_LIST /end MEASUREMENT
/begin MEASUREMENT vMLGBFRNG_C#38_R#1 "Buffer of the 20 last" UBYTE COMP_0068 1 100 0 255 ECU_ADDRESS 0xFFFFA03D /begin FUNCTION_LIST R208.10.dgn_ccadd_1_3_2 /end FUNCTION_LIST /end MEASUREMENT
/begin MEASUREMENT vMLGBFRNG_C#39_R#1 "Buffer of the 20 last" UBYTE COMP_0068 1 100 0 255 ECU_ADDRESS 0xFFFFA03E /begin FUNCTION_LIST R208.10.dgn_ccadd_1_3_2 /end FUNCTION_LIST /end MEASUREMENT
/begin MEASUREMENT vMLGBFRNG_C#40_R#1 "Buffer of the 20 last" UBYTE COMP_0068 1 100 0 255 ECU_ADDRESS 0xFFFFA03F /begin FUNCTION_LIST R208.10.dgn_ccadd_1_3_2 /end FUNCTION_LIST /end MEASUREMENT
/begin MEASUREMENT vMLGBFRNG_C#41_R#1 "Buffer of the 20 last" UBYTE COMP_0068 1 100 0 255 ECU_ADDRESS 0xFFFFA040 /begin FUNCTION_LIST R208.10.dgn_ccadd_1_3_2 /end FUNCTION_LIST /end MEASUREMENT
/begin MEASUREMENT vMLGBFRNG_C#42_R#1 "Buffer of the 20 last" UBYTE COMP_0068 1 100 0 255 ECU_ADDRESS 0xFFFFA041 /begin FUNCTION_LIST R208.10.dgn_ccadd_1_3_2 /end FUNCTION_LIST /end MEASUREMENT
/begin MEASUREMENT vMLGBFRNG_C#43_R#1 "Buffer of the 20 last" UBYTE COMP_0068 1 100 0 255 ECU_ADDRESS 0xFFFFA042 /begin FUNCTION_LIST R208.10.dgn_ccadd_1_3_2 /end FUNCTION_LIST /end MEASUREMENT
/begin MEASUREMENT vMLGBFRNG_C#44_R#1 "Buffer of the 20 last" UBYTE COMP_0068 1 100 0 255 ECU_ADDRESS 0xFFFFA043 /begin FUNCTION_LIST R208.10.dgn_ccadd_1_3_2 /end FUNCTION_LIST /end MEASUREMENT
/begin MEASUREMENT vMLGBFRNG_C#45_R#1 "Buffer of the 20 last" UBYTE COMP_0068 1 100 0 255 ECU_ADDRESS 0xFFFFA044 /begin FUNCTION_LIST R208.10.dgn_ccadd_1_3_2 /end FUNCTION_LIST /end MEASUREMENT
/begin MEASUREMENT vMLGBFRNG_C#46_R#1 "Buffer of the 20 last" UBYTE COMP_0068 1 100 0 255 ECU_ADDRESS 0xFFFFA045 /begin FUNCTION_LIST R208.10.dgn_ccadd_1_3_2 /end FUNCTION_LIST /end MEASUREMENT
/begin MEASUREMENT vMLGBFRNG_C#47_R#1 "Buffer of the 20 last" UBYTE COMP_0068 1 100 0 255 ECU_ADDRESS 0xFFFFA046 /begin FUNCTION_LIST R208.10.dgn_ccadd_1_3_2 /end FUNCTION_LIST /end MEASUREMENT
/begin MEASUREMENT vMLGBFRNG_C#48_R#1 "Buffer of the 20 last" UBYTE COMP_0068 1 100 0 255 ECU_ADDRESS 0xFFFFA047 /begin FUNCTION_LIST R208.10.dgn_ccadd_1_3_2 /end FUNCTION_LIST /end MEASUREMENT
/begin MEASUREMENT vMLGBFRNG_C#49_R#1 "Buffer of the 20 last" UBYTE COMP_0068 1 100 0 255 ECU_ADDRESS 0xFFFFA048 /begin FUNCTION_LIST R208.10.dgn_ccadd_1_3_2 /end FUNCTION_LIST /end MEASUREMENT
/begin MEASUREMENT vMLGBFRNG_C#50_R#1 "Buffer of the 20 last" UBYTE COMP_0068 1 100 0 255 ECU_ADDRESS 0xFFFFA049 /begin FUNCTION_LIST R208.10.dgn_ccadd_1_3_2 /end FUNCTION_LIST /end MEASUREMENT
/begin MEASUREMENT vMLGBFRNG_C#51_R#1 "Buffer of the 20 last" UBYTE COMP_0068 1 100 0 255 ECU_ADDRESS 0xFFFFA04A /begin FUNCTION_LIST R208.10.dgn_ccadd_1_3_2 /end FUNCTION_LIST /end MEASUREMENT
/begin MEASUREMENT vMLGBFRNG_C#52_R#1 "Buffer of the 20 last" UBYTE COMP_0068 1 100 0 255 ECU_ADDRESS 0xFFFFA04B /begin FUNCTION_LIST R208.10.dgn_ccadd_1_3_2 /end FUNCTION_LIST /end MEASUREMENT
/begin MEASUREMENT vMLGBFRNG_C#53_R#1 "Buffer of the 20 last" UBYTE COMP_0068 1 100 0 255 ECU_ADDRESS 0xFFFFA04C /begin FUNCTION_LIST R208.10.dgn_ccadd_1_3_2 /end FUNCTION_LIST /end MEASUREMENT
/begin MEASUREMENT vMLGBFRNG_C#54_R#1 "Buffer of the 20 last" UBYTE COMP_0068 1 100 0 255 ECU_ADDRESS 0xFFFFA04D /begin FUNCTION_LIST R208.10.dgn_ccadd_1_3_2 /end FUNCTION_LIST /end MEASUREMENT
/begin MEASUREMENT vMLGBFRNG_C#55_R#1 "Buffer of the 20 last" UBYTE COMP_0068 1 100 0 255 ECU_ADDRESS 0xFFFFA04E /begin FUNCTION_LIST R208.10.dgn_ccadd_1_3_2 /end FUNCTION_LIST /end MEASUREMENT
/begin MEASUREMENT vMLGBFRNG_C#56_R#1 "Buffer of the 20 last" UBYTE COMP_0068 1 100 0 255 ECU_ADDRESS 0xFFFFA04F /begin FUNCTION_LIST R208.10.dgn_ccadd_1_3_2 /end FUNCTION_LIST /end MEASUREMENT
/begin MEASUREMENT vMLGBFRNG_C#57_R#1 "Buffer of the 20 last" UBYTE COMP_0068 1 100 0 255 ECU_ADDRESS 0xFFFFA050 /begin FUNCTION_LIST R208.10.dgn_ccadd_1_3_2 /end FUNCTION_LIST /end MEASUREMENT
/begin MEASUREMENT vMLGBFRNG_C#58_R#1 "Buffer of the 20 last" UBYTE COMP_0068 1 100 0 255 ECU_ADDRESS 0xFFFFA051 /begin FUNCTION_LIST R208.10.dgn_ccadd_1_3_2 /end FUNCTION_LIST /end MEASUREMENT
/begin MEASUREMENT vMLGBFRNG_C#59_R#1 "Buffer of the 20 last" UBYTE COMP_0068 1 100 0 255 ECU_ADDRESS 0xFFFFA052 /begin FUNCTION_LIST R208.10.dgn_ccadd_1_3_2 /end FUNCTION_LIST /end MEASUREMENT
/begin MEASUREMENT vMLGBFRNG_C#60_R#1 "Buffer of the 20 last" UBYTE COMP_0068 1 100 0 255 ECU_ADDRESS 0xFFFFA053 /begin FUNCTION_LIST R208.10.dgn_ccadd_1_3_2 /end FUNCTION_LIST /end MEASUREMENT
/begin MEASUREMENT vMLGBFRNG_C#61_R#1 "Buffer of the 20 last" UBYTE COMP_0068 1 100 0 255 ECU_ADDRESS 0xFFFFA054 /begin FUNCTION_LIST R208.10.dgn_ccadd_1_3_2 /end FUNCTION_LIST /end MEASUREMENT
/begin MEASUREMENT vMLGBFRNG_C#62_R#1 "Buffer of the 20 last" UBYTE COMP_0068 1 100 0 255 ECU_ADDRESS 0xFFFFA055 /begin FUNCTION_LIST R208.10.dgn_ccadd_1_3_2 /end FUNCTION_LIST /end MEASUREMENT
/begin MEASUREMENT vMLGBFRNG_C#63_R#1 "Buffer of the 20 last" UBYTE COMP_0068 1 100 0 255 ECU_ADDRESS 0xFFFFA056 /begin FUNCTION_LIST R208.10.dgn_ccadd_1_3_2 /end FUNCTION_LIST /end MEASUREMENT
/begin MEASUREMENT vMLGBFRNG_C#64_R#1 "Buffer of the 20 last" UBYTE COMP_0068 1 100 0 255 ECU_ADDRESS 0xFFFFA057 /begin FUNCTION_LIST R208.10.dgn_ccadd_1_3_2 /end FUNCTION_LIST /end MEASUREMENT
/begin MEASUREMENT vMLGBFRNG_C#65_R#1 "Buffer of the 20 last" UBYTE COMP_0068 1 100 0 255 ECU_ADDRESS 0xFFFFA058 /begin FUNCTION_LIST R208.10.dgn_ccadd_1_3_2 /end FUNCTION_LIST /end MEASUREMENT
/begin MEASUREMENT vMLGBFRNG_C#66_R#1 "Buffer of the 20 last" UBYTE COMP_0068 1 100 0 255 ECU_ADDRESS 0xFFFFA059 /begin FUNCTION_LIST R208.10.dgn_ccadd_1_3_2 /end FUNCTION_LIST /end MEASUREMENT
/begin MEASUREMENT vMLGBFRNG_C#67_R#1 "Buffer of the 20 last" UBYTE COMP_0068 1 100 0 255 ECU_ADDRESS 0xFFFFA05A /begin FUNCTION_LIST R208.10.dgn_ccadd_1_3_2 /end FUNCTION_LIST /end MEASUREMENT
/begin MEASUREMENT vMLGBFRNG_C#68_R#1 "Buffer of the 20 last" UBYTE COMP_0068 1 100 0 255 ECU_ADDRESS 0xFFFFA05B /begin FUNCTION_LIST R208.10.dgn_ccadd_1_3_2 /end FUNCTION_LIST /end MEASUREMENT
/begin MEASUREMENT vMLGBFRNG_C#69_R#1 "Buffer of the 20 last" UBYTE COMP_0068 1 100 0 255 ECU_ADDRESS 0xFFFFA05C /begin FUNCTION_LIST R208.10.dgn_ccadd_1_3_2 /end FUNCTION_LIST /end MEASUREMENT
/begin MEASUREMENT vMLGBFRNG_C#70_R#1 "Buffer of the 20 last" UBYTE COMP_0068 1 100 0 255 ECU_ADDRESS 0xFFFFA05D /begin FUNCTION_LIST R208.10.dgn_ccadd_1_3_2 /end FUNCTION_LIST /end MEASUREMENT
/begin MEASUREMENT vMLGBFRNG_C#71_R#1 "Buffer of the 20 last" UBYTE COMP_0068 1 100 0 255 ECU_ADDRESS 0xFFFFA05E /begin FUNCTION_LIST R208.10.dgn_ccadd_1_3_2 /end FUNCTION_LIST /end MEASUREMENT
/begin MEASUREMENT vMLGBFRNG_C#72_R#1 "Buffer of the 20 last" UBYTE COMP_0068 1 100 0 255 ECU_ADDRESS 0xFFFFA05F /begin FUNCTION_LIST R208.10.dgn_ccadd_1_3_2 /end FUNCTION_LIST /end MEASUREMENT
/begin MEASUREMENT vMLGBFRNG_C#73_R#1 "Buffer of the 20 last" UBYTE COMP_0068 1 100 0 255 ECU_ADDRESS 0xFFFFA060 /begin FUNCTION_LIST R208.10.dgn_ccadd_1_3_2 /end FUNCTION_LIST /end MEASUREMENT
/begin MEASUREMENT vMLGBFRNG_C#74_R#1 "Buffer of the 20 last" UBYTE COMP_0068 1 100 0 255 ECU_ADDRESS 0xFFFFA061 /begin FUNCTION_LIST R208.10.dgn_ccadd_1_3_2 /end FUNCTION_LIST /end MEASUREMENT
/begin MEASUREMENT vMLGBFRNG_C#75_R#1 "Buffer of the 20 last" UBYTE COMP_0068 1 100 0 255 ECU_ADDRESS 0xFFFFA062 /begin FUNCTION_LIST R208.10.dgn_ccadd_1_3_2 /end FUNCTION_LIST /end MEASUREMENT
/begin MEASUREMENT vMLGBFRNG_C#76_R#1 "Buffer of the 20 last" UBYTE COMP_0068 1 100 0 255 ECU_ADDRESS 0xFFFFA063 /begin FUNCTION_LIST R208.10.dgn_ccadd_1_3_2 /end FUNCTION_LIST /end MEASUREMENT
/begin MEASUREMENT vMLGBFRNG_C#77_R#1 "Buffer of the 20 last" UBYTE COMP_0068 1 100 0 255 ECU_ADDRESS 0xFFFFA064 /begin FUNCTION_LIST R208.10.dgn_ccadd_1_3_2 /end FUNCTION_LIST /end MEASUREMENT
/begin MEASUREMENT vMLGBFRNG_C#78_R#1 "Buffer of the 20 last" UBYTE COMP_0068 1 100 0 255 ECU_ADDRESS 0xFFFFA065 /begin FUNCTION_LIST R208.10.dgn_ccadd_1_3_2 /end FUNCTION_LIST /end MEASUREMENT
/begin MEASUREMENT vMLGBFRNG_C#79_R#1 "Buffer of the 20 last" UBYTE COMP_0068 1 100 0 255 ECU_ADDRESS 0xFFFFA066 /begin FUNCTION_LIST R208.10.dgn_ccadd_1_3_2 /end FUNCTION_LIST /end MEASUREMENT
/begin MEASUREMENT vMLGBFRNG_C#80_R#1 "Buffer of the 20 last" UBYTE COMP_0068 1 100 0 255 ECU_ADDRESS 0xFFFFA067 /begin FUNCTION_LIST R208.10.dgn_ccadd_1_3_2 /end FUNCTION_LIST /end MEASUREMENT
/begin MEASUREMENT vMLGBFRNG_C#81_R#1 "Buffer of the 20 last" UBYTE COMP_0068 1 100 0 255 ECU_ADDRESS 0xFFFFA068 /begin FUNCTION_LIST R208.10.dgn_ccadd_1_3_2 /end FUNCTION_LIST /end MEASUREMENT
/begin MEASUREMENT vMLGBFRNG_C#82_R#1 "Buffer of the 20 last" UBYTE COMP_0068 1 100 0 255 ECU_ADDRESS 0xFFFFA069 /begin FUNCTION_LIST R208.10.dgn_ccadd_1_3_2 /end FUNCTION_LIST /end MEASUREMENT
/begin MEASUREMENT vMLGBFRNG_C#83_R#1 "Buffer of the 20 last" UBYTE COMP_0068 1 100 0 255 ECU_ADDRESS 0xFFFFA06A /begin FUNCTION_LIST R208.10.dgn_ccadd_1_3_2 /end FUNCTION_LIST /end MEASUREMENT
/begin MEASUREMENT vMLGBFRNG_C#84_R#1 "Buffer of the 20 last" UBYTE COMP_0068 1 100 0 255 ECU_ADDRESS 0xFFFFA06B /begin FUNCTION_LIST R208.10.dgn_ccadd_1_3_2 /end FUNCTION_LIST /end MEASUREMENT
/begin MEASUREMENT vMLGBFRNG_C#85_R#1 "Buffer of the 20 last" UBYTE COMP_0068 1 100 0 255 ECU_ADDRESS 0xFFFFA06C /begin FUNCTION_LIST R208.10.dgn_ccadd_1_3_2 /end FUNCTION_LIST /end MEASUREMENT
/begin MEASUREMENT vMLGBFRNG_C#86_R#1 "Buffer of the 20 last" UBYTE COMP_0068 1 100 0 255 ECU_ADDRESS 0xFFFFA06D /begin FUNCTION_LIST R208.10.dgn_ccadd_1_3_2 /end FUNCTION_LIST /end MEASUREMENT
/begin MEASUREMENT vMLGBFRNG_C#87_R#1 "Buffer of the 20 last" UBYTE COMP_0068 1 100 0 255 ECU_ADDRESS 0xFFFFA06E /begin FUNCTION_LIST R208.10.dgn_ccadd_1_3_2 /end FUNCTION_LIST /end MEASUREMENT
/begin MEASUREMENT vMLGBFRNG_C#88_R#1 "Buffer of the 20 last" UBYTE COMP_0068 1 100 0 255 ECU_ADDRESS 0xFFFFA06F /begin FUNCTION_LIST R208.10.dgn_ccadd_1_3_2 /end FUNCTION_LIST /end MEASUREMENT
/begin MEASUREMENT vMLGBFRNG_C#89_R#1 "Buffer of the 20 last" UBYTE COMP_0068 1 100 0 255 ECU_ADDRESS 0xFFFFA070 /begin FUNCTION_LIST R208.10.dgn_ccadd_1_3_2 /end FUNCTION_LIST /end MEASUREMENT
/begin MEASUREMENT vMLGBFRNG_C#90_R#1 "Buffer of the 20 last" UBYTE COMP_0068 1 100 0 255 ECU_ADDRESS 0xFFFFA071 /begin FUNCTION_LIST R208.10.dgn_ccadd_1_3_2 /end FUNCTION_LIST /end MEASUREMENT
/begin MEASUREMENT vMLGBFRNG_C#91_R#1 "Buffer of the 20 last" UBYTE COMP_0068 1 100 0 255 ECU_ADDRESS 0xFFFFA072 /begin FUNCTION_LIST R208.10.dgn_ccadd_1_3_2 /end FUNCTION_LIST /end MEASUREMENT
/begin MEASUREMENT vMLGBFRNG_C#92_R#1 "Buffer of the 20 last" UBYTE COMP_0068 1 100 0 255 ECU_ADDRESS 0xFFFFA073 /begin FUNCTION_LIST R208.10.dgn_ccadd_1_3_2 /end FUNCTION_LIST /end MEASUREMENT
/begin MEASUREMENT vMLGBFRNG_C#93_R#1 "Buffer of the 20 last" UBYTE COMP_0068 1 100 0 255 ECU_ADDRESS 0xFFFFA074 /begin FUNCTION_LIST R208.10.dgn_ccadd_1_3_2 /end FUNCTION_LIST /end MEASUREMENT
/begin MEASUREMENT vMLGBFRNG_C#94_R#1 "Buffer of the 20 last" UBYTE COMP_0068 1 100 0 255 ECU_ADDRESS 0xFFFFA075 /begin FUNCTION_LIST R208.10.dgn_ccadd_1_3_2 /end FUNCTION_LIST /end MEASUREMENT
/begin MEASUREMENT vMLGBFRNG_C#95_R#1 "Buffer of the 20 last" UBYTE COMP_0068 1 100 0 255 ECU_ADDRESS 0xFFFFA076 /begin FUNCTION_LIST R208.10.dgn_ccadd_1_3_2 /end FUNCTION_LIST /end MEASUREMENT
/begin MEASUREMENT vMLGBFRNG_C#96_R#1 "Buffer of the 20 last" UBYTE COMP_0068 1 100 0 255 ECU_ADDRESS 0xFFFFA077 /begin FUNCTION_LIST R208.10.dgn_ccadd_1_3_2 /end FUNCTION_LIST /end MEASUREMENT
/begin MEASUREMENT vMLGBFRNG_C#97_R#1 "Buffer of the 20 last" UBYTE COMP_0068 1 100 0 255 ECU_ADDRESS 0xFFFFA078 /begin FUNCTION_LIST R208.10.dgn_ccadd_1_3_2 /end FUNCTION_LIST /end MEASUREMENT
/begin MEASUREMENT vMLGBFRNG_C#98_R#1 "Buffer of the 20 last" UBYTE COMP_0068 1 100 0 255 ECU_ADDRESS 0xFFFFA079 /begin FUNCTION_LIST R208.10.dgn_ccadd_1_3_2 /end FUNCTION_LIST /end MEASUREMENT
/begin MEASUREMENT vMLGBFRNG_C#99_R#1 "Buffer of the 20 last" UBYTE COMP_0068 1 100 0 255 ECU_ADDRESS 0xFFFFA07A /begin FUNCTION_LIST R208.10.dgn_ccadd_1_3_2 /end FUNCTION_LIST /end MEASUREMENT
/begin MEASUREMENT vMLGBFRNG_C#100_R#1 "Buffer of the 20 last" UBYTE COMP_0068 1 100 0 255 ECU_ADDRESS 0xFFFFA07B /begin FUNCTION_LIST R208.10.dgn_ccadd_1_3_2 /end FUNCTION_LIST /end MEASUREMENT
/begin MEASUREMENT vNEGBPWM "Zoomed engine speed for correction applied in the calculation of torque consumed by AGB" UBYTE COMP_0609_S 1 100 600 1396.875 ECU_ADDRESS 0xFFFF15CF /begin FUNCTION_LIST R301.6.IscAirflow_1_4_5 /end FUNCTION_LIST /end MEASUREMENT
/begin MEASUREMENT vNEUTFT1 "Time constant for neutral switch filtering (on)" UBYTE COMP_0014 1 100 0 2550 ECU_ADDRESS 0xFFFF3008 /begin FUNCTION_LIST R301.6.IscAirflow_1_4_5 /end FUNCTION_LIST /end MEASUREMENT
/begin MEASUREMENT vNEUTFT2 "Time constant for neutral switch filtering (off)" UBYTE COMP_0014 1 100 0 2550 ECU_ADDRESS 0xFFFF3009 /begin FUNCTION_LIST R301.6.IscAirflow_1_4_5 /end FUNCTION_LIST /end MEASUREMENT
/begin MEASUREMENT vPGAINRN "P-Part gain" UWORD COMP_0438_S 1 100 0 1.999970916 ECU_ADDRESS 0xFFFF1666 /begin FUNCTION_LIST R301.19.ISC_PID_cont_1_0_2 /end FUNCTION_LIST /end MEASUREMENT
/begin MEASUREMENT vPGARN2 "P-gain 2" UWORD COMP_0438_S 1 100 0 1.999970916 ECU_ADDRESS 0xFFFF1668 /begin FUNCTION_LIST R301.19.ISC_PID_cont_1_0_2 /end FUNCTION_LIST /end MEASUREMENT
/begin MEASUREMENT vPGARN4 "P-gain 4" UWORD COMP_0438_S 1 100 0 1.999970916 ECU_ADDRESS 0xFFFF166A /begin FUNCTION_LIST R301.19.ISC_PID_cont_1_0_2 /end FUNCTION_LIST /end MEASUREMENT
/begin MEASUREMENT vQAGBCOR "ISC_Airflow_Correction_f (Torque consumed by AGB)" UWORD COMP_0499_S 1 100 0 6553.5 ECU_ADDRESS 0xFFFF30D0 /begin FUNCTION_LIST R301.6.IscAirflow_1_4_5 /end FUNCTION_LIST /end MEASUREMENT
/begin MEASUREMENT vQALTCOR "ISC_Airflow_Correction_f (Alternator load)" UWORD COMP_0499_S 1 100 0 6553.5 ECU_ADDRESS 0xFFFF30D6 /begin FUNCTION_LIST R301.6.IscAirflow_1_4_5 /end FUNCTION_LIST /end MEASUREMENT
/begin MEASUREMENT vQBCV1R "A negative pressure control air flow-quantity (for 6-8 cylinder)" UWORD COMP_0051 1 100 0 65535 ECU_ADDRESS 0xFFFF16BE /begin FUNCTION_LIST R301.6.IscAirflow_1_4_5 /end FUNCTION_LIST /end MEASUREMENT
/begin MEASUREMENT vQBCVR "Negative-pressure control part air flux" UWORD COMP_0051 1 100 0 65535 ECU_ADDRESS 0xFFFF16C0 /begin FUNCTION_LIST R301.6.IscAirflow_1_4_5 /end FUNCTION_LIST /end MEASUREMENT
/begin MEASUREMENT vRCSLFREF "Force request delivered by the control loop of the cruise control and speed limiter strategy" UWORD COMP_0374_S 1 100 -20000 111070 ECU_ADDRESS 0xFFFF30FA DISPLAY_IDENTIFIER Vxx_cru_sl_forc_ref /begin FUNCTION_LIST R208.6.SERVO_1_2_2 /end FUNCTION_LIST /end MEASUREMENT
/begin MEASUREMENT vRFFNGC "F.F. data buffer NG code (an edition for a DTC 3 bytes-ization)" ULONG COMP_0426 1 100 0 4294967295 ECU_ADDRESS 0xFFFFB7C0 /begin FUNCTION_LIST R301.13.FFDforDiagOnCAN_1_1_3 R901.1.Diag_on_can_app_1_6_2 /end FUNCTION_LIST /end MEASUREMENT
/begin MEASUREMENT vRNDF "QFBI D-Part air flux" SWORD COMP_0277 1 100 -32768 32767 ECU_ADDRESS 0xFFFF1756 /begin FUNCTION_LIST R301.19.ISC_PID_cont_1_0_2 /end FUNCTION_LIST /end MEASUREMENT
/begin MEASUREMENT vRNIF "F/B part air flux for vRNIF calculation" SLONG COMP_0458_S 1 100 -8192.0058720256 8192.0058682109 ECU_ADDRESS 0xFFFF1758 /begin FUNCTION_LIST R301.19.ISC_PID_cont_1_0_2 /end FUNCTION_LIST /end MEASUREMENT
/begin MEASUREMENT vRNPF "QFBI P-Part air flux" SWORD COMP_0277 1 100 -32768 32767 ECU_ADDRESS 0xFFFF175C /begin FUNCTION_LIST R301.19.ISC_PID_cont_1_0_2 /end FUNCTION_LIST /end MEASUREMENT
/begin MEASUREMENT vRTFDCCN "Driving force requested by Cruise Control" UWORD COMP_0374_S 1 100 -20000 111070 ECU_ADDRESS 0xFFFF31A4 DISPLAY_IDENTIFIER Vxx_cru_forc_sp_nom /begin FUNCTION_LIST R208.6.SERVO_1_2_2 R208.9.SAFETYX_1_3_2 /end FUNCTION_LIST /end MEASUREMENT
/begin MEASUREMENT vRTFDSLN "Driving force requested by Speed Limiter" UWORD COMP_0374_S 1 100 -20000 111070 ECU_ADDRESS 0xFFFF31AA DISPLAY_IDENTIFIER Vxx_sl_forc_sp_nom /begin FUNCTION_LIST R208.6.SERVO_1_2_2 R208.9.SAFETYX_1_3_2 /end FUNCTION_LIST /end MEASUREMENT
/begin MEASUREMENT vSPELIM "Speed limiter state" UBYTE COMP_0068 1 100 0 255 ECU_ADDRESS 0xFFFF31F4 DISPLAY_IDENTIFIER Vsx_sl_stt
 /begin FUNCTION_LIST R208.2.VSINT_1_1_2 R208.4.STFLW_1_2_2 R208.5.SETPT_1_1_0 R208.6.SERVO_1_2_2 R208.7.OUTMX_1_1_3 /end FUNCTION_LIST
/end MEASUREMENT
/begin MEASUREMENT vSVCLAREF "Acceleration command delivered by the control loop" SWORD COMP_0428_S 1 100 -62.5000448 62.49813745 ECU_ADDRESS 0xFFFF4242 DISPLAY_IDENTIFIER Vxx_cru_sl_svkl_acel_ref /begin FUNCTION_LIST R208.6.SERVO_1_2_2 /end FUNCTION_LIST /end MEASUREMENT
/begin MEASUREMENT vSVCLFORC "Force command delivered by the control loop" SWORD COMP_0030_S 1 100 -32768 32767 ECU_ADDRESS 0xFFFF3256 DISPLAY_IDENTIFIER Vxx_cru_sl_svkl_forc /begin FUNCTION_LIST R208.6.SERVO_1_2_2 /end FUNCTION_LIST /end MEASUREMENT
/begin MEASUREMENT vSVCLFORR "Total wheel force command delivered by the control loop" SWORD COMP_0030_S 1 100 -32768 32767 ECU_ADDRESS 0xFFFF3258 DISPLAY_IDENTIFIER Vxx_cru_sl_svkl_forc_ref /begin FUNCTION_LIST R208.6.SERVO_1_2_2 /end FUNCTION_LIST /end MEASUREMENT
/begin MEASUREMENT vSVCLICMN "Minimum value of the integral correction" SWORD COMP_0428_S 1 100 -62.5000448 62.49813745 ECU_ADDRESS 0xFFFF325A DISPLAY_IDENTIFIER Vxx_cru_sl_svkl_min_i_cor /begin FUNCTION_LIST R208.6.SERVO_1_2_2 /end FUNCTION_LIST /end MEASUREMENT
/begin MEASUREMENT vSVCLICMX "Maximum value of the integral correction" SWORD COMP_0428_S 1 100 -62.5000448 62.49813745 ECU_ADDRESS 0xFFFF325C DISPLAY_IDENTIFIER Vxx_cru_sl_svkl_max_i_cor /begin FUNCTION_LIST R208.6.SERVO_1_2_2 /end FUNCTION_LIST /end MEASUREMENT
/begin MEASUREMENT vSVCLICOR "Integral correction" SLONG COMP_0627_S 1 100 -62.4999345946624 62.4999345655586 ECU_ADDRESS 0xFFFF3260 DISPLAY_IDENTIFIER Vxx_cru_sl_svkl_i_cor /begin FUNCTION_LIST R208.6.SERVO_1_2_2 /end FUNCTION_LIST /end MEASUREMENT
/begin MEASUREMENT vSVCLIG "Integral gain" UWORD COMP_0427_S 1 100 0 1953.0937305 ECU_ADDRESS 0xFFFF3264 DISPLAY_IDENTIFIER Vxx_cru_sl_svkl_ig /begin FUNCTION_LIST R208.6.SERVO_1_2_2 /end FUNCTION_LIST /end MEASUREMENT
/begin MEASUREMENT vSVCLPCOR "Proportional correction" SWORD COMP_0428_S 1 100 -62.5000448 62.49813745 ECU_ADDRESS 0xFFFF3266 DISPLAY_IDENTIFIER Vxx_cru_sl_svkl_p_cor /begin FUNCTION_LIST R208.6.SERVO_1_2_2 /end FUNCTION_LIST /end MEASUREMENT
/begin MEASUREMENT vSVCLPG "Proportional gain" UWORD COMP_0628_S 1 100 0 124.99818225 ECU_ADDRESS 0xFFFF3268 DISPLAY_IDENTIFIER Vxx_cru_sl_svkl_pg /begin FUNCTION_LIST R208.6.SERVO_1_2_2 /end FUNCTION_LIST /end MEASUREMENT
/begin MEASUREMENT vTDRATPI2 "Target PI per cent" UWORD COMP_0063 1 100 0 255.99609375 ECU_ADDRESS 0xFFFF1834 /begin FUNCTION_LIST R301.1.Torque_realization_1_0_3 /end FUNCTION_LIST /end MEASUREMENT
/begin MEASUREMENT vTDRATPIA "Target PI per cent realized by ignition regard" UWORD COMP_0063 1 100 0 255.99609375 ECU_ADDRESS 0xFFFF1836 /begin FUNCTION_LIST R301.1.Torque_realization_1_0_3 /end FUNCTION_LIST /end MEASUREMENT
/begin MEASUREMENT vTDRATPIF "Final Target PI per cent" UWORD COMP_0063 1 100 0 255.99609375 ECU_ADDRESS 0xFFFF1838 /begin FUNCTION_LIST R301.1.Torque_realization_1_0_3 /end FUNCTION_LIST /end MEASUREMENT
/begin MEASUREMENT vTMDTD1 "Torque down time measurement 1" UWORD COMP_0014 1 100 0 655350 ECU_ADDRESS 0xFFFF1942 /begin FUNCTION_LIST R301.1.Torque_realization_1_0_3 /end FUNCTION_LIST /end MEASUREMENT
/begin MEASUREMENT vTMDTD2 "Torque down time measurement 2" UWORD COMP_0014 1 100 0 655350 ECU_ADDRESS 0xFFFF1944 /begin FUNCTION_LIST R301.1.Torque_realization_1_0_3 /end FUNCTION_LIST /end MEASUREMENT
/begin MEASUREMENT vTMRFCHK "Coolant temperature monitor time" UWORD COMP_0049 1 100 0 65535 ECU_ADDRESS 0xFFFF3372 /begin FUNCTION_LIST R301.3.FanAftPwl_1_0_4 /end FUNCTION_LIST /end MEASUREMENT
/begin MEASUREMENT vTMRFPV "Mailbox ventilation time" UWORD COMP_0049 1 100 0 65535 ECU_ADDRESS 0xFFFF3374 /begin FUNCTION_LIST R301.3.FanAftPwl_1_0_4 /end FUNCTION_LIST /end MEASUREMENT
/begin MEASUREMENT vTOGLCTR "Counter to detect toggling" UBYTE COMP_0068 1 100 0 255 ECU_ADDRESS 0xFFFF3F67 DISPLAY_IDENTIFIER Vxx_togl_ctr /begin FUNCTION_LIST R208.10.dgn_ccadd_1_3_2 /end FUNCTION_LIST /end MEASUREMENT
/begin MEASUREMENT vTOGLTMR "Timer to detect toggling" UBYTE COMP_0344_S 1 100 0 2.55 ECU_ADDRESS 0xFFFF3F68 DISPLAY_IDENTIFIER Vxx_togl_tmr /begin FUNCTION_LIST R208.10.dgn_ccadd_1_3_2 /end FUNCTION_LIST /end MEASUREMENT
/begin MEASUREMENT vTQCORDYN "Dynamic compensation for AGBCOR when AGB in drive but not drag" UWORD COMP_0473_S 1 100 0 6553.5 ECU_ADDRESS 0xFFFF33AC /begin FUNCTION_LIST R301.6.IscAirflow_1_4_5 /end FUNCTION_LIST /end MEASUREMENT
/begin MEASUREMENT vTQCRRDYN "Dynamic compensation for AGBCOR when AGB in reverse position" UWORD COMP_0473_S 1 100 0 6553.5 ECU_ADDRESS 0xFFFF33AE /begin FUNCTION_LIST R301.6.IscAirflow_1_4_5 /end FUNCTION_LIST /end MEASUREMENT
/begin MEASUREMENT vTQGBPWM "Gain to format the correction applied in the calculation of torque consumed by AGB" UBYTE COMP_0527_S 1 100 0 25.5 ECU_ADDRESS 0xFFFF33B2 /begin FUNCTION_LIST R301.6.IscAirflow_1_4_5 /end FUNCTION_LIST /end MEASUREMENT
/begin MEASUREMENT vTRETREL "Relational retard degree equivalent to target torque down per cent" UBYTE COMP_0017 1 100 0 255 ECU_ADDRESS 0xFFFF19B1 /begin FUNCTION_LIST R301.1.Torque_realization_1_0_3 /end FUNCTION_LIST /end MEASUREMENT
/begin MEASUREMENT vTRETRELA "Target regard relative value realized by ignition regard" UBYTE COMP_0017 1 100 0 255 ECU_ADDRESS 0xFFFF19B2 /begin FUNCTION_LIST R301.1.Torque_realization_1_0_3 /end FUNCTION_LIST /end MEASUREMENT
/begin MEASUREMENT vTTEP_C "After environment compensation, the final Slow torque order value" SWORD COMP_0228 1 100 -3276.8 3276.7 ECU_ADDRESS 0xFFFF19EC /begin FUNCTION_LIST R301.20.AmbientComp_1_0_2 /end FUNCTION_LIST /end MEASUREMENT
/begin MEASUREMENT vTWK2 "The water temperature for referring to the table2" UBYTE COMP_0640_S 1 100 -30 129.375 ECU_ADDRESS 0xFFFF89D8 /begin FUNCTION_LIST R301.2.MapBreakpoint_1_1_2 /end FUNCTION_LIST /end MEASUREMENT
/begin MEASUREMENT vTWKINT2 "At the time of the start for the table reference, coolant temperature 2" UBYTE COMP_0640_S 1 100 -30 129.375 ECU_ADDRESS 0xFFFF88AD /begin FUNCTION_LIST R301.6.IscAirflow_1_4_5 /end FUNCTION_LIST /end MEASUREMENT
/begin MEASUREMENT vVITCNMXN "Cruise control or speed limiter requested speed sent to the cluster by CAN for display" UBYTE COMP_0068 1 100 0 255 ECU_ADDRESS 0xFFFF3450 DISPLAY_IDENTIFIER Vxx_mux_cru_sl_vs_sp_nom /begin FUNCTION_LIST R208.7.OUTMX_1_1_3 R208.9.SAFETYX_1_3_2 /end FUNCTION_LIST /end MEASUREMENT
/begin MEASUREMENT vVITRVLV "Requested speed selected by the driver (Cruise Control or Speed Limiter)" UBYTE COMP_0068 1 100 0 255 ECU_ADDRESS 0xFFFF3451 DISPLAY_IDENTIFIER VITRVLV
 /begin FUNCTION_LIST R208.2.VSINT_1_1_2 R208.4.STFLW_1_2_2 R208.5.SETPT_1_1_0 R208.7.OUTMX_1_1_3 R208.8.DACAX_1_1_5 /end FUNCTION_LIST
/end MEASUREMENT
/begin MEASUREMENT vVITRVLVK "Requested speed selected by the driver (Cruise Control or Speed Limiter) in km/h" UBYTE COMP_0429 1 100 0 255 ECU_ADDRESS 0xFFFF425D DISPLAY_IDENTIFIER Vxx_cru_sl_driv_vs_sp_kmh
 /begin FUNCTION_LIST R208.5.SETPT_1_1_0 R208.6.SERVO_1_2_2 R901.1.Diag_on_can_app_1_6_2 /end FUNCTION_LIST
/end MEASUREMENT
/* COMPU_METHOD --------------------------------------------------------- */
/begin COMPU_METHOD COMP_0017 "1deg" RAT_FUNC "%8.2" "deg" COEFFS 0 1 0 0 0 1 /end COMPU_METHOD
/begin COMPU_METHOD COMP_0205_S "fixed axis Long" RAT_FUNC "%8.2" "Long" COEFFS 0 1 0 0 0 1 /end COMPU_METHOD
/begin COMPU_METHOD COMP_0068 "1-" RAT_FUNC "%8.2" "-" COEFFS 0 1 0 0 0 1 /end COMPU_METHOD
/begin COMPU_METHOD COMP_0429 "1km/h" RAT_FUNC "%8.2" "km/h" COEFFS 0 1 0 0 0 1 /end COMPU_METHOD
/begin COMPU_METHOD COMP_0045 "1/128-" RAT_FUNC "%8.4" "-" COEFFS 0 1 0 0 0 0.0078125 /end COMPU_METHOD
/begin COMPU_METHOD COMP_0020 "50rpm" RAT_FUNC "%8.2" "rpm" COEFFS 0 1 0 0 0 50 /end COMPU_METHOD
/begin COMPU_METHOD COMP_0002 "0.35deg" RAT_FUNC "%8.2" "deg" COEFFS 0 1 0 0 0 0.35 /end COMPU_METHOD
/begin COMPU_METHOD COMP_0014 "10ms" RAT_FUNC "%8.2" "ms" COEFFS 0 1 0 0 0 10 /end COMPU_METHOD
/begin COMPU_METHOD COMP_0008 "100ms" RAT_FUNC "%8.2" "ms" COEFFS 0 1 0 0 0 100 /end COMPU_METHOD
/begin COMPU_METHOD COMP_0009 "100/128%" RAT_FUNC "%8.2" "%" COEFFS 0 1 0 0 0 0.78125 /end COMPU_METHOD
/begin COMPU_METHOD COMP_0013 "1s" RAT_FUNC "%8.2" "s" COEFFS 0 1 0 0 0 1 /end COMPU_METHOD
/begin COMPU_METHOD COMP_0000 "25rpm" RAT_FUNC "%8.2" "rpm" COEFFS 0 1 0 0 0 25 /end COMPU_METHOD
/begin COMPU_METHOD COMP_0436 "0.1km/h" RAT_FUNC "%8.2" "km/h" COEFFS 0 1 0 0 0 0.1 /end COMPU_METHOD
/begin COMPU_METHOD COMP_0007 "2km/h" RAT_FUNC "%8.2" "km/h" COEFFS 0 1 0 0 0 2 /end COMPU_METHOD
/begin COMPU_METHOD COMP_0217 "1/16384-" RAT_FUNC "%8.6" "-" COEFFS 0 1 0 0 0 0.0000610352 /end COMPU_METHOD
/begin COMPU_METHOD COMP_0033 "80mV" RAT_FUNC "%8.2" "mV" COEFFS 0 1 0 0 0 80 /end COMPU_METHOD
/begin COMPU_METHOD COMP_0027 "1%" RAT_FUNC "%8.2" "%" COEFFS 0 1 0 0 0 1 /end COMPU_METHOD
/begin COMPU_METHOD COMP_0049 "1sec" RAT_FUNC "%8.2" "sec" COEFFS 0 1 0 0 0 1 /end COMPU_METHOD
/begin COMPU_METHOD COMP_0032 "1/256Å|" RAT_FUNC "%8.4" "Å|" COEFFS 0 1 0 0 0 0.00390625 /end COMPU_METHOD
/begin COMPU_METHOD COMP_0066 "1/64Å|" RAT_FUNC "%8.3" "Å|" COEFFS 0 1 0 0 0 0.015625 /end COMPU_METHOD
/begin COMPU_METHOD COMP_0063 "1/256-" RAT_FUNC "%8.4" "-" COEFFS 0 1 0 0 0 0.00390625 /end COMPU_METHOD
/begin COMPU_METHOD COMP_0130 "0.0275deg" RAT_FUNC "%8.3" "deg" COEFFS 0 1 0 0 0 0.0275 /end COMPU_METHOD
/begin COMPU_METHOD COMP_0344_S "0.01s" RAT_FUNC "%8.3" "s" COEFFS 0 1 0 0 0 0.01 /end COMPU_METHOD
/begin COMPU_METHOD COMP_0345_S "1/32Nm" RAT_FUNC "%8.3" "Nm" COEFFS 0 1 400 0 0 0.03125 /end COMPU_METHOD
/begin COMPU_METHOD COMP_0361_S "0.001-" RAT_FUNC "%8.4" "-" COEFFS 0 1 0 0 0 0.001 /end COMPU_METHOD
/begin COMPU_METHOD COMP_0183 "20ms" RAT_FUNC "%8.2" "ms" COEFFS 0 1 0 0 0 20 /end COMPU_METHOD
/begin COMPU_METHOD COMP_0365_S "10W" RAT_FUNC "%8.2" "W" COEFFS 0 1 0 0 0 10 /end COMPU_METHOD
/begin COMPU_METHOD COMP_0044 "1/128Å|" RAT_FUNC "%8.4" "Å|" COEFFS 0 1 0 0 0 0.0078125 /end COMPU_METHOD
/begin COMPU_METHOD COMP_0016 "1count" RAT_FUNC "%8.2" "count" COEFFS 0 1 0 0 0 1 /end COMPU_METHOD
/begin COMPU_METHOD COMP_0371_S "0.04s" RAT_FUNC "%8.3" "s" COEFFS 0 1 0 0 0 0.04 /end COMPU_METHOD
/begin COMPU_METHOD COMP_0055 "4deg" RAT_FUNC "%8.2" "deg" COEFFS 0 1 0 0 0 4 /end COMPU_METHOD
/begin COMPU_METHOD COMP_0373 "1/100-" RAT_FUNC "%8.3" "-" COEFFS 0 1 0 0 0 0.01 /end COMPU_METHOD
/begin COMPU_METHOD COMP_0373_S "2N/s" RAT_FUNC "%8.2" "N/s" COEFFS 0 1 0 0 0 2 /end COMPU_METHOD
/begin COMPU_METHOD COMP_0374_S "2N" RAT_FUNC "%8.2" "N" COEFFS 0 1 20000 0 0 2 /end COMPU_METHOD
/begin COMPU_METHOD COMP_0105 "0.1s" RAT_FUNC "%8.2" "s" COEFFS 0 1 0 0 0 0.1 /end COMPU_METHOD
/begin COMPU_METHOD COMP_0050 "5/64mV" RAT_FUNC "%8.3" "mV" COEFFS 0 1 0 0 0 0.078125 /end COMPU_METHOD
/begin COMPU_METHOD COMP_0035 "X-50Åé" RAT_FUNC "%8.2" "Åé" COEFFS 0 1 50 0 0 1 /end COMPU_METHOD
/begin COMPU_METHOD COMP_0375_S "0.01km/h" RAT_FUNC "%8.3" "km/h" COEFFS 0 1 0 0 0 0.01 /end COMPU_METHOD
/begin COMPU_METHOD COMP_0377_S "0.12s" RAT_FUNC "%8.2" "s" COEFFS 0 1 0 0 0 0.12 /end COMPU_METHOD
/begin COMPU_METHOD COMP_0378_S "0.0011/s" RAT_FUNC "%8.4" "1/s" COEFFS 0 1 0 0 0 0.001 /end COMPU_METHOD
/begin COMPU_METHOD COMP_0379_S "0.025km/h/s" RAT_FUNC "%8.3" "km/h/s" COEFFS 0 1 0 0 0 0.025 /end COMPU_METHOD
/begin COMPU_METHOD COMP_0381_S "0.1mph" RAT_FUNC "%8.2" "mph" COEFFS 0 1 0 0 0 0.1 /end COMPU_METHOD
/begin COMPU_METHOD COMP_0382_S "1mph" RAT_FUNC "%8.2" "mph" COEFFS 0 1 0 0 0 1 /end COMPU_METHOD
/begin COMPU_METHOD COMP_0228 "0.1Nm" RAT_FUNC "%8.2" "Nm" COEFFS 0 1 0 0 0 0.1 /end COMPU_METHOD
/begin COMPU_METHOD COMP_0387_S "0.1m/s^2" RAT_FUNC "%8.2" "m/s^2" COEFFS 0 1 0 0 0 0.1 /end COMPU_METHOD
/begin COMPU_METHOD COMP_0097 "1/64L/min" RAT_FUNC "%8.3" "L/min" COEFFS 0 1 0 0 0 0.015625 /end COMPU_METHOD
/begin COMPU_METHOD COMP_0051 "1L/min" RAT_FUNC "%8.2" "L/min" COEFFS 0 1 0 0 0 1 /end COMPU_METHOD
/begin COMPU_METHOD COMP_0393_S "4/256L/min/10" RAT_FUNC "%8.3" "L/min/10" COEFFS 0 1 0 0 0 0.015625 /end COMPU_METHOD
/begin COMPU_METHOD COMP_0111 "256/xÅ|" RAT_FUNC "%8.2" "Å|" COEFFS 0 0 256 0 1 0 /end COMPU_METHOD
/begin COMPU_METHOD COMP_0401_S "0.2km/h" RAT_FUNC "%8.2" "km/h" COEFFS 0 1 0 0 0 0.2 /end COMPU_METHOD
/begin COMPU_METHOD COMP_0456 "1/(256Å~128)-" RAT_FUNC "%8.6" "-" COEFFS 0 1 0 0 0 0.0000305176 /end COMPU_METHOD
/begin COMPU_METHOD COMP_0256 "64/128degCA" RAT_FUNC "%8.2" "degCA" COEFFS 0 1 64 0 0 0.5 /end COMPU_METHOD
/begin COMPU_METHOD COMP_0277 "1L/min" RAT_FUNC "%8.2" "L/min" COEFFS 0 1 0 0 0 1 /end COMPU_METHOD
/begin COMPU_METHOD COMP_0409_S "0.1count/ms" RAT_FUNC "%8.2" "count/ms" COEFFS 0 1 0 0 0 0.1 /end COMPU_METHOD
/begin COMPU_METHOD COMP_0064 "1.5625rpm" RAT_FUNC "%8.2" "rpm" COEFFS 0 1 0 0 0 1.5625 /end COMPU_METHOD
/begin COMPU_METHOD COMP_0420_S "0.1Bar" RAT_FUNC "%8.2" "Bar" COEFFS 0 1 0 0 0 0.1 /end COMPU_METHOD
/begin COMPU_METHOD COMP_0421_S "1degC" RAT_FUNC "%8.2" "degC" COEFFS 0 1 0 0 0 1 /end COMPU_METHOD
/begin COMPU_METHOD COMP_0423_S "1/2621441/262144" RAT_FUNC "%8.6" "1/262144" COEFFS 0 1 0 0 0 0.0000038147 /end COMPU_METHOD
/begin COMPU_METHOD COMP_0426_S "10us" RAT_FUNC "%8.2" "us" COEFFS 0 1 0 0 0 10 /end COMPU_METHOD
/begin COMPU_METHOD COMP_0073 "3.2us" RAT_FUNC "%8.2" "us" COEFFS 0 1 0 0 0 3.2 /end COMPU_METHOD
/begin COMPU_METHOD COMP_0427_S "10^6/2^251/s^2" RAT_FUNC "%8.3" "1/s^2" COEFFS 0 1 0 0 0 0.0298023 /end COMPU_METHOD
/begin COMPU_METHOD COMP_0428_S "10^3/2^19km/h/s" RAT_FUNC "%8.4" "km/h/s" COEFFS 0 1 0 0 0 0.00190735 /end COMPU_METHOD
/begin COMPU_METHOD COMP_0430_S "X-50degC" RAT_FUNC "%8.2" "degC" COEFFS 0 1 50 0 0 1 /end COMPU_METHOD
/begin COMPU_METHOD COMP_0263 "1-" RAT_FUNC "%8.2" "-" COEFFS 0 1 0 0 0 1 /end COMPU_METHOD
/begin COMPU_METHOD COMP_0438_S "1/32768L/min/12" RAT_FUNC "%8.6" "L/min/12" COEFFS 0 1 0 0 0 0.0000305176 /end COMPU_METHOD
/begin COMPU_METHOD COMP_0442_S "10^3/2^191/s^2" RAT_FUNC "%8.4" "1/s^2" COEFFS 0 1 0 0 0 0.00190735 /end COMPU_METHOD
/begin COMPU_METHOD COMP_0276 "4L/min" RAT_FUNC "%8.2" "L/min" COEFFS 0 1 0 0 0 4 /end COMPU_METHOD
/begin COMPU_METHOD COMP_0457_S "1L/min/10" RAT_FUNC "%8.2" "L/min/10" COEFFS 0 1 0 0 0 1 /end COMPU_METHOD
/begin COMPU_METHOD COMP_0458_S "1/262144L/min" RAT_FUNC "%8.6" "L/min" COEFFS 0 1 0 0 0 0.0000038147 /end COMPU_METHOD
/begin COMPU_METHOD COMP_0030_S "NN" RAT_FUNC "%8.2" "N" COEFFS 0 1 0 0 0 1 /end COMPU_METHOD
/begin COMPU_METHOD COMP_0388 "0.1-" RAT_FUNC "%8.2" "-" COEFFS 0 1 0 0 0 0.1 /end COMPU_METHOD
/begin COMPU_METHOD COMP_0464_S "1km/h" RAT_FUNC "%8.2" "km/h" COEFFS 0 1 0 0 0 1 /end COMPU_METHOD
/begin COMPU_METHOD COMP_0293 "2L/min" RAT_FUNC "%8.2" "L/min" COEFFS 0 1 0 0 0 2 /end COMPU_METHOD
/begin COMPU_METHOD COMP_0470_S "1/32Nm" RAT_FUNC "%8.3" "Nm" COEFFS 0 1 0 0 0 0.03125 /end COMPU_METHOD
/begin COMPU_METHOD COMP_0473_S "0.1L/min" RAT_FUNC "%8.2" "L/min" COEFFS 0 1 0 0 0 0.1 /end COMPU_METHOD
/begin COMPU_METHOD COMP_0475_S "10kg" RAT_FUNC "%8.2" "kg" COEFFS 0 1 -450 0 0 10 /end COMPU_METHOD
/begin COMPU_METHOD COMP_0053 "1ms" RAT_FUNC "%8.2" "ms" COEFFS 0 1 0 0 0 1 /end COMPU_METHOD
/begin COMPU_METHOD COMP_0276_S "fixed axis -" RAT_FUNC "%8.2" "-" COEFFS 0 1 -1 0 0 1 /end COMPU_METHOD
/begin COMPU_METHOD COMP_0271_S "fixed axis rpm" RAT_FUNC "%8.2" "rpm" COEFFS 0 1 0 0 0 400 /end COMPU_METHOD
/begin COMPU_METHOD COMP_0491_S "1mbar" RAT_FUNC "%8.2" "mbar" COEFFS 0 1 0 0 0 1 /end COMPU_METHOD
/begin COMPU_METHOD COMP_0492_S "25N" RAT_FUNC "%8.2" "N" COEFFS 0 1 0 0 0 25 /end COMPU_METHOD
/begin COMPU_METHOD COMP_0495_S "fixed axis Åé" RAT_FUNC "%8.2" "Åé" COEFFS 0 1 30 0 0 10 /end COMPU_METHOD
/begin COMPU_METHOD COMP_0497_S "1/256deg" RAT_FUNC "%8.4" "deg" COEFFS 0 1 128 0 0 0.00390625 /end COMPU_METHOD
/begin COMPU_METHOD COMP_0499_S "0.1L/m" RAT_FUNC "%8.2" "L/m" COEFFS 0 1 0 0 0 0.1 /end COMPU_METHOD
/begin COMPU_METHOD COMP_0500_S "0.625/256X-40degC" RAT_FUNC "%8.4" "degC" COEFFS 0 1 40 0 0 0.002441406 /end COMPU_METHOD
/begin COMPU_METHOD COMP_0511_S "0.625deg" RAT_FUNC "%8.2" "deg" COEFFS 0 1 40 0 0 0.625 /end COMPU_METHOD
/begin COMPU_METHOD COMP_0515_S "0.625degC" RAT_FUNC "%8.2" "degC" COEFFS 0 1 40 0 0 0.625 /end COMPU_METHOD
/begin COMPU_METHOD COMP_0519_S "100W" RAT_FUNC "%8.2" "W" COEFFS 0 1 0 0 0 100 /end COMPU_METHOD
/begin COMPU_METHOD COMP_0524_S "1L/min" RAT_FUNC "%8.2" "L/min" COEFFS 0 1 32768 0 0 1 /end COMPU_METHOD
/begin COMPU_METHOD COMP_0476 "12.5/64rpm" RAT_FUNC "%8.2" "rpm" COEFFS 0 1 0 0 0 0.1953125 /end COMPU_METHOD
/begin COMPU_METHOD COMP_0527_S "0.1L/(Nm*m)" RAT_FUNC "%8.2" "L/(Nm*m)" COEFFS 0 1 0 0 0 0.1 /end COMPU_METHOD
/begin COMPU_METHOD COMP_0528_S "fixed axis rpm" RAT_FUNC "%8.2" "rpm" COEFFS 0 1 -600 0 0 100 /end COMPU_METHOD
/begin COMPU_METHOD COMP_0283 "1flag" RAT_FUNC "%8.2" "flag" COEFFS 0 1 0 0 0 1 /end COMPU_METHOD
/begin COMPU_METHOD COMP_0202_S "100ms100ms" RAT_FUNC "%8.2" "100ms" COEFFS 0 1 0 0 0 1 /end COMPU_METHOD
/begin COMPU_METHOD COMP_0203_S "10ms10ms" RAT_FUNC "%8.2" "10ms" COEFFS 0 1 0 0 0 1 /end COMPU_METHOD
/begin COMPU_METHOD COMP_0532_S "km/h/skm/h/s" RAT_FUNC "%8.3" "km/h/s" COEFFS 0 1 0 0 0 0.01 /end COMPU_METHOD
/begin COMPU_METHOD COMP_0426 "Å|code" RAT_FUNC "%8.2" "code" COEFFS 0 1 0 0 0 1 /end COMPU_METHOD
/begin COMPU_METHOD COMP_0537_S "VV" RAT_FUNC "%8.4" "V" COEFFS 0 1 0 0 0 0.001 /end COMPU_METHOD
/begin COMPU_METHOD COMP_0545_S "rpmrpm" RAT_FUNC "%8.2" "rpm" COEFFS 0 1 0 0 0 0.1953125 /end COMPU_METHOD
/begin COMPU_METHOD COMP_0561_S "m/s2m/s2" RAT_FUNC "%8.2" "m/s2" COEFFS 0 1 12 0 0 0.1 /end COMPU_METHOD
/begin COMPU_METHOD COMP_0573_S "ÅéÅé" RAT_FUNC "%8.2" "Åé" COEFFS 0 1 273 0 0 0.1 /end COMPU_METHOD
/begin COMPU_METHOD COMP_0575_S "%%" RAT_FUNC "%8.3" "%" COEFFS 0 1 327.67 0 0 0.01 /end COMPU_METHOD
/begin COMPU_METHOD COMP_0578_S "É sÉ s" RAT_FUNC "%8.2" "É s" COEFFS 0 1 0 0 0 4 /end COMPU_METHOD
/begin COMPU_METHOD COMP_0595_S "ÅãCrSÅãCrS" RAT_FUNC "%8.3" "ÅãCrS" COEFFS 0 1 655.34 0 0 0.02 /end COMPU_METHOD
/begin COMPU_METHOD COMP_0444 "1/256L/min" RAT_FUNC "%8.4" "L/min" COEFFS 0 1 0 0 0 0.00390625 /end COMPU_METHOD
/begin COMPU_METHOD COMP_0609_S "rpmrpm" RAT_FUNC "%8.2" "rpm" COEFFS 0 1 -600 0 0 3.125 /end COMPU_METHOD
/begin COMPU_METHOD COMP_0627_S "km/h/skm/h/s" RAT_FUNC "%8.6" "km/h/s" COEFFS 0 1 0 0 0 0.0000000291038 /end COMPU_METHOD
/begin COMPU_METHOD COMP_0628_S "1/s1/s" RAT_FUNC "%8.4" "1/s" COEFFS 0 1 0 0 0 0.00190735 /end COMPU_METHOD
/begin COMPU_METHOD COMP_0640_S "ÅéÅé" RAT_FUNC "%8.2" "Åé" COEFFS 0 1 30 0 0 0.625 /end COMPU_METHOD
/* RECORD_LAYOUT ------------------------------------------------------ */
/begin RECORD_LAYOUT REC_UBYTE_C FNC_VALUES 1 UBYTE COLUMN_DIR DIRECT /end RECORD_LAYOUT
/begin RECORD_LAYOUT REC_UWORD_C FNC_VALUES 1 UWORD COLUMN_DIR DIRECT /end RECORD_LAYOUT
/begin RECORD_LAYOUT REC_SWORD_C FNC_VALUES 1 SWORD COLUMN_DIR DIRECT /end RECORD_LAYOUT
/begin RECORD_LAYOUT REC_SBYTE_C FNC_VALUES 1 SBYTE COLUMN_DIR DIRECT /end RECORD_LAYOUT
/begin RECORD_LAYOUT REC_ULONG_C FNC_VALUES 1 ULONG COLUMN_DIR DIRECT /end RECORD_LAYOUT
/begin RECORD_LAYOUT REC_SLONG_C FNC_VALUES 1 SLONG COLUMN_DIR DIRECT /end RECORD_LAYOUT
/begin RECORD_LAYOUT REC_AXIS_UBYTE AXIS_PTS_X 1 UBYTE INDEX_INCR DIRECT /end RECORD_LAYOUT
/begin RECORD_LAYOUT REC_AXIS_UWORD AXIS_PTS_X 1 UWORD INDEX_INCR DIRECT /end RECORD_LAYOUT
/end MODULE
/end PROJECT
