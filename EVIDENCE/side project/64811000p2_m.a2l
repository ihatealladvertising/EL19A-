ASAP2_VERSION 1 3_BETA
/begin PROJECT TK_X91_EUR_VC ""
/begin HEADER "" /* key HEADER ++ "comment" Ç… Par.scomment */ PROJECT_NO TK_X91_EUR_VC /* key PROJECT_NO ++ project number Ç… car_eng_desti_lot */ VERSION "7V4YHZEB2" /* key VERSION ++ version number Ç… mProgver */ /end HEADER
/begin MODULE DIM ""
/begin MOD_COMMON "" DEPOSIT ABSOLUTE BYTE_ORDER MSB_FIRST /* ﬁ≤ƒµ∞¿ﬁ∞Ç™ÿÃﬂ⁄∞ΩÇ≥ÇÍÇÈ */ /end MOD_COMMON
/begin FUNCTION KF7-301.25M[5] "ETC throttle-related items (main calculation section)" /end FUNCTION
/begin FUNCTION KF7-301.25P[5] "ETC throttle-related items (sub calculation section)" /end FUNCTION
/begin FUNCTION KF7-301.28[2] "Power steering oil puressure sensor voltage" /end FUNCTION
/begin FUNCTION KF7-301.30[2] "ETC-related input" /end FUNCTION
/begin FUNCTION KF7-301.31[1] "Abnormal analog signal cut-off" /end FUNCTION
/begin FUNCTION KF7-302.2M[3] "Switch input status  (main calculation section)" /end FUNCTION
/begin FUNCTION KF7-302.3M[1] "Ignition switch (main calculation section)" /end FUNCTION
/begin FUNCTION KF7-302.4MA[13] "ON-OFF judgment control of the Starter Switch signal flag #STSW" /end FUNCTION
/begin FUNCTION KF7-302.5M[10] "Neutral switch (main calculation section)" /end FUNCTION
/begin FUNCTION KF7-302.6A[4] "Air conditioner switch" /end FUNCTION
/begin FUNCTION KF7-302.13[1] "AT communication line signal" /end FUNCTION
/begin FUNCTION KF7-302.19M[N] "Brake switch (main calculation section)" /end FUNCTION
/begin FUNCTION KF7-303.1[14] "Vehicle speed" /end FUNCTION
/begin FUNCTION KF7-303.5A[9] "Input of hall IC crank angle sensor(for C-VTC) signal" /end FUNCTION
/begin FUNCTION KF7-303.6M[5] "Calculation of engine speed (Main calculation section)" /end FUNCTION
/begin FUNCTION KF7-303.6P[1] "Calculation of engine speed (redundant calculation part)" /end FUNCTION
/begin FUNCTION KF7-303.7B[N] "Detection of VTC position angle (POS10 crank angle sensor(for C-VTC))" /end FUNCTION
/begin FUNCTION KF7-304.1B[5] "Intake air quantity (for Hitachi slot-in type air flow meter)" /end FUNCTION
/begin FUNCTION KF7-304.2[21] "Pulse width equivalent to cylinder air quantity/ TP" /end FUNCTION
/begin FUNCTION KF7-304.3[2] "Prohibition of cylinder-specific SOFIS control of at idle" /end FUNCTION
/begin FUNCTION KF7-304.4B[2] "Engine stall judgment (other than magnetic crank sensor )" /end FUNCTION
/begin FUNCTION KF7-304.5[N] "TOP judgment " /end FUNCTION
/begin FUNCTION KF7-304.7[1] "Power off at VB16.5 [V] or more" /end FUNCTION
/begin FUNCTION KF7-304.9[2] "Calculation of TVO-N flow/ QH0" /end FUNCTION
/begin FUNCTION KF7-304.10[1] "Delta TVO calculation and acceleration detection" /end FUNCTION
/begin FUNCTION KF7-304.13[N] "Calculation of total flow passage area" /end FUNCTION
/begin FUNCTION KF7-305.1[7] "Backup RAM checking" /end FUNCTION
/begin FUNCTION KF7-305.2[1] "P-RUN signal" /end FUNCTION
/begin FUNCTION KF7-305.4AM[10] "Learning value EEP-ROM process (main CPU)" /end FUNCTION
/begin FUNCTION KF7-305.4BM[31] "EEP-ROM data allocation chart (main CPU)" /end FUNCTION
/begin FUNCTION KF7-305.5[3] "Self shut-off control" /end FUNCTION
/begin FUNCTION KF7-305.6[1] "Initialization " /end FUNCTION
/begin FUNCTION KF7-305.7[6] "Fuel consumption rate monitor output control " /end FUNCTION
/begin FUNCTION KF7-305.9[3] "TACHO output" /end FUNCTION
/begin FUNCTION KF7-305.14[2] "BACK-UP RAM-EEPROM control" /end FUNCTION
/begin CHARACTERISTIC mADVINT "Ignition advance initial value" VALUE 0x000081F8 REC_UBYTE_C 0 COMP_0019 0 255
 /begin FUNCTION_LIST KF7-303.5A[9] KF7-304.5[N] KF7-320A.4[6] KF7-320A.5[N] KF7-320A.10[14] KF7-320A.15[4] KF7-320A.19[7] KF7-390.3A[15] KF7-450.9A[5] KF7-450.50[10] KF7-460.1[6] KF7-580.1[8] R301.13.FFDforDiagOnCAN_1_1_3 R301.23.ADV_calculation_1_1_2 R901.1.Diag_on_can_app_1_6_2 /end FUNCTION_LIST
/end CHARACTERISTIC
/begin CHARACTERISTIC mADVVSPH "fFADVVSP judgement vehicle speed (value on the upside of the hysteresis)" VALUE 0x00008203 REC_UBYTE_C 0 COMP_0007 0 510 /begin FUNCTION_LIST KF7-303.1[14] /end FUNCTION_LIST /end CHARACTERISTIC
/begin CHARACTERISTIC mADVVSPL "fFADVVSP judgement vehicle speed (value under the hysteresis)" VALUE 0x00008204 REC_UBYTE_C 0 COMP_0007 0 510 /begin FUNCTION_LIST KF7-303.1[14] /end FUNCTION_LIST /end CHARACTERISTIC
/begin CHARACTERISTIC mAFLEA "At the time of the low frequency acceleration, compensation rate" VALUE 0x00008220 REC_UBYTE_C 0 COMP_0066 0 3.984375 /begin FUNCTION_LIST KF7-304.1B[5] /end FUNCTION_LIST /end CHARACTERISTIC
/begin CHARACTERISTIC mAFLEG "AFM low frequency delay gain" VALUE 0x00008221 REC_UBYTE_C 0 COMP_0132 0 0.498046875 /begin FUNCTION_LIST KF7-304.1B[5] /end FUNCTION_LIST /end CHARACTERISTIC
/begin CHARACTERISTIC mAFLETC "AFM time constant coefficient (for the low frequency)" VALUE 0x00008222 REC_UBYTE_C 0 COMP_0032 0 0.99609375 /begin FUNCTION_LIST KF7-304.1B[5] /end FUNCTION_LIST /end CHARACTERISTIC
/begin CHARACTERISTIC mAFMTC "AFM time constant coefficient (for the high frequency)" VALUE 0x00008227 REC_UBYTE_C 0 COMP_0015 0 31.875 /begin FUNCTION_LIST KF7-304.1B[5] /end FUNCTION_LIST /end CHARACTERISTIC
/begin CHARACTERISTIC mAPINTS "Accelerator pedal full-close position learning initial value" VALUE 0x00009024 REC_UWORD_C 0 COMP_0023 0 327675 /begin FUNCTION_LIST KF7-305.1[7] /end FUNCTION_LIST /end CHARACTERISTIC
/begin CHARACTERISTIC mAPOSPN "Accelerator open-degree (for full-close position per cent deg conversion)" VALUE 0x0000904E REC_UWORD_C 0 COMP_0005 0 7208.85
 /begin FUNCTION_LIST KF7-301.25M[5] KF7-301.25P[5] KF7-340.5[4] KF7-340.5P[2] KF7-360.7M[9] KF7-385.3[4] R000.1.RS_Integ_1_10_2 /end FUNCTION_LIST
/end CHARACTERISTIC
/begin CHARACTERISTIC mAVTQHH "Taking in advance compensation judgement value is high." VALUE 0x000082A2 REC_UBYTE_C 0 COMP_0032 0 0.99609375 /begin FUNCTION_LIST KF7-304.2[21] /end FUNCTION_LIST /end CHARACTERISTIC
/begin CHARACTERISTIC mAVTQHL "Taking in advance compensation judgement value è¨" VALUE 0x000082A3 REC_UBYTE_C 0 COMP_0032 0 0.99609375 /begin FUNCTION_LIST KF7-304.2[21] /end FUNCTION_LIST /end CHARACTERISTIC
/begin CHARACTERISTIC mCNROL "TINT measuring engine rotation delay" VALUE 0x00008347 REC_UBYTE_C 0 COMP_0071 0 255 /begin FUNCTION_LIST KF7-303.5A[9] /end FUNCTION_LIST /end CHARACTERISTIC
/begin CHARACTERISTIC mCRANGCT "Crank corner detection count value slice level" VALUE 0x00008360 REC_UBYTE_C 0 COMP_0068 0 255 /begin FUNCTION_LIST KF7-303.5A[9] KF7-450.9A[5] /end FUNCTION_LIST /end CHARACTERISTIC
/begin CHARACTERISTIC mCRMODLY "Parameter monitor permission delay time" VALUE 0x00008366 REC_UBYTE_C 0 COMP_0008 0 25500 /begin FUNCTION_LIST KF7-303.5A[9] /end FUNCTION_LIST /end CHARACTERISTIC
/begin CHARACTERISTIC mCRMONEL "Parameter monitor permission engine speed lower limit" VALUE 0x00008367 REC_UBYTE_C 0 COMP_0006 0 3187.5 /begin FUNCTION_LIST KF7-303.5A[9] /end FUNCTION_LIST /end CHARACTERISTIC
/begin CHARACTERISTIC mCRSET "A Ref signal rising is located." VALUE 0x00008368 REC_UBYTE_C 0 COMP_0017 0 255
 /begin FUNCTION_LIST KF7-303.5A[9] KF7-320A.4[6] KF7-320A.5[N] KF7-450.9A[5] KF7-450.50[10] KF7-460.1[6] KF7-500.1[54] R301.23.ADV_calculation_1_1_2 R904.1.Gst_on_can_1_0_1 /end FUNCTION_LIST
/end CHARACTERISTIC
/begin CHARACTERISTIC mCYLNGSL "Cylinder distinction NG count value slice level" VALUE 0x000083A7 REC_UBYTE_C 0 COMP_0068 0 255 /begin FUNCTION_LIST KF7-303.5A[9] /end FUNCTION_LIST /end CHARACTERISTIC
/begin CHARACTERISTIC mDLTQSL "S/L for the transient state judgement" VALUE 0x00008471 REC_UBYTE_C 0 COMP_0032 0 0.99609375 /begin FUNCTION_LIST KF7-304.2[21] /end FUNCTION_LIST /end CHARACTERISTIC
/begin CHARACTERISTIC mDLUNAC "L/U prohibition engine speed (at the time of A/C on)" VALUE 0x00008475 REC_UBYTE_C 0 COMP_0000 0 6375 /begin FUNCTION_LIST KF7-302.6A[4] KF7-376.2[21] KF7-385.1[32] /end FUNCTION_LIST /end CHARACTERISTIC
/begin CHARACTERISTIC mDMPTPG "A rotation proportion gain for the steady state W.T.O éû weighted average coefficient computation" VALUE 0x0000848C REC_UBYTE_C 0 COMP_0221_S 0 0.00124491 /begin FUNCTION_LIST KF7-304.2[21] /end FUNCTION_LIST /end CHARACTERISTIC
/begin CHARACTERISTIC mDNFCS "Crank angle sensor NG éû DLTNE" VALUE 0x0000848F REC_UBYTE_C 0 COMP_0006 0 3187.5 /begin FUNCTION_LIST KF7-303.6M[5] /end FUNCTION_LIST /end CHARACTERISTIC
/begin CHARACTERISTIC mDNKJU "Weighted average weight for DLTNE" VALUE 0x00008490 REC_UBYTE_C 0 COMP_0111 1.00392156862745 256 /begin FUNCTION_LIST KF7-303.6M[5] /end FUNCTION_LIST /end CHARACTERISTIC
/begin CHARACTERISTIC mDOTKJU "Weighted average weight for DLTOUTR" VALUE 0x0000849F REC_UBYTE_C 0 COMP_0398_S 1.00392156862745 256 /begin FUNCTION_LIST KF7-303.1[14] KF7-385.1[32] /end FUNCTION_LIST /end CHARACTERISTIC
/begin CHARACTERISTIC mDSUMPL "Delta-QH0 operation period" VALUE 0x000084D2 REC_UBYTE_C 0 COMP_0014 0 2550 /begin FUNCTION_LIST KF7-304.2[21] /end FUNCTION_LIST /end CHARACTERISTIC
/begin CHARACTERISTIC mDTVOMJ "Slowdown judgement delta-TVO" VALUE 0x000084F5 REC_UBYTE_C 0 COMP_0053_S 0 89.25 /begin FUNCTION_LIST KF7-304.10[1] /end FUNCTION_LIST /end CHARACTERISTIC
/begin CHARACTERISTIC mDTVOPJ "Acceleration judgement delta-TVO" VALUE 0x000084F6 REC_UBYTE_C 0 COMP_0053_S 0 89.25 /begin FUNCTION_LIST KF7-304.10[1] /end FUNCTION_LIST /end CHARACTERISTIC
/begin CHARACTERISTIC mDUMPNG2 "At the time of NG, DUMP (non-VIP mass airflow meter installation car)" VALUE 0x00009152 REC_UWORD_C 0 COMP_0456 0 1.999970916 /begin FUNCTION_LIST KF7-304.2[21] /end FUNCTION_LIST /end CHARACTERISTIC
/begin CHARACTERISTIC mFCOVR "CO variable (ROM flag)" VALUE 0x000085E6 REC_UBYTE_C 0 COMP_0068 0 255
 /begin FUNCTION_LIST KF7-304.1B[5] KF7-313C.1[36] KF7-314.1F[1] KF7-500.24[10] KF7-500.25A[7] /end FUNCTION_LIST
/end CHARACTERISTIC
/begin CHARACTERISTIC mGADVTP "TP taking in advance compensation rate" VALUE 0x00008654 REC_UBYTE_C 0 COMP_0066 0 3.984375 /begin FUNCTION_LIST KF7-304.2[21] /end FUNCTION_LIST /end CHARACTERISTIC
/begin CHARACTERISTIC mHNTPS "An engine speed switching speed hysteresis for the low rotation" VALUE 0x00009236 REC_UWORD_C 0 COMP_0006 0 819187.5 /begin FUNCTION_LIST KF7-303.6M[5] /end FUNCTION_LIST /end CHARACTERISTIC
/begin CHARACTERISTIC mIDMP "QAA2 weighted average coefficient" VALUE 0x000086F8 REC_UBYTE_C 0 COMP_0021 0 99.609375 /begin FUNCTION_LIST KF7-304.1B[5] /end FUNCTION_LIST /end CHARACTERISTIC
/begin CHARACTERISTIC mIGBTLMT "Drive circuit upper limit value" VALUE 0x000092E0 REC_UWORD_C 0 COMP_0187_S 0 2097120 /begin FUNCTION_LIST KF7-303.5A[9] /end FUNCTION_LIST /end CHARACTERISTIC
/begin CHARACTERISTIC mISCAVR "When control by the cylinder is prohibited, N weighted average index number" VALUE 0x00008751 REC_UBYTE_C 0 COMP_0063 0 0.99609375 /begin FUNCTION_LIST KF7-303.6M[5] /end FUNCTION_LIST /end CHARACTERISTIC
/begin CHARACTERISTIC mISCVSPH "fFISCVSP judgement vehicle speed (value on the upside of the hysteresis)" VALUE 0x00008767 REC_UBYTE_C 0 COMP_0007 0 510 /begin FUNCTION_LIST KF7-303.1[14] /end FUNCTION_LIST /end CHARACTERISTIC
/begin CHARACTERISTIC mISCVSPL "fFISCVSP judgement vehicle speed (value under the hysteresis)" VALUE 0x00008768 REC_UBYTE_C 0 COMP_0007 0 510 /begin FUNCTION_LIST KF7-303.1[14] /end FUNCTION_LIST /end CHARACTERISTIC
/begin CHARACTERISTIC mISFLTW "A control prohibition lower limit coolant temperature by the cylinder" VALUE 0x00008769 REC_UBYTE_C 0 COMP_0035 -50 205 /begin FUNCTION_LIST KF7-304.3[2] /end FUNCTION_LIST /end CHARACTERISTIC
/begin CHARACTERISTIC mISSNG "ISC motor position monitor NG initial value" VALUE 0x0000930E REC_UWORD_C 0 COMP_0025 0 32767.5 /begin FUNCTION_LIST KF7-304.13[N] KF7-500.38A[4] /end FUNCTION_LIST /end CHARACTERISTIC
/begin CHARACTERISTIC mKAFMV "CO adjustment compensation value" VALUE 0x0000877D REC_UBYTE_C 0 COMP_0205 0 796.875 /begin FUNCTION_LIST KF7-304.1B[5] /end FUNCTION_LIST /end CHARACTERISTIC
/begin CHARACTERISTIC mKCONST "K constant" VALUE 0x00009320 REC_UWORD_C 0 COMP_0210 0 65535 /begin FUNCTION_LIST KF7-304.2[21] /end FUNCTION_LIST /end CHARACTERISTIC
/begin CHARACTERISTIC mKIFADV "At the time of the acceleration, TOP judgement gear constant for the ADV phase control" VALUE 0x000087A2 REC_UBYTE_C 0 COMP_0213 0 199.21875 /begin FUNCTION_LIST KF7-304.5[N] /end FUNCTION_LIST /end CHARACTERISTIC
/begin CHARACTERISTIC mKIFFC "TOP judgement gear constant for the fuel cut" VALUE 0x000087A4 REC_UBYTE_C 0 COMP_0213 0 199.21875 /begin FUNCTION_LIST KF7-304.5[N] /end FUNCTION_LIST /end CHARACTERISTIC
/begin CHARACTERISTIC mKIFKMR "TOP judgement gear constant for KMR" VALUE 0x000087A5 REC_UBYTE_C 0 COMP_0213 0 199.21875 /begin FUNCTION_LIST KF7-304.5[N] /end FUNCTION_LIST /end CHARACTERISTIC
/begin CHARACTERISTIC mKSHO "Pulse width fuel consumption quantity conversion coefficient" VALUE 0x00009340 REC_UWORD_C 0 COMP_0240_S 0 0.65535 /begin FUNCTION_LIST KF7-305.7[6] /end FUNCTION_LIST /end CHARACTERISTIC
/begin CHARACTERISTIC mKVBYN "Vehicle speed operation conversion value" VALUE 0x0000934E REC_UWORD_C 0 COMP_0224 0 0.999985458 /begin FUNCTION_LIST KF7-303.1[14] /end FUNCTION_LIST /end CHARACTERISTIC
/begin CHARACTERISTIC mLOCKDY "An urgent slowdown judgement clear delay" VALUE 0x00008822 REC_UBYTE_C 0 COMP_0014 0 2550 /begin FUNCTION_LIST KF7-303.1[14] KF7-385.1[32] /end FUNCTION_LIST /end CHARACTERISTIC
/begin CHARACTERISTIC mLOCKN "Urgent slowdown judgement start engine speed" VALUE 0x00008824 REC_UBYTE_C 0 COMP_0000 0 6375 /begin FUNCTION_LIST KF7-303.1[14] KF7-385.1[32] /end FUNCTION_LIST /end CHARACTERISTIC
/begin CHARACTERISTIC mLUOFDY "A/C It waits for lockup release at the time of on, delay" VALUE 0x00008833 REC_UBYTE_C 0 COMP_0014 0 2550 /begin FUNCTION_LIST KF7-302.6A[4] /end FUNCTION_LIST /end CHARACTERISTIC
/begin CHARACTERISTIC mNDWINT "Non-energizing angle initial value" VALUE 0x00008898 REC_UBYTE_C 0 COMP_0019 0 255 /begin FUNCTION_LIST KF7-303.5A[9] KF7-320A.6[3] /end FUNCTION_LIST /end CHARACTERISTIC
/begin CHARACTERISTIC mNREF "The cycle (REF) number of around one turn" VALUE 0x000088E0 REC_UBYTE_C 0 COMP_0247_S 0 255
 /begin FUNCTION_LIST KF7-303.6M[5] KF7-303.6P[1] KF7-304.2[21] KF7-311.1A[21] KF7-450.9A[5] /end FUNCTION_LIST
/end CHARACTERISTIC
/begin CHARACTERISTIC mNSETST "Initial judgement rotation compensation value" VALUE 0x00008195 REC_SBYTE_C 0 COMP_0262 -1600 1587.5 /begin FUNCTION_LIST KF7-304.2[21] /end FUNCTION_LIST /end CHARACTERISTIC
/begin CHARACTERISTIC mNSTOFFA "START SW Off judgement speed A" VALUE 0x000088F6 REC_UBYTE_C 0 COMP_0006 0 3187.5 /begin FUNCTION_LIST KF7-302.4MA[13] /end FUNCTION_LIST /end CHARACTERISTIC
/begin CHARACTERISTIC mNSTON2 "At the time of the hard cranking, starter switch on permission speed" VALUE 0x000088FA REC_UBYTE_C 0 COMP_0006 0 3187.5 /begin FUNCTION_LIST KF7-302.4MA[13] /end FUNCTION_LIST /end CHARACTERISTIC
/begin CHARACTERISTIC mNTPSEL "Engine speed switching speed for the low rotation" VALUE 0x000093DC REC_UWORD_C 0 COMP_0006 0 819187.5 /begin FUNCTION_LIST KF7-303.6M[5] /end FUNCTION_LIST /end CHARACTERISTIC
/begin CHARACTERISTIC mOVOFSET "Energizing time angle room fee" VALUE 0x0000896E REC_UBYTE_C 0 COMP_0017 0 255 /begin FUNCTION_LIST KF7-303.5A[9] /end FUNCTION_LIST /end CHARACTERISTIC
/begin CHARACTERISTIC mPAKANJI "Misfire (unsuccessful starting) avoidance time" VALUE 0x00008970 REC_UBYTE_C 0 COMP_0014 0 2550 /begin FUNCTION_LIST KF7-302.4MA[13] /end FUNCTION_LIST /end CHARACTERISTIC
/begin CHARACTERISTIC mPPSVHYS "So far, P/S SW on equivalent judgement voltage hysteresis" VALUE 0x000089B5 REC_UBYTE_C 0 COMP_0054 0 5100 /begin FUNCTION_LIST KF7-301.28[2] /end FUNCTION_LIST /end CHARACTERISTIC
/begin CHARACTERISTIC mPPSVSW "So far, P/S SW on equivalent judgement voltage" VALUE 0x000089B6 REC_UBYTE_C 0 COMP_0054 0 5100 /begin FUNCTION_LIST KF7-301.28[2] /end FUNCTION_LIST /end CHARACTERISTIC
/begin CHARACTERISTIC mPREDLY "Estimated cylinder distinction rotation delay" VALUE 0x000089BA REC_UBYTE_C 0 COMP_0008 0 25500 /begin FUNCTION_LIST KF7-303.5A[9] KF7-450.9A[5] /end FUNCTION_LIST /end CHARACTERISTIC
/begin CHARACTERISTIC mPREOK "Estimated cylinder distinction judgement speed" VALUE 0x0000943A REC_UWORD_C 0 COMP_0006 0 819187.5 /begin FUNCTION_LIST KF7-303.5A[9] KF7-450.9A[5] /end FUNCTION_LIST /end CHARACTERISTIC
/begin CHARACTERISTIC mQAOFST "Inhalation air quantity index number offset" VALUE 0x00009458 REC_UWORD_C 0 COMP_0004 0 65535 /begin FUNCTION_LIST KF7-304.1B[5] /end FUNCTION_LIST /end CHARACTERISTIC
/begin CHARACTERISTIC mQDMP "Q weighted average number of times" VALUE 0x00008A00 REC_UBYTE_C 0 COMP_0030 0 255 /begin FUNCTION_LIST KF7-304.1B[5] /end FUNCTION_LIST /end CHARACTERISTIC
/begin CHARACTERISTIC mQUNIT "QA unit coefficient" VALUE 0x00008A20 REC_UBYTE_C 0 COMP_0282 0 0.0255 /begin FUNCTION_LIST KF7-304.2[21] R901.1.Diag_on_can_app_1_6_2 /end FUNCTION_LIST /end CHARACTERISTIC
/begin CHARACTERISTIC mRAPDLTO "A degree of a slowdown for the urgent slowdown judgement" VALUE 0x0000947C REC_UWORD_C 0 COMP_0392_S 0 65535 /begin FUNCTION_LIST KF7-303.1[14] /end FUNCTION_LIST /end CHARACTERISTIC
/begin CHARACTERISTIC mRECAC "A/C At the time of on, recover speed" VALUE 0x00008A31 REC_UBYTE_C 0 COMP_0000 0 6375
 /begin FUNCTION_LIST KF7-302.6A[4] KF7-312.6[34] KF7-376.2[21] KF7-385.1[32] KF7-450.1[N] KF7-450.2[1] KF7-450.3[1] KF7-450.4[1] KF7-500.1[54] /end FUNCTION_LIST
/end CHARACTERISTIC
/begin CHARACTERISTIC mRECAC2 "A/C At the time of on, recover rotation 2" VALUE 0x00008A32 REC_UBYTE_C 0 COMP_0000 0 6375 /begin FUNCTION_LIST KF7-302.6A[4] KF7-312.6[34] KF7-385.1[32] /end FUNCTION_LIST /end CHARACTERISTIC
/begin CHARACTERISTIC mRETLMT "Retard side maximum change width" VALUE 0x00008A4C REC_UBYTE_C 0 COMP_0017 0 255 /begin FUNCTION_LIST KF7-303.5A[9] KF7-320A.4[6] R301.23.ADV_calculation_1_1_2 /end FUNCTION_LIST /end CHARACTERISTIC
/begin CHARACTERISTIC mRQAVR "At the time of the start, sensor NG éû weighted average coefficient" VALUE 0x00008ACF REC_UBYTE_C 0 COMP_0032 0 0.99609375 /begin FUNCTION_LIST KF7-304.1B[5] /end FUNCTION_LIST /end CHARACTERISTIC
/begin CHARACTERISTIC mSCNGTP "A control prohibition switchover TP range by the cylinder" VALUE 0x00008AF5 REC_UBYTE_C 0 COMP_0001 0 31.875 /begin FUNCTION_LIST KF7-304.3[2] /end FUNCTION_LIST /end CHARACTERISTIC
/begin CHARACTERISTIC mSTOFFT "Initial judgement time" VALUE 0x00008B36 REC_UBYTE_C 0 COMP_0014 0 2550 /begin FUNCTION_LIST KF7-302.4MA[13] /end FUNCTION_LIST /end CHARACTERISTIC
/begin CHARACTERISTIC mSTOFFVBL "Starter SWOFF battery voltage judgement threshold" VALUE 0x00008B38 REC_UBYTE_C 0 COMP_0033 0 20400 /begin FUNCTION_LIST KF7-302.4MA[13] /end FUNCTION_LIST /end CHARACTERISTIC
/begin CHARACTERISTIC mSTONVBL "Starter SWON battery voltage judgement threshold" VALUE 0x00008B3A REC_UBYTE_C 0 COMP_0033 0 20400 /begin FUNCTION_LIST KF7-302.4MA[13] /end FUNCTION_LIST /end CHARACTERISTIC
/begin CHARACTERISTIC mSTRTVB "At the time of the hard cranking, starter switch on battery voltage" VALUE 0x00008B45 REC_UBYTE_C 0 COMP_0033 0 20400 /begin FUNCTION_LIST KF7-302.4MA[13] /end FUNCTION_LIST /end CHARACTERISTIC
/begin CHARACTERISTIC mTINADA "TINT measuring condition formation speed" VALUE 0x00008BF4 REC_UBYTE_C 0 COMP_0006 0 3187.5 /begin FUNCTION_LIST KF7-303.5A[9] /end FUNCTION_LIST /end CHARACTERISTIC
/begin CHARACTERISTIC mTINTED "TINT measuring completion position" VALUE 0x00008BF6 REC_UBYTE_C 0 COMP_0016 0 255 /begin FUNCTION_LIST KF7-303.5A[9] /end FUNCTION_LIST /end CHARACTERISTIC
/begin CHARACTERISTIC mTINTST "TINT measuring start position" VALUE 0x00008BF7 REC_UBYTE_C 0 COMP_0016 0 255 /begin FUNCTION_LIST KF7-303.5A[9] /end FUNCTION_LIST /end CHARACTERISTIC
/begin CHARACTERISTIC mTMFPON "The first fuel pump on time" VALUE 0x00008C48 REC_UBYTE_C 0 COMP_0008 0 25500 /begin FUNCTION_LIST KF7-305.4BM[31] KF7-311.1A[21] KF7-373.1[1] /end FUNCTION_LIST /end CHARACTERISTIC
/begin CHARACTERISTIC mTMLUBRK "An urgent brake slowdown judgement delay" VALUE 0x00008C5C REC_UBYTE_C 0 COMP_0014 0 2550 /begin FUNCTION_LIST KF7-303.1[14] /end FUNCTION_LIST /end CHARACTERISTIC
/begin CHARACTERISTIC mTMRCD "Stable voltage continuation judgement time" VALUE 0x00008C7A REC_UBYTE_C 0 COMP_0014 0 2550 /begin FUNCTION_LIST KF7-304.7[1] /end FUNCTION_LIST /end CHARACTERISTIC
/begin CHARACTERISTIC mTNOIS "Filtering constant" VALUE 0x00008CB9 REC_UBYTE_C 0 COMP_0063 0 0.99609375 /begin FUNCTION_LIST KF7-303.1[14] /end FUNCTION_LIST /end CHARACTERISTIC
/begin CHARACTERISTIC mTNZERO "KNRPM continuation time" VALUE 0x00008CBC REC_UBYTE_C 0 COMP_0014 0 2550 /begin FUNCTION_LIST KF7-302.4MA[13] /end FUNCTION_LIST /end CHARACTERISTIC
/begin CHARACTERISTIC mTP100 "Filling up efficiency 100% éû TP" VALUE 0x000095E0 REC_UWORD_C 0 COMP_0052 0 31.99956087 /begin FUNCTION_LIST KF7-304.2[21] KF7-350.4M[14] KF7-350.4P[13] KF7-386.1[4] /end FUNCTION_LIST /end CHARACTERISTIC
/begin CHARACTERISTIC mTPIHT "At the time of the start, TP maintenance time" VALUE 0x00008CD0 REC_UBYTE_C 0 COMP_0008 0 25500 /begin FUNCTION_LIST KF7-304.2[21] /end FUNCTION_LIST /end CHARACTERISTIC
/begin CHARACTERISTIC mTPJDGSL1 "Control REF judgement permission CRACNT value (the front which the first reference position is detected in)" VALUE 0x00008CD1 REC_UBYTE_C 0 COMP_0068 0 255 /begin FUNCTION_LIST KF7-303.5A[9] /end FUNCTION_LIST /end CHARACTERISTIC
/begin CHARACTERISTIC mTPJDGSL2 "Control REF judgement permission CRACNT value (After the first reference position is detected.)" VALUE 0x00008CD2 REC_UBYTE_C 0 COMP_0068 0 255 /begin FUNCTION_LIST KF7-303.5A[9] /end FUNCTION_LIST /end CHARACTERISTIC
/begin CHARACTERISTIC mTPOSCPSL "The head POS signal judgement periodic ratio" VALUE 0x00008CD8 REC_UBYTE_C 0 COMP_0186 0 3.984375 /begin FUNCTION_LIST KF7-303.5A[9] /end FUNCTION_LIST /end CHARACTERISTIC
/begin CHARACTERISTIC mTRSDLY "After the transient state judgement, delay time" VALUE 0x00008CEB REC_UBYTE_C 0 COMP_0295 0 25500 /begin FUNCTION_LIST KF7-304.2[21] /end FUNCTION_LIST /end CHARACTERISTIC
/begin CHARACTERISTIC mVOLR "Engine displacement/manifold capacity ratio" VALUE 0x00008DE0 REC_UBYTE_C 0 COMP_0044 0 1.9921875 /begin FUNCTION_LIST KF7-304.2[21] /end FUNCTION_LIST /end CHARACTERISTIC
/begin CHARACTERISTIC mVSPNOIS "Filtering constant for the vehicle speed" VALUE 0x00008E16 REC_UBYTE_C 0 COMP_0063 0 0.99609375 /begin FUNCTION_LIST KF7-303.1[14] /end FUNCTION_LIST /end CHARACTERISTIC
/begin CHARACTERISTIC mWTMX "EEPROM writing trial number of times" VALUE 0x00008E99 REC_UBYTE_C 0 COMP_0030 0 255 /begin FUNCTION_LIST KF7-305.4AM[10] KF7-400.1[1] /end FUNCTION_LIST /end CHARACTERISTIC
/begin CHARACTERISTIC mMDUMP "At the time of the steady state judgement, smoothing coefficient map" MAP 0x00009D0E REC_UBYTE_C 0 COMP_0230_S 0 0.49804815
 /begin AXIS_DESCR COM_AXIS NO_INPUT_QUANTITY COMP_0020 4 0 12750 AXIS_PTS_REF mDMPN /end AXIS_DESCR
 /begin AXIS_DESCR COM_AXIS NO_INPUT_QUANTITY COMP_0032 4 0 0.99609375 AXIS_PTS_REF mDMPQH /end AXIS_DESCR
 /begin FUNCTION_LIST KF7-304.2[21] /end FUNCTION_LIST
/end CHARACTERISTIC
/begin CHARACTERISTIC mMITAN "Fresh air rate map" MAP 0x00009E1E REC_UBYTE_C 0 COMP_0009 0 199.21875
 /begin AXIS_DESCR COM_AXIS NO_INPUT_QUANTITY COMP_0020 4 0 12750 AXIS_PTS_REF mITANN /end AXIS_DESCR
 /begin AXIS_DESCR COM_AXIS NO_INPUT_QUANTITY COMP_0009 4 0 199.21875 AXIS_PTS_REF mITANI /end AXIS_DESCR
 /begin FUNCTION_LIST KF7-304.2[21] KF7-350.4M[14] /end FUNCTION_LIST
/end CHARACTERISTIC
/begin CHARACTERISTIC mMITANDA "At the time of the transient state, fresh air rate map (for the acceleration)" MAP 0x00009E2E REC_UBYTE_C 0 COMP_0009 0 199.21875
 /begin AXIS_DESCR COM_AXIS NO_INPUT_QUANTITY COMP_0020 8 0 12750 AXIS_PTS_REF mITANDNE /end AXIS_DESCR
 /begin AXIS_DESCR COM_AXIS NO_INPUT_QUANTITY COMP_0032 8 0 0.99609375 AXIS_PTS_REF mITANDQH /end AXIS_DESCR
 /begin FUNCTION_LIST KF7-304.2[21] /end FUNCTION_LIST
/end CHARACTERISTIC
/begin CHARACTERISTIC mMITANDD "At the time of the transient state, fresh air rate map (for the slowdown)" MAP 0x00009E6E REC_UBYTE_C 0 COMP_0009 0 199.21875
 /begin AXIS_DESCR COM_AXIS NO_INPUT_QUANTITY COMP_0020 8 0 12750 AXIS_PTS_REF mITANDNE /end AXIS_DESCR
 /begin AXIS_DESCR COM_AXIS NO_INPUT_QUANTITY COMP_0032 8 0 0.99609375 AXIS_PTS_REF mITANDQH /end AXIS_DESCR
 /begin FUNCTION_LIST KF7-304.2[21] /end FUNCTION_LIST
/end CHARACTERISTIC
/begin CHARACTERISTIC mMKMFAT "Quantity rate basic value" MAP 0x00009EBE REC_UBYTE_C 0 COMP_0088 0 0.062255955
 /begin AXIS_DESCR FIX_AXIS NO_INPUT_QUANTITY COMP_0278_S 8 -40 100 FIX_AXIS_PAR_DIST 0 1 8 /end AXIS_DESCR
 /begin AXIS_DESCR FIX_AXIS NO_INPUT_QUANTITY COMP_0279_S 8 0 87.5 FIX_AXIS_PAR_DIST 0 1 8 /end AXIS_DESCR
 /begin FUNCTION_LIST KF7-304.13[N] KF7-312.4A[6] KF7-312.4C[4] /end FUNCTION_LIST
/end CHARACTERISTIC
/begin CHARACTERISTIC mTQH0H "TVO_N flow-quantity table high flow-quantity" CURVE 0x0000EDF2 REC_UWORD_C 0 COMP_0290 0 0.999985458
 /begin AXIS_DESCR FIX_AXIS NO_INPUT_QUANTITY COMP_0501_S 16 0.000001 55.785001 FIX_AXIS_PAR_DIST 0 1 16 /end AXIS_DESCR
 /begin FUNCTION_LIST KF7-304.9[2] KF7-500.7[12] /end FUNCTION_LIST
/end CHARACTERISTIC
/begin CHARACTERISTIC mTQH0L "TVO_N flow-quantity table low flow-quantity" CURVE 0x0000EE12 REC_UWORD_C 0 COMP_0290 0 0.999985458
 /begin AXIS_DESCR FIX_AXIS NO_INPUT_QUANTITY COMP_0502_S 16 0 139.455 FIX_AXIS_PAR_DIST 0 1 16 /end AXIS_DESCR
 /begin FUNCTION_LIST KF7-304.9[2] KF7-500.7[12] /end FUNCTION_LIST
/end CHARACTERISTIC
/begin CHARACTERISTIC mTTPMAX "TPMAX value table" CURVE 0x0000DB06 REC_UBYTE_C 0 COMP_0001 0 31.875
 /begin AXIS_DESCR FIX_AXIS NO_INPUT_QUANTITY COMP_0271_S 16 0 6000 FIX_AXIS_PAR_DIST 0 1 16 /end AXIS_DESCR
 /begin FUNCTION_LIST KF7-304.2[21] /end FUNCTION_LIST
/end CHARACTERISTIC
/begin CHARACTERISTIC mTATVO "Throttle ceremony road surface product table (GKTVO2.8125deg)" CURVE 0x0000E5BA REC_UWORD_C 0 COMP_0042 0 52.428
 /begin AXIS_DESCR FIX_AXIS NO_INPUT_QUANTITY COMP_0298_S 32 0 87.1875 FIX_AXIS_PAR_DIST 0 1 32 /end AXIS_DESCR
 /begin FUNCTION_LIST KF7-304.13[N] /end FUNCTION_LIST
/end CHARACTERISTIC
/begin CHARACTERISTIC mTTQH0ST "Target basis QH0" CURVE 0x0000F3CE REC_UWORD_C 0 COMP_0146 0 99.998480265
 /begin AXIS_DESCR COM_AXIS NO_INPUT_QUANTITY COMP_0303_S 32 0 2.5599609375E-06 AXIS_PTS_REF mTTGADNV /end AXIS_DESCR
 /begin FUNCTION_LIST KF7-304.9[2] KF7-340.1M[8] KF7-340.2M[2] KF7-340.8M[8] KF7-350.4M[14] KF7-351.3[11] KF7-385.3[4] KF7-410.11M[4] KF7-410.17M[5] R000.1.RS_Integ_1_10_2 R301.20.AmbientComp_1_0_2 /end FUNCTION_LIST
/end CHARACTERISTIC
/begin CHARACTERISTIC mTTQH0STH "Target basis QH0" CURVE 0x0000F40E REC_UWORD_C 0 COMP_0146 0 99.998480265
 /begin AXIS_DESCR COM_AXIS NO_INPUT_QUANTITY COMP_0304_S 32 0 0.000040959375 AXIS_PTS_REF mTTGADNVH /end AXIS_DESCR
 /begin FUNCTION_LIST KF7-304.9[2] KF7-340.1M[8] KF7-340.2M[2] KF7-350.4M[14] KF7-351.3[11] KF7-385.3[4] KF7-410.17M[5] R301.20.AmbientComp_1_0_2 /end FUNCTION_LIST
/end CHARACTERISTIC
/begin CHARACTERISTIC mTDLNEMSK "DLTNE non-operation time table" CURVE 0x0000CF9E REC_UBYTE_C 0 COMP_0014 0 2550
 /begin AXIS_DESCR FIX_AXIS NO_INPUT_QUANTITY COMP_0506_S 4 1200 3600 FIX_AXIS_PAR_DIST 0 1 4 /end AXIS_DESCR
 /begin FUNCTION_LIST KF7-303.6M[5] /end FUNCTION_LIST
/end CHARACTERISTIC
/begin CHARACTERISTIC mTKANBAKU "An engine speed table for the complete combustion judgement" CURVE 0x0000D31A REC_UBYTE_C 0 COMP_0006 0 3187.5
 /begin AXIS_DESCR FIX_AXIS NO_INPUT_QUANTITY COMP_0278_S 8 -40 100 FIX_AXIS_PAR_DIST 0 1 8 /end AXIS_DESCR
 /begin FUNCTION_LIST KF7-302.4MA[13] /end FUNCTION_LIST
/end CHARACTERISTIC
/begin CHARACTERISTIC mTSFSTT "After the start, a control prohibition delay by the cylinder" CURVE 0x0000D8BA REC_UBYTE_C 0 COMP_0008 0 25500
 /begin AXIS_DESCR FIX_AXIS NO_INPUT_QUANTITY COMP_0278_S 8 -40 100 FIX_AXIS_PAR_DIST 0 1 8 /end AXIS_DESCR
 /begin FUNCTION_LIST KF7-304.3[2] /end FUNCTION_LIST
/end CHARACTERISTIC
/begin CHARACTERISTIC mTSTLIMIT "Starter motor on continuation time upper limit table" CURVE 0x0000D912 REC_UBYTE_C 0 COMP_0013 0 255
 /begin AXIS_DESCR FIX_AXIS NO_INPUT_QUANTITY COMP_0278_S 8 -40 100 FIX_AXIS_PAR_DIST 0 1 8 /end AXIS_DESCR
 /begin FUNCTION_LIST KF7-302.4MA[13] /end FUNCTION_LIST
/end CHARACTERISTIC
/begin CHARACTERISTIC mTSTTMIN "An initial judgement time table (at the time of the start, coolant temperature reference)" CURVE 0x0000D92A REC_UBYTE_C 0 COMP_0008 0 25500
 /begin AXIS_DESCR FIX_AXIS NO_INPUT_QUANTITY COMP_0278_S 8 -40 100 FIX_AXIS_PAR_DIST 0 1 8 /end AXIS_DESCR
 /begin FUNCTION_LIST KF7-304.2[21] /end FUNCTION_LIST
/end CHARACTERISTIC
/begin CHARACTERISTIC mTTATDN "D- >N switching delay table" CURVE 0x0000D942 REC_UBYTE_C 0 COMP_0295 0 25500
 /begin AXIS_DESCR FIX_AXIS NO_INPUT_QUANTITY COMP_0278_S 8 -40 100 FIX_AXIS_PAR_DIST 0 1 8 /end AXIS_DESCR
 /begin FUNCTION_LIST KF7-302.5M[10] /end FUNCTION_LIST
/end CHARACTERISTIC
/begin CHARACTERISTIC mTTATDN1 "D- >N switching delay table" CURVE 0x0000D94A REC_UBYTE_C 0 COMP_0014 0 2550
 /begin AXIS_DESCR COM_AXIS NO_INPUT_QUANTITY COMP_0016 8 0 255 AXIS_PTS_REF mTTATTMP /end AXIS_DESCR
 /begin FUNCTION_LIST KF7-302.5M[10] /end FUNCTION_LIST
/end CHARACTERISTIC
/begin CHARACTERISTIC mTTATND "N- >D switching delay table" CURVE 0x0000D952 REC_UBYTE_C 0 COMP_0295 0 25500
 /begin AXIS_DESCR FIX_AXIS NO_INPUT_QUANTITY COMP_0278_S 8 -40 100 FIX_AXIS_PAR_DIST 0 1 8 /end AXIS_DESCR
 /begin FUNCTION_LIST KF7-302.5M[10] /end FUNCTION_LIST
/end CHARACTERISTIC
/begin CHARACTERISTIC mTTATND1 "N- >D switching delay table" CURVE 0x0000D95A REC_UBYTE_C 0 COMP_0014 0 2550
 /begin AXIS_DESCR COM_AXIS NO_INPUT_QUANTITY COMP_0016 8 0 255 AXIS_PTS_REF mTTATTMP /end AXIS_DESCR
 /begin FUNCTION_LIST KF7-302.5M[10] /end FUNCTION_LIST
/end CHARACTERISTIC
/begin CHARACTERISTIC mTTKTDN "D- >N switching delay table" CURVE 0x0000DA8A REC_UBYTE_C 0 COMP_0008 0 25500
 /begin AXIS_DESCR FIX_AXIS NO_INPUT_QUANTITY COMP_0128_S 8 -30 5 FIX_AXIS_PAR_DIST 0 1 8 /end AXIS_DESCR
 /begin FUNCTION_LIST KF7-302.5M[10] /end FUNCTION_LIST
/end CHARACTERISTIC
/begin CHARACTERISTIC mTTKTND "N- >D switching delay table" CURVE 0x0000DA92 REC_UBYTE_C 0 COMP_0008 0 25500
 /begin AXIS_DESCR FIX_AXIS NO_INPUT_QUANTITY COMP_0128_S 8 -30 5 FIX_AXIS_PAR_DIST 0 1 8 /end AXIS_DESCR
 /begin FUNCTION_LIST KF7-302.5M[10] /end FUNCTION_LIST
/end CHARACTERISTIC
/begin CHARACTERISTIC mTTPINT "TP initial value table" CURVE 0x0000F3AE REC_UWORD_C 0 COMP_0052 0 31.99956087
 /begin AXIS_DESCR FIX_AXIS NO_INPUT_QUANTITY COMP_0278_S 8 -40 100 FIX_AXIS_PAR_DIST 0 1 8 /end AXIS_DESCR
 /begin FUNCTION_LIST KF7-304.2[21] /end FUNCTION_LIST
/end CHARACTERISTIC
/begin CHARACTERISTIC mfCHIGER "The energizing prevention switching flag which it is simultaneous with" VALUE 0x00008375 REC_UBYTE_C 0 COMP_0283 0 1 BIT_MASK 0x0080 /begin FUNCTION_LIST KF7-303.5A[9] /end FUNCTION_LIST /end CHARACTERISTIC
/begin CHARACTERISTIC mfEPWNGM "0:Not DGN  1:DGN" VALUE 0x00010231 REC_UBYTE_C 0 COMP_0283 0 1 BIT_MASK 0x0002
 /begin FUNCTION_LIST KF7-305.4AM[10] KF7-450.22[1] KF7-500.2A[29] KF7-525.2[6] KF7-525.2S[10] /end FUNCTION_LIST
/end CHARACTERISTIC
/begin CHARACTERISTIC mfEPRNGM "0:Not DGN  1:DGN" VALUE 0x00010231 REC_UBYTE_C 0 COMP_0283 0 1 BIT_MASK 0x0001
 /begin FUNCTION_LIST KF7-305.1[7] KF7-351.1[16] KF7-351.2[17] KF7-500.2A[29] KF7-505.22[3] KF7-525.2[6] KF7-525.2S[10] /end FUNCTION_LIST
/end CHARACTERISTIC
/begin AXIS_PTS mDMPN "50rpm" 0x0000C926 NO_INPUT_QUANTITY REC_AXIS_UBYTE 0 COMP_0020 4 0 12750 /end AXIS_PTS
/begin AXIS_PTS mDMPQH "1/256Å|" 0x0000C92A NO_INPUT_QUANTITY REC_AXIS_UBYTE 0 COMP_0032 4 0 0.99609375 /end AXIS_PTS
/begin AXIS_PTS mITANN "50rpm" 0x0000CA3F NO_INPUT_QUANTITY REC_AXIS_UBYTE 0 COMP_0020 4 0 12750 /end AXIS_PTS
/begin AXIS_PTS mITANI "100/128%" 0x0000CA3B NO_INPUT_QUANTITY REC_AXIS_UBYTE 0 COMP_0009 4 0 199.21875 /end AXIS_PTS
/begin AXIS_PTS mITANDNE "50rpm" 0x0000CA2B NO_INPUT_QUANTITY REC_AXIS_UBYTE 0 COMP_0020 8 0 12750 /end AXIS_PTS
/begin AXIS_PTS mITANDQH "1/256Å|" 0x0000CA33 NO_INPUT_QUANTITY REC_AXIS_UBYTE 0 COMP_0032 8 0 0.99609375 /end AXIS_PTS
/begin AXIS_PTS mTTGADNV "3.90625E-11cm**2/rp" 0x0000F2BE NO_INPUT_QUANTITY REC_AXIS_UWORD 0 COMP_0303_S 32 0 2.5599609375E-06 /end AXIS_PTS
/begin AXIS_PTS mTTGADNVH "6.25E-10cm**2/rp" 0x0000F2FE NO_INPUT_QUANTITY REC_AXIS_UWORD 0 COMP_0304_S 32 0 0.000040959375 /end AXIS_PTS
/begin AXIS_PTS mTTATTMP "1count" 0x0000D96A NO_INPUT_QUANTITY REC_AXIS_UBYTE 0 COMP_0016 8 0 255 /end AXIS_PTS
/begin MEASUREMENT wfDOWNVSP "An urgent slowdown judgement signal" UBYTE COMP_0283 1 100 0 1 BIT_MASK 0x0004 ECU_ADDRESS 0xFFFF49CC /begin FUNCTION_LIST KF7-303.1[14] KF7-385.1[32] /end FUNCTION_LIST /end MEASUREMENT
/begin MEASUREMENT wfIDLEPR "ASCD A former IDLE flag to process" UBYTE COMP_0283 1 100 0 1 BIT_MASK 0x0020 ECU_ADDRESS 0xFFFF49D0 /begin FUNCTION_LIST KF7-301.25M[5] KF7-340.6M[2] KF7-340.6P[2] KF7-340.7[4] /end FUNCTION_LIST /end MEASUREMENT
/begin MEASUREMENT wfOUTREVF "CVT output speed fail flag" UBYTE COMP_0283 1 100 0 1 BIT_MASK 0x0008 ECU_ADDRESS 0xFFFF49D2 /begin FUNCTION_LIST KF7-303.1[14] KF7-385.1[32] /end FUNCTION_LIST /end MEASUREMENT
/begin MEASUREMENT wfSSOFF "Self-shut-off judgement flag" UBYTE COMP_0283 1 100 0 1 BIT_MASK 0x0010 ECU_ADDRESS 0xFFFF49D4
 /begin FUNCTION_LIST KF7-305.4BM[31] KF7-305.14[2] KF7-311.1A[21] KF7-376.1[6] KF7-505.18[3] KF7-505.25[3] /end FUNCTION_LIST
/end MEASUREMENT
/begin MEASUREMENT wfIDLE_S "Idle switch" UBYTE COMP_0283 1 100 0 1 BIT_MASK 0x0001 ECU_ADDRESS 0xFFFF49D5
 /begin FUNCTION_LIST KF7-301.25P[5] KF7-340.1P[7] KF7-340.15[3] KF7-340.16[4] KF7-500.47B[15] /end FUNCTION_LIST
/end MEASUREMENT
/begin MEASUREMENT fDOWNVSP "An urgent slowdown judgement signal" UBYTE COMP_0283 1 100 0 1 BIT_MASK 0x0004 ECU_ADDRESS 0xFFFF49DC /begin FUNCTION_LIST KF7-303.1[14] KF7-385.1[32] /end FUNCTION_LIST /end MEASUREMENT
/begin MEASUREMENT fIDLEPR "ASCD A former IDLE flag to process" UBYTE COMP_0283 1 100 0 1 BIT_MASK 0x0020 ECU_ADDRESS 0xFFFF49E0
 /begin FUNCTION_LIST KF7-301.25M[5] KF7-340.6M[2] KF7-340.6P[2] KF7-340.7[4] R000.1.RS_Integ_1_10_2 Rxxx.2.Integration_Diagnostic_cycle_1_1_1 /end FUNCTION_LIST
/end MEASUREMENT
/begin MEASUREMENT fOUTREVF "CVT output speed fail flag" UBYTE COMP_0283 1 100 0 1 BIT_MASK 0x0008 ECU_ADDRESS 0xFFFF49E2 /begin FUNCTION_LIST KF7-303.1[14] KF7-385.1[32] /end FUNCTION_LIST /end MEASUREMENT
/begin MEASUREMENT fSSOFF "Self-shut-off judgement flag" UBYTE COMP_0283 1 100 0 1 BIT_MASK 0x0010 ECU_ADDRESS 0xFFFF49E4
 /begin FUNCTION_LIST KF7-305.4BM[31] KF7-305.14[2] KF7-311.1A[21] KF7-376.1[6] KF7-505.18[3] KF7-505.25[3] /end FUNCTION_LIST
/end MEASUREMENT
/begin MEASUREMENT fIDLE_S "Idle switch" UBYTE COMP_0283 1 100 0 1 BIT_MASK 0x0001 ECU_ADDRESS 0xFFFF49E5
 /begin FUNCTION_LIST KF7-301.25P[5] KF7-340.1P[7] KF7-340.15[3] KF7-340.16[4] KF7-410.17P[1] KF7-500.47B[15] R000.1.RS_Integ_1_10_2 R101.1P.aps_pedin_1_1_2 /end FUNCTION_LIST
/end MEASUREMENT
/begin MEASUREMENT fADVADJ "Ignition timing adjustment flag" UBYTE COMP_0283 1 100 0 1 BIT_MASK 0x0008 ECU_ADDRESS 0xFFFF427D /begin FUNCTION_LIST KF7-305.4AM[10] KF7-320A.3[N] KF7-320A.4[6] KF7-580.1[8] /end FUNCTION_LIST /end MEASUREMENT
/begin MEASUREMENT fDTVONG "Throttle sensor trouble judgement flag" UBYTE COMP_0283 1 100 0 1 BIT_MASK 0x0002 ECU_ADDRESS 0xFFFF4295
 /begin FUNCTION_LIST KF7-304.2[21] KF7-330.5[53] KF7-376.2[21] KF7-450.7[2] KF7-450.50[10] KF7-500.26[17] KF7-505.91[2] /end FUNCTION_LIST
/end MEASUREMENT
/begin MEASUREMENT fEEPWNG "EEPROM writing NG condition flag" UBYTE COMP_0283 1 100 0 1 BIT_MASK 0x0020 ECU_ADDRESS 0xFFFF4298 /begin FUNCTION_LIST KF7-305.4AM[10] /end FUNCTION_LIST /end MEASUREMENT
/begin MEASUREMENT fEGRACNT "EGRACNT count rise experience flag" UBYTE COMP_0283 1 100 0 1 BIT_MASK 0x0080 ECU_ADDRESS 0xFFFF4299 /begin FUNCTION_LIST KF7-305.4BM[31] KF7-500.6D[9] KF7-500.47B[15] /end FUNCTION_LIST /end MEASUREMENT
/begin MEASUREMENT fEGRATRP "EGR (close) diagnosis trip counter count check flag" UBYTE COMP_0283 1 100 0 1 BIT_MASK 0x0020 ECU_ADDRESS 0xFFFF4299 /begin FUNCTION_LIST KF7-305.4BM[31] /end FUNCTION_LIST /end MEASUREMENT
/begin MEASUREMENT fEGRBCNT "EGRBCNT count rise experience flag" UBYTE COMP_0283 1 100 0 1 BIT_MASK 0x0010 ECU_ADDRESS 0xFFFF4299 /begin FUNCTION_LIST KF7-305.4BM[31] KF7-500.47B[15] /end FUNCTION_LIST /end MEASUREMENT
/begin MEASUREMENT fEGRBTRP "EGR (opening) diagnosis trip counter count check flag" UBYTE COMP_0283 1 100 0 1 BIT_MASK 0x0004 ECU_ADDRESS 0xFFFF4299 /begin FUNCTION_LIST KF7-305.4BM[31] /end FUNCTION_LIST /end MEASUREMENT
/begin MEASUREMENT fEPBUWED "EEPROM writing completion flag" UBYTE COMP_0283 1 100 0 1 BIT_MASK 0x0004 ECU_ADDRESS 0xFFFF429D /begin FUNCTION_LIST KF7-305.4AM[10] KF7-305.14[2] /end FUNCTION_LIST /end MEASUREMENT
/begin MEASUREMENT fEPBUWIN "EEPROM writing initialization execution flag" UBYTE COMP_0283 1 100 0 1 BIT_MASK 0x0002 ECU_ADDRESS 0xFFFF429D /begin FUNCTION_LIST KF7-305.14[2] /end FUNCTION_LIST /end MEASUREMENT
/begin MEASUREMENT fEPBUWST "EEPROM writing start flag" UBYTE COMP_0283 1 100 0 1 BIT_MASK 0x0080 ECU_ADDRESS 0xFFFF429E /begin FUNCTION_LIST KF7-305.4AM[10] KF7-305.14[2] /end FUNCTION_LIST /end MEASUREMENT
/begin MEASUREMENT fESCING "EEPread_all reading NG flag" UBYTE COMP_0283 1 100 0 1 BIT_MASK 0x0001 ECU_ADDRESS 0xFFFF429F /begin FUNCTION_LIST KF7-305.14[2] /end FUNCTION_LIST /end MEASUREMENT
/begin MEASUREMENT fFASCD "ASCD order value switching (release (B)) condition" UBYTE COMP_0283 1 100 0 1 BIT_MASK 0x0040 ECU_ADDRESS 0xFFFF42A9
 /begin FUNCTION_LIST KF7-301.25M[5] KF7-301.25P[5] KF7-340.8M[8] KF7-340.8P[8] KF7-410.20[N] /end FUNCTION_LIST
/end MEASUREMENT
/begin MEASUREMENT fFCRADJ "Combustion efficiency compensation coefficient adjustment mode flag" UBYTE COMP_0283 1 100 0 1 BIT_MASK 0x0001 ECU_ADDRESS 0xFFFF42AB /begin FUNCTION_LIST KF7-305.4AM[10] /end FUNCTION_LIST /end MEASUREMENT
/begin MEASUREMENT fFFDWR_M "EEPROM writing flag" UBYTE COMP_0283 1 100 0 1 BIT_MASK 0x0010 ECU_ADDRESS 0xFFFF42B5 /begin FUNCTION_LIST KF7-305.4AM[10] KF7-505.22[3] /end FUNCTION_LIST /end MEASUREMENT
/begin MEASUREMENT fINITBRAME "Category BC reading completion flag" UBYTE COMP_0283 1 100 0 1 BIT_MASK 0x0008 ECU_ADDRESS 0xFFFF42C9 /begin FUNCTION_LIST KF7-305.4AM[10] KF7-305.14[2] /end FUNCTION_LIST /end MEASUREMENT
/begin MEASUREMENT fIQTSEP1 "It is dealing with a TAS learning value (reversal value) EEPROM writing, flag" UBYTE COMP_0283 1 100 0 1 BIT_MASK 0x0080 ECU_ADDRESS 0xFFFF42CA /begin FUNCTION_LIST KF7-305.4BM[31] KF7-351.1[16] /end FUNCTION_LIST /end MEASUREMENT
/begin MEASUREMENT fIDLEASCD "ASCD order value IDLE judgement flag" UBYTE COMP_0283 1 100 0 1 BIT_MASK 0x0004 ECU_ADDRESS 0xFFFF432B /begin FUNCTION_LIST KF7-301.25M[5] KF7-301.25P[5] /end FUNCTION_LIST /end MEASUREMENT
/begin MEASUREMENT fKNRZERO "At the time of the TNZERO progress, flag" UBYTE COMP_0283 1 100 0 1 BIT_MASK 0x0080 ECU_ADDRESS 0xFFFF4330 /begin FUNCTION_LIST KF7-302.4MA[13] /end FUNCTION_LIST /end MEASUREMENT
/begin MEASUREMENT fVSPASCD2 "A vehicle speed pulse periodic measuring switch flag for ASCD" UBYTE COMP_0283 1 100 0 1 BIT_MASK 0x0020 ECU_ADDRESS 0xFFFF4345 /begin FUNCTION_LIST KF7-303.1[14] /end FUNCTION_LIST /end MEASUREMENT
/begin MEASUREMENT afAPSDBLCA "APS the second-fold CA flag" UBYTE COMP_0283 1 100 0 1 BIT_MASK 0x0001 ECU_ADDRESS 0xFFFF434A /begin FUNCTION_LIST KF7-301.25M[5] KF7-301.25P[5] KF7-450.50[10] /end FUNCTION_LIST /end MEASUREMENT
/begin MEASUREMENT afBRKSWCA1 "Brake SWCA1 flag" UBYTE COMP_0283 1 100 0 1 BIT_MASK 0x0004 ECU_ADDRESS 0xFFFF434C /begin FUNCTION_LIST KF7-301.25M[5] KF7-301.25P[5] KF7-450.50[10] /end FUNCTION_LIST /end MEASUREMENT
/begin MEASUREMENT afBRKSWCA2 "Brake SWCA2 flag" UBYTE COMP_0283 1 100 0 1 BIT_MASK 0x0002 ECU_ADDRESS 0xFFFF434C /begin FUNCTION_LIST KF7-301.25M[5] KF7-301.25P[5] KF7-450.50[10] /end FUNCTION_LIST /end MEASUREMENT
/begin MEASUREMENT afDTNG "A/T signal line condition" UBYTE COMP_0283 1 100 0 1 BIT_MASK 0x0002 ECU_ADDRESS 0xFFFF4352
 /begin FUNCTION_LIST KF7-303.1[14] KF7-312.6[34] KF7-340.11[4] KF7-340.13[4] KF7-360.9M[43] KF7-385.1[32] KF7-385.2[18] KF7-385.3[4] /end FUNCTION_LIST
/end MEASUREMENT
/begin MEASUREMENT afEEPRWNG "EEPROM NG Flag" UBYTE COMP_0283 1 100 0 1 BIT_MASK 0x0001 ECU_ADDRESS 0xFFFF4352 /begin FUNCTION_LIST KF7-305.14[2] /end FUNCTION_LIST /end MEASUREMENT
/begin MEASUREMENT afETCFAIL "ETC fail flag" UBYTE COMP_0283 1 100 0 1 BIT_MASK 0x0010 ECU_ADDRESS 0xFFFF4353
 /begin FUNCTION_LIST KF7-301.25M[5] KF7-340.13[4] KF7-360.2[N] KF7-360.4[14] KF7-450.50[10] KF7-505.15[4] KF7-505.34[3] /end FUNCTION_LIST
/end MEASUREMENT
/begin MEASUREMENT afETCFAL_S "ETC fail flag (the sub-side)" UBYTE COMP_0283 1 100 0 1 BIT_MASK 0x0001 ECU_ADDRESS 0xFFFF4359
 /begin FUNCTION_LIST KF7-301.25P[5] KF7-360.2[N] KF7-360.4[14] KF7-505.34[3] KF7-525.2S[10] /end FUNCTION_LIST
/end MEASUREMENT
/begin MEASUREMENT afTARBON_S "Torque inter-system operation flag (vice-operation part)" UBYTE COMP_0283 1 100 0 1 BIT_MASK 0x0080 ECU_ADDRESS 0xFFFF435A /begin FUNCTION_LIST KF7-301.25P[5] /end FUNCTION_LIST /end MEASUREMENT
/begin MEASUREMENT fAPSDBLCA "APS the second-fold CA flag" UBYTE COMP_0283 1 100 0 1 BIT_MASK 0x0001 ECU_ADDRESS 0xFFFF435B
 /begin FUNCTION_LIST KF7-301.25M[5] KF7-301.25P[5] KF7-450.50[10] R000.1.RS_Integ_1_10_2 /end FUNCTION_LIST
/end MEASUREMENT
/begin MEASUREMENT fBRKSWCA1 "Brake SWCA1 flag" UBYTE COMP_0283 1 100 0 1 BIT_MASK 0x0004 ECU_ADDRESS 0xFFFF435D
 /begin FUNCTION_LIST KF7-301.25M[5] KF7-301.25P[5] KF7-450.50[10] R000.1.RS_Integ_1_10_2 /end FUNCTION_LIST
/end MEASUREMENT
/begin MEASUREMENT fBRKSWCA2 "Brake SWCA2 flag" UBYTE COMP_0283 1 100 0 1 BIT_MASK 0x0002 ECU_ADDRESS 0xFFFF435D
 /begin FUNCTION_LIST KF7-301.25M[5] KF7-301.25P[5] KF7-450.50[10] R000.1.RS_Integ_1_10_2 /end FUNCTION_LIST
/end MEASUREMENT
/begin MEASUREMENT fDTNG "A/T signal line condition" UBYTE COMP_0283 1 100 0 1 BIT_MASK 0x0002 ECU_ADDRESS 0xFFFF4363
 /begin FUNCTION_LIST KF7-303.1[14] KF7-312.6[34] KF7-340.11[4] KF7-340.13[4] KF7-360.9M[43] KF7-385.1[32] KF7-385.2[18] KF7-385.3[4] /end FUNCTION_LIST
/end MEASUREMENT
/begin MEASUREMENT fEEPRWNG "EEPROM NG condition flag" UBYTE COMP_0283 1 100 0 1 BIT_MASK 0x0001 ECU_ADDRESS 0xFFFF4363 /begin FUNCTION_LIST KF7-305.14[2] /end FUNCTION_LIST /end MEASUREMENT
/begin MEASUREMENT fETCFAIL "ETC fail flag" UBYTE COMP_0283 1 100 0 1 BIT_MASK 0x0010 ECU_ADDRESS 0xFFFF4364
 /begin FUNCTION_LIST KF7-301.25M[5] KF7-340.13[4] KF7-360.2[N] KF7-360.4[14] KF7-410.16M[1] KF7-450.50[10] KF7-505.15[4] KF7-505.34[3] R000.1.RS_Integ_1_10_2 R301.23.ADV_calculation_1_1_2 R902.2.DiagMiscell_1_3_5 /end FUNCTION_LIST
/end MEASUREMENT
/begin MEASUREMENT fTQARBTON "Torque inter-system operation flag" UBYTE COMP_0283 1 100 0 1 BIT_MASK 0x0002 ECU_ADDRESS 0xFFFF4369 /begin FUNCTION_LIST KF7-301.25M[5] R000.1.RS_Integ_1_10_2 R102.5M.ARBIT_1_1_0 /end FUNCTION_LIST /end MEASUREMENT
/begin MEASUREMENT fETCFAL_S "ETC fail flag (the sub-side)" UBYTE COMP_0283 1 100 0 1 BIT_MASK 0x0001 ECU_ADDRESS 0xFFFF436A
 /begin FUNCTION_LIST KF7-301.25P[5] KF7-360.2[N] KF7-360.4[14] KF7-505.34[3] KF7-525.2S[10] R000.1.RS_Integ_1_10_2 /end FUNCTION_LIST
/end MEASUREMENT
/begin MEASUREMENT fTARBON_S "Torque inter-system operation flag (vice-operation part)" UBYTE COMP_0283 1 100 0 1 BIT_MASK 0x0080 ECU_ADDRESS 0xFFFF436B /begin FUNCTION_LIST KF7-301.25P[5] R000.1.RS_Integ_1_10_2 R102.5P.ARBIT_1_0_2 /end FUNCTION_LIST /end MEASUREMENT
/begin MEASUREMENT wfFTROF "Output off condition flag" UBYTE COMP_0283 1 100 0 1 BIT_MASK 0x0080 ECU_ADDRESS 0xFFFF8A74 /begin FUNCTION_LIST KF7-304.7[1] /end FUNCTION_LIST /end MEASUREMENT
/begin MEASUREMENT fFTROF "Output off condition flag" UBYTE COMP_0283 1 100 0 1 BIT_MASK 0x0080 ECU_ADDRESS 0xFFFF8A75 /begin FUNCTION_LIST KF7-304.7[1] /end FUNCTION_LIST /end MEASUREMENT
/begin MEASUREMENT wfFADVVSP "Vehicle speed condition judgement flag" UBYTE COMP_0283 1 100 0 1 BIT_MASK 0x0080 ECU_ADDRESS 0xFFFF8A7C /begin FUNCTION_LIST KF7-303.1[14] KF7-330.3[6] KF7-390.3A[15] /end FUNCTION_LIST /end MEASUREMENT
/begin MEASUREMENT wfFISCVSP "Vehicle speed condition judgement flag" UBYTE COMP_0283 1 100 0 1 BIT_MASK 0x0040 ECU_ADDRESS 0xFFFF8A7C /begin FUNCTION_LIST KF7-303.1[14] KF7-330.3[6] KF7-376.2[21] /end FUNCTION_LIST /end MEASUREMENT
/begin MEASUREMENT fFADVVSP "Vehicle speed condition judgement flag" UBYTE COMP_0283 1 100 0 1 BIT_MASK 0x0080 ECU_ADDRESS 0xFFFF8A7D /begin FUNCTION_LIST KF7-303.1[14] KF7-330.3[6] KF7-390.3A[15] /end FUNCTION_LIST /end MEASUREMENT
/begin MEASUREMENT fFISCVSP "Vehicle speed condition judgement flag" UBYTE COMP_0283 1 100 0 1 BIT_MASK 0x0040 ECU_ADDRESS 0xFFFF8A7D /begin FUNCTION_LIST KF7-303.1[14] KF7-330.3[6] KF7-376.2[21] /end FUNCTION_LIST /end MEASUREMENT
/begin MEASUREMENT wfACSW "Air-conditioning SW" UBYTE COMP_0283 1 100 0 1 BIT_MASK 0x0080 ECU_ADDRESS 0xFFFF8A83 /begin FUNCTION_LIST KF7-302.6A[4] KF7-376.3[2] KF7-377.1A[19] /end FUNCTION_LIST /end MEASUREMENT
/begin MEASUREMENT wfBLFAN "Blower fan SW flag" UBYTE COMP_0283 1 100 0 1 BIT_MASK 0x0020 ECU_ADDRESS 0xFFFF8A83 /begin FUNCTION_LIST KF7-302.2M[3] KF7-330.5[53] KF7-580.1[8] /end FUNCTION_LIST /end MEASUREMENT
/begin MEASUREMENT wfBRKSW "Brake switch" UBYTE COMP_0283 1 100 0 1 BIT_MASK 0x0010 ECU_ADDRESS 0xFFFF8A83
 /begin FUNCTION_LIST KF7-301.25M[5] KF7-301.25P[5] KF7-302.19M[N] KF7-330.4A[53] KF7-340.15[3] KF7-360.4[14] KF7-385.1[32] KF7-450.19[4] KF7-450.50[10] KF7-500.7[12] KF7-505.27[4] KF7-505.49[3] KF7-525.2[6] KF7-580.1[8] /end FUNCTION_LIST
/end MEASUREMENT
/begin MEASUREMENT wfFRFOG "Front fog SW flag" UBYTE COMP_0283 1 100 0 1 BIT_MASK 0x0002 ECU_ADDRESS 0xFFFF8A83 /begin FUNCTION_LIST KF7-302.2M[3] KF7-330.5[53] KF7-580.1[8] /end FUNCTION_LIST /end MEASUREMENT
/begin MEASUREMENT wfLDHLH "Headlights (High) SW flag" UBYTE COMP_0283 1 100 0 1 BIT_MASK 0x0080 ECU_ADDRESS 0xFFFF8A84 /begin FUNCTION_LIST KF7-302.2M[3] KF7-330.5[53] KF7-580.1[8] /end FUNCTION_LIST /end MEASUREMENT
/begin MEASUREMENT wfLDHLL "Headlights (Low) SW flag" UBYTE COMP_0283 1 100 0 1 BIT_MASK 0x0040 ECU_ADDRESS 0xFFFF8A84 /begin FUNCTION_LIST KF7-302.2M[3] KF7-330.5[53] KF7-580.1[8] /end FUNCTION_LIST /end MEASUREMENT
/begin MEASUREMENT wfPOSLP "Position light SW flag" UBYTE COMP_0283 1 100 0 1 BIT_MASK 0x0002 ECU_ADDRESS 0xFFFF8A84 /begin FUNCTION_LIST KF7-302.2M[3] KF7-330.5[53] KF7-580.1[8] /end FUNCTION_LIST /end MEASUREMENT
/begin MEASUREMENT wfREDEF "Rear defogger SW flag" UBYTE COMP_0283 1 100 0 1 BIT_MASK 0x0080 ECU_ADDRESS 0xFFFF8A85 /begin FUNCTION_LIST KF7-302.2M[3] KF7-330.5[53] KF7-580.1[8] /end FUNCTION_LIST /end MEASUREMENT
/begin MEASUREMENT fACSW "Air-conditioning SW" UBYTE COMP_0283 1 100 0 1 BIT_MASK 0x0080 ECU_ADDRESS 0xFFFF8A86
 /begin FUNCTION_LIST KF7-302.6A[4] KF7-376.3[2] KF7-377.1A[19] R000.1.RS_Integ_1_10_2 R204.1.CanComm_1_9_2 R301.6.IscAirflow_1_4_5 R901.1.Diag_on_can_app_1_6_2 /end FUNCTION_LIST
/end MEASUREMENT
/begin MEASUREMENT fBLFAN "Blower fan SW flag" UBYTE COMP_0283 1 100 0 1 BIT_MASK 0x0020 ECU_ADDRESS 0xFFFF8A86 /begin FUNCTION_LIST KF7-302.2M[3] KF7-330.5[53] KF7-580.1[8] /end FUNCTION_LIST /end MEASUREMENT
/begin MEASUREMENT fBRKSW "Brake switch" UBYTE COMP_0283 1 100 0 1 BIT_MASK 0x0010 ECU_ADDRESS 0xFFFF8A86 DISPLAY_IDENTIFIER Vbx_cru_brk
 /begin FUNCTION_LIST KF7-301.25M[5] KF7-301.25P[5] KF7-302.19M[N] KF7-330.4A[53] KF7-340.15[3] KF7-360.4[14] KF7-385.1[32] KF7-410.3[N] KF7-450.19[4] KF7-450.50[10] KF7-500.7[12] KF7-505.27[4] KF7-505.49[3] KF7-525.2[6] KF7-580.1[8] R000.1.RS_Integ_1_10_2 R101.1M.aps_pedin_1_2_2 R101.1P.aps_pedin_1_1_2 R204.1.CanComm_1_9_2 R208.4.STFLW_1_2_2 R208.8.DACAX_1_1_5 R208.9.SAFETYX_1_3_2 R208.10.dgn_ccadd_1_3_2 R901.1.Diag_on_can_app_1_6_2 Rxxx.2.Integration_Diagnostic_cycle_1_1_1 /end FUNCTION_LIST
/end MEASUREMENT
/begin MEASUREMENT fFRFOG "Front fog SW flag" UBYTE COMP_0283 1 100 0 1 BIT_MASK 0x0002 ECU_ADDRESS 0xFFFF8A86 /begin FUNCTION_LIST KF7-302.2M[3] KF7-330.5[53] KF7-580.1[8] /end FUNCTION_LIST /end MEASUREMENT
/begin MEASUREMENT fLDHLH "Headlights (High) SW flag" UBYTE COMP_0283 1 100 0 1 BIT_MASK 0x0080 ECU_ADDRESS 0xFFFF8A87 /begin FUNCTION_LIST KF7-302.2M[3] KF7-330.5[53] KF7-580.1[8] /end FUNCTION_LIST /end MEASUREMENT
/begin MEASUREMENT fLDHLL "Headlights (Low) SW flag" UBYTE COMP_0283 1 100 0 1 BIT_MASK 0x0040 ECU_ADDRESS 0xFFFF8A87 /begin FUNCTION_LIST KF7-302.2M[3] KF7-330.5[53] KF7-580.1[8] /end FUNCTION_LIST /end MEASUREMENT
/begin MEASUREMENT fPOSLP "Position light SW flag" UBYTE COMP_0283 1 100 0 1 BIT_MASK 0x0002 ECU_ADDRESS 0xFFFF8A87 /begin FUNCTION_LIST KF7-302.2M[3] KF7-330.5[53] KF7-580.1[8] /end FUNCTION_LIST /end MEASUREMENT
/begin MEASUREMENT fREDEF "Rear defogger SW flag" UBYTE COMP_0283 1 100 0 1 BIT_MASK 0x0080 ECU_ADDRESS 0xFFFF8A88 /begin FUNCTION_LIST KF7-302.2M[3] KF7-330.5[53] KF7-580.1[8] /end FUNCTION_LIST /end MEASUREMENT
/begin MEASUREMENT wfACSWLU "An air-conditioning SW for lockup release" UBYTE COMP_0283 1 100 0 1 BIT_MASK 0x0080 ECU_ADDRESS 0xFFFF8A8F /begin FUNCTION_LIST KF7-302.6A[4] KF7-385.1[32] /end FUNCTION_LIST /end MEASUREMENT
/begin MEASUREMENT wfTPSTEND "TP initial tense completion flag" UBYTE COMP_0283 1 100 0 1 BIT_MASK 0x0008 ECU_ADDRESS 0xFFFF8A91 /begin FUNCTION_LIST KF7-304.2[21] /end FUNCTION_LIST /end MEASUREMENT
/begin MEASUREMENT wfTRANS "Steady state/transient state judgement flag" UBYTE COMP_0283 1 100 0 1 BIT_MASK 0x0004 ECU_ADDRESS 0xFFFF8A91 /begin FUNCTION_LIST KF7-304.2[21] /end FUNCTION_LIST /end MEASUREMENT
/begin MEASUREMENT wfIDLEPR_S "ASCD A former IDLE judgement flag to process" UBYTE COMP_0283 1 100 0 1 BIT_MASK 0x0002 ECU_ADDRESS 0xFFFF8A91 /begin FUNCTION_LIST KF7-301.25P[5] KF7-340.6M[2] KF7-340.6P[2] /end FUNCTION_LIST /end MEASUREMENT
/begin MEASUREMENT fACSWLU "An air-conditioning SW for lockup release" UBYTE COMP_0283 1 100 0 1 BIT_MASK 0x0080 ECU_ADDRESS 0xFFFF8A92
 /begin FUNCTION_LIST KF7-302.6A[4] KF7-385.1[32] R204.1.CanComm_1_9_2 R301.6.IscAirflow_1_4_5 /end FUNCTION_LIST
/end MEASUREMENT
/begin MEASUREMENT fTPSTEND "TP initial tense completion flag" UBYTE COMP_0283 1 100 0 1 BIT_MASK 0x0008 ECU_ADDRESS 0xFFFF8A94 /begin FUNCTION_LIST KF7-304.2[21] /end FUNCTION_LIST /end MEASUREMENT
/begin MEASUREMENT fTRANS "Steady state/transient state judgement flag" UBYTE COMP_0283 1 100 0 1 BIT_MASK 0x0004 ECU_ADDRESS 0xFFFF8A94 /begin FUNCTION_LIST KF7-304.2[21] /end FUNCTION_LIST /end MEASUREMENT
/begin MEASUREMENT fIDLEPR_S "ASCD A former idle flag to process" UBYTE COMP_0283 1 100 0 1 BIT_MASK 0x0002 ECU_ADDRESS 0xFFFF8A94
 /begin FUNCTION_LIST KF7-301.25P[5] KF7-340.6M[2] KF7-340.6P[2] R000.1.RS_Integ_1_10_2 /end FUNCTION_LIST
/end MEASUREMENT
/begin MEASUREMENT wfNEREF0 "The formation excuse of vNEREF0" UBYTE COMP_0283 1 100 0 1 BIT_MASK 0x0040 ECU_ADDRESS 0xFFFF8A95
 /begin FUNCTION_LIST KF7-303.6M[5] KF7-330.3[6] KF7-330.4A[53] KF7-330.5[53] KF7-350.1M[5] KF7-390.3A[15] /end FUNCTION_LIST
/end MEASUREMENT
/begin MEASUREMENT wfTREF1ST "REF periodic measuring start flag" UBYTE COMP_0283 1 100 0 1 BIT_MASK 0x0020 ECU_ADDRESS 0xFFFF8A95 /begin FUNCTION_LIST KF7-303.6M[5] KF7-320A.19[7] KF7-320A.21[N] /end FUNCTION_LIST /end MEASUREMENT
/begin MEASUREMENT fNEREF0 "The formation excuse of vNEREF0" UBYTE COMP_0283 1 100 0 1 BIT_MASK 0x0040 ECU_ADDRESS 0xFFFF8A96
 /begin FUNCTION_LIST KF7-303.6M[5] KF7-330.3[6] KF7-330.4A[53] KF7-330.5[53] KF7-350.1M[5] KF7-390.3A[15] /end FUNCTION_LIST
/end MEASUREMENT
/begin MEASUREMENT fTREF1ST "REF periodic measuring start flag" UBYTE COMP_0283 1 100 0 1 BIT_MASK 0x0020 ECU_ADDRESS 0xFFFF8A96 /begin FUNCTION_LIST KF7-303.6M[5] KF7-320A.19[7] KF7-320A.21[N] /end FUNCTION_LIST /end MEASUREMENT
/begin MEASUREMENT bfFLOCK "An urgent slowdown tense condition formation flag" UBYTE COMP_0283 1 100 0 1 BIT_MASK 0x0008 ECU_ADDRESS 0xFFFF2456
 /begin FUNCTION_LIST KF7-303.1[14] KF7-312.2A[16] KF7-312.4A[6] KF7-312.4C[4] KF7-312.6[34] KF7-385.1[32] /end FUNCTION_LIST
/end MEASUREMENT
/begin MEASUREMENT fBRKLUOF "An urgent brake slowdown judgement flag" UBYTE COMP_0283 1 100 0 1 BIT_MASK 0x0004 ECU_ADDRESS 0xFFFF2467 /begin FUNCTION_LIST KF7-303.1[14] KF7-385.1[32] /end FUNCTION_LIST /end MEASUREMENT
/begin MEASUREMENT fDYNDOWN "An urgent slowdown judgement flag" UBYTE COMP_0283 1 100 0 1 BIT_MASK 0x0004 ECU_ADDRESS 0xFFFF2470 /begin FUNCTION_LIST KF7-303.1[14] KF7-385.1[32] /end FUNCTION_LIST /end MEASUREMENT
/begin MEASUREMENT fISCLRC "Learning condition formation" UBYTE COMP_0283 1 100 0 1 BIT_MASK 0x0080 ECU_ADDRESS 0xFFFF2489 /begin FUNCTION_LIST KF7-305.1[7] KF7-580.1[8] /end FUNCTION_LIST /end MEASUREMENT
/begin MEASUREMENT fITANDM "ITAND map switching flag" UBYTE COMP_0283 1 100 0 1 BIT_MASK 0x0080 ECU_ADDRESS 0xFFFF24B1 /begin FUNCTION_LIST KF7-304.2[21] /end FUNCTION_LIST /end MEASUREMENT
/begin MEASUREMENT fOKURI "vOKURI attribute" UBYTE COMP_0283 1 100 0 1 BIT_MASK 0x0001 ECU_ADDRESS 0xFFFF24B3 /begin FUNCTION_LIST KF7-304.1B[5] /end FUNCTION_LIST /end MEASUREMENT
/begin MEASUREMENT fPBFSLH "Supercharge pressure sensor hysteresis judgement (Hi side)" UBYTE COMP_0283 1 100 0 1 BIT_MASK 0x0080 ECU_ADDRESS 0xFFFF24B4 /begin FUNCTION_LIST KF7-304.1B[5] /end FUNCTION_LIST /end MEASUREMENT
/begin MEASUREMENT fPBFSLL "Supercharge pressure sensor hysteresis judgement (LO side)" UBYTE COMP_0283 1 100 0 1 BIT_MASK 0x0040 ECU_ADDRESS 0xFFFF24B4 /begin FUNCTION_LIST KF7-304.1B[5] /end FUNCTION_LIST /end MEASUREMENT
/begin MEASUREMENT fQTCQ "QTC addition judgement Q hysteresis" UBYTE COMP_0283 1 100 0 1 BIT_MASK 0x0008 ECU_ADDRESS 0xFFFF24B4 /begin FUNCTION_LIST KF7-304.1B[5] /end FUNCTION_LIST /end MEASUREMENT
/begin MEASUREMENT fDTVOM "Slowdown judgement flag" UBYTE COMP_0283 1 100 0 1 BIT_MASK 0x0001 ECU_ADDRESS 0xFFFF24B6 /begin FUNCTION_LIST KF7-304.10[1] /end FUNCTION_LIST /end MEASUREMENT
/begin MEASUREMENT fDTVOP "Acceleration judgement flag" UBYTE COMP_0283 1 100 0 1 BIT_MASK 0x0080 ECU_ADDRESS 0xFFFF24B7
 /begin FUNCTION_LIST KF7-304.10[1] KF7-312.2A[16] KF7-320A.12[N] KF7-320A.13[N] KF7-320A.15[4] /end FUNCTION_LIST
/end MEASUREMENT
/begin MEASUREMENT fFBRKFS_M "Brake SW failsafe condition" UBYTE COMP_0283 1 100 0 1 BIT_MASK 0x0001 ECU_ADDRESS 0xFFFF24B7 /begin FUNCTION_LIST KF7-301.25M[5] KF7-301.25P[5] KF7-450.19[4] /end FUNCTION_LIST /end MEASUREMENT
/begin MEASUREMENT fISFLTW "A control prohibition coolant temperature hysteresis flag by the cylinder" UBYTE COMP_0283 1 100 0 1 BIT_MASK 0x0004 ECU_ADDRESS 0xFFFF24BA /begin FUNCTION_LIST KF7-304.3[2] /end FUNCTION_LIST /end MEASUREMENT
/begin MEASUREMENT fNTPSEL "KNRPMQs are KNRPM and a FNLOW switching hysteresis flag." UBYTE COMP_0283 1 100 0 1 BIT_MASK 0x0002 ECU_ADDRESS 0xFFFF24BB /begin FUNCTION_LIST KF7-303.6M[5] /end FUNCTION_LIST /end MEASUREMENT
/begin MEASUREMENT fPPSVHYS "So far, P/S SW on equivalent judgement voltage hysteresis flag" UBYTE COMP_0283 1 100 0 1 BIT_MASK 0x0004 ECU_ADDRESS 0xFFFF24BC /begin FUNCTION_LIST KF7-301.28[2] /end FUNCTION_LIST /end MEASUREMENT
/begin MEASUREMENT afACCUT "Air-conditioning cut control executive flag" UBYTE COMP_0283 1 100 0 1 BIT_MASK 0x0080 ECU_ADDRESS 0xFFFF24C6 /begin FUNCTION_LIST KF7-302.6A[4] KF7-376.1[6] KF7-376.2[21] KF7-376.3[2] /end FUNCTION_LIST /end MEASUREMENT
/begin MEASUREMENT fACCUT "Air-conditioning cut control executive flag" UBYTE COMP_0283 1 100 0 1 BIT_MASK 0x0080 ECU_ADDRESS 0xFFFF24C7
 /begin FUNCTION_LIST KF7-302.6A[4] KF7-376.1[6] KF7-376.2[21] KF7-376.3[2] R301.6.IscAirflow_1_4_5 /end FUNCTION_LIST
/end MEASUREMENT
/begin MEASUREMENT afAPS1SEL "APS1 sensor normality judgement flag (MAIN)" UBYTE COMP_0283 1 100 0 1 BIT_MASK 0x0010 ECU_ADDRESS 0xFFFF24CD /begin FUNCTION_LIST KF7-301.25M[5] KF7-301.25P[5] KF7-450.50[10] /end FUNCTION_LIST /end MEASUREMENT
/begin MEASUREMENT afAPS2SEL "APS2 sensor normality judgement flag (MAIN)" UBYTE COMP_0283 1 100 0 1 BIT_MASK 0x0008 ECU_ADDRESS 0xFFFF24CD /begin FUNCTION_LIST KF7-301.25M[5] KF7-301.25P[5] KF7-450.50[10] /end FUNCTION_LIST /end MEASUREMENT
/begin MEASUREMENT afAPSSNG "APS Single trouble judgement flag (MAIN)" UBYTE COMP_0283 1 100 0 1 BIT_MASK 0x0004 ECU_ADDRESS 0xFFFF24CD
 /begin FUNCTION_LIST KF7-301.25M[5] KF7-301.25P[5] KF7-340.1M[8] KF7-340.13[4] KF7-350.1M[5] KF7-350.1P[4] KF7-350.4M[14] KF7-350.4P[13] KF7-360.4[14] KF7-450.50[10] /end FUNCTION_LIST
/end MEASUREMENT
/begin MEASUREMENT afTPS1SEL "TPS1 sensor normality judgement flag (MAIN)" UBYTE COMP_0283 1 100 0 1 BIT_MASK 0x0001 ECU_ADDRESS 0xFFFF24D1 /begin FUNCTION_LIST KF7-301.25P[5] KF7-450.50[10] /end FUNCTION_LIST /end MEASUREMENT
/begin MEASUREMENT afTPS2SEL "TPS2 sensor normality judgement flag (MAIN)" UBYTE COMP_0283 1 100 0 1 BIT_MASK 0x0080 ECU_ADDRESS 0xFFFF24D2 /begin FUNCTION_LIST KF7-301.25M[5] KF7-450.50[10] /end FUNCTION_LIST /end MEASUREMENT
/begin MEASUREMENT fAPS1SEL "APS1 sensor normality judgement flag (MAIN)" UBYTE COMP_0283 1 100 0 1 BIT_MASK 0x0010 ECU_ADDRESS 0xFFFF24D4
 /begin FUNCTION_LIST KF7-301.25M[5] KF7-301.25P[5] KF7-450.50[10] R000.1.RS_Integ_1_10_2 /end FUNCTION_LIST
/end MEASUREMENT
/begin MEASUREMENT fAPS2SEL "APS2 sensor normality judgement flag (MAIN)" UBYTE COMP_0283 1 100 0 1 BIT_MASK 0x0008 ECU_ADDRESS 0xFFFF24D4
 /begin FUNCTION_LIST KF7-301.25M[5] KF7-301.25P[5] KF7-450.50[10] R000.1.RS_Integ_1_10_2 /end FUNCTION_LIST
/end MEASUREMENT
/begin MEASUREMENT fAPSSNG "APS Single trouble judgement flag (MAIN)" UBYTE COMP_0283 1 100 0 1 BIT_MASK 0x0004 ECU_ADDRESS 0xFFFF24D4
 /begin FUNCTION_LIST KF7-301.25M[5] KF7-301.25P[5] KF7-340.1M[8] KF7-340.13[4] KF7-350.1M[5] KF7-350.1P[4] KF7-350.4M[14] KF7-350.4P[13] KF7-360.4[14] KF7-410.16M[1] KF7-450.50[10] R000.1.RS_Integ_1_10_2 R101.1M.aps_pedin_1_2_2 R101.1P.aps_pedin_1_1_2 /end FUNCTION_LIST
/end MEASUREMENT
/begin MEASUREMENT fTPS1SEL "TPS1 sensor normality judgement flag (MAIN)" UBYTE COMP_0283 1 100 0 1 BIT_MASK 0x0001 ECU_ADDRESS 0xFFFF24D8 /begin FUNCTION_LIST KF7-301.25P[5] KF7-450.50[10] R000.1.RS_Integ_1_10_2 /end FUNCTION_LIST /end MEASUREMENT
/begin MEASUREMENT fTPS2SEL "TPS2 sensor normality judgement flag (MAIN)" UBYTE COMP_0283 1 100 0 1 BIT_MASK 0x0080 ECU_ADDRESS 0xFFFF24D9 /begin FUNCTION_LIST KF7-301.25M[5] KF7-450.50[10] R000.1.RS_Integ_1_10_2 /end FUNCTION_LIST /end MEASUREMENT
/begin MEASUREMENT fBASPCV "Reference pressure BASPCV renewal flag" UBYTE COMP_0283 1 100 0 1 BIT_MASK 0x0040 ECU_ADDRESS 0xFFFFB7DC /begin FUNCTION_LIST KF7-305.4BM[31] KF7-500.30[8] R000.4.EepAlloc_1_2_2 /end FUNCTION_LIST /end MEASUREMENT
/begin MEASUREMENT fBASPCVST "Reference pressure BASPCV renewal flag" UBYTE COMP_0283 1 100 0 1 BIT_MASK 0x0020 ECU_ADDRESS 0xFFFFB7DC /begin FUNCTION_LIST KF7-305.4BM[31] KF7-500.30[8] R000.4.EepAlloc_1_2_2 /end FUNCTION_LIST /end MEASUREMENT
/begin MEASUREMENT fEEPWRITE "During writing, flag" UBYTE COMP_0283 1 100 0 1 BIT_MASK 0x0001 ECU_ADDRESS 0xFFFFB7DC
 /begin FUNCTION_LIST KF7-305.1[7] KF7-305.4AM[10] KF7-305.4BM[31] KF7-505.22[3] R000.4.EepAlloc_1_2_2 /end FUNCTION_LIST
/end MEASUREMENT
/begin MEASUREMENT fEWTEND "After EEPROM writing, WAIT flag" UBYTE COMP_0283 1 100 0 1 BIT_MASK 0x0040 ECU_ADDRESS 0xFFFFB7DD /begin FUNCTION_LIST KF7-305.4AM[10] /end FUNCTION_LIST /end MEASUREMENT
/begin MEASUREMENT fFACTAS "Rapid TAS learning experience flag" UBYTE COMP_0283 1 100 0 1 BIT_MASK 0x0010 ECU_ADDRESS 0xFFFFB7DD
 /begin FUNCTION_LIST KF7-305.4BM[31] KF7-351.1[16] KF7-580.1[8] R000.4.EepAlloc_1_2_2 /end FUNCTION_LIST
/end MEASUREMENT
/begin MEASUREMENT fFPRINJ "At the time of the start, fuel spare injection control completion judgement flag" UBYTE COMP_0283 1 100 0 1 BIT_MASK 0x0020 ECU_ADDRESS 0xFFFFB7DF /begin FUNCTION_LIST KF7-305.4BM[31] KF7-311.1A[21] R000.4.EepAlloc_1_2_2 /end FUNCTION_LIST /end MEASUREMENT
/begin MEASUREMENT fINITBURAM "Backup RAM initialization flag" UBYTE COMP_0283 1 100 0 1 BIT_MASK 0x0020 ECU_ADDRESS 0xFFFFB7E0 /begin FUNCTION_LIST KF7-305.4AM[10] KF7-305.14[2] /end FUNCTION_LIST /end MEASUREMENT
/begin MEASUREMENT fBRAMNG "Backup RAM NG judgement" UBYTE COMP_0283 1 100 0 1 BIT_MASK 0x0080 ECU_ADDRESS 0xFFFFB7E5 /begin FUNCTION_LIST KF7-305.1[7] /end FUNCTION_LIST /end MEASUREMENT
/begin MEASUREMENT fFPRESNG "Absolute pressure sensor NG flag" UBYTE COMP_0283 1 100 0 1 BIT_MASK 0x0008 ECU_ADDRESS 0xFFFFB7E6 /begin FUNCTION_LIST KF7-305.4BM[31] R000.4.EepAlloc_1_2_2 /end FUNCTION_LIST /end MEASUREMENT
/begin MEASUREMENT fWDTNG_M "WDT function diagnosis" UBYTE COMP_0283 1 100 0 1 BIT_MASK 0x0008 ECU_ADDRESS 0xFFFFB7E7 /begin FUNCTION_LIST KF7-305.4BM[31] KF7-505.18[3] R000.4.EepAlloc_1_2_2 /end FUNCTION_LIST /end MEASUREMENT
/begin MEASUREMENT tSTOFFTSF "Starter switch on continuation time upper limit" UBYTE COMP_0202_S 1 100 0 255 ECU_ADDRESS 0xFFFF44C2 /begin FUNCTION_LIST KF7-302.4MA[13] /end FUNCTION_LIST /end MEASUREMENT
/begin MEASUREMENT tTMFPON "The first fuel pump on time" UBYTE COMP_0202_S 1 100 0 255 ECU_ADDRESS 0xFFFF451D /begin FUNCTION_LIST KF7-305.4BM[31] KF7-311.1A[21] KF7-373.1[1] /end FUNCTION_LIST /end MEASUREMENT
/begin MEASUREMENT tTNHOJI "At the time of the hard cranking, starter switch on continuation time" UBYTE COMP_0202_S 1 100 0 255 ECU_ADDRESS 0xFFFF453F /begin FUNCTION_LIST KF7-302.4MA[13] /end FUNCTION_LIST /end MEASUREMENT
/begin MEASUREMENT tTPIHT "At the time of the start, TP maintenance time" UBYTE COMP_0202_S 1 100 0 255 ECU_ADDRESS 0xFFFF4547 /begin FUNCTION_LIST KF7-304.2[21] /end FUNCTION_LIST /end MEASUREMENT
/begin MEASUREMENT tVSPASCD2 "ASCD vehicle speed progress timer" UBYTE COMP_0202_S 1 100 0 255 ECU_ADDRESS 0xFFFF4570 /begin FUNCTION_LIST KF7-303.1[14] /end FUNCTION_LIST /end MEASUREMENT
/begin MEASUREMENT tTNZERO "KNRPM continuation time" UBYTE COMP_0203_S 1 100 0 255 ECU_ADDRESS 0xFFFF466C /begin FUNCTION_LIST KF7-302.4MA[13] /end FUNCTION_LIST /end MEASUREMENT
/begin MEASUREMENT tSTONLIMT "Starter switch on continuation time upper limit" UBYTE COMP_0201_S 1 100 0 255 ECU_ADDRESS 0xFFFF24FC /begin FUNCTION_LIST KF7-302.4MA[13] /end FUNCTION_LIST /end MEASUREMENT
/begin MEASUREMENT tCRMODLY "Parameter monitor permission delay time" UBYTE COMP_0202_S 1 100 0 255 ECU_ADDRESS 0xFFFF2531 /begin FUNCTION_LIST KF7-303.5A[9] /end FUNCTION_LIST /end MEASUREMENT
/begin MEASUREMENT tPREDLY "A timer for the estimated cylinder distinction rotation delay" UBYTE COMP_0202_S 1 100 0 255 ECU_ADDRESS 0xFFFF257F /begin FUNCTION_LIST KF7-303.5A[9] KF7-450.9A[5] /end FUNCTION_LIST /end MEASUREMENT
/begin MEASUREMENT tTATDN "D- >N switching delay table" UBYTE COMP_0202_S 1 100 0 255 ECU_ADDRESS 0xFFFF2592 /begin FUNCTION_LIST KF7-302.5M[10] /end FUNCTION_LIST /end MEASUREMENT
/begin MEASUREMENT tTATND "N- >D switching delay table" UBYTE COMP_0202_S 1 100 0 255 ECU_ADDRESS 0xFFFF2593 /begin FUNCTION_LIST KF7-302.5M[10] /end FUNCTION_LIST /end MEASUREMENT
/begin MEASUREMENT tTIMEST "ST/SW After off, time" UBYTE COMP_0202_S 1 100 0 255 ECU_ADDRESS 0xFFFF259D /begin FUNCTION_LIST KF7-304.2[21] /end FUNCTION_LIST /end MEASUREMENT
/begin MEASUREMENT tTKTDN "D- >N switching delay timer" UBYTE COMP_0202_S 1 100 0 255 ECU_ADDRESS 0xFFFF25A0 /begin FUNCTION_LIST KF7-302.5M[10] /end FUNCTION_LIST /end MEASUREMENT
/begin MEASUREMENT tTKTND "N- >D switching delay timer" UBYTE COMP_0202_S 1 100 0 255 ECU_ADDRESS 0xFFFF25A1 /begin FUNCTION_LIST KF7-302.5M[10] /end FUNCTION_LIST /end MEASUREMENT
/begin MEASUREMENT tTRSDLY "After the transient state judgement, delay timer" UBYTE COMP_0202_S 1 100 0 255 ECU_ADDRESS 0xFFFF25B6 /begin FUNCTION_LIST KF7-304.2[21] /end FUNCTION_LIST /end MEASUREMENT
/begin MEASUREMENT tDLNEMSK "DLTNE non-operation time" UBYTE COMP_0203_S 1 100 0 255 ECU_ADDRESS 0xFFFF25E2 /begin FUNCTION_LIST KF7-303.6M[5] /end FUNCTION_LIST /end MEASUREMENT
/begin MEASUREMENT tKNRPM "A timer for the engine speed un-adjustment diagnosis" UBYTE COMP_0203_S 1 100 0 255 ECU_ADDRESS 0xFFFF2609
 /begin FUNCTION_LIST KF7-302.4MA[13] KF7-303.6M[5] KF7-304.2[21] KF7-305.7[6] KF7-500.26[17] /end FUNCTION_LIST
/end MEASUREMENT
/begin MEASUREMENT tLOCKDY "An urgent slowdown judgement clear delay" UBYTE COMP_0203_S 1 100 0 255 ECU_ADDRESS 0xFFFF260B /begin FUNCTION_LIST KF7-303.1[14] KF7-385.1[32] /end FUNCTION_LIST /end MEASUREMENT
/begin MEASUREMENT tLUOFDY "A/C It waits for lockup release at the time of on, delay timer" UBYTE COMP_0203_S 1 100 0 255 ECU_ADDRESS 0xFFFF260C /begin FUNCTION_LIST KF7-302.6A[4] /end FUNCTION_LIST /end MEASUREMENT
/begin MEASUREMENT tMMTQUPTM "M mode rotation synchronous control operation timer" UBYTE COMP_0203_S 1 100 0 255 ECU_ADDRESS 0xFFFF2612
 /begin FUNCTION_LIST KF7-301.25M[5] KF7-301.25P[5] KF7-312.6[34] KF7-340.1M[8] KF7-340.1P[7] KF7-360.9M[43] R301.20.AmbientComp_1_0_2 /end FUNCTION_LIST
/end MEASUREMENT
/begin MEASUREMENT tPAKANJI "Misfire (unsuccessful starting) avoidance time" UBYTE COMP_0203_S 1 100 0 255 ECU_ADDRESS 0xFFFF261D /begin FUNCTION_LIST KF7-302.4MA[13] /end FUNCTION_LIST /end MEASUREMENT
/begin MEASUREMENT tSTOFFT "Initial judgement time" UBYTE COMP_0203_S 1 100 0 255 ECU_ADDRESS 0xFFFF2641 /begin FUNCTION_LIST KF7-302.4MA[13] /end FUNCTION_LIST /end MEASUREMENT
/begin MEASUREMENT tTATDN1 "D- >N switching delay timer" UBYTE COMP_0203_S 1 100 0 255 ECU_ADDRESS 0xFFFF2646 /begin FUNCTION_LIST KF7-302.5M[10] /end FUNCTION_LIST /end MEASUREMENT
/begin MEASUREMENT tTATND1 "N- >D switching delay timer" UBYTE COMP_0203_S 1 100 0 255 ECU_ADDRESS 0xFFFF2647 /begin FUNCTION_LIST KF7-302.5M[10] /end FUNCTION_LIST /end MEASUREMENT
/begin MEASUREMENT tTMLUBRK "An urgent brake slowdown judgement delay timer" UBYTE COMP_0203_S 1 100 0 255 ECU_ADDRESS 0xFFFF2661 /begin FUNCTION_LIST KF7-303.1[14] /end FUNCTION_LIST /end MEASUREMENT
/begin MEASUREMENT avADVADJ "ADV adjustment value" SBYTE COMP_0018 1 100 -128 127 ECU_ADDRESS 0xFFFFB680 /begin FUNCTION_LIST KF7-305.4AM[10] KF7-320A.3[N] KF7-320A.4[6] KF7-580.1[8] /end FUNCTION_LIST /end MEASUREMENT
/begin MEASUREMENT avCATCNT1 "Backup RAM RATE law catalyst diagnosis complete number of times counter bank 1" UWORD COMP_0016 1 100 0 65535 ECU_ADDRESS 0xFFFFB684 /begin FUNCTION_LIST KF7-305.4BM[31] KF7-500.21[19] /end FUNCTION_LIST /end MEASUREMENT
/begin MEASUREMENT avCATCNT2 "Backup RAM RATE law catalyst diagnosis complete number of times counter bank 2" UWORD COMP_0016 1 100 0 65535 ECU_ADDRESS 0xFFFFB686 /begin FUNCTION_LIST KF7-305.4BM[31] KF7-500.21[19] /end FUNCTION_LIST /end MEASUREMENT
/begin MEASUREMENT avCATTRP "A trip counter for the backup RAM RATE law catalyst diagnosis" UWORD COMP_0016 1 100 0 65535 ECU_ADDRESS 0xFFFFB688 /begin FUNCTION_LIST KF7-305.4BM[31] /end FUNCTION_LIST /end MEASUREMENT
/begin MEASUREMENT avCONQA "CO adjustment value" SBYTE COMP_0000_S 1 100 -128 127 ECU_ADDRESS 0xFFFFB691 /begin FUNCTION_LIST KF7-304.1B[5] KF7-580.1[8] /end FUNCTION_LIST /end MEASUREMENT
/begin MEASUREMENT avCONSOMUX "The amount of integration fuel consumption for the CAN transmission" UBYTE COMP_0031_S 1 100 0 20400 ECU_ADDRESS 0xFFFF2305 /begin FUNCTION_LIST KF7-305.7[6] /end FUNCTION_LIST /end MEASUREMENT
/begin MEASUREMENT avCUMCONSY "IT MASTER is turned, the amount of integration fuel consumption" UWORD COMP_0034_S 1 100 0 20479.6875 ECU_ADDRESS 0xFFFF231E /begin FUNCTION_LIST KF7-305.7[6] /end FUNCTION_LIST /end MEASUREMENT
/begin MEASUREMENT avDCTCNT1 "A/F sensor (O2 sensor) breakage diagnosis complete number of times counter bank 1" UWORD COMP_0016 1 100 0 65535 ECU_ADDRESS 0xFFFFB698 /begin FUNCTION_LIST KF7-305.4BM[31] KF7-500.76[8] /end FUNCTION_LIST /end MEASUREMENT
/begin MEASUREMENT avDCTCNT2 "A/F sensor (O2 sensor) breakage diagnosis complete number of times counter bank 2" UWORD COMP_0016 1 100 0 65535 ECU_ADDRESS 0xFFFFB69A /begin FUNCTION_LIST KF7-305.4BM[31] KF7-500.76[8] /end FUNCTION_LIST /end MEASUREMENT
/begin MEASUREMENT avDCTTRP "A trip counter for the A/F sensor (O2 sensor) breakage diagnosis" UWORD COMP_0016 1 100 0 65535 ECU_ADDRESS 0xFFFFB69C /begin FUNCTION_LIST KF7-305.4BM[31] /end FUNCTION_LIST /end MEASUREMENT
/begin MEASUREMENT avEGRACNT "Backup RAM RATE law VTC alignment check diagnosis complete number of times counter" UWORD COMP_0016 1 100 0 65535 ECU_ADDRESS 0xFFFFB6A2 /begin FUNCTION_LIST KF7-305.4BM[31] KF7-500.6D[9] KF7-500.47B[15] /end FUNCTION_LIST /end MEASUREMENT
/begin MEASUREMENT avEGRATRP "A trip counter for the backup RAM RATE law VTC alignment check diagnosis" UWORD COMP_0016 1 100 0 65535 ECU_ADDRESS 0xFFFFB6A4 /begin FUNCTION_LIST KF7-305.4BM[31] /end FUNCTION_LIST /end MEASUREMENT
/begin MEASUREMENT avEGRBCNT "Backup RAM RATE law VTC drive abnormality diagnosis complete number of times counter" UWORD COMP_0016 1 100 0 65535 ECU_ADDRESS 0xFFFFB6A6 /begin FUNCTION_LIST KF7-305.4BM[31] KF7-500.47B[15] /end FUNCTION_LIST /end MEASUREMENT
/begin MEASUREMENT avEGRBTRP "A trip counter for the backup RAM RATE law VTC drive abnormality diagnosis" UWORD COMP_0016 1 100 0 65535 ECU_ADDRESS 0xFFFFB6A8 /begin FUNCTION_LIST KF7-305.4BM[31] /end FUNCTION_LIST /end MEASUREMENT
/begin MEASUREMENT avEGRCCNT "Backup RAM RATE law EGR close diagnosis complete number of times count" UWORD COMP_0016 1 100 0 65535 ECU_ADDRESS 0xFFFFB6AA /begin FUNCTION_LIST KF7-305.4BM[31] /end FUNCTION_LIST /end MEASUREMENT
/begin MEASUREMENT avEGRTRP "A trip count for the backup RAM RATE law EGR close diagnosis" UWORD COMP_0016 1 100 0 65535 ECU_ADDRESS 0xFFFFB6AC /begin FUNCTION_LIST KF7-305.4BM[31] /end FUNCTION_LIST /end MEASUREMENT
/begin MEASUREMENT avGCVN "ECM CVN value (after North America 2005MY)" UBYTE COMP_0068 1 100 0 255 ECU_ADDRESS 0xFFFFB6DF /begin FUNCTION_LIST KF7-305.4AM[10] /end FUNCTION_LIST /end MEASUREMENT
/begin MEASUREMENT avGCVN_R#1 "ECM CVN value (after North America 2005MY)" UBYTE COMP_0068 1 100 0 255 ECU_ADDRESS 0xFFFFB6DF /begin FUNCTION_LIST KF7-305.4AM[10] /end FUNCTION_LIST /end MEASUREMENT
/begin MEASUREMENT avGCVN_R#2 "ECM CVN value (after North America 2005MY)" UBYTE COMP_0068 1 100 0 255 ECU_ADDRESS 0xFFFFB6E0 /begin FUNCTION_LIST KF7-305.4AM[10] /end FUNCTION_LIST /end MEASUREMENT
/begin MEASUREMENT avGCVN_R#3 "ECM CVN value (after North America 2005MY)" UBYTE COMP_0068 1 100 0 255 ECU_ADDRESS 0xFFFFB6E1 /begin FUNCTION_LIST KF7-305.4AM[10] /end FUNCTION_LIST /end MEASUREMENT
/begin MEASUREMENT avGCVN_R#4 "ECM CVN value (after North America 2005MY)" UBYTE COMP_0068 1 100 0 255 ECU_ADDRESS 0xFFFFB6E2 /begin FUNCTION_LIST KF7-305.4AM[10] /end FUNCTION_LIST /end MEASUREMENT
/begin MEASUREMENT avGNRTRP "ÉWÉFÉlÉâÉãÉgÉäÉbÉv" UWORD COMP_0016 1 100 0 65535 ECU_ADDRESS 0xFFFFB6EA /begin FUNCTION_LIST KF7-305.4BM[31] /end FUNCTION_LIST /end MEASUREMENT
/begin MEASUREMENT avISCLRCB "Idle speed learning value" SWORD COMP_0277 1 100 -32768 32767 ECU_ADDRESS 0xFFFFB6F4
 /begin FUNCTION_LIST KF7-305.4AM[10] KF7-305.4BM[31] KF7-330.5[53] KF7-351.1[16] KF7-351.2[17] /end FUNCTION_LIST
/end MEASUREMENT
/begin MEASUREMENT avLEAKCNT "Backup RAM RATE law 0.02. evapo leak diagnosis complete number of times counter" UWORD COMP_0016 1 100 0 65535 ECU_ADDRESS 0xFFFFB6F6 /begin FUNCTION_LIST KF7-305.4BM[31] KF7-500.1[54] /end FUNCTION_LIST /end MEASUREMENT
/begin MEASUREMENT avLEAKTRP "Backup RAM RATE law 0.020 a trip counter for the evapo leak diagnosis" UWORD COMP_0016 1 100 0 65535 ECU_ADDRESS 0xFFFFB6F8 /begin FUNCTION_LIST KF7-305.4BM[31] /end FUNCTION_LIST /end MEASUREMENT
/begin MEASUREMENT avNSET4 "NSET lower limit adjustment value" UBYTE COMP_0006 1 100 0 3187.5 ECU_ADDRESS 0xFFFFB704 /begin FUNCTION_LIST KF7-305.4AM[10] KF7-330.4A[53] KF7-580.1[8] /end FUNCTION_LIST /end MEASUREMENT
/begin MEASUREMENT avPARGEQA "Purge inhalation air quantity index number" UWORD COMP_0068 1 100 0 65535 ECU_ADDRESS 0xFFFF233E /begin FUNCTION_LIST KF7-304.1B[5] KF7-371.1E[15] KF7-500.8[5] KF7-500.60[5] /end FUNCTION_LIST /end MEASUREMENT
/begin MEASUREMENT avRATECNT1 "A/F sensor response deterioration diagnosis (an active form) complete number of times counter bank 1" UWORD COMP_0016 1 100 0 65535 ECU_ADDRESS 0xFFFFB708 /begin FUNCTION_LIST KF7-305.4BM[31] KF7-313C.1[36] /end FUNCTION_LIST /end MEASUREMENT
/begin MEASUREMENT avRATECNT2 "A/F sensor response deterioration diagnosis (an active form) complete number of times counter bank 2" UWORD COMP_0016 1 100 0 65535 ECU_ADDRESS 0xFFFFB70A /begin FUNCTION_LIST KF7-305.4BM[31] KF7-313C.1[36] /end FUNCTION_LIST /end MEASUREMENT
/begin MEASUREMENT avRESCNT1 "A/F sensor (O2 sensor) response deterioration diagnosis complete number of times counter bank 1" UWORD COMP_0016 1 100 0 65535 ECU_ADDRESS 0xFFFFB70C /begin FUNCTION_LIST KF7-305.4BM[31] KF7-500.74[11] /end FUNCTION_LIST /end MEASUREMENT
/begin MEASUREMENT avRESCNT2 "A/F sensor (O2 sensor) response deterioration diagnosis complete number of times counter bank 2" UWORD COMP_0016 1 100 0 65535 ECU_ADDRESS 0xFFFFB70E /begin FUNCTION_LIST KF7-305.4BM[31] KF7-500.74[11] /end FUNCTION_LIST /end MEASUREMENT
/begin MEASUREMENT avRESCNTR2 "A/F sensor response diagnosis complete number of times counter bank 2 (rich lean)" UWORD COMP_0016 1 100 0 65535 ECU_ADDRESS 0xFFFFB710 /begin FUNCTION_LIST KF7-305.4BM[31] KF7-500.74[11] /end FUNCTION_LIST /end MEASUREMENT
/begin MEASUREMENT avRESTRP "A trip counter for the A/F sensor (O2 sensor) response deterioration diagnosis" UWORD COMP_0016 1 100 0 65535 ECU_ADDRESS 0xFFFFB712 /begin FUNCTION_LIST KF7-305.4BM[31] KF7-500.74[11] /end FUNCTION_LIST /end MEASUREMENT
/begin MEASUREMENT avRESTRP2 "A trip counter for the A/F sensor response deterioration diagnosis (Form.)" UWORD COMP_0016 1 100 0 65535 ECU_ADDRESS 0xFFFFB714 /begin FUNCTION_LIST KF7-305.4BM[31] /end FUNCTION_LIST /end MEASUREMENT
/begin MEASUREMENT avSTTCNT "An initial number of times counter" UWORD COMP_0016 1 100 0 65535 ECU_ADDRESS 0xFFFFB71C /begin FUNCTION_LIST KF7-305.4BM[31] /end FUNCTION_LIST /end MEASUREMENT
/begin MEASUREMENT avTDWLL "Energizing angle" UBYTE COMP_0017 1 100 0 255 ECU_ADDRESS 0xFFFF235A /begin FUNCTION_LIST KF7-303.5A[9] KF7-320A.6[3] KF7-320A.21[N] /end FUNCTION_LIST /end MEASUREMENT
/begin MEASUREMENT avUBNCNT1 "The voltage diagnosis complete number of times counter bank 1 whose A/F sensor (O2 sensor) is unusual" UWORD COMP_0016 1 100 0 65535 ECU_ADDRESS 0xFFFFB71E /begin FUNCTION_LIST KF7-305.4BM[31] KF7-500.74[11] /end FUNCTION_LIST /end MEASUREMENT
/begin MEASUREMENT avUBNCNT2 "The voltage diagnosis complete number of times counter bank 2 whose A/F sensor (O2 sensor) is unusual" UWORD COMP_0016 1 100 0 65535 ECU_ADDRESS 0xFFFFB720 /begin FUNCTION_LIST KF7-305.4BM[31] KF7-500.74[11] /end FUNCTION_LIST /end MEASUREMENT
/begin MEASUREMENT avUBNTRP "The trip counter for the voltage diagnosis whose A/F sensor (O2 sensor) is unusual" UWORD COMP_0016 1 100 0 65535 ECU_ADDRESS 0xFFFFB722 /begin FUNCTION_LIST KF7-305.4BM[31] /end FUNCTION_LIST /end MEASUREMENT
/begin MEASUREMENT avVSPASCD2 "In front of the limiter, a vehicle speed for ASCD" SLONG COMP_0001_S 1 100 -1842.540969984 1842.540969126 ECU_ADDRESS 0xFFFF41A4 /begin FUNCTION_LIST KF7-303.1[14] /end FUNCTION_LIST /end MEASUREMENT
/begin MEASUREMENT bvALPHA "Air-fuel ratio fF/B compensation coefficient" UWORD COMP_0031 1 100 0 255.99609375 ECU_ADDRESS 0xFFFF22A0
 /begin FUNCTION_LIST KF7-305.7[6] KF7-312.1C[N] KF7-312.3A[27] KF7-313C.1[36] KF7-313C.4[3] KF7-313C.5[3] KF7-313C.9[3] KF7-313C.11B[1] KF7-314.1F[1] KF7-371.1E[15] KF7-410.12[2] KF7-450.50[10] KF7-460.1[6] KF7-500.1[54] KF7-500.20B[4] KF7-500.21[19] KF7-500.24[10] KF7-525.2[6] KF7-580.1[8] R901.1.Diag_on_can_app_1_6_2 R904.1.Gst_on_can_1_0_1 /end FUNCTION_LIST
/end MEASUREMENT
/begin MEASUREMENT bvALPHA_R#1 "Air-fuel ratio fF/B compensation coefficient" UWORD COMP_0031 1 100 0 255.99609375 ECU_ADDRESS 0xFFFF22A0
 /begin FUNCTION_LIST KF7-305.7[6] KF7-312.1C[N] KF7-312.3A[27] KF7-313C.1[36] KF7-313C.4[3] KF7-313C.5[3] KF7-313C.9[3] KF7-313C.11B[1] KF7-314.1F[1] KF7-371.1E[15] KF7-410.12[2] KF7-450.50[10] KF7-460.1[6] KF7-500.1[54] KF7-500.20B[4] KF7-500.21[19] KF7-500.24[10] KF7-525.2[6] KF7-580.1[8] R901.1.Diag_on_can_app_1_6_2 R904.1.Gst_on_can_1_0_1 /end FUNCTION_LIST
/end MEASUREMENT
/begin MEASUREMENT bvALPHA_R#2 "Air-fuel ratio fF/B compensation coefficient" UWORD COMP_0031 1 100 0 255.99609375 ECU_ADDRESS 0xFFFF22A2
 /begin FUNCTION_LIST KF7-305.7[6] KF7-312.1C[N] KF7-312.3A[27] KF7-313C.1[36] KF7-313C.4[3] KF7-313C.5[3] KF7-313C.9[3] KF7-313C.11B[1] KF7-314.1F[1] KF7-371.1E[15] KF7-410.12[2] KF7-450.50[10] KF7-460.1[6] KF7-500.1[54] KF7-500.20B[4] KF7-500.21[19] KF7-500.24[10] KF7-525.2[6] KF7-580.1[8] R901.1.Diag_on_can_app_1_6_2 R904.1.Gst_on_can_1_0_1 /end FUNCTION_LIST
/end MEASUREMENT
/begin MEASUREMENT bvISSTPM "ISC output condition" UWORD COMP_0025 1 100 0 32767.5 ECU_ADDRESS 0xFFFFB674 /begin FUNCTION_LIST KF7-304.13[N] KF7-500.38A[4] /end FUNCTION_LIST /end MEASUREMENT
/begin MEASUREMENT bvST "DDL1 stage" UBYTE COMP_0004 1 100 0 255 ECU_ADDRESS 0xFFFF40DC
 /begin FUNCTION_LIST KF7-304.2[21] KF7-312.3A[27] KF7-320A.6[3] KF7-320A.10[14] KF7-320A.12[N] KF7-320A.19[7] KF7-330.8[1] KF7-390.3A[15] KF7-450.9A[5] KF7-500.6D[9] KF7-500.30[8] KF7-500.69[25] KF7-580.1[8] /end FUNCTION_LIST
/end MEASUREMENT
/begin MEASUREMENT bvTFBYA "Target air-fuel ratio" UWORD COMP_0217 1 100 0 3.999941832 ECU_ADDRESS 0xFFFF22AA
 /begin FUNCTION_LIST KF7-305.7[6] KF7-312.1C[N] KF7-312.2A[16] KF7-312.4A[6] KF7-312.4C[4] KF7-312.5A[4] KF7-312.5C[1] KF7-313C.1[36] KF7-313C.2[4] KF7-313C.9[3] KF7-313C.11B[1] KF7-314.1F[1] KF7-450.50[10] KF7-460.1[6] KF7-500.1[54] KF7-500.20B[4] R301.9.Target_Equivalent_Ratio_1_0_2 /end FUNCTION_LIST
/end MEASUREMENT
/begin MEASUREMENT vAA "A total duct area" UWORD COMP_0042 1 100 0 52.428 ECU_ADDRESS 0xFFFF8960
 /begin FUNCTION_LIST KF7-304.9[2] KF7-304.13[N] KF7-305.14[2] KF7-400.1[1] KF7-500.7[12] /end FUNCTION_LIST
/end MEASUREMENT
/begin MEASUREMENT vAADNV "AA/N/V" UWORD COMP_0006_S 1 100 0 0.000002975289 ECU_ADDRESS 0xFFFF1DF8
 /begin FUNCTION_LIST KF7-304.9[2] KF7-340.1M[8] KF7-340.2M[2] KF7-340.8M[8] KF7-350.4M[14] KF7-351.3[11] KF7-385.3[4] KF7-410.11M[4] KF7-410.17M[5] KF7-410.17P[1] /end FUNCTION_LIST
/end MEASUREMENT
/begin MEASUREMENT vAADNV2 "AA/N/V" UWORD COMP_0539_S 1 100 0 0.000005950578 ECU_ADDRESS 0xFFFF1DFA /begin FUNCTION_LIST KF7-304.9[2] /end FUNCTION_LIST /end MEASUREMENT
/begin MEASUREMENT vADDNE "MNRPM integration value" UWORD COMP_0000 1 100 0 1638375 ECU_ADDRESS 0xFFFFA094 /begin FUNCTION_LIST KF7-305.4AM[10] KF7-351.1[16] R000.4.EepAlloc_1_2_2 /end FUNCTION_LIST /end MEASUREMENT
/begin MEASUREMENT vADNVQL "-" UWORD COMP_0303_S 1 100 0 2.5599609375E-06 ECU_ADDRESS 0xFFFF3898 /begin FUNCTION_LIST KF7-304.9[2] KF7-351.3[11] /end FUNCTION_LIST /end MEASUREMENT
/begin MEASUREMENT vADVADJ "ADV adjustment value" SBYTE COMP_0018 1 100 -128 127 ECU_ADDRESS 0xFFFFB728
 /begin FUNCTION_LIST KF7-305.4AM[10] KF7-320A.3[N] KF7-320A.4[6] KF7-580.1[8] R000.4.EepAlloc_1_2_2 R301.23.ADV_calculation_1_1_2 /end FUNCTION_LIST
/end MEASUREMENT
/begin MEASUREMENT vADVB "Battery voltage" UWORD COMP_0054 1 100 0 1310700 ECU_ADDRESS 0xFFFF1CEA /begin FUNCTION_LIST KF7-304.7[1] /end FUNCTION_LIST /end MEASUREMENT
/begin MEASUREMENT vAFLE "Low frequency compensation value" SWORD COMP_0264 1 100 -32768 32767 ECU_ADDRESS 0xFFFF1D8C /begin FUNCTION_LIST KF7-304.1B[5] /end FUNCTION_LIST /end MEASUREMENT
/begin MEASUREMENT vAFMV "CO adjustment volume voltage" UBYTE COMP_0054 1 100 0 5100 ECU_ADDRESS 0xFFFF1E14 /begin FUNCTION_LIST KF7-304.1B[5] /end FUNCTION_LIST /end MEASUREMENT
/begin MEASUREMENT vAN "A/D value acquisition RAM" UWORD COMP_0023 1 100 0 327675 ECU_ADDRESS 0xFFFF2826 /begin FUNCTION_LIST KF7-302.5M[10] KF7-302.13[1] KF7-360.1[12] /end FUNCTION_LIST /end MEASUREMENT
/begin MEASUREMENT vAN_R#1 "A/D value acquisition RAM" UWORD COMP_0023 1 100 0 327675 ECU_ADDRESS 0xFFFF2826 /begin FUNCTION_LIST KF7-302.5M[10] KF7-302.13[1] KF7-360.1[12] /end FUNCTION_LIST /end MEASUREMENT
/begin MEASUREMENT vAN_R#2 "A/D value acquisition RAM" UWORD COMP_0023 1 100 0 327675 ECU_ADDRESS 0xFFFF2828 /begin FUNCTION_LIST KF7-302.5M[10] KF7-302.13[1] KF7-360.1[12] /end FUNCTION_LIST /end MEASUREMENT
/begin MEASUREMENT vAN_R#3 "A/D value acquisition RAM" UWORD COMP_0023 1 100 0 327675 ECU_ADDRESS 0xFFFF282A /begin FUNCTION_LIST KF7-302.5M[10] KF7-302.13[1] KF7-360.1[12] /end FUNCTION_LIST /end MEASUREMENT
/begin MEASUREMENT vAN_R#4 "A/D value acquisition RAM" UWORD COMP_0023 1 100 0 327675 ECU_ADDRESS 0xFFFF282C /begin FUNCTION_LIST KF7-302.5M[10] KF7-302.13[1] KF7-360.1[12] /end FUNCTION_LIST /end MEASUREMENT
/begin MEASUREMENT vAN_R#5 "A/D value acquisition RAM" UWORD COMP_0023 1 100 0 327675 ECU_ADDRESS 0xFFFF282E /begin FUNCTION_LIST KF7-302.5M[10] KF7-302.13[1] KF7-360.1[12] /end FUNCTION_LIST /end MEASUREMENT
/begin MEASUREMENT vAN_R#6 "A/D value acquisition RAM" UWORD COMP_0023 1 100 0 327675 ECU_ADDRESS 0xFFFF2830 /begin FUNCTION_LIST KF7-302.5M[10] KF7-302.13[1] KF7-360.1[12] /end FUNCTION_LIST /end MEASUREMENT
/begin MEASUREMENT vAN_R#7 "A/D value acquisition RAM" UWORD COMP_0023 1 100 0 327675 ECU_ADDRESS 0xFFFF2832 /begin FUNCTION_LIST KF7-302.5M[10] KF7-302.13[1] KF7-360.1[12] /end FUNCTION_LIST /end MEASUREMENT
/begin MEASUREMENT vAN_R#8 "A/D value acquisition RAM" UWORD COMP_0023 1 100 0 327675 ECU_ADDRESS 0xFFFF2834 /begin FUNCTION_LIST KF7-302.5M[10] KF7-302.13[1] KF7-360.1[12] /end FUNCTION_LIST /end MEASUREMENT
/begin MEASUREMENT vAN_R#9 "A/D value acquisition RAM" UWORD COMP_0023 1 100 0 327675 ECU_ADDRESS 0xFFFF2836 /begin FUNCTION_LIST KF7-302.5M[10] KF7-302.13[1] KF7-360.1[12] /end FUNCTION_LIST /end MEASUREMENT
/begin MEASUREMENT vAN_R#10 "A/D value acquisition RAM" UWORD COMP_0023 1 100 0 327675 ECU_ADDRESS 0xFFFF2838 /begin FUNCTION_LIST KF7-302.5M[10] KF7-302.13[1] KF7-360.1[12] /end FUNCTION_LIST /end MEASUREMENT
/begin MEASUREMENT vAN_R#11 "A/D value acquisition RAM" UWORD COMP_0023 1 100 0 327675 ECU_ADDRESS 0xFFFF283A /begin FUNCTION_LIST KF7-302.5M[10] KF7-302.13[1] KF7-360.1[12] /end FUNCTION_LIST /end MEASUREMENT
/begin MEASUREMENT vAN_R#12 "A/D value acquisition RAM" UWORD COMP_0023 1 100 0 327675 ECU_ADDRESS 0xFFFF283C /begin FUNCTION_LIST KF7-302.5M[10] KF7-302.13[1] KF7-360.1[12] /end FUNCTION_LIST /end MEASUREMENT
/begin MEASUREMENT vAN_R#13 "A/D value acquisition RAM" UWORD COMP_0023 1 100 0 327675 ECU_ADDRESS 0xFFFF283E /begin FUNCTION_LIST KF7-302.5M[10] KF7-302.13[1] KF7-360.1[12] /end FUNCTION_LIST /end MEASUREMENT
/begin MEASUREMENT vAN_R#14 "A/D value acquisition RAM" UWORD COMP_0023 1 100 0 327675 ECU_ADDRESS 0xFFFF2840 /begin FUNCTION_LIST KF7-302.5M[10] KF7-302.13[1] KF7-360.1[12] /end FUNCTION_LIST /end MEASUREMENT
/begin MEASUREMENT vAN_R#15 "A/D value acquisition RAM" UWORD COMP_0023 1 100 0 327675 ECU_ADDRESS 0xFFFF2842 /begin FUNCTION_LIST KF7-302.5M[10] KF7-302.13[1] KF7-360.1[12] /end FUNCTION_LIST /end MEASUREMENT
/begin MEASUREMENT vAN_R#16 "A/D value acquisition RAM" UWORD COMP_0023 1 100 0 327675 ECU_ADDRESS 0xFFFF2844 /begin FUNCTION_LIST KF7-302.5M[10] KF7-302.13[1] KF7-360.1[12] /end FUNCTION_LIST /end MEASUREMENT
/begin MEASUREMENT vAN_R#17 "A/D value acquisition RAM" UWORD COMP_0023 1 100 0 327675 ECU_ADDRESS 0xFFFF2846 /begin FUNCTION_LIST KF7-302.5M[10] KF7-302.13[1] KF7-360.1[12] /end FUNCTION_LIST /end MEASUREMENT
/begin MEASUREMENT vAN_R#18 "A/D value acquisition RAM" UWORD COMP_0023 1 100 0 327675 ECU_ADDRESS 0xFFFF2848 /begin FUNCTION_LIST KF7-302.5M[10] KF7-302.13[1] KF7-360.1[12] /end FUNCTION_LIST /end MEASUREMENT
/begin MEASUREMENT vAN_R#19 "A/D value acquisition RAM" UWORD COMP_0023 1 100 0 327675 ECU_ADDRESS 0xFFFF284A /begin FUNCTION_LIST KF7-302.5M[10] KF7-302.13[1] KF7-360.1[12] /end FUNCTION_LIST /end MEASUREMENT
/begin MEASUREMENT vAN_R#20 "A/D value acquisition RAM" UWORD COMP_0023 1 100 0 327675 ECU_ADDRESS 0xFFFF284C /begin FUNCTION_LIST KF7-302.5M[10] KF7-302.13[1] KF7-360.1[12] /end FUNCTION_LIST /end MEASUREMENT
/begin MEASUREMENT vAN_R#21 "A/D value acquisition RAM" UWORD COMP_0023 1 100 0 327675 ECU_ADDRESS 0xFFFF284E /begin FUNCTION_LIST KF7-302.5M[10] KF7-302.13[1] KF7-360.1[12] /end FUNCTION_LIST /end MEASUREMENT
/begin MEASUREMENT vAN_R#22 "A/D value acquisition RAM" UWORD COMP_0023 1 100 0 327675 ECU_ADDRESS 0xFFFF2850 /begin FUNCTION_LIST KF7-302.5M[10] KF7-302.13[1] KF7-360.1[12] /end FUNCTION_LIST /end MEASUREMENT
/begin MEASUREMENT vAN_R#23 "A/D value acquisition RAM" UWORD COMP_0023 1 100 0 327675 ECU_ADDRESS 0xFFFF2852 /begin FUNCTION_LIST KF7-302.5M[10] KF7-302.13[1] KF7-360.1[12] /end FUNCTION_LIST /end MEASUREMENT
/begin MEASUREMENT vAN_R#24 "A/D value acquisition RAM" UWORD COMP_0023 1 100 0 327675 ECU_ADDRESS 0xFFFF2854 /begin FUNCTION_LIST KF7-302.5M[10] KF7-302.13[1] KF7-360.1[12] /end FUNCTION_LIST /end MEASUREMENT
/begin MEASUREMENT vAN_R#25 "A/D value acquisition RAM" UWORD COMP_0023 1 100 0 327675 ECU_ADDRESS 0xFFFF2856 /begin FUNCTION_LIST KF7-302.5M[10] KF7-302.13[1] KF7-360.1[12] /end FUNCTION_LIST /end MEASUREMENT
/begin MEASUREMENT vAN_R#26 "A/D value acquisition RAM" UWORD COMP_0023 1 100 0 327675 ECU_ADDRESS 0xFFFF2858 /begin FUNCTION_LIST KF7-302.5M[10] KF7-302.13[1] KF7-360.1[12] /end FUNCTION_LIST /end MEASUREMENT
/begin MEASUREMENT vAN_R#27 "A/D value acquisition RAM" UWORD COMP_0023 1 100 0 327675 ECU_ADDRESS 0xFFFF285A /begin FUNCTION_LIST KF7-302.5M[10] KF7-302.13[1] KF7-360.1[12] /end FUNCTION_LIST /end MEASUREMENT
/begin MEASUREMENT vAN_R#28 "A/D value acquisition RAM" UWORD COMP_0023 1 100 0 327675 ECU_ADDRESS 0xFFFF285C /begin FUNCTION_LIST KF7-302.5M[10] KF7-302.13[1] KF7-360.1[12] /end FUNCTION_LIST /end MEASUREMENT
/begin MEASUREMENT vAN_R#29 "A/D value acquisition RAM" UWORD COMP_0023 1 100 0 327675 ECU_ADDRESS 0xFFFF285E /begin FUNCTION_LIST KF7-302.5M[10] KF7-302.13[1] KF7-360.1[12] /end FUNCTION_LIST /end MEASUREMENT
/begin MEASUREMENT vAN_R#30 "A/D value acquisition RAM" UWORD COMP_0023 1 100 0 327675 ECU_ADDRESS 0xFFFF2860 /begin FUNCTION_LIST KF7-302.5M[10] KF7-302.13[1] KF7-360.1[12] /end FUNCTION_LIST /end MEASUREMENT
/begin MEASUREMENT vAN_R#31 "A/D value acquisition RAM" UWORD COMP_0023 1 100 0 327675 ECU_ADDRESS 0xFFFF2862 /begin FUNCTION_LIST KF7-302.5M[10] KF7-302.13[1] KF7-360.1[12] /end FUNCTION_LIST /end MEASUREMENT
/begin MEASUREMENT vAN_R#32 "A/D value acquisition RAM" UWORD COMP_0023 1 100 0 327675 ECU_ADDRESS 0xFFFF2864 /begin FUNCTION_LIST KF7-302.5M[10] KF7-302.13[1] KF7-360.1[12] /end FUNCTION_LIST /end MEASUREMENT
/begin MEASUREMENT vANGOV "Energizing limitation angle" UBYTE COMP_0017 1 100 0 255 ECU_ADDRESS 0xFFFF116C /begin FUNCTION_LIST KF7-303.5A[9] /end FUNCTION_LIST /end MEASUREMENT
/begin MEASUREMENT vANRPM "Engine speed for the TP0 computation" UWORD COMP_0064 1 100 0 102398.4375 ECU_ADDRESS 0xFFFF1F98 /begin FUNCTION_LIST KF7-303.6M[5] KF7-304.2[21] /end FUNCTION_LIST /end MEASUREMENT
/begin MEASUREMENT vAPAGED "Purge duct area" UWORD COMP_0374 1 100 0 13.107 ECU_ADDRESS 0xFFFF116E
 /begin FUNCTION_LIST KF7-304.9[2] KF7-350.1M[5] KF7-350.1P[4] KF7-371.1E[15] KF7-500.7[12] /end FUNCTION_LIST
/end MEASUREMENT
/begin MEASUREMENT vAPO "Accelerator open-degree" UWORD COMP_0005 1 100 0 7208.85 ECU_ADDRESS 0xFFFF476C
 /begin FUNCTION_LIST KF7-301.25M[5] KF7-304.2[21] KF7-330.5[53] KF7-340.1M[8] KF7-340.1P[7] KF7-340.2M[2] KF7-340.2P[1] KF7-340.5[4] KF7-340.5P[2] KF7-340.6M[2] KF7-340.7[4] KF7-340.8M[8] KF7-340.16[4] KF7-351.1[16] KF7-351.3[11] KF7-376.2[21] KF7-385.1[32] KF7-385.3[4] KF7-410.17M[5] KF7-410.17P[1] KF7-410.19[2] KF7-450.19[4] KF7-500.1[54] KF7-500.2A[29] KF7-500.26[17] KF7-505.2[9] KF7-505.9[3] KF7-505.26[2] KF7-505.50[1] KF7-525.2[6] KF7-525.2S[10] R000.1.RS_Integ_1_10_2 R301.6.IscAirflow_1_4_5 /end FUNCTION_LIST
/end MEASUREMENT
/begin MEASUREMENT vAPOFS_S "Failsafe treatment accelerator open-degree" UWORD COMP_0005 1 100 0 7208.85 ECU_ADDRESS 0xFFFF49A0
 /begin FUNCTION_LIST KF7-301.25P[5] KF7-350.4P[13] KF7-505.9[3] R000.1.RS_Integ_1_10_2 /end FUNCTION_LIST
/end MEASUREMENT
/begin MEASUREMENT vAPO_S "Accelerator open-degree (the sub-side)" UWORD COMP_0005 1 100 0 7208.85 ECU_ADDRESS 0xFFFF4026 /begin FUNCTION_LIST KF7-301.25P[5] R000.1.RS_Integ_1_10_2 /end FUNCTION_LIST /end MEASUREMENT
/begin MEASUREMENT vAPSFS "An accelerator open-degree limiter for the target open-degree operation" UWORD COMP_0005 1 100 0 7208.85 ECU_ADDRESS 0xFFFF3918 /begin FUNCTION_LIST KF7-301.25M[5] /end FUNCTION_LIST /end MEASUREMENT
/begin MEASUREMENT vAPSFS_S "An accelerator open-degree limiter for the target open-degree operation" UWORD COMP_0005 1 100 0 7208.85 ECU_ADDRESS 0xFFFF402A /begin FUNCTION_LIST KF7-301.25P[5] /end FUNCTION_LIST /end MEASUREMENT
/begin MEASUREMENT vATPO1 "TPO1 opening area" UWORD COMP_0042 1 100 0 52.428 ECU_ADDRESS 0xFFFF48E8 /begin FUNCTION_LIST KF7-304.9[2] KF7-304.13[N] KF7-351.3[11] KF7-500.7[12] /end FUNCTION_LIST /end MEASUREMENT
/begin MEASUREMENT vATTEMP "AT oil temperature data" UBYTE COMP_0035_S 1 100 0 255 ECU_ADDRESS 0xFFFF48EB /begin FUNCTION_LIST KF7-302.5M[10] KF7-330.9[8] /end FUNCTION_LIST /end MEASUREMENT
/begin MEASUREMENT vATVO "Throttle duct area" UWORD COMP_0042 1 100 0 52.428 ECU_ADDRESS 0xFFFF1E20 /begin FUNCTION_LIST KF7-304.13[N] KF7-500.21[19] /end FUNCTION_LIST /end MEASUREMENT
/begin MEASUREMENT vAVCC "Sensor reference power supply voltage" UBYTE COMP_0118 1 100 0 10200 ECU_ADDRESS 0xFFFF48EE
 /begin FUNCTION_LIST KF7-301.30[2] KF7-400.3[N] KF7-500.2A[29] KF7-505.26[2] KF7-505.32[6] KF7-505.34[3] KF7-525.1[4] KF7-525.2[6] KF7-525.2S[10] R000.1.RS_Integ_1_10_2 R301.13.FFDforDiagOnCAN_1_1_3 R901.1.Diag_on_can_app_1_6_2 /end FUNCTION_LIST
/end MEASUREMENT
/begin MEASUREMENT vAVTPD "At the time of the steady state W.O.T, after the weighted average, pulse width" UWORD COMP_0144 1 100 0 31.999495335 ECU_ADDRESS 0xFFFF1D6C /begin FUNCTION_LIST KF7-304.2[21] /end FUNCTION_LIST /end MEASUREMENT
/begin MEASUREMENT vAVTPR "After the weighted average, pulse width" UWORD COMP_0144 1 100 0 31.999495335 ECU_ADDRESS 0xFFFF1D6E /begin FUNCTION_LIST KF7-304.2[21] /end FUNCTION_LIST /end MEASUREMENT
/begin MEASUREMENT vBASPCV "At the time of the purge V close, reference pressure" UBYTE COMP_0054 1 100 0 5100 ECU_ADDRESS 0xFFFFA28D /begin FUNCTION_LIST KF7-305.4BM[31] KF7-500.30[8] /end FUNCTION_LIST /end MEASUREMENT
/begin MEASUREMENT vBFAPO "Change addition accelerator open-degree" UWORD COMP_0005 1 100 0 7208.85 ECU_ADDRESS 0xFFFF11C4 /begin FUNCTION_LIST KF7-301.25M[5] /end FUNCTION_LIST /end MEASUREMENT
/begin MEASUREMENT vBFAPO_S "Change addition accelerator open-degree" UWORD COMP_0005 1 100 0 7208.85 ECU_ADDRESS 0xFFFF4030 /begin FUNCTION_LIST KF7-301.25P[5] /end FUNCTION_LIST /end MEASUREMENT
/begin MEASUREMENT vBURCNT "Backup RAM system diagnosis counter" UBYTE COMP_0016 1 100 0 255 ECU_ADDRESS 0xFFFF2939
 /begin FUNCTION_LIST KF7-305.4AM[10] KF7-305.4BM[31] KF7-505.24[1] KF7-505.26[2] R000.4.EepAlloc_1_2_2 /end FUNCTION_LIST
/end MEASUREMENT
/begin MEASUREMENT vBUSUM "Backup RAM sum value" UBYTE COMP_0068 1 100 0 255 ECU_ADDRESS 0xFFFF293A /begin FUNCTION_LIST KF7-305.1[7] KF7-305.14[2] /end FUNCTION_LIST /end MEASUREMENT
/begin MEASUREMENT vCAMCNT "CAM signal data" UBYTE COMP_0068 1 100 0 255 ECU_ADDRESS 0xFFFF11CD /begin FUNCTION_LIST KF7-303.5A[9] KF7-450.9A[5] /end FUNCTION_LIST /end MEASUREMENT
/begin MEASUREMENT vCAMCNT1 "Phase LH signal counter" UBYTE COMP_0068 1 100 0 255 ECU_ADDRESS 0xFFFF11CE /begin FUNCTION_LIST KF7-303.5A[9] KF7-450.9A[5] KF7-500.6D[9] /end FUNCTION_LIST /end MEASUREMENT
/begin MEASUREMENT vCAMCNT2 "Phase RH signal counter" UBYTE COMP_0068 1 100 0 255 ECU_ADDRESS 0xFFFF11CF /begin FUNCTION_LIST KF7-303.5A[9] KF7-450.9A[5] KF7-500.6D[9] /end FUNCTION_LIST /end MEASUREMENT
/begin MEASUREMENT vCAMIN "START/SW After OFF-> on, CAM input experience" UBYTE COMP_0068 1 100 0 255 ECU_ADDRESS 0xFFFF4045 /begin FUNCTION_LIST KF7-303.5A[9] /end FUNCTION_LIST /end MEASUREMENT
/begin MEASUREMENT vCAMIN1 "START/SW After OFF-> on, Phase LH input experience" UBYTE COMP_0068 1 100 0 255 ECU_ADDRESS 0xFFFF4046 /begin FUNCTION_LIST KF7-303.5A[9] /end FUNCTION_LIST /end MEASUREMENT
/begin MEASUREMENT vCAMIN2 "START/SW After OFF-> on, Phase RH input experience" UBYTE COMP_0068 1 100 0 255 ECU_ADDRESS 0xFFFF4047 /begin FUNCTION_LIST KF7-303.5A[9] /end FUNCTION_LIST /end MEASUREMENT
/begin MEASUREMENT vCATCNT1 "Backup RAM RATE law catalyst diagnosis complete number of times counter bank 1" UWORD COMP_0016 1 100 0 65535 ECU_ADDRESS 0xFFFFB72C /begin FUNCTION_LIST KF7-305.4BM[31] KF7-500.21[19] R000.4.EepAlloc_1_2_2 /end FUNCTION_LIST /end MEASUREMENT
/begin MEASUREMENT vCATCNT2 "Backup RAM RATE law catalyst diagnosis complete number of times counter bank 2" UWORD COMP_0016 1 100 0 65535 ECU_ADDRESS 0xFFFFB72E /begin FUNCTION_LIST KF7-305.4BM[31] KF7-500.21[19] R000.4.EepAlloc_1_2_2 /end FUNCTION_LIST /end MEASUREMENT
/begin MEASUREMENT vCATTRP "A trip counter for the backup RAM RATE law catalyst diagnosis" UWORD COMP_0016 1 100 0 65535 ECU_ADDRESS 0xFFFFB730 /begin FUNCTION_LIST KF7-305.4BM[31] R000.4.EepAlloc_1_2_2 /end FUNCTION_LIST /end MEASUREMENT
/begin MEASUREMENT vCFL "FLOAD basic value" UWORD COMP_0069 1 100 0 1.999970916 ECU_ADDRESS 0xFFFF1E6A /begin FUNCTION_LIST KF7-304.2[21] /end FUNCTION_LIST /end MEASUREMENT
/begin MEASUREMENT vCMTMP "At the time of the Phase signal input, crank angle counter preservation value (for the first cylinder distinction)" UBYTE COMP_0068 1 100 0 255 ECU_ADDRESS 0xFFFF11E9 /begin FUNCTION_LIST KF7-303.5A[9] /end FUNCTION_LIST /end MEASUREMENT
/begin MEASUREMENT vCMTMP_R#1 "At the time of the Phase signal input, crank angle counter preservation value (for the first cylinder distinction)" UBYTE COMP_0068 1 100 0 255 ECU_ADDRESS 0xFFFF11E9 /begin FUNCTION_LIST KF7-303.5A[9] /end FUNCTION_LIST /end MEASUREMENT
/begin MEASUREMENT vCMTMP_R#2 "At the time of the Phase signal input, crank angle counter preservation value (for the first cylinder distinction)" UBYTE COMP_0068 1 100 0 255 ECU_ADDRESS 0xFFFF11EA /begin FUNCTION_LIST KF7-303.5A[9] /end FUNCTION_LIST /end MEASUREMENT
/begin MEASUREMENT vCMTMP_R#3 "At the time of the Phase signal input, crank angle counter preservation value (for the first cylinder distinction)" UBYTE COMP_0068 1 100 0 255 ECU_ADDRESS 0xFFFF11EB /begin FUNCTION_LIST KF7-303.5A[9] /end FUNCTION_LIST /end MEASUREMENT
/begin MEASUREMENT vCMTMP_R#4 "At the time of the Phase signal input, crank angle counter preservation value (for the first cylinder distinction)" UBYTE COMP_0068 1 100 0 255 ECU_ADDRESS 0xFFFF11EC /begin FUNCTION_LIST KF7-303.5A[9] /end FUNCTION_LIST /end MEASUREMENT
/begin MEASUREMENT vCMTMP1 "Phase At the time of the LH signal input, crank angle counter preservation value (for the first cylinder distinction)" UBYTE COMP_0068 1 100 0 255 ECU_ADDRESS 0xFFFF11ED /begin FUNCTION_LIST KF7-303.5A[9] /end FUNCTION_LIST /end MEASUREMENT
/begin MEASUREMENT vCMTMP1_R#1 "Phase At the time of the LH signal input, crank angle counter preservation value (for the first cylinder distinction)" UBYTE COMP_0068 1 100 0 255 ECU_ADDRESS 0xFFFF11ED /begin FUNCTION_LIST KF7-303.5A[9] /end FUNCTION_LIST /end MEASUREMENT
/begin MEASUREMENT vCMTMP1_R#2 "Phase At the time of the LH signal input, crank angle counter preservation value (for the first cylinder distinction)" UBYTE COMP_0068 1 100 0 255 ECU_ADDRESS 0xFFFF11EE /begin FUNCTION_LIST KF7-303.5A[9] /end FUNCTION_LIST /end MEASUREMENT
/begin MEASUREMENT vCMTMP2 "Phase At the time of the RH signal input, crank angle counter preservation value (for the first cylinder distinction)" UBYTE COMP_0068 1 100 0 255 ECU_ADDRESS 0xFFFF11EF /begin FUNCTION_LIST KF7-303.5A[9] /end FUNCTION_LIST /end MEASUREMENT
/begin MEASUREMENT vCMTMP2_R#1 "Phase At the time of the RH signal input, crank angle counter preservation value (for the first cylinder distinction)" UBYTE COMP_0068 1 100 0 255 ECU_ADDRESS 0xFFFF11EF /begin FUNCTION_LIST KF7-303.5A[9] /end FUNCTION_LIST /end MEASUREMENT
/begin MEASUREMENT vCMTMP2_R#2 "Phase At the time of the RH signal input, crank angle counter preservation value (for the first cylinder distinction)" UBYTE COMP_0068 1 100 0 255 ECU_ADDRESS 0xFFFF11F0 /begin FUNCTION_LIST KF7-303.5A[9] /end FUNCTION_LIST /end MEASUREMENT
/begin MEASUREMENT vCNROL "TINT measuring start engine rotation delay" UBYTE COMP_0071 1 100 0 255 ECU_ADDRESS 0xFFFF409A /begin FUNCTION_LIST KF7-303.5A[9] /end FUNCTION_LIST /end MEASUREMENT
/begin MEASUREMENT vCONQA "CO adjustment value" SBYTE COMP_0000_S 1 100 -128 127 ECU_ADDRESS 0xFFFFB739 /begin FUNCTION_LIST KF7-304.1B[5] KF7-580.1[8] /end FUNCTION_LIST /end MEASUREMENT
/begin MEASUREMENT vCONSOMUX "The amount of integration fuel consumption for the CAN transmission" UBYTE COMP_0031_S 1 100 0 20400 ECU_ADDRESS 0xFFFF23B3 /begin FUNCTION_LIST KF7-305.7[6] R204.1.CanComm_1_9_2 /end FUNCTION_LIST /end MEASUREMENT
/begin MEASUREMENT vCRACNT "Crank corner detection counter" UBYTE COMP_0068 1 100 0 255 ECU_ADDRESS 0xFFFF1201 /begin FUNCTION_LIST KF7-303.5A[9] KF7-303.7B[N] KF7-450.9A[5] KF7-500.6D[9] /end FUNCTION_LIST /end MEASUREMENT
/begin MEASUREMENT vCRACNT0 "Crank angle counter (for the first cylinder distinction)" UBYTE COMP_0068 1 100 0 255 ECU_ADDRESS 0xFFFF1202 /begin FUNCTION_LIST KF7-303.5A[9] KF7-450.9A[5] /end FUNCTION_LIST /end MEASUREMENT
/begin MEASUREMENT vCRACNTHH "At the time of the TPOSCPHH renewal, CRACNT value" UBYTE COMP_0068 1 100 0 255 ECU_ADDRESS 0xFFFFA2C6 /begin FUNCTION_LIST KF7-303.5A[9] /end FUNCTION_LIST /end MEASUREMENT
/begin MEASUREMENT vCRACNTHL "At the time of the TPOSCPHL renewal, CRACNT value" UBYTE COMP_0068 1 100 0 255 ECU_ADDRESS 0xFFFFA2C7 /begin FUNCTION_LIST KF7-303.5A[9] /end FUNCTION_LIST /end MEASUREMENT
/begin MEASUREMENT vCRACNTLH "At the time of the TPOSCPLH renewal, CRACNT value" UBYTE COMP_0068 1 100 0 255 ECU_ADDRESS 0xFFFFA2C8 /begin FUNCTION_LIST KF7-303.5A[9] /end FUNCTION_LIST /end MEASUREMENT
/begin MEASUREMENT vCRACNTLL "At the time of the TPOSCPLL renewal, CRACNT value" UBYTE COMP_0068 1 100 0 255 ECU_ADDRESS 0xFFFFA2C9 /begin FUNCTION_LIST KF7-303.5A[9] /end FUNCTION_LIST /end MEASUREMENT
/begin MEASUREMENT vCTINJ "For the injection start timing angle" UWORD COMP_0390 1 100 0 655350 ECU_ADDRESS 0xFFFF1206 /begin FUNCTION_LIST KF7-303.5A[9] /end FUNCTION_LIST /end MEASUREMENT
/begin MEASUREMENT vCTINJS "For the stratified injection start timing angle" UWORD COMP_0390 1 100 0 655350 ECU_ADDRESS 0xFFFF1FB4 /begin FUNCTION_LIST KF7-303.5A[9] /end FUNCTION_LIST /end MEASUREMENT
/begin MEASUREMENT vCUMCONSO "The amount of integration fuel consumption" UWORD COMP_0034_S 1 100 0 20479.6875 ECU_ADDRESS 0xFFFF120A /begin FUNCTION_LIST KF7-305.7[6] R205.1.ADAC_spec_1_1_0 /end FUNCTION_LIST /end MEASUREMENT
/begin MEASUREMENT vCUMCONSY "IT MASTER is turned, the amount of integration fuel consumption" UWORD COMP_0034_S 1 100 0 20479.6875 ECU_ADDRESS 0xFFFF23CC /begin FUNCTION_LIST KF7-305.7[6] /end FUNCTION_LIST /end MEASUREMENT
/begin MEASUREMENT vCVN "ROM area sum value" ULONG COMP_0004 1 100 0 4294967295 ECU_ADDRESS 0xFFFF29E8 /begin FUNCTION_LIST KF7-305.4AM[10] KF7-305.4BM[31] /end FUNCTION_LIST /end MEASUREMENT
/begin MEASUREMENT vCVSP1 "Vehicle speed pulse counter 1" UWORD COMP_0030 1 100 0 65535 ECU_ADDRESS 0xFFFF1D24 /begin FUNCTION_LIST KF7-303.1[14] /end FUNCTION_LIST /end MEASUREMENT
/begin MEASUREMENT vCVSP1S "Vehicle speed pulse counter 1S" UWORD COMP_0030 1 100 0 65535 ECU_ADDRESS 0xFFFF1D26 /begin FUNCTION_LIST KF7-303.1[14] /end FUNCTION_LIST /end MEASUREMENT
/begin MEASUREMENT vCVSP2 "Vehicle speed pulse counter 2" UWORD COMP_0030 1 100 0 65535 ECU_ADDRESS 0xFFFF1D28 /begin FUNCTION_LIST KF7-303.1[14] /end FUNCTION_LIST /end MEASUREMENT
/begin MEASUREMENT vCVSP2S "Vehicle speed pulse counter 2S" UWORD COMP_0030 1 100 0 65535 ECU_ADDRESS 0xFFFF1D2A /begin FUNCTION_LIST KF7-303.1[14] /end FUNCTION_LIST /end MEASUREMENT
/begin MEASUREMENT vCYLADV "Ignition cylinder" UBYTE COMP_0567_S 1 100 0 255 ECU_ADDRESS 0xFFFF120E /begin FUNCTION_LIST KF7-303.5A[9] KF7-450.9A[5] /end FUNCTION_LIST /end MEASUREMENT
/begin MEASUREMENT vCYLCAM "Extreme fresh air pipe distinction value" UBYTE COMP_0068 1 100 0 255 ECU_ADDRESS 0xFFFF1214 /begin FUNCTION_LIST KF7-303.5A[9] KF7-450.9A[5] KF7-500.6D[9] /end FUNCTION_LIST /end MEASUREMENT
/begin MEASUREMENT vCYLCAM1 "CYLCAM renewal value" UBYTE COMP_0068 1 100 0 255 ECU_ADDRESS 0xFFFF1215 /begin FUNCTION_LIST KF7-303.5A[9] KF7-450.9A[5] /end FUNCTION_LIST /end MEASUREMENT
/begin MEASUREMENT vCYLCNT "Reference position renewal cylinder distinction value" UBYTE COMP_0068 1 100 0 255 ECU_ADDRESS 0xFFFF8A38 /begin FUNCTION_LIST KF7-303.5A[9] KF7-311.1A[21] KF7-379.1[9] KF7-450.9A[5] /end FUNCTION_LIST /end MEASUREMENT
/begin MEASUREMENT vCYLCS "Cylinder distinction value" UBYTE COMP_0567_S 1 100 0 255 ECU_ADDRESS 0xFFFF1216 /begin FUNCTION_LIST KF7-303.5A[9] KF7-320A.4[6] KF7-450.9A[5] /end FUNCTION_LIST /end MEASUREMENT
/begin MEASUREMENT vCYLCS2 "Cylinder distinction value (CRACNT0=0 renewal)" UBYTE COMP_0567_S 1 100 0 255 ECU_ADDRESS 0xFFFF1217 /begin FUNCTION_LIST KF7-303.5A[9] KF7-450.9A[5] /end FUNCTION_LIST /end MEASUREMENT
/begin MEASUREMENT vCYLCSnew "Cylinder distinction value" UBYTE COMP_0567_S 1 100 0 255 ECU_ADDRESS 0xFFFF1218 /begin FUNCTION_LIST KF7-303.5A[9] /end FUNCTION_LIST /end MEASUREMENT
/begin MEASUREMENT vCYLDWL "Energizing start cylinder" UBYTE COMP_0567_S 1 100 0 255 ECU_ADDRESS 0xFFFF1220 /begin FUNCTION_LIST KF7-303.5A[9] KF7-450.9A[5] /end FUNCTION_LIST /end MEASUREMENT
/begin MEASUREMENT vCYLERR "The number of times that a cylinder distinction is unusual" UBYTE COMP_0068 1 100 0 255 ECU_ADDRESS 0xFFFFA2D0 /begin FUNCTION_LIST KF7-303.5A[9] /end FUNCTION_LIST /end MEASUREMENT
/begin MEASUREMENT vCYLFDW "At the time of the mis-electric supply prevention logic operation, energizing cylinder" UBYTE COMP_0567_S 1 100 0 255 ECU_ADDRESS 0xFFFF1221 /begin FUNCTION_LIST KF7-303.5A[9] KF7-450.9A[5] /end FUNCTION_LIST /end MEASUREMENT
/begin MEASUREMENT vCYLGATE "Electric supply cylinder distinction value" UBYTE COMP_0567_S 1 100 0 255 ECU_ADDRESS 0xFFFF1222 /begin FUNCTION_LIST KF7-303.5A[9] KF7-311.1A[21] KF7-450.9A[5] /end FUNCTION_LIST /end MEASUREMENT
/begin MEASUREMENT vCYLNGCT "Cylinder distinction NG counter" UBYTE COMP_0068 1 100 0 255 ECU_ADDRESS 0xFFFF1223 /begin FUNCTION_LIST KF7-303.5A[9] /end FUNCTION_LIST /end MEASUREMENT
/begin MEASUREMENT vDCTCNT1 "A/F sensor (O2 sensor) breakage diagnosis complete number of times counter bank 1" UWORD COMP_0016 1 100 0 65535 ECU_ADDRESS 0xFFFFB740 /begin FUNCTION_LIST KF7-305.4BM[31] KF7-500.76[8] R000.4.EepAlloc_1_2_2 /end FUNCTION_LIST /end MEASUREMENT
/begin MEASUREMENT vDCTCNT2 "A/F sensor (O2 sensor) breakage diagnosis complete number of times counter bank 2" UWORD COMP_0016 1 100 0 65535 ECU_ADDRESS 0xFFFFB742 /begin FUNCTION_LIST KF7-305.4BM[31] KF7-500.76[8] R000.4.EepAlloc_1_2_2 /end FUNCTION_LIST /end MEASUREMENT
/begin MEASUREMENT vDCTTRP "A trip counter for the A/F sensor (O2 sensor) breakage diagnosis" UWORD COMP_0016 1 100 0 65535 ECU_ADDRESS 0xFFFFB744 /begin FUNCTION_LIST KF7-305.4BM[31] R000.4.EepAlloc_1_2_2 /end FUNCTION_LIST /end MEASUREMENT
/begin MEASUREMENT vDLNEMSK "DLTNE non-operation time" UBYTE COMP_0014 1 100 0 2550 ECU_ADDRESS 0xFFFF1E76 /begin FUNCTION_LIST KF7-303.6M[5] /end FUNCTION_LIST /end MEASUREMENT
/begin MEASUREMENT vDLTNE "A degree of an engine speed slowdown" UBYTE COMP_0006 1 100 0 3187.5 ECU_ADDRESS 0xFFFF88A6
 /begin FUNCTION_LIST KF7-303.6M[5] KF7-312.4A[6] KF7-312.4C[4] KF7-312.6[34] KF7-330.5[53] KF7-330.7A[1] KF7-330.9[8] KF7-390.3A[15] R301.5.FuelCut_1_2_2 /end FUNCTION_LIST
/end MEASUREMENT
/begin MEASUREMENT vDLTNE0 "A degree of an engine speed slowdown" UWORD COMP_0582_S 1 100 0 3199.9495335 ECU_ADDRESS 0xFFFF1DE4 /begin FUNCTION_LIST KF7-303.6M[5] /end FUNCTION_LIST /end MEASUREMENT
/begin MEASUREMENT vDLTOUTR "A degree of a TM output speed slowdown" UWORD COMP_0392_S 1 100 0 65535 ECU_ADDRESS 0xFFFF897E /begin FUNCTION_LIST KF7-303.1[14] KF7-385.1[32] /end FUNCTION_LIST /end MEASUREMENT
/begin MEASUREMENT vDLTQH0 "Delta-QH0 for the steady state transient state judgement" UBYTE COMP_0032 1 100 0 0.99609375 ECU_ADDRESS 0xFFFF8980 /begin FUNCTION_LIST KF7-304.2[21] KF7-312.5A[4] KF7-312.5C[1] /end FUNCTION_LIST /end MEASUREMENT
/begin MEASUREMENT vDMPTP "At the time of the steady state W.O.T, weighted average coefficient" UBYTE COMP_0032 1 100 0 0.99609375 ECU_ADDRESS 0xFFFF1E78 /begin FUNCTION_LIST KF7-304.2[21] /end FUNCTION_LIST /end MEASUREMENT
/begin MEASUREMENT vDQCO "CO adjustment value" SWORD COMP_0264 1 100 -32768 32767 ECU_ADDRESS 0xFFFF1DAA /begin FUNCTION_LIST KF7-304.1B[5] KF7-304.2[21] /end FUNCTION_LIST /end MEASUREMENT
/begin MEASUREMENT vDQH010MS "Delta-QH0 (10mS)" SWORD COMP_0203 1 100 -128 127.99609375 ECU_ADDRESS 0xFFFF8982 /begin FUNCTION_LIST KF7-304.1B[5] /end FUNCTION_LIST /end MEASUREMENT
/begin MEASUREMENT vDSP "Wheel speed (drive wheel)" UWORD COMP_0436 1 100 0 6553.5 ECU_ADDRESS 0xFFFF8986
 /begin FUNCTION_LIST KF7-303.1[14] KF7-330.4A[53] KF7-360.9M[43] KF7-410.3[N] R204.1.CanComm_1_9_2 /end FUNCTION_LIST
/end MEASUREMENT
/begin MEASUREMENT vDTVO "Delta-TVO absolute value" UBYTE COMP_0053_S 1 100 0 89.25 ECU_ADDRESS 0xFFFF8988 /begin FUNCTION_LIST KF7-304.10[1] KF7-500.26[17] /end FUNCTION_LIST /end MEASUREMENT
/begin MEASUREMENT vDTVOM "At the time of the slowdown, delta-TVO" UBYTE COMP_0053_S 1 100 0 89.25 ECU_ADDRESS 0xFFFF1E7F /begin FUNCTION_LIST KF7-304.10[1] /end FUNCTION_LIST /end MEASUREMENT
/begin MEASUREMENT vDTVOP "For 150mS, delta-TVO acceleration side" UBYTE COMP_0053_S 1 100 0 89.25 ECU_ADDRESS 0xFFFF8989
 /begin FUNCTION_LIST KF7-304.10[1] KF7-312.2A[16] KF7-320A.12[N] KF7-320A.13[N] KF7-320A.15[4] R301.9.Target_Equivalent_Ratio_1_0_2 R301.23.ADV_calculation_1_1_2 /end FUNCTION_LIST
/end MEASUREMENT
/begin MEASUREMENT vDUMP "At the time of the steady state judgement, weighted average coefficient" UBYTE COMP_0132 1 100 0 0.498046875 ECU_ADDRESS 0xFFFF898B /begin FUNCTION_LIST KF7-304.2[21] /end FUNCTION_LIST /end MEASUREMENT
/begin MEASUREMENT vDUMP2 "At the time of the steady state judgement, weighted average coefficient" UWORD COMP_0456 1 100 0 1.999970916 ECU_ADDRESS 0xFFFF898C /begin FUNCTION_LIST KF7-304.2[21] /end FUNCTION_LIST /end MEASUREMENT
/begin MEASUREMENT vDVSP "Vehicle speed increase width" UBYTE COMP_0236 1 100 0 63.75 ECU_ADDRESS 0xFFFF885C /begin FUNCTION_LIST KF7-303.1[14] /end FUNCTION_LIST /end MEASUREMENT
/begin MEASUREMENT vDWLCT1 "Energizing start timing angle (1,3CYL)" UWORD COMP_0390 1 100 0 655350 ECU_ADDRESS 0xFFFF12BC /begin FUNCTION_LIST KF7-303.5A[9] /end FUNCTION_LIST /end MEASUREMENT
/begin MEASUREMENT vDWLTM1 "Energizing start timing time (1,3CYL)" UBYTE COMP_0073 1 100 0 816 ECU_ADDRESS 0xFFFF12C2 /begin FUNCTION_LIST KF7-303.5A[9] /end FUNCTION_LIST /end MEASUREMENT
/begin MEASUREMENT vEEPVSP "At the time of the trouble, mileage" ULONG COMP_0587_S 1 100 0 431657098.049385 ECU_ADDRESS 0xFFFFB5EC /begin FUNCTION_LIST KF7-305.4BM[31] KF7-500.1[54] R000.4.EepAlloc_1_2_2 /end FUNCTION_LIST /end MEASUREMENT
/begin MEASUREMENT vEGRACNT "Backup RAM RATE law EGR close diagnosis (VTC alignment check diagnosis) complete number of times counter" UWORD COMP_0016 1 100 0 65535 ECU_ADDRESS 0xFFFFB74A
 /begin FUNCTION_LIST KF7-305.4BM[31] KF7-500.6D[9] KF7-500.47B[15] R000.4.EepAlloc_1_2_2 /end FUNCTION_LIST
/end MEASUREMENT
/begin MEASUREMENT vEGRATRP "A trip counter for the backup RAM RATE law EGR close diagnosis" UWORD COMP_0016 1 100 0 65535 ECU_ADDRESS 0xFFFFB74C /begin FUNCTION_LIST KF7-305.4BM[31] R000.4.EepAlloc_1_2_2 /end FUNCTION_LIST /end MEASUREMENT
/begin MEASUREMENT vEGRBCNT "Backup RAM RATE law EGR open diagnosis (VTC drive abnormality diagnosis) complete number of times counter" UWORD COMP_0016 1 100 0 65535 ECU_ADDRESS 0xFFFFB74E /begin FUNCTION_LIST KF7-305.4BM[31] KF7-500.47B[15] R000.4.EepAlloc_1_2_2 /end FUNCTION_LIST /end MEASUREMENT
/begin MEASUREMENT vEGRBTRP "A trip counter for the backup RAM RATE law EGR open diagnosis" UWORD COMP_0016 1 100 0 65535 ECU_ADDRESS 0xFFFFB750 /begin FUNCTION_LIST KF7-305.4BM[31] R000.4.EepAlloc_1_2_2 /end FUNCTION_LIST /end MEASUREMENT
/begin MEASUREMENT vEGRCCNT "Backup RAM RATE law EGR close diagnosis complete number of times count" UWORD COMP_0016 1 100 0 65535 ECU_ADDRESS 0xFFFFB752 /begin FUNCTION_LIST KF7-305.4BM[31] R000.4.EepAlloc_1_2_2 /end FUNCTION_LIST /end MEASUREMENT
/begin MEASUREMENT vEGRTRP "A trip count for the backup RAM RATE law EGR close diagnosis" UWORD COMP_0016 1 100 0 65535 ECU_ADDRESS 0xFFFFB754 /begin FUNCTION_LIST KF7-305.4BM[31] R000.4.EepAlloc_1_2_2 /end FUNCTION_LIST /end MEASUREMENT
/begin MEASUREMENT vEPBUSUM "EEP- ROM preservation backup RAM sum value" UBYTE COMP_0068 1 100 0 255 ECU_ADDRESS 0xFFFF2B4A /begin FUNCTION_LIST KF7-305.14[2] R000.4.EepAlloc_1_2_2 /end FUNCTION_LIST /end MEASUREMENT
/begin MEASUREMENT vEVPKOF "Ignition switch off line pressure" UBYTE COMP_0054 1 100 0 5100 ECU_ADDRESS 0xFFFFA3A5 /begin FUNCTION_LIST KF7-305.4BM[31] R000.4.EepAlloc_1_2_2 /end FUNCTION_LIST /end MEASUREMENT
/begin MEASUREMENT vFLOAD1 "Transient state response compensation weighted average coefficient 1" UWORD COMP_0069 1 100 0 1.999970916 ECU_ADDRESS 0xFFFF899C /begin FUNCTION_LIST KF7-304.2[21] /end FUNCTION_LIST /end MEASUREMENT
/begin MEASUREMENT vFLOAD2 "Transient state response compensation weighted average coefficient 2" UWORD COMP_0069 1 100 0 1.999970916 ECU_ADDRESS 0xFFFF1EB2 /begin FUNCTION_LIST KF7-304.2[21] /end FUNCTION_LIST /end MEASUREMENT
/begin MEASUREMENT vFNLOW "Engine speed for the high periodic renewal low rotation" UWORD COMP_0064 1 100 0 102398.4375 ECU_ADDRESS 0xFFFF3D7A /begin FUNCTION_LIST KF7-303.6M[5] /end FUNCTION_LIST /end MEASUREMENT
/begin MEASUREMENT vFNRPM "Engine speed (renewal periodic high speed)" UWORD COMP_0006 1 100 0 819187.5 ECU_ADDRESS 0xFFFF899E
 /begin FUNCTION_LIST KF7-303.5A[9] KF7-303.6M[5] KF7-311.1A[21] KF7-312.1C[N] KF7-312.6[34] KF7-320A.6[3] KF7-320A.19[7] KF7-320A.21[N] KF7-330.5[53] KF7-450.9A[5] KF7-500.7[12] KF7-500.10[3] KF7-580.1[8] /end FUNCTION_LIST
/end MEASUREMENT
/begin MEASUREMENT vFNRPM2 "Engine speed for the hard cranking judgement" UBYTE COMP_0006 1 100 0 3187.5 ECU_ADDRESS 0xFFFF4943
 /begin FUNCTION_LIST KF7-302.4MA[13] KF7-303.6M[5] KF7-304.2[21] KF7-304.4B[2] KF7-312.2A[16] KF7-450.9A[5] KF7-500.6D[9] R301.9.Target_Equivalent_Ratio_1_0_2 /end FUNCTION_LIST
/end MEASUREMENT
/begin MEASUREMENT vFNRPMQ "Engine speed for the low rotation" UWORD COMP_0064 1 100 0 102398.4375 ECU_ADDRESS 0xFFFF3D80 /begin FUNCTION_LIST KF7-303.6M[5] /end FUNCTION_LIST /end MEASUREMENT
/begin MEASUREMENT vFSFLG "Failsafe flag" UWORD COMP_0068 1 100 0 65535 ECU_ADDRESS 0xFFFFB5FC /begin FUNCTION_LIST KF7-305.4BM[31] /end FUNCTION_LIST /end MEASUREMENT
/begin MEASUREMENT vGCVN "ECM CVN value (after North America 2005MY)" UBYTE COMP_0068 1 100 0 255 ECU_ADDRESS 0xFFFFB787
 /begin FUNCTION_LIST KF7-305.4AM[10] R000.4.EepAlloc_1_2_2 R904.1.Gst_on_can_1_0_1 /end FUNCTION_LIST
/end MEASUREMENT
/begin MEASUREMENT vGCVN_R#1 "ECM CVN value (after North America 2005MY)" UBYTE COMP_0068 1 100 0 255 ECU_ADDRESS 0xFFFFB787
 /begin FUNCTION_LIST KF7-305.4AM[10] R000.4.EepAlloc_1_2_2 R904.1.Gst_on_can_1_0_1 /end FUNCTION_LIST
/end MEASUREMENT
/begin MEASUREMENT vGCVN_R#2 "ECM CVN value (after North America 2005MY)" UBYTE COMP_0068 1 100 0 255 ECU_ADDRESS 0xFFFFB788
 /begin FUNCTION_LIST KF7-305.4AM[10] R000.4.EepAlloc_1_2_2 R904.1.Gst_on_can_1_0_1 /end FUNCTION_LIST
/end MEASUREMENT
/begin MEASUREMENT vGCVN_R#3 "ECM CVN value (after North America 2005MY)" UBYTE COMP_0068 1 100 0 255 ECU_ADDRESS 0xFFFFB789
 /begin FUNCTION_LIST KF7-305.4AM[10] R000.4.EepAlloc_1_2_2 R904.1.Gst_on_can_1_0_1 /end FUNCTION_LIST
/end MEASUREMENT
/begin MEASUREMENT vGCVN_R#4 "ECM CVN value (after North America 2005MY)" UBYTE COMP_0068 1 100 0 255 ECU_ADDRESS 0xFFFFB78A
 /begin FUNCTION_LIST KF7-305.4AM[10] R000.4.EepAlloc_1_2_2 R904.1.Gst_on_can_1_0_1 /end FUNCTION_LIST
/end MEASUREMENT
/begin MEASUREMENT vGNMV "The reciprocal number of vNMV" UWORD COMP_0597_S 1 100 0 0.000014535663 ECU_ADDRESS 0xFFFF89A2 /begin FUNCTION_LIST KF7-304.9[2] KF7-500.7[12] /end FUNCTION_LIST /end MEASUREMENT
/begin MEASUREMENT vGNRTRP "ÉWÉFÉlÉâÉãÉgÉäÉbÉv" UWORD COMP_0016 1 100 0 65535 ECU_ADDRESS 0xFFFFB792 /begin FUNCTION_LIST KF7-305.4BM[31] R000.4.EepAlloc_1_2_2 /end FUNCTION_LIST /end MEASUREMENT
/begin MEASUREMENT vHNRPM "Engine speed" UBYTE COMP_0020 1 100 0 12750 ECU_ADDRESS 0xFFFF8A3E
 /begin FUNCTION_LIST KF7-303.6M[5] KF7-304.2[21] KF7-312.2A[16] KF7-312.3A[27] KF7-312.6[34] KF7-314.1F[1] KF7-320A.6[3] KF7-320A.8[2] KF7-320A.9[9] KF7-320A.10[14] KF7-320A.15[4] KF7-320A.19[7] KF7-320A.21[N] KF7-360.8M[4] KF7-360.9M[43] KF7-376.1[6] KF7-376.2[21] KF7-379.2[1] KF7-379.4[1] KF7-379.5[3] KF7-385.1[32] KF7-385.2[18] KF7-385.3[4] KF7-390.3A[15] KF7-393.1C[8] KF7-395.1[4] KF7-410.12[2] KF7-500.16[4] KF7-500.20B[4] KF7-500.26[17] KF7-500.47B[15] R301.1.Torque_realization_1_0_3 R301.4.AfFeedback_1_0_1 R301.5.FuelCut_1_2_2 R301.7.KHOT_1_0_2 R301.8.Inverse_filter_1_1_3 R301.9.Target_Equivalent_Ratio_1_0_2 R301.23.ADV_calculation_1_1_2 /end FUNCTION_LIST
/end MEASUREMENT
/begin MEASUREMENT vHRVSP "A high precision vehicle speed" UWORD COMP_0436 1 100 0 6553.5 ECU_ADDRESS 0xFFFF89A6
 /begin FUNCTION_LIST KF7-303.1[14] KF7-340.1M[8] KF7-340.3M[1] KF7-340.3P[2] KF7-340.4[1] KF7-340.5[4] KF7-340.5P[2] KF7-340.6M[2] KF7-340.7[4] KF7-340.9M[3] KF7-340.9P[3] KF7-340.11[4] KF7-340.15[3] KF7-340.16[4] KF7-360.7M[9] KF7-360.7P[8] KF7-360.9M[43] KF7-385.1[32] KF7-410.17M[5] KF7-410.19[2] KF7-505.49[3] KF7-580.1[8] R301.20.AmbientComp_1_0_2 /end FUNCTION_LIST
/end MEASUREMENT
/begin MEASUREMENT vIGNCT "For the ignition timing angle" UWORD COMP_0390 1 100 0 655350 ECU_ADDRESS 0xFFFF1442 /begin FUNCTION_LIST KF7-303.5A[9] /end FUNCTION_LIST /end MEASUREMENT
/begin MEASUREMENT vIGNTM "For the ignition timing time" UBYTE COMP_0073 1 100 0 816 ECU_ADDRESS 0xFFFF1444 /begin FUNCTION_LIST KF7-303.5A[9] /end FUNCTION_LIST /end MEASUREMENT
/begin MEASUREMENT vIILRC "The bit reversal data of ISCLRC" UBYTE COMP_0004 1 100 0 255 ECU_ADDRESS 0xFFFFA498 /begin FUNCTION_LIST KF7-305.1[7] /end FUNCTION_LIST /end MEASUREMENT
/begin MEASUREMENT vIILRC1 "The bit reversal data of ISCLRCB" UWORD COMP_0004 1 100 0 65535 ECU_ADDRESS 0xFFFFA49A /begin FUNCTION_LIST KF7-305.4AM[10] KF7-351.2[17] R000.4.EepAlloc_1_2_2 /end FUNCTION_LIST /end MEASUREMENT
/begin MEASUREMENT vIN "-" SLONG COMP_0264 1 100 -2147483648 2147483647 ECU_ADDRESS 0xFFFF1FDC /begin FUNCTION_LIST KF7-305.4AM[10] /end FUNCTION_LIST /end MEASUREMENT
/begin MEASUREMENT vIN_R#1 "-" SLONG COMP_0264 1 100 -2147483648 2147483647 ECU_ADDRESS 0xFFFF1FDC /begin FUNCTION_LIST KF7-305.4AM[10] /end FUNCTION_LIST /end MEASUREMENT
/begin MEASUREMENT vIN_R#2 "-" SLONG COMP_0264 1 100 -2147483648 2147483647 ECU_ADDRESS 0xFFFF1FE0 /begin FUNCTION_LIST KF7-305.4AM[10] /end FUNCTION_LIST /end MEASUREMENT
/begin MEASUREMENT vIN_R#3 "-" SLONG COMP_0264 1 100 -2147483648 2147483647 ECU_ADDRESS 0xFFFF1FE4 /begin FUNCTION_LIST KF7-305.4AM[10] /end FUNCTION_LIST /end MEASUREMENT
/begin MEASUREMENT vIN_R#4 "-" SLONG COMP_0264 1 100 -2147483648 2147483647 ECU_ADDRESS 0xFFFF1FE8 /begin FUNCTION_LIST KF7-305.4AM[10] /end FUNCTION_LIST /end MEASUREMENT
/begin MEASUREMENT vIN_R#5 "-" SLONG COMP_0264 1 100 -2147483648 2147483647 ECU_ADDRESS 0xFFFF1FEC /begin FUNCTION_LIST KF7-305.4AM[10] /end FUNCTION_LIST /end MEASUREMENT
/begin MEASUREMENT vIN_R#6 "-" SLONG COMP_0264 1 100 -2147483648 2147483647 ECU_ADDRESS 0xFFFF1FF0 /begin FUNCTION_LIST KF7-305.4AM[10] /end FUNCTION_LIST /end MEASUREMENT
/begin MEASUREMENT vIN_R#7 "-" SLONG COMP_0264 1 100 -2147483648 2147483647 ECU_ADDRESS 0xFFFF1FF4 /begin FUNCTION_LIST KF7-305.4AM[10] /end FUNCTION_LIST /end MEASUREMENT
/begin MEASUREMENT vIN_R#8 "-" SLONG COMP_0264 1 100 -2147483648 2147483647 ECU_ADDRESS 0xFFFF1FF8 /begin FUNCTION_LIST KF7-305.4AM[10] /end FUNCTION_LIST /end MEASUREMENT
/begin MEASUREMENT vIN_R#9 "-" SLONG COMP_0264 1 100 -2147483648 2147483647 ECU_ADDRESS 0xFFFF1FFC /begin FUNCTION_LIST KF7-305.4AM[10] /end FUNCTION_LIST /end MEASUREMENT
/begin MEASUREMENT vIN_R#10 "-" SLONG COMP_0264 1 100 -2147483648 2147483647 ECU_ADDRESS 0xFFFF2000 /begin FUNCTION_LIST KF7-305.4AM[10] /end FUNCTION_LIST /end MEASUREMENT
/begin MEASUREMENT vIN_R#11 "-" SLONG COMP_0264 1 100 -2147483648 2147483647 ECU_ADDRESS 0xFFFF2004 /begin FUNCTION_LIST KF7-305.4AM[10] /end FUNCTION_LIST /end MEASUREMENT
/begin MEASUREMENT vIN_R#12 "-" SLONG COMP_0264 1 100 -2147483648 2147483647 ECU_ADDRESS 0xFFFF2008 /begin FUNCTION_LIST KF7-305.4AM[10] /end FUNCTION_LIST /end MEASUREMENT
/begin MEASUREMENT vIN_R#13 "-" SLONG COMP_0264 1 100 -2147483648 2147483647 ECU_ADDRESS 0xFFFF200C /begin FUNCTION_LIST KF7-305.4AM[10] /end FUNCTION_LIST /end MEASUREMENT
/begin MEASUREMENT vIN_R#14 "-" SLONG COMP_0264 1 100 -2147483648 2147483647 ECU_ADDRESS 0xFFFF2010 /begin FUNCTION_LIST KF7-305.4AM[10] /end FUNCTION_LIST /end MEASUREMENT
/begin MEASUREMENT vIN_R#15 "-" SLONG COMP_0264 1 100 -2147483648 2147483647 ECU_ADDRESS 0xFFFF2014 /begin FUNCTION_LIST KF7-305.4AM[10] /end FUNCTION_LIST /end MEASUREMENT
/begin MEASUREMENT vIN_R#16 "-" SLONG COMP_0264 1 100 -2147483648 2147483647 ECU_ADDRESS 0xFFFF2018 /begin FUNCTION_LIST KF7-305.4AM[10] /end FUNCTION_LIST /end MEASUREMENT
/begin MEASUREMENT vIN_R#17 "-" SLONG COMP_0264 1 100 -2147483648 2147483647 ECU_ADDRESS 0xFFFF201C /begin FUNCTION_LIST KF7-305.4AM[10] /end FUNCTION_LIST /end MEASUREMENT
/begin MEASUREMENT vIN_R#18 "-" SLONG COMP_0264 1 100 -2147483648 2147483647 ECU_ADDRESS 0xFFFF2020 /begin FUNCTION_LIST KF7-305.4AM[10] /end FUNCTION_LIST /end MEASUREMENT
/begin MEASUREMENT vIN_R#19 "-" SLONG COMP_0264 1 100 -2147483648 2147483647 ECU_ADDRESS 0xFFFF2024 /begin FUNCTION_LIST KF7-305.4AM[10] /end FUNCTION_LIST /end MEASUREMENT
/begin MEASUREMENT vIN_R#20 "-" SLONG COMP_0264 1 100 -2147483648 2147483647 ECU_ADDRESS 0xFFFF2028 /begin FUNCTION_LIST KF7-305.4AM[10] /end FUNCTION_LIST /end MEASUREMENT
/begin MEASUREMENT vIN_R#21 "-" SLONG COMP_0264 1 100 -2147483648 2147483647 ECU_ADDRESS 0xFFFF202C /begin FUNCTION_LIST KF7-305.4AM[10] /end FUNCTION_LIST /end MEASUREMENT
/begin MEASUREMENT vIN_R#22 "-" SLONG COMP_0264 1 100 -2147483648 2147483647 ECU_ADDRESS 0xFFFF2030 /begin FUNCTION_LIST KF7-305.4AM[10] /end FUNCTION_LIST /end MEASUREMENT
/begin MEASUREMENT vIN_R#23 "-" SLONG COMP_0264 1 100 -2147483648 2147483647 ECU_ADDRESS 0xFFFF2034 /begin FUNCTION_LIST KF7-305.4AM[10] /end FUNCTION_LIST /end MEASUREMENT
/begin MEASUREMENT vIN_R#24 "-" SLONG COMP_0264 1 100 -2147483648 2147483647 ECU_ADDRESS 0xFFFF2038 /begin FUNCTION_LIST KF7-305.4AM[10] /end FUNCTION_LIST /end MEASUREMENT
/begin MEASUREMENT vIN_R#25 "-" SLONG COMP_0264 1 100 -2147483648 2147483647 ECU_ADDRESS 0xFFFF203C /begin FUNCTION_LIST KF7-305.4AM[10] /end FUNCTION_LIST /end MEASUREMENT
/begin MEASUREMENT vIN_R#26 "-" SLONG COMP_0264 1 100 -2147483648 2147483647 ECU_ADDRESS 0xFFFF2040 /begin FUNCTION_LIST KF7-305.4AM[10] /end FUNCTION_LIST /end MEASUREMENT
/begin MEASUREMENT vIN_R#27 "-" SLONG COMP_0264 1 100 -2147483648 2147483647 ECU_ADDRESS 0xFFFF2044 /begin FUNCTION_LIST KF7-305.4AM[10] /end FUNCTION_LIST /end MEASUREMENT
/begin MEASUREMENT vIN_R#28 "-" SLONG COMP_0264 1 100 -2147483648 2147483647 ECU_ADDRESS 0xFFFF2048 /begin FUNCTION_LIST KF7-305.4AM[10] /end FUNCTION_LIST /end MEASUREMENT
/begin MEASUREMENT vIN_R#29 "-" SLONG COMP_0264 1 100 -2147483648 2147483647 ECU_ADDRESS 0xFFFF204C /begin FUNCTION_LIST KF7-305.4AM[10] /end FUNCTION_LIST /end MEASUREMENT
/begin MEASUREMENT vIN_R#30 "-" SLONG COMP_0264 1 100 -2147483648 2147483647 ECU_ADDRESS 0xFFFF2050 /begin FUNCTION_LIST KF7-305.4AM[10] /end FUNCTION_LIST /end MEASUREMENT
/begin MEASUREMENT vIN_R#31 "-" SLONG COMP_0264 1 100 -2147483648 2147483647 ECU_ADDRESS 0xFFFF2054 /begin FUNCTION_LIST KF7-305.4AM[10] /end FUNCTION_LIST /end MEASUREMENT
/begin MEASUREMENT vIN_R#32 "-" SLONG COMP_0264 1 100 -2147483648 2147483647 ECU_ADDRESS 0xFFFF2058 /begin FUNCTION_LIST KF7-305.4AM[10] /end FUNCTION_LIST /end MEASUREMENT
/begin MEASUREMENT vINPREV "CVT input speed" UWORD COMP_0443 1 100 0 65535 ECU_ADDRESS 0xFFFF89AA
 /begin FUNCTION_LIST KF7-303.1[14] KF7-312.6[34] KF7-330.9[8] KF7-340.10M[1] KF7-340.10P[N] KF7-360.9M[43] KF7-505.47[3] R204.1.CanComm_1_9_2 R301.23.ADV_calculation_1_1_2 /end FUNCTION_LIST
/end MEASUREMENT
/begin MEASUREMENT vINPREVFL "After filtering, CVT input speed" UWORD COMP_0443 1 100 0 65535 ECU_ADDRESS 0xFFFF89AC /begin FUNCTION_LIST KF7-303.1[14] KF7-340.9M[3] KF7-340.9P[3] /end FUNCTION_LIST /end MEASUREMENT
/begin MEASUREMENT vIQTSEP "Off-line idle air quantity bit reversal value" UBYTE COMP_0068 1 100 0 255 ECU_ADDRESS 0xFFFFA4A4 /begin FUNCTION_LIST KF7-305.4BM[31] /end FUNCTION_LIST /end MEASUREMENT
/begin MEASUREMENT vIQTSEP1 "Off-line idle air quantity bit reversal value" UWORD COMP_0068 1 100 0 65535 ECU_ADDRESS 0xFFFFA4A6 /begin FUNCTION_LIST KF7-305.4BM[31] KF7-351.1[16] R000.4.EepAlloc_1_2_2 /end FUNCTION_LIST /end MEASUREMENT
/begin MEASUREMENT vISCLRC "Idle speed learning value" SBYTE COMP_0277 1 100 -128 127 ECU_ADDRESS 0xFFFFA4AA /begin FUNCTION_LIST KF7-305.1[7] KF7-580.1[8] /end FUNCTION_LIST /end MEASUREMENT
/begin MEASUREMENT vISCLRCB "Idle speed learning value" SWORD COMP_0277 1 100 -32768 32767 ECU_ADDRESS 0xFFFFB79C
 /begin FUNCTION_LIST KF7-305.4AM[10] KF7-305.4BM[31] KF7-330.5[53] KF7-351.1[16] KF7-351.2[17] R000.4.EepAlloc_1_2_2 R301.6.IscAirflow_1_4_5 R301.19.ISC_PID_cont_1_0_2 R901.1.Diag_on_can_app_1_6_2 /end FUNCTION_LIST
/end MEASUREMENT
/begin MEASUREMENT vITAC "Cylinder intake filling up efficiency" UBYTE COMP_0009 1 100 0 199.21875 ECU_ADDRESS 0xFFFF8884
 /begin FUNCTION_LIST KF7-304.2[21] KF7-312.2A[16] KF7-312.3A[27] KF7-312.4A[6] KF7-312.4C[4] KF7-320A.4[6] KF7-320A.8[2] KF7-320A.9[9] KF7-320A.17[N] KF7-379.2[1] KF7-386.1[4] KF7-393.1C[8] KF7-500.1[54] KF7-500.7[12] R301.2.MapBreakpoint_1_1_2 R301.4.AfFeedback_1_0_1 R301.7.KHOT_1_0_2 R301.9.Target_Equivalent_Ratio_1_0_2 R301.10.TITM_1_0_2 R301.13.FFDforDiagOnCAN_1_1_3 R301.23.ADV_calculation_1_1_2 R901.1.Diag_on_can_app_1_6_2 R904.1.Gst_on_can_1_0_1 /end FUNCTION_LIST
/end MEASUREMENT
/begin MEASUREMENT vITAFSV "Combustion efficiency compensation coefficient adjustment value" UBYTE COMP_0009 1 100 0 199.21875 ECU_ADDRESS 0xFFFFA4B8 /begin FUNCTION_LIST KF7-305.4AM[10] KF7-305.4BM[31] R000.4.EepAlloc_1_2_2 /end FUNCTION_LIST /end MEASUREMENT
/begin MEASUREMENT vITAN "Cylinder fresh air rate" UBYTE COMP_0009 1 100 0 199.21875 ECU_ADDRESS 0xFFFF89AF /begin FUNCTION_LIST KF7-304.2[21] KF7-320A.8[2] /end FUNCTION_LIST /end MEASUREMENT
/begin MEASUREMENT vITAND "At the time of the excessiveness, i cylinder i fresh air a rate" UBYTE COMP_0009 1 100 0 199.21875 ECU_ADDRESS 0xFFFF1DE6 /begin FUNCTION_LIST KF7-304.2[21] /end FUNCTION_LIST /end MEASUREMENT
/begin MEASUREMENT vITVQLS "Low speed air learning value (reversal value)" UWORD COMP_0131 1 100 0 1279.98046875 ECU_ADDRESS 0xFFFFA4BC /begin FUNCTION_LIST KF7-305.1[7] KF7-305.4AM[10] R000.4.EepAlloc_1_2_2 /end FUNCTION_LIST /end MEASUREMENT
/begin MEASUREMENT vKAJYU1 "TPTRM weighted average coefficient" UWORD COMP_0069 1 100 0 1.999970916 ECU_ADDRESS 0xFFFF89B0 /begin FUNCTION_LIST KF7-304.2[21] /end FUNCTION_LIST /end MEASUREMENT
/begin MEASUREMENT vKAJYU2 "TP weighted average coefficient" UWORD COMP_0069 1 100 0 1.999970916 ECU_ADDRESS 0xFFFF1EB8 /begin FUNCTION_LIST KF7-304.2[21] /end FUNCTION_LIST /end MEASUREMENT
/begin MEASUREMENT vKDSP "After the weighted average, DSP" UWORD COMP_0436 1 100 0 6553.5 ECU_ADDRESS 0xFFFF1EBA /begin FUNCTION_LIST KF7-303.1[14] KF7-330.4A[53] /end FUNCTION_LIST /end MEASUREMENT
/begin MEASUREMENT vKNRPM "Engine speed" UWORD COMP_0064 1 100 0 102398.4375 ECU_ADDRESS 0xFFFF8A40 DISPLAY_IDENTIFIER Vxx_n01
 /begin FUNCTION_LIST KF7-302.4MA[13] KF7-303.6M[5] KF7-304.2[21] KF7-305.7[6] KF7-500.26[17] R000.1.RS_Integ_1_10_2 R204.1.CanComm_1_9_2 R301.6.IscAirflow_1_4_5 R901.1.Diag_on_can_app_1_6_2 /end FUNCTION_LIST
/end MEASUREMENT
/begin MEASUREMENT vKNRPMQ "Engine speed for the low rotation" UWORD COMP_0064 1 100 0 102398.4375 ECU_ADDRESS 0xFFFF3DDE /begin FUNCTION_LIST KF7-302.4MA[13] KF7-303.6M[5] R000.1.RS_Integ_1_10_2 /end FUNCTION_LIST /end MEASUREMENT
/begin MEASUREMENT vKNRPM_S "Engine speed redundant part" UWORD COMP_0064 1 100 0 102398.4375 ECU_ADDRESS 0xFFFF2298 /begin FUNCTION_LIST KF7-303.6P[1] /end FUNCTION_LIST /end MEASUREMENT
/begin MEASUREMENT vKVCC2 "AD conversion compensation value 2" UWORD COMP_0069 1 100 0 1.999970916 ECU_ADDRESS 0xFFFFA4C4
 /begin FUNCTION_LIST KF7-305.4BM[31] KF7-379.1[9] KF7-400.1[1] KF7-400.2[N] KF7-400.3[N] KF7-400.5[3] R000.4.EepAlloc_1_2_2 /end FUNCTION_LIST
/end MEASUREMENT
/begin MEASUREMENT vLEAKCNT "Backup RAM RATE law evapo leak diagnosis complete number of times counter" UWORD COMP_0016 1 100 0 65535 ECU_ADDRESS 0xFFFFB79E /begin FUNCTION_LIST KF7-305.4BM[31] KF7-500.1[54] R000.4.EepAlloc_1_2_2 /end FUNCTION_LIST /end MEASUREMENT
/begin MEASUREMENT vLEAKTRP "A trip counter for the backup RAM RATE law evapo leak diagnosis" UWORD COMP_0016 1 100 0 65535 ECU_ADDRESS 0xFFFFB7A0 /begin FUNCTION_LIST KF7-305.4BM[31] R000.4.EepAlloc_1_2_2 /end FUNCTION_LIST /end MEASUREMENT
/begin MEASUREMENT vLRVSP "A low precision vehicle speed" UWORD COMP_0436 1 100 0 6553.5 ECU_ADDRESS 0xFFFF89B2
 /begin FUNCTION_LIST KF7-303.1[14] KF7-340.3M[1] KF7-340.3P[2] KF7-340.5[4] KF7-340.5P[2] KF7-360.9M[43] KF7-360.11[1] KF7-410.19[2] KF7-505.49[3] /end FUNCTION_LIST
/end MEASUREMENT
/begin MEASUREMENT vMDI "Switch input condition" UBYTE COMP_0004 1 100 0 255 ECU_ADDRESS 0xFFFF89B4 /begin FUNCTION_LIST KF7-302.2M[3] KF7-360.4[14] KF7-505.15[4] KF7-505.23[2] /end FUNCTION_LIST /end MEASUREMENT
/begin MEASUREMENT vMDIEL "Electric load switch input condition" UBYTE COMP_0068 1 100 0 255 ECU_ADDRESS 0xFFFF1ED4 /begin FUNCTION_LIST KF7-302.2M[3] KF7-580.1[8] /end FUNCTION_LIST /end MEASUREMENT
/begin MEASUREMENT vMLTRP "A trip counter for the second level self-diagnosis" UBYTE COMP_0030 1 100 0 255 ECU_ADDRESS 0xFFFFA73C /begin FUNCTION_LIST KF7-305.4BM[31] KF7-500.1[54] R000.4.EepAlloc_1_2_2 /end FUNCTION_LIST /end MEASUREMENT
/begin MEASUREMENT vMMTQUPTM "AGB torque rise permission time (realtime)" UBYTE COMP_0014 1 100 0 2550 ECU_ADDRESS 0xFFFF2FD4
 /begin FUNCTION_LIST KF7-301.25M[5] KF7-301.25P[5] KF7-312.6[34] KF7-340.1M[8] KF7-340.1P[7] KF7-360.9M[43] KF7-410.17P[1] /end FUNCTION_LIST
/end MEASUREMENT
/begin MEASUREMENT vMNRPM "Engine speed" UBYTE COMP_0000 1 100 0 6375 ECU_ADDRESS 0xFFFF8A43
 /begin FUNCTION_LIST KF7-302.6A[4] KF7-303.1[14] KF7-303.6M[5] KF7-304.1B[5] KF7-304.2[21] KF7-305.4AM[10] KF7-305.4BM[31] KF7-311.1A[21] KF7-312.1C[N] KF7-312.2A[16] KF7-312.3A[27] KF7-312.4A[6] KF7-312.4C[4] KF7-312.5C[1] KF7-312.6[34] KF7-313C.4[3] KF7-313C.5[3] KF7-320A.1[6] KF7-320A.4[6] KF7-320A.12[N] KF7-320A.13[N] KF7-320A.15[4] KF7-320A.23[N] KF7-330.1M[3] KF7-330.1P[3] KF7-330.5[53] KF7-350.4M[14] KF7-350.4P[13] KF7-351.1[16] KF7-376.2[21] KF7-378.2B[6] KF7-379.1[9] KF7-385.1[32] KF7-385.2[18] KF7-386.1[4] KF7-386.3[8] KF7-393.1C[8] KF7-410.12[2] KF7-450.22[1] KF7-500.1[54] KF7-500.7[12] KF7-500.21[19] KF7-500.24[10] KF7-500.25A[7] KF7-500.26[17] KF7-500.28[4] KF7-500.30[8] KF7-500.39[5] KF7-500.51[3] KF7-500.59[6] KF7-500.74[11] KF7-500.76[8] KF7-505.23[2] KF7-525.2[6] KF7-580.1[8] R301.1.Torque_realization_1_0_3 R301.2.MapBreakpoint_1_1_2 R301.5.FuelCut_1_2_2 R301.6.IscAirflow_1_4_5 R301.7.KHOT_1_0_2 R301.9.Target_Equivalent_Ratio_1_0_2 R301.10.TITM_1_0_2 R301.23.ADV_calculation_1_1_2 /end FUNCTION_LIST
/end MEASUREMENT
/begin MEASUREMENT vNDWLL "Non-energizing angle" UBYTE COMP_0017 1 100 0 255 ECU_ADDRESS 0xFFFF21D0 /begin FUNCTION_LIST KF7-303.5A[9] KF7-320A.6[3] KF7-450.9A[5] /end FUNCTION_LIST /end MEASUREMENT
/begin MEASUREMENT vNE "Engine speed" UWORD COMP_0065 1 100 0 204796.875 ECU_ADDRESS 0xFFFF8A46
 /begin FUNCTION_LIST KF7-303.1[14] KF7-303.6M[5] KF7-304.9[2] KF7-312.4A[6] KF7-312.4C[4] KF7-312.6[34] KF7-314.1F[1] KF7-320A.2[3] KF7-330.5[53] KF7-330.9[8] KF7-340.1M[8] KF7-340.1P[7] KF7-340.2M[2] KF7-340.2P[1] KF7-340.6M[2] KF7-340.6P[2] KF7-340.8M[8] KF7-340.10M[1] KF7-340.10P[N] KF7-350.1M[5] KF7-350.4M[14] KF7-350.4P[13] KF7-351.3[11] KF7-360.8M[4] KF7-360.9M[43] KF7-360.12[6] KF7-376.2[21] KF7-385.2[18] KF7-385.3[4] KF7-386.1[4] KF7-410.3[N] KF7-410.11M[4] KF7-500.7[12] KF7-500.30[8] KF7-505.50[1] KF7-505.51[2] R301.23.ADV_calculation_1_1_2 /end FUNCTION_LIST
/end MEASUREMENT
/begin MEASUREMENT vNEREF0 "REF signal periodic conversion engine speed" UWORD COMP_0476 1 100 0 12799.8046875 ECU_ADDRESS 0xFFFF89FA
 /begin FUNCTION_LIST KF7-303.6M[5] KF7-330.3[6] KF7-330.4A[53] KF7-330.5[53] KF7-350.1M[5] KF7-390.3A[15] R301.6.IscAirflow_1_4_5 R301.19.ISC_PID_cont_1_0_2 /end FUNCTION_LIST
/end MEASUREMENT
/begin MEASUREMENT vNEREF125 "REF signal synchronous conversion engine speed 2" UWORD COMP_0006 1 100 0 819187.5 ECU_ADDRESS 0xFFFF8A48
 /begin FUNCTION_LIST KF7-303.6M[5] KF7-330.3[6] KF7-330.5[53] KF7-376.2[21] KF7-390.3A[15] R301.6.IscAirflow_1_4_5 R301.26.Dashpot_DandN_1_0_2 /end FUNCTION_LIST
/end MEASUREMENT
/begin MEASUREMENT vNE_S "Engine speed redundant part" UWORD COMP_0065 1 100 0 204796.875 ECU_ADDRESS 0xFFFF8A6C /begin FUNCTION_LIST KF7-303.6P[1] /end FUNCTION_LIST /end MEASUREMENT
/begin MEASUREMENT vNKANBAKU "Complete combustion judgement engine speed threshold" UBYTE COMP_0006 1 100 0 3187.5 ECU_ADDRESS 0xFFFF1EDE /begin FUNCTION_LIST KF7-302.4MA[13] /end FUNCTION_LIST /end MEASUREMENT
/begin MEASUREMENT vNMV "Engine speed Å~ engine displacement" UWORD COMP_0479 1 100 0 20479687.5 ECU_ADDRESS 0xFFFF1EE0 /begin FUNCTION_LIST KF7-304.9[2] /end FUNCTION_LIST /end MEASUREMENT
/begin MEASUREMENT vNRPM2 "Engine speed" UWORD COMP_0480 1 100 0 409593.75 ECU_ADDRESS 0xFFFF21D8 /begin FUNCTION_LIST KF7-303.6M[5] /end FUNCTION_LIST /end MEASUREMENT
/begin MEASUREMENT vNSET4 "NSET lower limit adjustment value" UBYTE COMP_0006 1 100 0 3187.5 ECU_ADDRESS 0xFFFFB7AC /begin FUNCTION_LIST KF7-305.4AM[10] KF7-330.4A[53] KF7-580.1[8] /end FUNCTION_LIST /end MEASUREMENT
/begin MEASUREMENT vOKURI "Overflow, minus maintenance value" UWORD COMP_0004 1 100 0 65535 ECU_ADDRESS 0xFFFF1DAE /begin FUNCTION_LIST KF7-304.1B[5] /end FUNCTION_LIST /end MEASUREMENT
/begin MEASUREMENT vOUTREV "CVT output speed" UWORD COMP_0443 1 100 0 65535 ECU_ADDRESS 0xFFFF89B6
 /begin FUNCTION_LIST KF7-303.1[14] KF7-312.6[34] KF7-320A.2[3] KF7-330.9[8] KF7-385.1[32] KF7-505.47[3] /end FUNCTION_LIST
/end MEASUREMENT
/begin MEASUREMENT vOUTREV1 "Before 10mS, TM output speed" UWORD COMP_0443 1 100 0 65535 ECU_ADDRESS 0xFFFF1EE6 /begin FUNCTION_LIST KF7-303.1[14] KF7-385.1[32] /end FUNCTION_LIST /end MEASUREMENT
/begin MEASUREMENT vOUTREV2 "Before 20mS, TM output speed" UWORD COMP_0443 1 100 0 65535 ECU_ADDRESS 0xFFFF1EE8 /begin FUNCTION_LIST KF7-303.1[14] KF7-385.1[32] /end FUNCTION_LIST /end MEASUREMENT
/begin MEASUREMENT vOUTREV3 "Before 30mS, TM output speed" UWORD COMP_0443 1 100 0 65535 ECU_ADDRESS 0xFFFF1EEA /begin FUNCTION_LIST KF7-303.1[14] KF7-385.1[32] /end FUNCTION_LIST /end MEASUREMENT
/begin MEASUREMENT vOUTREV4 "Before 40mS, TM output speed" UWORD COMP_0443 1 100 0 65535 ECU_ADDRESS 0xFFFF1EEC /begin FUNCTION_LIST KF7-303.1[14] KF7-385.1[32] /end FUNCTION_LIST /end MEASUREMENT
/begin MEASUREMENT vOUTREV5 "Before 50mS, TM output speed" UWORD COMP_0443 1 100 0 65535 ECU_ADDRESS 0xFFFF1EEE /begin FUNCTION_LIST KF7-303.1[14] KF7-385.1[32] /end FUNCTION_LIST /end MEASUREMENT
/begin MEASUREMENT vOUTREVFL "After filtering, CVT output speed" UWORD COMP_0443 1 100 0 65535 ECU_ADDRESS 0xFFFF89B8 /begin FUNCTION_LIST KF7-303.1[14] KF7-340.9M[3] KF7-340.9P[3] /end FUNCTION_LIST /end MEASUREMENT
/begin MEASUREMENT vPARGEQA "Purge inhalation air quantity index number" UWORD COMP_0068 1 100 0 65535 ECU_ADDRESS 0xFFFF23EC /begin FUNCTION_LIST KF7-304.1B[5] KF7-371.1E[15] KF7-500.8[5] KF7-500.60[5] /end FUNCTION_LIST /end MEASUREMENT
/begin MEASUREMENT vPBADNW "Supercharge pressure sensor output value" UWORD COMP_0023 1 100 0 327675 ECU_ADDRESS 0xFFFF8886 /begin FUNCTION_LIST KF7-304.1B[5] /end FUNCTION_LIST /end MEASUREMENT
/begin MEASUREMENT vPBAV "Supercharge pressure sensor weighted average value" UWORD COMP_0023 1 100 0 327675 ECU_ADDRESS 0xFFFF8888 /begin FUNCTION_LIST KF7-304.1B[5] KF7-304.2[21] KF7-304.13[N] KF7-312.6[34] /end FUNCTION_LIST /end MEASUREMENT
/begin MEASUREMENT vPOSCNTE "Between the VTC reference signal - the cam target signal, POS10 signal input counter" UBYTE COMP_0068 1 100 0 255 ECU_ADDRESS 0xFFFF1692 /begin FUNCTION_LIST KF7-303.7B[N] /end FUNCTION_LIST /end MEASUREMENT
/begin MEASUREMENT vPOSTIME "POS10 signal period (for the VTC angle detection)" UWORD COMP_0189 1 100 0 209712 ECU_ADDRESS 0xFFFF21F0 /begin FUNCTION_LIST KF7-303.7B[N] /end FUNCTION_LIST /end MEASUREMENT
/begin MEASUREMENT vPPSV "P/S oil pressure sensor voltage" UBYTE COMP_0054 1 100 0 5100 ECU_ADDRESS 0xFFFF1693 /begin FUNCTION_LIST KF7-301.28[2] KF7-330.5[53] KF7-460.1[6] KF7-500.73[1] /end FUNCTION_LIST /end MEASUREMENT
/begin MEASUREMENT vPTDNE "Engine speed (10mS renewal NE)" UWORD COMP_0065 1 100 0 204796.875 ECU_ADDRESS 0xFFFF16A6
 /begin FUNCTION_LIST KF7-303.6M[5] KF7-340.1M[8] KF7-340.1P[7] KF7-340.2M[2] KF7-340.8M[8] KF7-340.10M[1] KF7-340.10P[N] KF7-360.8M[4] KF7-360.9M[43] KF7-385.3[4] KF7-410.11M[4] KF7-410.17M[5] R000.1.RS_Integ_1_10_2 R301.8.Inverse_filter_1_1_3 R301.20.AmbientComp_1_0_2 /end FUNCTION_LIST
/end MEASUREMENT
/begin MEASUREMENT vPTDNE_S "Engine speed SubCPU" UWORD COMP_0065 1 100 0 204796.875 ECU_ADDRESS 0xFFFF1C48
 /begin FUNCTION_LIST KF7-303.6M[5] KF7-340.1P[7] KF7-340.2P[1] KF7-340.8P[8] KF7-410.11P[4] KF7-410.17P[1] R000.1.RS_Integ_1_10_2 R301.20.AmbientComp_1_0_2 /end FUNCTION_LIST
/end MEASUREMENT
/begin MEASUREMENT vQ4 "QS+DQCO" ULONG COMP_0004 1 100 0 4294967295 ECU_ADDRESS 0xFFFF1DC0 /begin FUNCTION_LIST KF7-304.1B[5] KF7-304.2[21] /end FUNCTION_LIST /end MEASUREMENT
/begin MEASUREMENT vQAA "Inhalation air quantity index number mean" UWORD COMP_0004 1 100 0 65535 ECU_ADDRESS 0xFFFF1DC4 /begin FUNCTION_LIST KF7-304.1B[5] /end FUNCTION_LIST /end MEASUREMENT
/begin MEASUREMENT vQAA2 "Inhalation air quantity index number mean" UWORD COMP_0004 1 100 0 65535 ECU_ADDRESS 0xFFFF1D70 /begin FUNCTION_LIST KF7-304.1B[5] /end FUNCTION_LIST /end MEASUREMENT
/begin MEASUREMENT vQFUN "The amount of fuel consumption" UWORD COMP_0034_S 1 100 0 20479.6875 ECU_ADDRESS 0xFFFF16DA /begin FUNCTION_LIST KF7-305.7[6] R901.1.Diag_on_can_app_1_6_2 /end FUNCTION_LIST /end MEASUREMENT
/begin MEASUREMENT vQM "Inhalation air quantity mean" UWORD COMP_0004 1 100 0 65535 ECU_ADDRESS 0xFFFF888C
 /begin FUNCTION_LIST KF7-304.1B[5] KF7-313C.6[5] KF7-313C.9[3] KF7-378.2B[6] KF7-500.1[54] KF7-500.21[19] KF7-500.24[10] KF7-525.2[6] KF7-580.1[8] R904.1.Gst_on_can_1_0_1 /end FUNCTION_LIST
/end MEASUREMENT
/begin MEASUREMENT vQM0 "Inhalation air quantity index number weighted average value" UWORD COMP_0004 1 100 0 65535 ECU_ADDRESS 0xFFFF1D72 /begin FUNCTION_LIST KF7-304.1B[5] KF7-500.8[5] /end FUNCTION_LIST /end MEASUREMENT
/begin MEASUREMENT vQS "The amount of inhalation air" ULONG COMP_0004 1 100 0 4294967295 ECU_ADDRESS 0xFFFF1D74 /begin FUNCTION_LIST KF7-304.1B[5] KF7-304.2[21] /end FUNCTION_LIST /end MEASUREMENT
/begin MEASUREMENT vQSS "The amount of high frequency compensation" UWORD COMP_0004 1 100 0 65535 ECU_ADDRESS 0xFFFF1D78 /begin FUNCTION_LIST KF7-304.1B[5] /end FUNCTION_LIST /end MEASUREMENT
/begin MEASUREMENT vQTASEEP "The amount of off-line idle air" SBYTE COMP_0277 1 100 -128 127 ECU_ADDRESS 0xFFFFAEF0 /begin FUNCTION_LIST KF7-305.1[7] KF7-305.4BM[31] KF7-580.1[8] /end FUNCTION_LIST /end MEASUREMENT
/begin MEASUREMENT vQTASEEP1 "The amount of off-line idle air" SWORD COMP_0277 1 100 -32768 32767 ECU_ADDRESS 0xFFFFAEF2
 /begin FUNCTION_LIST KF7-305.4AM[10] KF7-305.4BM[31] KF7-330.5[53] KF7-351.1[16] KF7-351.2[17] R000.4.EepAlloc_1_2_2 R301.6.IscAirflow_1_4_5 R301.19.ISC_PID_cont_1_0_2 R901.1.Diag_on_can_app_1_6_2 /end FUNCTION_LIST
/end MEASUREMENT
/begin MEASUREMENT vQTC "The amount of supercharge pressure compensation" SLONG COMP_0263 1 100 -2147483648 2147483647 ECU_ADDRESS 0xFFFF1DC8 /begin FUNCTION_LIST KF7-304.1B[5] /end FUNCTION_LIST /end MEASUREMENT
/begin MEASUREMENT vRATECNT1 "A/F sensor response deterioration diagnosis (an active form) complete number of times counter bank 1" UWORD COMP_0016 1 100 0 65535 ECU_ADDRESS 0xFFFFB7B0 /begin FUNCTION_LIST KF7-305.4BM[31] KF7-313C.1[36] R000.4.EepAlloc_1_2_2 /end FUNCTION_LIST /end MEASUREMENT
/begin MEASUREMENT vRATECNT2 "A/F sensor response deterioration diagnosis (an active form) complete number of times counter bank 2" UWORD COMP_0016 1 100 0 65535 ECU_ADDRESS 0xFFFFB7B2 /begin FUNCTION_LIST KF7-305.4BM[31] KF7-313C.1[36] R000.4.EepAlloc_1_2_2 /end FUNCTION_LIST /end MEASUREMENT
/begin MEASUREMENT vRESCNT1 "A/F sensor (O2 sensor) response deterioration diagnosis complete number of times counter bank 1" UWORD COMP_0016 1 100 0 65535 ECU_ADDRESS 0xFFFFB7B4 /begin FUNCTION_LIST KF7-305.4BM[31] KF7-500.74[11] R000.4.EepAlloc_1_2_2 /end FUNCTION_LIST /end MEASUREMENT
/begin MEASUREMENT vRESCNT2 "A/F sensor (O2 sensor) response deterioration diagnosis complete number of times counter bank 2" UWORD COMP_0016 1 100 0 65535 ECU_ADDRESS 0xFFFFB7B6 /begin FUNCTION_LIST KF7-305.4BM[31] KF7-500.74[11] R000.4.EepAlloc_1_2_2 /end FUNCTION_LIST /end MEASUREMENT
/begin MEASUREMENT vRESCNTL1 "A/F sensor response diagnosis complete number of times counter bank 1 (lean rich)" UWORD COMP_0016 1 100 0 65535 ECU_ADDRESS 0xFFFFAF00 /begin FUNCTION_LIST KF7-305.4BM[31] KF7-500.74[11] R000.4.EepAlloc_1_2_2 /end FUNCTION_LIST /end MEASUREMENT
/begin MEASUREMENT vRESCNTL2 "A/F sensor response diagnosis complete number of times counter bank 2 (lean rich)" UWORD COMP_0016 1 100 0 65535 ECU_ADDRESS 0xFFFFAF02 /begin FUNCTION_LIST KF7-305.4BM[31] KF7-500.74[11] R000.4.EepAlloc_1_2_2 /end FUNCTION_LIST /end MEASUREMENT
/begin MEASUREMENT vRESCNTR1 "A/F sensor response diagnosis complete number of times counter bank 1 (rich lean)" UWORD COMP_0016 1 100 0 65535 ECU_ADDRESS 0xFFFFAF04 /begin FUNCTION_LIST KF7-305.4BM[31] KF7-500.74[11] R000.4.EepAlloc_1_2_2 /end FUNCTION_LIST /end MEASUREMENT
/begin MEASUREMENT vRESCNTR2 "A/F sensor response diagnosis complete number of times counter bank 2 (rich lean)" UWORD COMP_0016 1 100 0 65535 ECU_ADDRESS 0xFFFFB7B8 /begin FUNCTION_LIST KF7-305.4BM[31] KF7-500.74[11] R000.4.EepAlloc_1_2_2 /end FUNCTION_LIST /end MEASUREMENT
/begin MEASUREMENT vRESTRP "A trip counter for the A/F sensor (O2 sensor) response deterioration diagnosis" UWORD COMP_0016 1 100 0 65535 ECU_ADDRESS 0xFFFFB7BA /begin FUNCTION_LIST KF7-305.4BM[31] KF7-500.74[11] R000.4.EepAlloc_1_2_2 /end FUNCTION_LIST /end MEASUREMENT
/begin MEASUREMENT vRESTRP2 "A trip counter for the A/F sensor response deterioration diagnosis (Form.)" UWORD COMP_0016 1 100 0 65535 ECU_ADDRESS 0xFFFFB7BC /begin FUNCTION_LIST KF7-305.4BM[31] R000.4.EepAlloc_1_2_2 /end FUNCTION_LIST /end MEASUREMENT
/begin MEASUREMENT vREVX "Low precision speed" UWORD COMP_0443 1 100 0 65535 ECU_ADDRESS 0xFFFF1F06 /begin FUNCTION_LIST KF7-303.1[14] /end FUNCTION_LIST /end MEASUREMENT
/begin MEASUREMENT vREVXFL "After filtering, low precision speed" UWORD COMP_0443 1 100 0 65535 ECU_ADDRESS 0xFFFF89C4 /begin FUNCTION_LIST KF7-303.1[14] KF7-340.9M[3] KF7-340.9P[3] /end FUNCTION_LIST /end MEASUREMENT
/begin MEASUREMENT vRPMCNT "A POS counter for the engine speed (POS) computation" UWORD COMP_0004 1 100 0 65535 ECU_ADDRESS 0xFFFF1D1E /begin FUNCTION_LIST KF7-303.6M[5] /end FUNCTION_LIST /end MEASUREMENT
/begin MEASUREMENT vRPMPS1 "Before 10mS, engine speed" UWORD COMP_0006 1 100 0 819187.5 ECU_ADDRESS 0xFFFF1F08 /begin FUNCTION_LIST KF7-303.6M[5] /end FUNCTION_LIST /end MEASUREMENT
/begin MEASUREMENT vRPMPS2 "Before 20mS, engine speed" UWORD COMP_0006 1 100 0 819187.5 ECU_ADDRESS 0xFFFF1F0A /begin FUNCTION_LIST KF7-303.6M[5] /end FUNCTION_LIST /end MEASUREMENT
/begin MEASUREMENT vRPMPS3 "Before 30mS, engine speed" UWORD COMP_0006 1 100 0 819187.5 ECU_ADDRESS 0xFFFF1F0C /begin FUNCTION_LIST KF7-303.6M[5] /end FUNCTION_LIST /end MEASUREMENT
/begin MEASUREMENT vRPMPS4 "Before 40mS, engine speed" UWORD COMP_0006 1 100 0 819187.5 ECU_ADDRESS 0xFFFF1F0E /begin FUNCTION_LIST KF7-303.6M[5] /end FUNCTION_LIST /end MEASUREMENT
/begin MEASUREMENT vRPMPS5 "Before 50mS, engine speed" UWORD COMP_0006 1 100 0 819187.5 ECU_ADDRESS 0xFFFF1F10 /begin FUNCTION_LIST KF7-303.6M[5] /end FUNCTION_LIST /end MEASUREMENT
/begin MEASUREMENT vSECID "Security ID (parameter K)" UWORD COMP_0068 1 100 0 65535 ECU_ADDRESS 0xFFFFB642 /begin FUNCTION_LIST KF7-305.4BM[31] /end FUNCTION_LIST /end MEASUREMENT
/begin MEASUREMENT vSEED "Seed" UWORD COMP_0068 1 100 0 65535 ECU_ADDRESS 0xFFFFB644 /begin FUNCTION_LIST KF7-305.4BM[31] /end FUNCTION_LIST /end MEASUREMENT
/begin MEASUREMENT vSFSTTS "After the start, a control prohibition delay by the cylinder" UBYTE COMP_0008 1 100 0 25500 ECU_ADDRESS 0xFFFF1F12 /begin FUNCTION_LIST KF7-304.3[2] /end FUNCTION_LIST /end MEASUREMENT
/begin MEASUREMENT vSNRPM "Engine speed" UBYTE COMP_0480 1 100 0 1593.75 ECU_ADDRESS 0xFFFF2238 /begin FUNCTION_LIST KF7-303.6M[5] /end FUNCTION_LIST /end MEASUREMENT
/begin MEASUREMENT vSSFCNT "S/S/ off system diagnosis counter" UBYTE COMP_0016 1 100 0 255 ECU_ADDRESS 0xFFFFB22E
 /begin FUNCTION_LIST KF7-305.4BM[31] KF7-505.25[3] KF7-505.26[2] R000.4.EepAlloc_1_2_2 /end FUNCTION_LIST
/end MEASUREMENT
/begin MEASUREMENT vSTONVB "At the time of starter on, at least, battery voltage" UBYTE COMP_0033 1 100 0 20400 ECU_ADDRESS 0xFFFF17BB /begin FUNCTION_LIST KF7-302.4MA[13] /end FUNCTION_LIST /end MEASUREMENT
/begin MEASUREMENT vSTTCNT "An initial number of times counter" UWORD COMP_0016 1 100 0 65535 ECU_ADDRESS 0xFFFFB7C4 /begin FUNCTION_LIST KF7-305.4BM[31] R000.4.EepAlloc_1_2_2 /end FUNCTION_LIST /end MEASUREMENT
/begin MEASUREMENT vSTTM "Initial judgement time" UBYTE COMP_0008 1 100 0 25500 ECU_ADDRESS 0xFFFF1F18 /begin FUNCTION_LIST KF7-304.2[21] /end FUNCTION_LIST /end MEASUREMENT
/begin MEASUREMENT vSTTMIN "Initial judgement time" UBYTE COMP_0008 1 100 0 25500 ECU_ADDRESS 0xFFFF1F19 /begin FUNCTION_LIST KF7-304.2[21] /end FUNCTION_LIST /end MEASUREMENT
/begin MEASUREMENT vSUMVSP "At the time of the trouble, vehicle speed integration value" ULONG COMP_0389 1 100 0 1685624.33943218 ECU_ADDRESS 0xFFFFB648
 /begin FUNCTION_LIST KF7-305.4BM[31] KF7-500.1[54] R000.4.EepAlloc_1_2_2 R904.1.Gst_on_can_1_0_1 /end FUNCTION_LIST
/end MEASUREMENT
/begin MEASUREMENT vTADVOV "Energizing time limit" UWORD COMP_0157_S 1 100 0 2097120 ECU_ADDRESS 0xFFFF17FE /begin FUNCTION_LIST KF7-303.5A[9] /end FUNCTION_LIST /end MEASUREMENT
/begin MEASUREMENT vTCAM "CAM signal period" ULONG COMP_0189 1 100 0 13743895344 ECU_ADDRESS 0xFFFF2240 /begin FUNCTION_LIST KF7-303.6P[1] KF7-450.9A[5] /end FUNCTION_LIST /end MEASUREMENT
/begin MEASUREMENT vTCAM1 "CAM signal periodic memory 1" ULONG COMP_0189 1 100 0 13743895344 ECU_ADDRESS 0xFFFF2244 /begin FUNCTION_LIST KF7-303.6P[1] KF7-450.9A[5] /end FUNCTION_LIST /end MEASUREMENT
/begin MEASUREMENT vTCAM2 "CAM signal periodic memory 2" ULONG COMP_0189 1 100 0 13743895344 ECU_ADDRESS 0xFFFF2248 /begin FUNCTION_LIST KF7-303.6P[1] KF7-450.9A[5] /end FUNCTION_LIST /end MEASUREMENT
/begin MEASUREMENT vTDWLL "Energizing angle" UBYTE COMP_0017 1 100 0 255 ECU_ADDRESS 0xFFFF2408
 /begin FUNCTION_LIST KF7-303.5A[9] KF7-320A.6[3] KF7-320A.21[N] R901.1.Diag_on_can_app_1_6_2 /end FUNCTION_LIST
/end MEASUREMENT
/begin MEASUREMENT vTFBYAX "The target air-fuel ratio which doesn't become 0 at the time as the fuel cut" UWORD COMP_0217 1 100 0 3.999941832 ECU_ADDRESS 0xFFFF18D4 /begin FUNCTION_LIST KF7-305.7[6] KF7-386.1[4] KF7-450.50[10] /end FUNCTION_LIST /end MEASUREMENT
/begin MEASUREMENT vTIM "Fuel consumption meter monitor pulse width" UWORD COMP_0098 1 100 0 104856 ECU_ADDRESS 0xFFFF192E /begin FUNCTION_LIST KF7-305.7[6] KF7-320A.6[3] KF7-320A.21[N] /end FUNCTION_LIST /end MEASUREMENT
/begin MEASUREMENT vTIMON "Fuel consumption quantity monitor pulse width" ULONG COMP_0320 1 100 0 6871947672 ECU_ADDRESS 0xFFFF1930 /begin FUNCTION_LIST KF7-305.7[6] /end FUNCTION_LIST /end MEASUREMENT
/begin MEASUREMENT vTIPSd "At the time of the sequential injection, output pulse width" UWORD COMP_0320 1 100 0 104856 ECU_ADDRESS 0xFFFF1936 /begin FUNCTION_LIST KF7-305.7[6] KF7-450.50[10] KF7-525.2[6] KF7-580.1[8] /end FUNCTION_LIST /end MEASUREMENT
/begin MEASUREMENT vTIPSd_R#1 "At the time of the sequential injection, output pulse width" UWORD COMP_0320 1 100 0 104856 ECU_ADDRESS 0xFFFF1936 /begin FUNCTION_LIST KF7-305.7[6] KF7-450.50[10] KF7-525.2[6] KF7-580.1[8] /end FUNCTION_LIST /end MEASUREMENT
/begin MEASUREMENT vTIPSd_R#2 "At the time of the sequential injection, output pulse width" UWORD COMP_0320 1 100 0 104856 ECU_ADDRESS 0xFFFF1938 /begin FUNCTION_LIST KF7-305.7[6] KF7-450.50[10] KF7-525.2[6] KF7-580.1[8] /end FUNCTION_LIST /end MEASUREMENT
/begin MEASUREMENT vTMFPON "F/P relay on time integration timer" UBYTE COMP_0014 1 100 0 2550 ECU_ADDRESS 0xFFFFB2A6
 /begin FUNCTION_LIST KF7-305.4BM[31] KF7-311.1A[21] KF7-373.1[1] R000.4.EepAlloc_1_2_2 /end FUNCTION_LIST
/end MEASUREMENT
/begin MEASUREMENT vTMINJ "For the injection start timing time" UBYTE COMP_0017 1 100 0 255 ECU_ADDRESS 0xFFFF194F /begin FUNCTION_LIST KF7-303.5A[9] /end FUNCTION_LIST /end MEASUREMENT
/begin MEASUREMENT vTMINJS "For the stratified injection start timing time" UBYTE COMP_0017 1 100 0 255 ECU_ADDRESS 0xFFFF224F /begin FUNCTION_LIST KF7-303.5A[9] /end FUNCTION_LIST /end MEASUREMENT
/begin MEASUREMENT vTOIL "KT oil temperature" UBYTE COMP_0128_S 1 100 -30 1245 ECU_ADDRESS 0xFFFF497C /begin FUNCTION_LIST KF7-302.5M[10] KF7-312.6[34] KF7-360.9M[43] /end FUNCTION_LIST /end MEASUREMENT
/begin MEASUREMENT vTOLDQH "An old QH0 table" UBYTE COMP_0032 1 100 0 0.99609375 ECU_ADDRESS 0xFFFF1F2B /begin FUNCTION_LIST KF7-304.2[21] /end FUNCTION_LIST /end MEASUREMENT
/begin MEASUREMENT vTOLDQH_R#1 "An old QH0 table" UBYTE COMP_0032 1 100 0 0.99609375 ECU_ADDRESS 0xFFFF1F2B /begin FUNCTION_LIST KF7-304.2[21] /end FUNCTION_LIST /end MEASUREMENT
/begin MEASUREMENT vTOLDQH_R#2 "An old QH0 table" UBYTE COMP_0032 1 100 0 0.99609375 ECU_ADDRESS 0xFFFF1F2C /begin FUNCTION_LIST KF7-304.2[21] /end FUNCTION_LIST /end MEASUREMENT
/begin MEASUREMENT vTOLDQH_R#3 "An old QH0 table" UBYTE COMP_0032 1 100 0 0.99609375 ECU_ADDRESS 0xFFFF1F2D /begin FUNCTION_LIST KF7-304.2[21] /end FUNCTION_LIST /end MEASUREMENT
/begin MEASUREMENT vTOLDQH_R#4 "An old QH0 table" UBYTE COMP_0032 1 100 0 0.99609375 ECU_ADDRESS 0xFFFF1F2E /begin FUNCTION_LIST KF7-304.2[21] /end FUNCTION_LIST /end MEASUREMENT
/begin MEASUREMENT vTOLDQH_R#5 "An old QH0 table" UBYTE COMP_0032 1 100 0 0.99609375 ECU_ADDRESS 0xFFFF1F2F /begin FUNCTION_LIST KF7-304.2[21] /end FUNCTION_LIST /end MEASUREMENT
/begin MEASUREMENT vTOLDQH_R#6 "An old QH0 table" UBYTE COMP_0032 1 100 0 0.99609375 ECU_ADDRESS 0xFFFF1F30 /begin FUNCTION_LIST KF7-304.2[21] /end FUNCTION_LIST /end MEASUREMENT
/begin MEASUREMENT vTOLDQH_R#7 "An old QH0 table" UBYTE COMP_0032 1 100 0 0.99609375 ECU_ADDRESS 0xFFFF1F31 /begin FUNCTION_LIST KF7-304.2[21] /end FUNCTION_LIST /end MEASUREMENT
/begin MEASUREMENT vTOLDQH_R#8 "An old QH0 table" UBYTE COMP_0032 1 100 0 0.99609375 ECU_ADDRESS 0xFFFF1F32 /begin FUNCTION_LIST KF7-304.2[21] /end FUNCTION_LIST /end MEASUREMENT
/begin MEASUREMENT vTOLDQH_R#9 "An old QH0 table" UBYTE COMP_0032 1 100 0 0.99609375 ECU_ADDRESS 0xFFFF1F33 /begin FUNCTION_LIST KF7-304.2[21] /end FUNCTION_LIST /end MEASUREMENT
/begin MEASUREMENT vTOLDQH_R#10 "An old QH0 table" UBYTE COMP_0032 1 100 0 0.99609375 ECU_ADDRESS 0xFFFF1F34 /begin FUNCTION_LIST KF7-304.2[21] /end FUNCTION_LIST /end MEASUREMENT
/begin MEASUREMENT vTOLDQH_R#11 "An old QH0 table" UBYTE COMP_0032 1 100 0 0.99609375 ECU_ADDRESS 0xFFFF1F35 /begin FUNCTION_LIST KF7-304.2[21] /end FUNCTION_LIST /end MEASUREMENT
/begin MEASUREMENT vTP0 "Basic pulse width" ULONG COMP_0512 1 100 0 8388607.99804688 ECU_ADDRESS 0xFFFF1DD0 /begin FUNCTION_LIST KF7-303.6M[5] KF7-304.2[21] /end FUNCTION_LIST /end MEASUREMENT
/begin MEASUREMENT vTP100 "Before 100mS, TP" UWORD COMP_0001 1 100 0 8191.875 ECU_ADDRESS 0xFFFF3F6C /begin FUNCTION_LIST KF7-304.2[21] KF7-350.4M[14] KF7-350.4P[13] KF7-386.1[4] /end FUNCTION_LIST /end MEASUREMENT
/begin MEASUREMENT vTPBGH "QH0 supercharge pressure compensation coefficient" UBYTE COMP_0009 1 100 0 199.21875 ECU_ADDRESS 0xFFFF1F36 /begin FUNCTION_LIST KF7-304.2[21] KF7-304.13[N] /end FUNCTION_LIST /end MEASUREMENT
/begin MEASUREMENT vTPMAX "TTPMAX reference value" UBYTE COMP_0001 1 100 0 31.875 ECU_ADDRESS 0xFFFF1DD6 /begin FUNCTION_LIST KF7-304.2[21] KF7-312.6[34] /end FUNCTION_LIST /end MEASUREMENT
/begin MEASUREMENT vTPMXQH "At the time of the slowdown, TPMAX" UWORD COMP_0144 1 100 0 31.999495335 ECU_ADDRESS 0xFFFF1F38 /begin FUNCTION_LIST KF7-304.2[21] /end FUNCTION_LIST /end MEASUREMENT
/begin MEASUREMENT vTPO1QL "TPO1 learning compensation value" UWORD COMP_0023 1 100 0 327675 ECU_ADDRESS 0xFFFF3F70 /begin FUNCTION_LIST KF7-304.9[2] KF7-351.3[11] /end FUNCTION_LIST /end MEASUREMENT
/begin MEASUREMENT vTPOS10 "POS10 signal - cam target signal measuring time" UWORD COMP_0189 1 100 0 209712 ECU_ADDRESS 0xFFFF225A /begin FUNCTION_LIST KF7-303.5A[9] KF7-303.6M[5] KF7-450.9A[5] /end FUNCTION_LIST /end MEASUREMENT
/begin MEASUREMENT vTPOS10Q "Time until now from the TPOS10 signal" ULONG COMP_0369 1 100 0 13743895344 ECU_ADDRESS 0xFFFF1F3C /begin FUNCTION_LIST KF7-303.6M[5] /end FUNCTION_LIST /end MEASUREMENT
/begin MEASUREMENT vTPOSCP "POS signal periodic ratio" UBYTE COMP_0186 1 100 0 3.984375 ECU_ADDRESS 0xFFFF198D /begin FUNCTION_LIST KF7-303.5A[9] KF7-450.9A[5] /end FUNCTION_LIST /end MEASUREMENT
/begin MEASUREMENT vTPOSCPHH "More than the head POS judgement S/L upper limit value" UBYTE COMP_0186 1 100 0 3.984375 ECU_ADDRESS 0xFFFFB2AA /begin FUNCTION_LIST KF7-303.5A[9] /end FUNCTION_LIST /end MEASUREMENT
/begin MEASUREMENT vTPOSCPHL "More than the head POS judgement S/L lower limit value" UBYTE COMP_0186 1 100 0 3.984375 ECU_ADDRESS 0xFFFFB2AB /begin FUNCTION_LIST KF7-303.5A[9] /end FUNCTION_LIST /end MEASUREMENT
/begin MEASUREMENT vTPOSCPLH "The head POS judgement S/L following upper limit value" UBYTE COMP_0186 1 100 0 3.984375 ECU_ADDRESS 0xFFFFB2AC /begin FUNCTION_LIST KF7-303.5A[9] /end FUNCTION_LIST /end MEASUREMENT
/begin MEASUREMENT vTPOSCPLL "The head POS judgement S/L following lower limit value" UBYTE COMP_0186 1 100 0 3.984375 ECU_ADDRESS 0xFFFFB2AD /begin FUNCTION_LIST KF7-303.5A[9] /end FUNCTION_LIST /end MEASUREMENT
/begin MEASUREMENT vTPSK "Taking in advance compensation pulse width" SWORD COMP_0515 1 100 -15.999991808 15.999503527 ECU_ADDRESS 0xFFFF8890 /begin FUNCTION_LIST KF7-304.2[21] KF7-313C.11B[1] /end FUNCTION_LIST /end MEASUREMENT
/begin MEASUREMENT vTREF "REF signal period" ULONG COMP_0073 1 100 0 13743895344 ECU_ADDRESS 0xFFFF89F0 /begin FUNCTION_LIST KF7-303.5A[9] KF7-303.6M[5] KF7-450.9A[5] /end FUNCTION_LIST /end MEASUREMENT
/begin MEASUREMENT vTREF10 "Crank angle 10deg period" UWORD COMP_0189 1 100 0 209712 ECU_ADDRESS 0xFFFF225C
 /begin FUNCTION_LIST KF7-303.5A[9] KF7-303.6M[5] KF7-303.7B[N] KF7-305.9[3] KF7-450.9A[5] /end FUNCTION_LIST
/end MEASUREMENT
/begin MEASUREMENT vTREF_S "REF-15B signal period" ULONG COMP_0369 1 100 0 13743895344 ECU_ADDRESS 0xFFFF229C /begin FUNCTION_LIST KF7-303.6P[1] /end FUNCTION_LIST /end MEASUREMENT
/begin MEASUREMENT vTSQH0 "QH0 supercharge pressure compensation value" UBYTE COMP_0045 1 100 0 1.9921875 ECU_ADDRESS 0xFFFF89CE /begin FUNCTION_LIST KF7-304.2[21] KF7-304.13[N] KF7-312.4A[6] KF7-312.4C[4] /end FUNCTION_LIST /end MEASUREMENT
/begin MEASUREMENT vTVOFQL "High-speed air learning value" SWORD COMP_0519 1 100 -640.0016384 639.9821071 ECU_ADDRESS 0xFFFF341C /begin FUNCTION_LIST KF7-304.9[2] KF7-351.3[11] /end FUNCTION_LIST /end MEASUREMENT
/begin MEASUREMENT vTVOFQLS "Low speed air learning value" SWORD COMP_0519 1 100 -640.0016384 639.9821071 ECU_ADDRESS 0xFFFFB2B8
 /begin FUNCTION_LIST KF7-304.9[2] KF7-305.1[7] KF7-305.4AM[10] KF7-351.3[11] R000.4.EepAlloc_1_2_2 /end FUNCTION_LIST
/end MEASUREMENT
/begin MEASUREMENT vTVOz1 "Before TVOi* 10mS" UBYTE COMP_0002 1 100 0 89.25 ECU_ADDRESS 0xFFFF1F4F /begin FUNCTION_LIST KF7-304.10[1] /end FUNCTION_LIST /end MEASUREMENT
/begin MEASUREMENT vTVOz10 "Before TVOi* 10mS" UBYTE COMP_0002 1 100 0 89.25 ECU_ADDRESS 0xFFFF8895 /begin FUNCTION_LIST KF7-304.10[1] /end FUNCTION_LIST /end MEASUREMENT
/begin MEASUREMENT vTVOz15 "Before TVOi* 50mS" UBYTE COMP_0002 1 100 0 89.25 ECU_ADDRESS 0xFFFF89D4 /begin FUNCTION_LIST KF7-304.10[1] /end FUNCTION_LIST /end MEASUREMENT
/begin MEASUREMENT vTVOz2 "Before TVOi* 10mS" UBYTE COMP_0002 1 100 0 89.25 ECU_ADDRESS 0xFFFF1F50 /begin FUNCTION_LIST KF7-304.10[1] /end FUNCTION_LIST /end MEASUREMENT
/begin MEASUREMENT vTVOz3 "Before TVOi* 10mS" UBYTE COMP_0002 1 100 0 89.25 ECU_ADDRESS 0xFFFF89D5 /begin FUNCTION_LIST KF7-304.1B[5] KF7-304.10[1] /end FUNCTION_LIST /end MEASUREMENT
/begin MEASUREMENT vTVOz4 "Before TVOi* 10mS" UBYTE COMP_0002 1 100 0 89.25 ECU_ADDRESS 0xFFFF1F51 /begin FUNCTION_LIST KF7-304.10[1] /end FUNCTION_LIST /end MEASUREMENT
/begin MEASUREMENT vTVOz5 "Before TVOi* 10mS" UBYTE COMP_0002 1 100 0 89.25 ECU_ADDRESS 0xFFFF1F52 /begin FUNCTION_LIST KF7-304.10[1] /end FUNCTION_LIST /end MEASUREMENT
/begin MEASUREMENT vTVOz6 "Before TVOi* 10mS" UBYTE COMP_0002 1 100 0 89.25 ECU_ADDRESS 0xFFFF1F53 /begin FUNCTION_LIST KF7-304.10[1] /end FUNCTION_LIST /end MEASUREMENT
/begin MEASUREMENT vTVOz8 "Before TVOi* 10mS" UBYTE COMP_0002 1 100 0 89.25 ECU_ADDRESS 0xFFFF1F55 /begin FUNCTION_LIST KF7-304.10[1] /end FUNCTION_LIST /end MEASUREMENT
/begin MEASUREMENT vTVOz9 "Before TVOi* 10mS" UBYTE COMP_0002 1 100 0 89.25 ECU_ADDRESS 0xFFFF1F56 /begin FUNCTION_LIST KF7-304.10[1] /end FUNCTION_LIST /end MEASUREMENT
/begin MEASUREMENT vUBNCNT1 "The voltage diagnosis complete number of times counter bank 1 whose A/F sensor (O2 sensor) is unusual" UWORD COMP_0016 1 100 0 65535 ECU_ADDRESS 0xFFFFB7C6 /begin FUNCTION_LIST KF7-305.4BM[31] KF7-500.74[11] R000.4.EepAlloc_1_2_2 /end FUNCTION_LIST /end MEASUREMENT
/begin MEASUREMENT vUBNCNT2 "The voltage diagnosis complete number of times counter bank 2 whose A/F sensor (O2 sensor) is unusual" UWORD COMP_0016 1 100 0 65535 ECU_ADDRESS 0xFFFFB7C8 /begin FUNCTION_LIST KF7-305.4BM[31] KF7-500.74[11] R000.4.EepAlloc_1_2_2 /end FUNCTION_LIST /end MEASUREMENT
/begin MEASUREMENT vUBNTRP "The trip counter for the voltage diagnosis whose A/F sensor (O2 sensor) is unusual" UWORD COMP_0016 1 100 0 65535 ECU_ADDRESS 0xFFFFB7CA /begin FUNCTION_LIST KF7-305.4BM[31] R000.4.EepAlloc_1_2_2 /end FUNCTION_LIST /end MEASUREMENT
/begin MEASUREMENT vVBAVE "Battery voltage value (average treatment)" UWORD COMP_0054 1 100 0 1310700 ECU_ADDRESS 0xFFFF3836 /begin FUNCTION_LIST KF7-301.30[2] KF7-360.1[12] /end FUNCTION_LIST /end MEASUREMENT
/begin MEASUREMENT vVIN "Veicle Identifire Number" UBYTE COMP_0068 1 100 0 255 ECU_ADDRESS 0xFFFFB657 /begin FUNCTION_LIST KF7-305.4AM[10] KF7-305.4BM[31] KF7-580.1[8] /end FUNCTION_LIST /end MEASUREMENT
/begin MEASUREMENT vVIN_R#1 "Veicle Identifire Number" UBYTE COMP_0068 1 100 0 255 ECU_ADDRESS 0xFFFFB657 /begin FUNCTION_LIST KF7-305.4AM[10] KF7-305.4BM[31] KF7-580.1[8] /end FUNCTION_LIST /end MEASUREMENT
/begin MEASUREMENT vVIN_R#2 "Veicle Identifire Number" UBYTE COMP_0068 1 100 0 255 ECU_ADDRESS 0xFFFFB658 /begin FUNCTION_LIST KF7-305.4AM[10] KF7-305.4BM[31] KF7-580.1[8] /end FUNCTION_LIST /end MEASUREMENT
/begin MEASUREMENT vVIN_R#3 "Veicle Identifire Number" UBYTE COMP_0068 1 100 0 255 ECU_ADDRESS 0xFFFFB659 /begin FUNCTION_LIST KF7-305.4AM[10] KF7-305.4BM[31] KF7-580.1[8] /end FUNCTION_LIST /end MEASUREMENT
/begin MEASUREMENT vVIN_R#4 "Veicle Identifire Number" UBYTE COMP_0068 1 100 0 255 ECU_ADDRESS 0xFFFFB65A /begin FUNCTION_LIST KF7-305.4AM[10] KF7-305.4BM[31] KF7-580.1[8] /end FUNCTION_LIST /end MEASUREMENT
/begin MEASUREMENT vVIN_R#5 "Veicle Identifire Number" UBYTE COMP_0068 1 100 0 255 ECU_ADDRESS 0xFFFFB65B /begin FUNCTION_LIST KF7-305.4AM[10] KF7-305.4BM[31] KF7-580.1[8] /end FUNCTION_LIST /end MEASUREMENT
/begin MEASUREMENT vVIN_R#6 "Veicle Identifire Number" UBYTE COMP_0068 1 100 0 255 ECU_ADDRESS 0xFFFFB65C /begin FUNCTION_LIST KF7-305.4AM[10] KF7-305.4BM[31] KF7-580.1[8] /end FUNCTION_LIST /end MEASUREMENT
/begin MEASUREMENT vVIN_R#7 "Veicle Identifire Number" UBYTE COMP_0068 1 100 0 255 ECU_ADDRESS 0xFFFFB65D /begin FUNCTION_LIST KF7-305.4AM[10] KF7-305.4BM[31] KF7-580.1[8] /end FUNCTION_LIST /end MEASUREMENT
/begin MEASUREMENT vVIN_R#8 "Veicle Identifire Number" UBYTE COMP_0068 1 100 0 255 ECU_ADDRESS 0xFFFFB65E /begin FUNCTION_LIST KF7-305.4AM[10] KF7-305.4BM[31] KF7-580.1[8] /end FUNCTION_LIST /end MEASUREMENT
/begin MEASUREMENT vVIN_R#9 "Veicle Identifire Number" UBYTE COMP_0068 1 100 0 255 ECU_ADDRESS 0xFFFFB65F /begin FUNCTION_LIST KF7-305.4AM[10] KF7-305.4BM[31] KF7-580.1[8] /end FUNCTION_LIST /end MEASUREMENT
/begin MEASUREMENT vVIN_R#10 "Veicle Identifire Number" UBYTE COMP_0068 1 100 0 255 ECU_ADDRESS 0xFFFFB660 /begin FUNCTION_LIST KF7-305.4AM[10] KF7-305.4BM[31] KF7-580.1[8] /end FUNCTION_LIST /end MEASUREMENT
/begin MEASUREMENT vVIN_R#11 "Veicle Identifire Number" UBYTE COMP_0068 1 100 0 255 ECU_ADDRESS 0xFFFFB661 /begin FUNCTION_LIST KF7-305.4AM[10] KF7-305.4BM[31] KF7-580.1[8] /end FUNCTION_LIST /end MEASUREMENT
/begin MEASUREMENT vVIN_R#12 "Veicle Identifire Number" UBYTE COMP_0068 1 100 0 255 ECU_ADDRESS 0xFFFFB662 /begin FUNCTION_LIST KF7-305.4AM[10] KF7-305.4BM[31] KF7-580.1[8] /end FUNCTION_LIST /end MEASUREMENT
/begin MEASUREMENT vVIN_R#13 "Veicle Identifire Number" UBYTE COMP_0068 1 100 0 255 ECU_ADDRESS 0xFFFFB663 /begin FUNCTION_LIST KF7-305.4AM[10] KF7-305.4BM[31] KF7-580.1[8] /end FUNCTION_LIST /end MEASUREMENT
/begin MEASUREMENT vVIN_R#14 "Veicle Identifire Number" UBYTE COMP_0068 1 100 0 255 ECU_ADDRESS 0xFFFFB664 /begin FUNCTION_LIST KF7-305.4AM[10] KF7-305.4BM[31] KF7-580.1[8] /end FUNCTION_LIST /end MEASUREMENT
/begin MEASUREMENT vVIN_R#15 "Veicle Identifire Number" UBYTE COMP_0068 1 100 0 255 ECU_ADDRESS 0xFFFFB665 /begin FUNCTION_LIST KF7-305.4AM[10] KF7-305.4BM[31] KF7-580.1[8] /end FUNCTION_LIST /end MEASUREMENT
/begin MEASUREMENT vVIN_R#16 "Veicle Identifire Number" UBYTE COMP_0068 1 100 0 255 ECU_ADDRESS 0xFFFFB666 /begin FUNCTION_LIST KF7-305.4AM[10] KF7-305.4BM[31] KF7-580.1[8] /end FUNCTION_LIST /end MEASUREMENT
/begin MEASUREMENT vVIN_R#17 "Veicle Identifire Number" UBYTE COMP_0068 1 100 0 255 ECU_ADDRESS 0xFFFFB667 /begin FUNCTION_LIST KF7-305.4AM[10] KF7-305.4BM[31] KF7-580.1[8] /end FUNCTION_LIST /end MEASUREMENT
/begin MEASUREMENT vVIN_R#18 "Veicle Identifire Number" UBYTE COMP_0068 1 100 0 255 ECU_ADDRESS 0xFFFFB668 /begin FUNCTION_LIST KF7-305.4AM[10] KF7-305.4BM[31] KF7-580.1[8] /end FUNCTION_LIST /end MEASUREMENT
/begin MEASUREMENT vVIN_R#19 "Veicle Identifire Number" UBYTE COMP_0068 1 100 0 255 ECU_ADDRESS 0xFFFFB669 /begin FUNCTION_LIST KF7-305.4AM[10] KF7-305.4BM[31] KF7-580.1[8] /end FUNCTION_LIST /end MEASUREMENT
/begin MEASUREMENT vVINNUM "VIN writing value" UBYTE COMP_0068 1 100 0 255 ECU_ADDRESS 0xFFFFB2CA /begin FUNCTION_LIST KF7-305.4AM[10] KF7-305.4BM[31] KF7-580.1[8] /end FUNCTION_LIST /end MEASUREMENT
/begin MEASUREMENT vVINNUM_R#1 "VIN writing value" UBYTE COMP_0068 1 100 0 255 ECU_ADDRESS 0xFFFFB2CA /begin FUNCTION_LIST KF7-305.4AM[10] KF7-305.4BM[31] KF7-580.1[8] /end FUNCTION_LIST /end MEASUREMENT
/begin MEASUREMENT vVINNUM_R#2 "VIN writing value" UBYTE COMP_0068 1 100 0 255 ECU_ADDRESS 0xFFFFB2CB /begin FUNCTION_LIST KF7-305.4AM[10] KF7-305.4BM[31] KF7-580.1[8] /end FUNCTION_LIST /end MEASUREMENT
/begin MEASUREMENT vVINNUM_R#3 "VIN writing value" UBYTE COMP_0068 1 100 0 255 ECU_ADDRESS 0xFFFFB2CC /begin FUNCTION_LIST KF7-305.4AM[10] KF7-305.4BM[31] KF7-580.1[8] /end FUNCTION_LIST /end MEASUREMENT
/begin MEASUREMENT vVINNUM_R#4 "VIN writing value" UBYTE COMP_0068 1 100 0 255 ECU_ADDRESS 0xFFFFB2CD /begin FUNCTION_LIST KF7-305.4AM[10] KF7-305.4BM[31] KF7-580.1[8] /end FUNCTION_LIST /end MEASUREMENT
/begin MEASUREMENT vVINNUM_R#5 "VIN writing value" UBYTE COMP_0068 1 100 0 255 ECU_ADDRESS 0xFFFFB2CE /begin FUNCTION_LIST KF7-305.4AM[10] KF7-305.4BM[31] KF7-580.1[8] /end FUNCTION_LIST /end MEASUREMENT
/begin MEASUREMENT vVINNUM_R#6 "VIN writing value" UBYTE COMP_0068 1 100 0 255 ECU_ADDRESS 0xFFFFB2CF /begin FUNCTION_LIST KF7-305.4AM[10] KF7-305.4BM[31] KF7-580.1[8] /end FUNCTION_LIST /end MEASUREMENT
/begin MEASUREMENT vVINNUM_R#7 "VIN writing value" UBYTE COMP_0068 1 100 0 255 ECU_ADDRESS 0xFFFFB2D0 /begin FUNCTION_LIST KF7-305.4AM[10] KF7-305.4BM[31] KF7-580.1[8] /end FUNCTION_LIST /end MEASUREMENT
/begin MEASUREMENT vVINNUM_R#8 "VIN writing value" UBYTE COMP_0068 1 100 0 255 ECU_ADDRESS 0xFFFFB2D1 /begin FUNCTION_LIST KF7-305.4AM[10] KF7-305.4BM[31] KF7-580.1[8] /end FUNCTION_LIST /end MEASUREMENT
/begin MEASUREMENT vVINNUM_R#9 "VIN writing value" UBYTE COMP_0068 1 100 0 255 ECU_ADDRESS 0xFFFFB2D2 /begin FUNCTION_LIST KF7-305.4AM[10] KF7-305.4BM[31] KF7-580.1[8] /end FUNCTION_LIST /end MEASUREMENT
/begin MEASUREMENT vVINNUM_R#10 "VIN writing value" UBYTE COMP_0068 1 100 0 255 ECU_ADDRESS 0xFFFFB2D3 /begin FUNCTION_LIST KF7-305.4AM[10] KF7-305.4BM[31] KF7-580.1[8] /end FUNCTION_LIST /end MEASUREMENT
/begin MEASUREMENT vVINNUM_R#11 "VIN writing value" UBYTE COMP_0068 1 100 0 255 ECU_ADDRESS 0xFFFFB2D4 /begin FUNCTION_LIST KF7-305.4AM[10] KF7-305.4BM[31] KF7-580.1[8] /end FUNCTION_LIST /end MEASUREMENT
/begin MEASUREMENT vVINNUM_R#12 "VIN writing value" UBYTE COMP_0068 1 100 0 255 ECU_ADDRESS 0xFFFFB2D5 /begin FUNCTION_LIST KF7-305.4AM[10] KF7-305.4BM[31] KF7-580.1[8] /end FUNCTION_LIST /end MEASUREMENT
/begin MEASUREMENT vVINNUM_R#13 "VIN writing value" UBYTE COMP_0068 1 100 0 255 ECU_ADDRESS 0xFFFFB2D6 /begin FUNCTION_LIST KF7-305.4AM[10] KF7-305.4BM[31] KF7-580.1[8] /end FUNCTION_LIST /end MEASUREMENT
/begin MEASUREMENT vVINNUM_R#14 "VIN writing value" UBYTE COMP_0068 1 100 0 255 ECU_ADDRESS 0xFFFFB2D7 /begin FUNCTION_LIST KF7-305.4AM[10] KF7-305.4BM[31] KF7-580.1[8] /end FUNCTION_LIST /end MEASUREMENT
/begin MEASUREMENT vVINNUM_R#15 "VIN writing value" UBYTE COMP_0068 1 100 0 255 ECU_ADDRESS 0xFFFFB2D8 /begin FUNCTION_LIST KF7-305.4AM[10] KF7-305.4BM[31] KF7-580.1[8] /end FUNCTION_LIST /end MEASUREMENT
/begin MEASUREMENT vVINNUM_R#16 "VIN writing value" UBYTE COMP_0068 1 100 0 255 ECU_ADDRESS 0xFFFFB2D9 /begin FUNCTION_LIST KF7-305.4AM[10] KF7-305.4BM[31] KF7-580.1[8] /end FUNCTION_LIST /end MEASUREMENT
/begin MEASUREMENT vVINNUM_R#17 "VIN writing value" UBYTE COMP_0068 1 100 0 255 ECU_ADDRESS 0xFFFFB2DA /begin FUNCTION_LIST KF7-305.4AM[10] KF7-305.4BM[31] KF7-580.1[8] /end FUNCTION_LIST /end MEASUREMENT
/begin MEASUREMENT vVMOT "Motor power supply voltage" UBYTE COMP_0033 1 100 0 20400 ECU_ADDRESS 0xFFFF499E /begin FUNCTION_LIST KF7-301.30[2] KF7-360.1[12] KF7-400.5[3] KF7-505.32[6] /end FUNCTION_LIST /end MEASUREMENT
/begin MEASUREMENT vVSPASCD2 "In front of the limiter, a vehicle speed for ASCD" SLONG COMP_0209_S 1 100 -1843.20024746394 1843.20024660563 ECU_ADDRESS 0xFFFF4264 /begin FUNCTION_LIST KF7-303.1[14] /end FUNCTION_LIST /end MEASUREMENT
/begin MEASUREMENT vVSPASCDP "The former vehicle speed which deals with a limiter" SLONG COMP_0209_S 1 100 -1843.20024746394 1843.20024660563 ECU_ADDRESS 0xFFFF346C /begin FUNCTION_LIST KF7-303.1[14] /end FUNCTION_LIST /end MEASUREMENT
/begin MEASUREMENT vVSPREVFL "CVT output speed for the vehicle speed computation" UWORD COMP_0443 1 100 0 65535 ECU_ADDRESS 0xFFFF1F62 /begin FUNCTION_LIST KF7-303.1[14] /end FUNCTION_LIST /end MEASUREMENT
/begin MEASUREMENT vVSPS "A vehicle speed for the control control" UBYTE COMP_0007 1 100 0 510 ECU_ADDRESS 0xFFFF8866
 /begin FUNCTION_LIST KF7-303.1[14] KF7-320A.15[4] KF7-330.4A[53] KF7-360.7M[9] KF7-360.7P[8] KF7-360.8M[4] KF7-360.9M[43] KF7-450.19[4] R301.8.Inverse_filter_1_1_3 R301.23.ADV_calculation_1_1_2 /end FUNCTION_LIST
/end MEASUREMENT
/begin MEASUREMENT vVSPX "A high precision vehicle speed" UWORD COMP_0236 1 100 0 16383.75 ECU_ADDRESS 0xFFFF8868 /begin FUNCTION_LIST KF7-303.1[14] R301.20.AmbientComp_1_0_2 /end FUNCTION_LIST /end MEASUREMENT
/begin MEASUREMENT vVSPX2 "VSPX before 1412mS" UWORD COMP_0236 1 100 0 16383.75 ECU_ADDRESS 0xFFFF886A /begin FUNCTION_LIST KF7-303.1[14] /end FUNCTION_LIST /end MEASUREMENT
/begin MEASUREMENT vVSPXS "A high precision vehicle speed" UWORD COMP_0236 1 100 0 16383.75 ECU_ADDRESS 0xFFFF1D68 /begin FUNCTION_LIST KF7-303.1[14] /end FUNCTION_LIST /end MEASUREMENT
/begin MEASUREMENT vVTCCLK "VTC operation angle count rise value" UWORD COMP_0187_S 1 100 0 2097120 ECU_ADDRESS 0xFFFF2288 /begin FUNCTION_LIST KF7-303.5A[9] KF7-393.1C[8] KF7-500.47B[15] /end FUNCTION_LIST /end MEASUREMENT
/begin MEASUREMENT vVTCCLK1 "VTC operation angle count rise value" UWORD COMP_0073 1 100 0 209712 ECU_ADDRESS 0xFFFF228A /begin FUNCTION_LIST KF7-303.5A[9] /end FUNCTION_LIST /end MEASUREMENT
/begin MEASUREMENT vVTCCLK1_R#1 "VTC operation angle count rise value" UWORD COMP_0073 1 100 0 209712 ECU_ADDRESS 0xFFFF228A /begin FUNCTION_LIST KF7-303.5A[9] /end FUNCTION_LIST /end MEASUREMENT
/begin MEASUREMENT vVTCCLK1_R#2 "VTC operation angle count rise value" UWORD COMP_0073 1 100 0 209712 ECU_ADDRESS 0xFFFF228C /begin FUNCTION_LIST KF7-303.5A[9] /end FUNCTION_LIST /end MEASUREMENT
/begin MEASUREMENT vVTCCLKE "POS10 signal - cam target signal measuring time" UWORD COMP_0189 1 100 0 209712 ECU_ADDRESS 0xFFFF1AAC /begin FUNCTION_LIST KF7-303.7B[N] /end FUNCTION_LIST /end MEASUREMENT
/begin MEASUREMENT vVTCCLKE_R#1 "POS10 signal - cam target signal measuring time" UWORD COMP_0189 1 100 0 209712 ECU_ADDRESS 0xFFFF1AAC /begin FUNCTION_LIST KF7-303.7B[N] /end FUNCTION_LIST /end MEASUREMENT
/begin MEASUREMENT vVTCCLKE_R#2 "POS10 signal - cam target signal measuring time" UWORD COMP_0189 1 100 0 209712 ECU_ADDRESS 0xFFFF1AAE /begin FUNCTION_LIST KF7-303.7B[N] /end FUNCTION_LIST /end MEASUREMENT
/begin MEASUREMENT vVTCPOS4 "VTC operation angle count rise value" UBYTE COMP_0048 1 100 0 127.5 ECU_ADDRESS 0xFFFF1BA8 /begin FUNCTION_LIST KF7-303.5A[9] KF7-393.1C[8] KF7-500.6D[9] KF7-500.47B[15] /end FUNCTION_LIST /end MEASUREMENT
/begin MEASUREMENT vVTCPOS42 "Between the VTC reference signal - the cam target signal, measuring angle" UBYTE COMP_0266 1 100 0 127.5 ECU_ADDRESS 0xFFFF228E /begin FUNCTION_LIST KF7-303.5A[9] KF7-393.1C[8] KF7-500.6D[9] /end FUNCTION_LIST /end MEASUREMENT
/begin MEASUREMENT vVTCPOS42_R#1 "Between the VTC reference signal - the cam target signal, measuring angle" UBYTE COMP_0266 1 100 0 127.5 ECU_ADDRESS 0xFFFF228E /begin FUNCTION_LIST KF7-303.5A[9] KF7-393.1C[8] KF7-500.6D[9] /end FUNCTION_LIST /end MEASUREMENT
/begin MEASUREMENT vVTCPOS42_R#2 "Between the VTC reference signal - the cam target signal, measuring angle" UBYTE COMP_0266 1 100 0 127.5 ECU_ADDRESS 0xFFFF228F /begin FUNCTION_LIST KF7-303.5A[9] KF7-393.1C[8] KF7-500.6D[9] /end FUNCTION_LIST /end MEASUREMENT
/begin MEASUREMENT vVTCPOS42P "Phase LH (RH) signal phase angle" UBYTE COMP_0266 1 100 0 127.5 ECU_ADDRESS 0xFFFF2294 /begin FUNCTION_LIST KF7-303.5A[9] /end FUNCTION_LIST /end MEASUREMENT
/begin MEASUREMENT vVTCPOS42P_R#1 "Phase LH (RH) signal phase angle" UBYTE COMP_0266 1 100 0 127.5 ECU_ADDRESS 0xFFFF2294 /begin FUNCTION_LIST KF7-303.5A[9] /end FUNCTION_LIST /end MEASUREMENT
/begin MEASUREMENT vVTCPOS42P_R#2 "Phase LH (RH) signal phase angle" UBYTE COMP_0266 1 100 0 127.5 ECU_ADDRESS 0xFFFF2295 /begin FUNCTION_LIST KF7-303.5A[9] /end FUNCTION_LIST /end MEASUREMENT
/begin MEASUREMENT vWDTNGC "WDT At the time of IGN-off, diagnosis NG counter" UBYTE COMP_0030 1 100 0 255 ECU_ADDRESS 0xFFFFB66A /begin FUNCTION_LIST KF7-305.4BM[31] KF7-505.18[3] R000.4.EepAlloc_1_2_2 /end FUNCTION_LIST /end MEASUREMENT
/begin MEASUREMENT wvAA "A total duct area" UWORD COMP_0042 1 100 0 52.428 ECU_ADDRESS 0xFFFF88D4
 /begin FUNCTION_LIST KF7-304.9[2] KF7-304.13[N] KF7-305.14[2] KF7-400.1[1] KF7-500.7[12] /end FUNCTION_LIST
/end MEASUREMENT
/begin MEASUREMENT wvAPO "Accelerator open-degree" UWORD COMP_0005 1 100 0 7208.85 ECU_ADDRESS 0xFFFF4768
 /begin FUNCTION_LIST KF7-301.25M[5] KF7-304.2[21] KF7-330.5[53] KF7-340.1M[8] KF7-340.1P[7] KF7-340.2M[2] KF7-340.2P[1] KF7-340.5[4] KF7-340.5P[2] KF7-340.6M[2] KF7-340.7[4] KF7-340.8M[8] KF7-340.16[4] KF7-351.1[16] KF7-351.3[11] KF7-376.2[21] KF7-385.1[32] KF7-385.3[4] KF7-410.17M[5] KF7-410.17P[1] KF7-410.19[2] KF7-450.19[4] KF7-500.1[54] KF7-500.2A[29] KF7-500.26[17] KF7-505.2[9] KF7-505.9[3] KF7-505.26[2] KF7-505.50[1] KF7-525.2[6] KF7-525.2S[10] /end FUNCTION_LIST
/end MEASUREMENT
/begin MEASUREMENT wvAPOFS_S "Failsafe treatment accelerator open-degree" UWORD COMP_0005 1 100 0 7208.85 ECU_ADDRESS 0xFFFF489E /begin FUNCTION_LIST KF7-301.25P[5] KF7-350.4P[13] KF7-505.9[3] /end FUNCTION_LIST /end MEASUREMENT
/begin MEASUREMENT wvATPO1 "TPO1 opening area" UWORD COMP_0042 1 100 0 52.428 ECU_ADDRESS 0xFFFF47E6 /begin FUNCTION_LIST KF7-304.9[2] KF7-304.13[N] KF7-351.3[11] KF7-500.7[12] /end FUNCTION_LIST /end MEASUREMENT
/begin MEASUREMENT wvATTEMP "AT oil temperature data" UBYTE COMP_0035_S 1 100 0 255 ECU_ADDRESS 0xFFFF47E9 /begin FUNCTION_LIST KF7-302.5M[10] KF7-330.9[8] /end FUNCTION_LIST /end MEASUREMENT
/begin MEASUREMENT wvAVCC "Sensor reference power supply voltage" UBYTE COMP_0118 1 100 0 10200 ECU_ADDRESS 0xFFFF47EC
 /begin FUNCTION_LIST KF7-301.30[2] KF7-400.3[N] KF7-500.2A[29] KF7-505.32[6] KF7-505.34[3] KF7-525.1[4] KF7-525.2[6] KF7-525.2S[10] /end FUNCTION_LIST
/end MEASUREMENT
/begin MEASUREMENT wvCYLCNT "Reference position renewal cylinder distinction value" UBYTE COMP_0068 1 100 0 255 ECU_ADDRESS 0xFFFF8A00 /begin FUNCTION_LIST KF7-303.5A[9] KF7-311.1A[21] KF7-379.1[9] KF7-450.9A[5] /end FUNCTION_LIST /end MEASUREMENT
/begin MEASUREMENT wvDLTNE "A degree of an engine speed slowdown" UBYTE COMP_0006 1 100 0 3187.5 ECU_ADDRESS 0xFFFF889A
 /begin FUNCTION_LIST KF7-303.6M[5] KF7-312.4A[6] KF7-312.4C[4] KF7-312.6[34] KF7-330.5[53] KF7-330.7A[1] KF7-330.9[8] KF7-390.3A[15] /end FUNCTION_LIST
/end MEASUREMENT
/begin MEASUREMENT wvDLTOUTR "A degree of a TM output speed slowdown" UWORD COMP_0392_S 1 100 0 65535 ECU_ADDRESS 0xFFFF88F2 /begin FUNCTION_LIST KF7-303.1[14] KF7-385.1[32] /end FUNCTION_LIST /end MEASUREMENT
/begin MEASUREMENT wvDLTQH0 "Delta-QH0 for the steady state transient state judgement" UBYTE COMP_0032 1 100 0 0.99609375 ECU_ADDRESS 0xFFFF88F4 /begin FUNCTION_LIST KF7-304.2[21] KF7-312.5A[4] KF7-312.5C[1] /end FUNCTION_LIST /end MEASUREMENT
/begin MEASUREMENT wvDQH010MS "Delta-QH0 (10mS)" SWORD COMP_0203 1 100 -128 127.99609375 ECU_ADDRESS 0xFFFF88F6 /begin FUNCTION_LIST KF7-304.1B[5] /end FUNCTION_LIST /end MEASUREMENT
/begin MEASUREMENT wvDSP "Wheel speed (drive wheel)" UWORD COMP_0436 1 100 0 6553.5 ECU_ADDRESS 0xFFFF88FA /begin FUNCTION_LIST KF7-303.1[14] KF7-330.4A[53] KF7-360.9M[43] /end FUNCTION_LIST /end MEASUREMENT
/begin MEASUREMENT wvDTVO "Delta-TVO absolute value" UBYTE COMP_0053_S 1 100 0 89.25 ECU_ADDRESS 0xFFFF88FC /begin FUNCTION_LIST KF7-304.10[1] KF7-500.26[17] /end FUNCTION_LIST /end MEASUREMENT
/begin MEASUREMENT wvDTVOP "For 150mS, delta-TVO acceleration side" UBYTE COMP_0053_S 1 100 0 89.25 ECU_ADDRESS 0xFFFF88FD
 /begin FUNCTION_LIST KF7-304.10[1] KF7-312.2A[16] KF7-320A.12[N] KF7-320A.13[N] KF7-320A.15[4] /end FUNCTION_LIST
/end MEASUREMENT
/begin MEASUREMENT wvDUMP "At the time of the steady state judgement, weighted average coefficient" UBYTE COMP_0132 1 100 0 0.498046875 ECU_ADDRESS 0xFFFF88FF /begin FUNCTION_LIST KF7-304.2[21] /end FUNCTION_LIST /end MEASUREMENT
/begin MEASUREMENT wvDUMP2 "At the time of the steady state judgement, weighted average coefficient" UWORD COMP_0456 1 100 0 1.999970916 ECU_ADDRESS 0xFFFF8900 /begin FUNCTION_LIST KF7-304.2[21] /end FUNCTION_LIST /end MEASUREMENT
/begin MEASUREMENT wvDVSP "Vehicle speed increase width" UBYTE COMP_0236 1 100 0 63.75 ECU_ADDRESS 0xFFFF884A /begin FUNCTION_LIST KF7-303.1[14] /end FUNCTION_LIST /end MEASUREMENT
/begin MEASUREMENT wvFLOAD1 "Transient state response compensation weighted average coefficient 1" UWORD COMP_0069 1 100 0 1.999970916 ECU_ADDRESS 0xFFFF8910 /begin FUNCTION_LIST KF7-304.2[21] /end FUNCTION_LIST /end MEASUREMENT
/begin MEASUREMENT wvFNRPM "Engine speed (renewal periodic high speed)" UWORD COMP_0006 1 100 0 819187.5 ECU_ADDRESS 0xFFFF8912
 /begin FUNCTION_LIST KF7-303.5A[9] KF7-303.6M[5] KF7-311.1A[21] KF7-312.1C[N] KF7-312.6[34] KF7-320A.6[3] KF7-320A.19[7] KF7-320A.21[N] KF7-330.5[53] KF7-450.9A[5] KF7-500.7[12] KF7-500.10[3] KF7-580.1[8] /end FUNCTION_LIST
/end MEASUREMENT
/begin MEASUREMENT wvFNRPM2 "Engine speed for the hard cranking judgement" UBYTE COMP_0006 1 100 0 3187.5 ECU_ADDRESS 0xFFFF4841
 /begin FUNCTION_LIST KF7-302.4MA[13] KF7-303.6M[5] KF7-304.2[21] KF7-304.4B[2] KF7-312.2A[16] KF7-450.9A[5] KF7-500.6D[9] /end FUNCTION_LIST
/end MEASUREMENT
/begin MEASUREMENT wvGNMV "The reciprocal number of vNMV" UWORD COMP_0597_S 1 100 0 0.000014535663 ECU_ADDRESS 0xFFFF8916 /begin FUNCTION_LIST KF7-304.9[2] KF7-500.7[12] /end FUNCTION_LIST /end MEASUREMENT
/begin MEASUREMENT wvHNRPM "Engine speed" UBYTE COMP_0020 1 100 0 12750 ECU_ADDRESS 0xFFFF8A06
 /begin FUNCTION_LIST KF7-303.6M[5] KF7-304.2[21] KF7-312.2A[16] KF7-312.3A[27] KF7-312.6[34] KF7-314.1F[1] KF7-320A.6[3] KF7-320A.8[2] KF7-320A.9[9] KF7-320A.10[14] KF7-320A.15[4] KF7-320A.19[7] KF7-320A.21[N] KF7-360.8M[4] KF7-360.9M[43] KF7-376.1[6] KF7-376.2[21] KF7-379.2[1] KF7-379.4[1] KF7-379.5[3] KF7-385.1[32] KF7-385.2[18] KF7-385.3[4] KF7-390.3A[15] KF7-393.1C[8] KF7-395.1[4] KF7-410.12[2] KF7-500.16[4] KF7-500.20B[4] KF7-500.26[17] KF7-500.47B[15] /end FUNCTION_LIST
/end MEASUREMENT
/begin MEASUREMENT wvHRVSP "A high precision vehicle speed for PTD" UWORD COMP_0436 1 100 0 6553.5 ECU_ADDRESS 0xFFFF891A
 /begin FUNCTION_LIST KF7-303.1[14] KF7-340.1M[8] KF7-340.3M[1] KF7-340.3P[2] KF7-340.4[1] KF7-340.5[4] KF7-340.5P[2] KF7-340.6M[2] KF7-340.7[4] KF7-340.9M[3] KF7-340.9P[3] KF7-340.11[4] KF7-340.15[3] KF7-340.16[4] KF7-360.7M[9] KF7-360.7P[8] KF7-360.9M[43] KF7-385.1[32] KF7-410.19[2] KF7-505.49[3] KF7-580.1[8] /end FUNCTION_LIST
/end MEASUREMENT
/begin MEASUREMENT wvINPREV "CVT input speed" UWORD COMP_0443 1 100 0 65535 ECU_ADDRESS 0xFFFF891E
 /begin FUNCTION_LIST KF7-303.1[14] KF7-312.6[34] KF7-330.9[8] KF7-340.10M[1] KF7-340.10P[N] KF7-360.9M[43] KF7-505.47[3] /end FUNCTION_LIST
/end MEASUREMENT
/begin MEASUREMENT wvINPREVFL "After filtering, CVT input speed" UWORD COMP_0443 1 100 0 65535 ECU_ADDRESS 0xFFFF8920 /begin FUNCTION_LIST KF7-303.1[14] KF7-340.9M[3] KF7-340.9P[3] /end FUNCTION_LIST /end MEASUREMENT
/begin MEASUREMENT wvITAC "Cylinder intake filling up efficiency" UBYTE COMP_0009 1 100 0 199.21875 ECU_ADDRESS 0xFFFF8874
 /begin FUNCTION_LIST KF7-304.2[21] KF7-312.2A[16] KF7-312.3A[27] KF7-312.4A[6] KF7-312.4C[4] KF7-320A.4[6] KF7-320A.8[2] KF7-320A.9[9] KF7-320A.17[N] KF7-379.2[1] KF7-386.1[4] KF7-393.1C[8] KF7-500.1[54] KF7-500.7[12] /end FUNCTION_LIST
/end MEASUREMENT
/begin MEASUREMENT wvITAN "Cylinder fresh air rate" UBYTE COMP_0009 1 100 0 199.21875 ECU_ADDRESS 0xFFFF8923 /begin FUNCTION_LIST KF7-304.2[21] KF7-320A.8[2] /end FUNCTION_LIST /end MEASUREMENT
/begin MEASUREMENT wvKAJYU1 "TPTRM weighted average coefficient" UWORD COMP_0069 1 100 0 1.999970916 ECU_ADDRESS 0xFFFF8924 /begin FUNCTION_LIST KF7-304.2[21] /end FUNCTION_LIST /end MEASUREMENT
/begin MEASUREMENT wvKNRPM "Engine speed" UWORD COMP_0064 1 100 0 102398.4375 ECU_ADDRESS 0xFFFF8A08
 /begin FUNCTION_LIST KF7-302.4MA[13] KF7-303.6M[5] KF7-304.2[21] KF7-305.7[6] KF7-500.26[17] /end FUNCTION_LIST
/end MEASUREMENT
/begin MEASUREMENT wvLRVSP "A low precision vehicle speed" UWORD COMP_0436 1 100 0 6553.5 ECU_ADDRESS 0xFFFF8926
 /begin FUNCTION_LIST KF7-303.1[14] KF7-340.3M[1] KF7-340.3P[2] KF7-340.5[4] KF7-340.5P[2] KF7-360.9M[43] KF7-360.11[1] KF7-410.19[2] KF7-505.49[3] /end FUNCTION_LIST
/end MEASUREMENT
/begin MEASUREMENT wvMDI "Switch input condition" UBYTE COMP_0004 1 100 0 255 ECU_ADDRESS 0xFFFF8928 /begin FUNCTION_LIST KF7-302.2M[3] KF7-360.4[14] KF7-505.23[2] /end FUNCTION_LIST /end MEASUREMENT
/begin MEASUREMENT wvMNRPM "Engine speed" UBYTE COMP_0000 1 100 0 6375 ECU_ADDRESS 0xFFFF8A0B
 /begin FUNCTION_LIST KF7-302.6A[4] KF7-303.1[14] KF7-303.6M[5] KF7-304.1B[5] KF7-304.2[21] KF7-305.4AM[10] KF7-305.4BM[31] KF7-311.1A[21] KF7-312.1C[N] KF7-312.2A[16] KF7-312.3A[27] KF7-312.4A[6] KF7-312.4C[4] KF7-312.5C[1] KF7-312.6[34] KF7-313C.4[3] KF7-313C.5[3] KF7-320A.1[6] KF7-320A.4[6] KF7-320A.12[N] KF7-320A.13[N] KF7-320A.15[4] KF7-320A.23[N] KF7-330.1M[3] KF7-330.1P[3] KF7-330.5[53] KF7-350.4M[14] KF7-350.4P[13] KF7-351.1[16] KF7-376.2[21] KF7-378.2B[6] KF7-379.1[9] KF7-385.1[32] KF7-385.2[18] KF7-386.1[4] KF7-386.3[8] KF7-393.1C[8] KF7-410.12[2] KF7-450.22[1] KF7-500.1[54] KF7-500.7[12] KF7-500.21[19] KF7-500.24[10] KF7-500.25A[7] KF7-500.26[17] KF7-500.28[4] KF7-500.30[8] KF7-500.39[5] KF7-500.51[3] KF7-500.59[6] KF7-500.74[11] KF7-500.76[8] KF7-505.23[2] KF7-525.2[6] KF7-580.1[8] /end FUNCTION_LIST
/end MEASUREMENT
/begin MEASUREMENT wvNE "Engine speed" UWORD COMP_0065 1 100 0 204796.875 ECU_ADDRESS 0xFFFF8A0E
 /begin FUNCTION_LIST KF7-303.1[14] KF7-303.6M[5] KF7-304.9[2] KF7-312.4A[6] KF7-312.4C[4] KF7-312.6[34] KF7-314.1F[1] KF7-320A.2[3] KF7-330.5[53] KF7-330.9[8] KF7-340.1M[8] KF7-340.1P[7] KF7-340.2M[2] KF7-340.2P[1] KF7-340.6M[2] KF7-340.6P[2] KF7-340.8M[8] KF7-340.10M[1] KF7-340.10P[N] KF7-350.1M[5] KF7-350.4M[14] KF7-350.4P[13] KF7-351.3[11] KF7-360.8M[4] KF7-360.9M[43] KF7-360.12[6] KF7-376.2[21] KF7-385.2[18] KF7-385.3[4] KF7-386.1[4] KF7-410.11M[4] KF7-500.7[12] KF7-500.30[8] KF7-505.50[1] KF7-505.51[2] /end FUNCTION_LIST
/end MEASUREMENT
/begin MEASUREMENT wvNEREF0 "REF signal periodic conversion engine speed" UWORD COMP_0476 1 100 0 12799.8046875 ECU_ADDRESS 0xFFFF89F8
 /begin FUNCTION_LIST KF7-303.6M[5] KF7-330.3[6] KF7-330.4A[53] KF7-330.5[53] KF7-350.1M[5] KF7-390.3A[15] /end FUNCTION_LIST
/end MEASUREMENT
/begin MEASUREMENT wvNEREF125 "REF signal synchronous conversion engine speed 2" UWORD COMP_0006 1 100 0 819187.5 ECU_ADDRESS 0xFFFF8A10
 /begin FUNCTION_LIST KF7-303.6M[5] KF7-330.3[6] KF7-330.5[53] KF7-376.2[21] KF7-390.3A[15] /end FUNCTION_LIST
/end MEASUREMENT
/begin MEASUREMENT wvNE_S "Engine speed redundant part" UWORD COMP_0065 1 100 0 204796.875 ECU_ADDRESS 0xFFFF8A34 /begin FUNCTION_LIST KF7-303.6P[1] /end FUNCTION_LIST /end MEASUREMENT
/begin MEASUREMENT wvOUTREV "CVT output speed" UWORD COMP_0443 1 100 0 65535 ECU_ADDRESS 0xFFFF892A
 /begin FUNCTION_LIST KF7-303.1[14] KF7-312.6[34] KF7-320A.2[3] KF7-330.9[8] KF7-385.1[32] KF7-505.47[3] /end FUNCTION_LIST
/end MEASUREMENT
/begin MEASUREMENT wvOUTREVFL "After filtering, CVT output speed" UWORD COMP_0443 1 100 0 65535 ECU_ADDRESS 0xFFFF892C /begin FUNCTION_LIST KF7-303.1[14] KF7-340.9M[3] KF7-340.9P[3] /end FUNCTION_LIST /end MEASUREMENT
/begin MEASUREMENT wvPBADNW "Supercharge pressure sensor output value" UWORD COMP_0023 1 100 0 327675 ECU_ADDRESS 0xFFFF8876 /begin FUNCTION_LIST KF7-304.1B[5] /end FUNCTION_LIST /end MEASUREMENT
/begin MEASUREMENT wvPBAV "Supercharge pressure sensor weighted average value" UWORD COMP_0023 1 100 0 327675 ECU_ADDRESS 0xFFFF8878 /begin FUNCTION_LIST KF7-304.1B[5] KF7-304.2[21] KF7-304.13[N] KF7-312.6[34] /end FUNCTION_LIST /end MEASUREMENT
/begin MEASUREMENT wvQM "Inhalation air quantity mean" UWORD COMP_0004 1 100 0 65535 ECU_ADDRESS 0xFFFF887C
 /begin FUNCTION_LIST KF7-304.1B[5] KF7-313C.6[5] KF7-313C.9[3] KF7-378.2B[6] KF7-500.1[54] KF7-500.21[19] KF7-500.24[10] KF7-525.2[6] KF7-580.1[8] /end FUNCTION_LIST
/end MEASUREMENT
/begin MEASUREMENT wvREVXFL "After filtering, low precision speed" UWORD COMP_0443 1 100 0 65535 ECU_ADDRESS 0xFFFF8938 /begin FUNCTION_LIST KF7-303.1[14] KF7-340.9M[3] KF7-340.9P[3] /end FUNCTION_LIST /end MEASUREMENT
/begin MEASUREMENT wvTOIL "KT oil temperature" UBYTE COMP_0128_S 1 100 -30 1245 ECU_ADDRESS 0xFFFF487A /begin FUNCTION_LIST KF7-302.5M[10] KF7-312.6[34] KF7-360.9M[43] /end FUNCTION_LIST /end MEASUREMENT
/begin MEASUREMENT wvTPSK "Taking in advance compensation pulse width" SWORD COMP_0515 1 100 -15.999991808 15.999503527 ECU_ADDRESS 0xFFFF8880 /begin FUNCTION_LIST KF7-304.2[21] /end FUNCTION_LIST /end MEASUREMENT
/begin MEASUREMENT wvTREF "REF signal period" ULONG COMP_0073 1 100 0 13743895344 ECU_ADDRESS 0xFFFF89EC /begin FUNCTION_LIST KF7-303.5A[9] KF7-303.6M[5] KF7-450.9A[5] /end FUNCTION_LIST /end MEASUREMENT
/begin MEASUREMENT wvTSQH0 "QH0 supercharge pressure compensation value" UBYTE COMP_0045 1 100 0 1.9921875 ECU_ADDRESS 0xFFFF8942 /begin FUNCTION_LIST KF7-304.2[21] KF7-304.13[N] KF7-312.4A[6] KF7-312.4C[4] /end FUNCTION_LIST /end MEASUREMENT
/begin MEASUREMENT wvTVOz10 "Before 100mS, TVO" UBYTE COMP_0002 1 100 0 89.25 ECU_ADDRESS 0xFFFF8894 /begin FUNCTION_LIST KF7-304.10[1] /end FUNCTION_LIST /end MEASUREMENT
/begin MEASUREMENT wvTVOz15 "Before TVOi* 50mS" UBYTE COMP_0002 1 100 0 89.25 ECU_ADDRESS 0xFFFF8948 /begin FUNCTION_LIST KF7-304.10[1] /end FUNCTION_LIST /end MEASUREMENT
/begin MEASUREMENT wvTVOz3 "Before TVOi* 10mS" UBYTE COMP_0002 1 100 0 89.25 ECU_ADDRESS 0xFFFF8949 /begin FUNCTION_LIST KF7-304.1B[5] KF7-304.10[1] /end FUNCTION_LIST /end MEASUREMENT
/begin MEASUREMENT wvVMOT "Motor power supply voltage" UBYTE COMP_0033 1 100 0 20400 ECU_ADDRESS 0xFFFF489C /begin FUNCTION_LIST KF7-301.30[2] KF7-360.1[12] KF7-400.5[3] KF7-505.32[6] /end FUNCTION_LIST /end MEASUREMENT
/begin MEASUREMENT wvVSPS "A vehicle speed for the control control" UBYTE COMP_0007 1 100 0 510 ECU_ADDRESS 0xFFFF8854
 /begin FUNCTION_LIST KF7-303.1[14] KF7-320A.15[4] KF7-330.4A[53] KF7-360.7M[9] KF7-360.7P[8] KF7-360.8M[4] KF7-360.9M[43] KF7-450.19[4] /end FUNCTION_LIST
/end MEASUREMENT
/begin MEASUREMENT wvVSPX "A high precision vehicle speed" UWORD COMP_0236 1 100 0 16383.75 ECU_ADDRESS 0xFFFF8856 /begin FUNCTION_LIST KF7-303.1[14] /end FUNCTION_LIST /end MEASUREMENT
/begin MEASUREMENT wvVSPX2 "VSPX before 1412mS" UWORD COMP_0236 1 100 0 16383.75 ECU_ADDRESS 0xFFFF8858 /begin FUNCTION_LIST KF7-303.1[14] /end FUNCTION_LIST /end MEASUREMENT
/begin MEASUREMENT EPWNGM "RAM value EPWNGM" UBYTE COMP_0068 1 100 0 255 ECU_ADDRESS 0xFFFF9D20
 /begin FUNCTION_LIST KF7-305.4AM[10] KF7-450.22[1] KF7-500.2A[29] KF7-525.2[6] KF7-525.2S[10] R000.3.RS_SelfDiagflags_1_1_2 /end FUNCTION_LIST
/end MEASUREMENT
/begin MEASUREMENT EPRNGM "RAM value EPRNGM" UBYTE COMP_0068 1 100 0 255 ECU_ADDRESS 0xFFFF9D23
 /begin FUNCTION_LIST KF7-305.1[7] KF7-351.1[16] KF7-351.2[17] KF7-500.2A[29] KF7-505.22[3] KF7-525.2[6] KF7-525.2S[10] R000.3.RS_SelfDiagflags_1_1_2 /end FUNCTION_LIST
/end MEASUREMENT
/begin MEASUREMENT vEPRNGM "RAM value vEPRNGM" UWORD COMP_0068 1 100 0 65535 ECU_ADDRESS 0xFFFF9D24
 /begin FUNCTION_LIST KF7-305.1[7] KF7-351.1[16] KF7-351.2[17] KF7-500.2A[29] KF7-505.22[3] KF7-525.2[6] KF7-525.2S[10] /end FUNCTION_LIST
/end MEASUREMENT
/* COMPU_METHOD --------------------------------------------------------- */
/begin COMPU_METHOD COMP_0017 "1deg" RAT_FUNC "%8.2" "deg" COEFFS 0 1 0 0 0 1 /end COMPU_METHOD
/begin COMPU_METHOD COMP_0290 "1/65536-" RAT_FUNC "%8.6" "-" COEFFS 0 1 0 0 0 0.0000152588 /end COMPU_METHOD
/begin COMPU_METHOD COMP_0068 "1-" RAT_FUNC "%8.2" "-" COEFFS 0 1 0 0 0 1 /end COMPU_METHOD
/begin COMPU_METHOD COMP_0004 "1Å|" RAT_FUNC "%8.2" "Å|" COEFFS 0 1 0 0 0 1 /end COMPU_METHOD
/begin COMPU_METHOD COMP_0023 "5mV" RAT_FUNC "%8.2" "mV" COEFFS 0 1 0 0 0 5 /end COMPU_METHOD
/begin COMPU_METHOD COMP_0045 "1/128-" RAT_FUNC "%8.4" "-" COEFFS 0 1 0 0 0 0.0078125 /end COMPU_METHOD
/begin COMPU_METHOD COMP_0186 "1/64-" RAT_FUNC "%8.3" "-" COEFFS 0 1 0 0 0 0.015625 /end COMPU_METHOD
/begin COMPU_METHOD COMP_0001 "1/8ms" RAT_FUNC "%8.2" "ms" COEFFS 0 1 0 0 0 0.125 /end COMPU_METHOD
/begin COMPU_METHOD COMP_0020 "50rpm" RAT_FUNC "%8.2" "rpm" COEFFS 0 1 0 0 0 50 /end COMPU_METHOD
/begin COMPU_METHOD COMP_0002 "0.35deg" RAT_FUNC "%8.2" "deg" COEFFS 0 1 0 0 0 0.35 /end COMPU_METHOD
/begin COMPU_METHOD COMP_0014 "10ms" RAT_FUNC "%8.2" "ms" COEFFS 0 1 0 0 0 10 /end COMPU_METHOD
/begin COMPU_METHOD COMP_0006 "12.5rpm" RAT_FUNC "%8.2" "rpm" COEFFS 0 1 0 0 0 12.5 /end COMPU_METHOD
/begin COMPU_METHOD COMP_0008 "100ms" RAT_FUNC "%8.2" "ms" COEFFS 0 1 0 0 0 100 /end COMPU_METHOD
/begin COMPU_METHOD COMP_0009 "100/128%" RAT_FUNC "%8.2" "%" COEFFS 0 1 0 0 0 0.78125 /end COMPU_METHOD
/begin COMPU_METHOD COMP_0013 "1s" RAT_FUNC "%8.2" "s" COEFFS 0 1 0 0 0 1 /end COMPU_METHOD
/begin COMPU_METHOD COMP_0000 "25rpm" RAT_FUNC "%8.2" "rpm" COEFFS 0 1 0 0 0 25 /end COMPU_METHOD
/begin COMPU_METHOD COMP_0436 "0.1km/h" RAT_FUNC "%8.2" "km/h" COEFFS 0 1 0 0 0 0.1 /end COMPU_METHOD
/begin COMPU_METHOD COMP_0018 "1deg" RAT_FUNC "%8.2" "deg" COEFFS 0 1 0 0 0 1 /end COMPU_METHOD
/begin COMPU_METHOD COMP_0019 "1degCA" RAT_FUNC "%8.2" "degCA" COEFFS 0 1 0 0 0 1 /end COMPU_METHOD
/begin COMPU_METHOD COMP_0007 "2km/h" RAT_FUNC "%8.2" "km/h" COEFFS 0 1 0 0 0 2 /end COMPU_METHOD
/begin COMPU_METHOD COMP_0021 "100/256%" RAT_FUNC "%8.2" "%" COEFFS 0 1 0 0 0 0.390625 /end COMPU_METHOD
/begin COMPU_METHOD COMP_0217 "1/16384-" RAT_FUNC "%8.6" "-" COEFFS 0 1 0 0 0 0.0000610352 /end COMPU_METHOD
/begin COMPU_METHOD COMP_0033 "80mV" RAT_FUNC "%8.2" "mV" COEFFS 0 1 0 0 0 80 /end COMPU_METHOD
/begin COMPU_METHOD COMP_0032 "1/256Å|" RAT_FUNC "%8.4" "Å|" COEFFS 0 1 0 0 0 0.00390625 /end COMPU_METHOD
/begin COMPU_METHOD COMP_0066 "1/64Å|" RAT_FUNC "%8.3" "Å|" COEFFS 0 1 0 0 0 0.015625 /end COMPU_METHOD
/begin COMPU_METHOD COMP_0132 "1/512Å|" RAT_FUNC "%8.4" "Å|" COEFFS 0 1 0 0 0 0.001953125 /end COMPU_METHOD
/begin COMPU_METHOD COMP_0063 "1/256-" RAT_FUNC "%8.4" "-" COEFFS 0 1 0 0 0 0.00390625 /end COMPU_METHOD
/begin COMPU_METHOD COMP_0015 "0.125Å|" RAT_FUNC "%8.2" "Å|" COEFFS 0 1 0 0 0 0.125 /end COMPU_METHOD
/begin COMPU_METHOD COMP_0030 "1âÒ" RAT_FUNC "%8.2" "âÒ" COEFFS 0 1 0 0 0 1 /end COMPU_METHOD
/begin COMPU_METHOD COMP_0443 "1rpm" RAT_FUNC "%8.2" "rpm" COEFFS 0 1 0 0 0 1 /end COMPU_METHOD
/begin COMPU_METHOD COMP_0031 "1/256%" RAT_FUNC "%8.4" "%" COEFFS 0 1 0 0 0 0.00390625 /end COMPU_METHOD
/begin COMPU_METHOD COMP_0053_S "deg/150msdeg/150m" RAT_FUNC "%8.2" "deg/150m" COEFFS 0 1 0 0 0 0.35 /end COMPU_METHOD
/begin COMPU_METHOD COMP_0005 "0.11deg" RAT_FUNC "%8.2" "deg" COEFFS 0 1 0 0 0 0.11 /end COMPU_METHOD
/begin COMPU_METHOD COMP_0035_S "∂≥›ƒ∂≥›ƒ" RAT_FUNC "%8.2" "∂≥›ƒ" COEFFS 0 1 0 0 0 1 /end COMPU_METHOD
/begin COMPU_METHOD COMP_0044 "1/128Å|" RAT_FUNC "%8.4" "Å|" COEFFS 0 1 0 0 0 0.0078125 /end COMPU_METHOD
/begin COMPU_METHOD COMP_0048 "64/128degCA" RAT_FUNC "%8.2" "degCA" COEFFS 0 1 0 0 0 0.5 /end COMPU_METHOD
/begin COMPU_METHOD COMP_0016 "1count" RAT_FUNC "%8.2" "count" COEFFS 0 1 0 0 0 1 /end COMPU_METHOD
/begin COMPU_METHOD COMP_0054 "20mV" RAT_FUNC "%8.2" "mV" COEFFS 0 1 0 0 0 20 /end COMPU_METHOD
/begin COMPU_METHOD COMP_0035 "X-50Åé" RAT_FUNC "%8.2" "Åé" COEFFS 0 1 50 0 0 1 /end COMPU_METHOD
/begin COMPU_METHOD COMP_0071 "1rev" RAT_FUNC "%8.2" "rev" COEFFS 0 1 0 0 0 1 /end COMPU_METHOD
/begin COMPU_METHOD COMP_0262 "12.5rpm" RAT_FUNC "%8.2" "rpm" COEFFS 0 1 0 0 0 12.5 /end COMPU_METHOD
/begin COMPU_METHOD COMP_0392_S "1rpm/50ms" RAT_FUNC "%8.2" "rpm/50ms" COEFFS 0 1 0 0 0 1 /end COMPU_METHOD
/begin COMPU_METHOD COMP_0221_S "4.882*10ÅO-61/rpm" RAT_FUNC "%8.6" "1/rpm" COEFFS 0 1 0 0 0 0.000004882 /end COMPU_METHOD
/begin COMPU_METHOD COMP_0111 "256/xÅ|" RAT_FUNC "%8.2" "Å|" COEFFS 0 0 256 0 1 0 /end COMPU_METHOD
/begin COMPU_METHOD COMP_0398_S "256/x-" RAT_FUNC "%8.2" "-" COEFFS 0 0 256 0 1 0 /end COMPU_METHOD
/begin COMPU_METHOD COMP_0069 "1/(128*256)Å|" RAT_FUNC "%8.6" "Å|" COEFFS 0 1 0 0 0 0.0000305176 /end COMPU_METHOD
/begin COMPU_METHOD COMP_0131 "5/256mV" RAT_FUNC "%8.3" "mV" COEFFS 0 1 0 0 0 0.01953125 /end COMPU_METHOD
/begin COMPU_METHOD COMP_0456 "1/(256Å~128)-" RAT_FUNC "%8.6" "-" COEFFS 0 1 0 0 0 0.0000305176 /end COMPU_METHOD
/begin COMPU_METHOD COMP_0277 "1L/min" RAT_FUNC "%8.2" "L/min" COEFFS 0 1 0 0 0 1 /end COMPU_METHOD
/begin COMPU_METHOD COMP_0064 "1.5625rpm" RAT_FUNC "%8.2" "rpm" COEFFS 0 1 0 0 0 1.5625 /end COMPU_METHOD
/begin COMPU_METHOD COMP_0187_S "É sÉ s" RAT_FUNC "%8.2" "É s" COEFFS 0 1 0 0 0 32 /end COMPU_METHOD
/begin COMPU_METHOD COMP_0073 "3.2us" RAT_FUNC "%8.2" "us" COEFFS 0 1 0 0 0 3.2 /end COMPU_METHOD
/begin COMPU_METHOD COMP_0025 "0.5step" RAT_FUNC "%8.2" "step" COEFFS 0 1 0 0 0 0.5 /end COMPU_METHOD
/begin COMPU_METHOD COMP_0203 "1/256-" RAT_FUNC "%8.4" "-" COEFFS 0 1 0 0 0 0.00390625 /end COMPU_METHOD
/begin COMPU_METHOD COMP_0205 "100/32%" RAT_FUNC "%8.2" "%" COEFFS 0 1 0 0 0 3.125 /end COMPU_METHOD
/begin COMPU_METHOD COMP_0210 "1msec/kg" RAT_FUNC "%8.2" "msec/kg" COEFFS 0 1 0 0 0 1 /end COMPU_METHOD
/begin COMPU_METHOD COMP_0213 "100/128rpm/km/h" RAT_FUNC "%8.2" "rpm/km/h" COEFFS 0 1 0 0 0 0.78125 /end COMPU_METHOD
/begin COMPU_METHOD COMP_0240_S "1Å~10^-5mm^3/us" RAT_FUNC "%8.6" "mm^3/us" COEFFS 0 1 0 0 0 0.00001 /end COMPU_METHOD
/begin COMPU_METHOD COMP_0224 "1/65536km/h/rpm" RAT_FUNC "%8.6" "km/h/rpm" COEFFS 0 1 0 0 0 0.0000152588 /end COMPU_METHOD
/begin COMPU_METHOD COMP_0146 "100/256/256%" RAT_FUNC "%8.4" "%" COEFFS 0 1 0 0 0 0.001525879 /end COMPU_METHOD
/begin COMPU_METHOD COMP_0247_S "1ÉTÉCÉNÉã" RAT_FUNC "%8.2" "ÉTÉCÉNÉã" COEFFS 0 1 0 0 0 1 /end COMPU_METHOD
/begin COMPU_METHOD COMP_0263 "1-" RAT_FUNC "%8.2" "-" COEFFS 0 1 0 0 0 1 /end COMPU_METHOD
/begin COMPU_METHOD COMP_0065 "3.125rpm" RAT_FUNC "%8.2" "rpm" COEFFS 0 1 0 0 0 3.125 /end COMPU_METHOD
/begin COMPU_METHOD COMP_0052 "1/2048ms" RAT_FUNC "%8.5" "ms" COEFFS 0 1 0 0 0 0.000488282 /end COMPU_METHOD
/begin COMPU_METHOD COMP_0282 "1*10**-4kg/hr" RAT_FUNC "%8.5" "kg/hr" COEFFS 0 1 0 0 0 0.0001 /end COMPU_METHOD
/begin COMPU_METHOD COMP_0144 "1/2048ms" RAT_FUNC "%8.5" "ms" COEFFS 0 1 0 0 0 0.000488281 /end COMPU_METHOD
/begin COMPU_METHOD COMP_0295 "100msec" RAT_FUNC "%8.2" "msec" COEFFS 0 1 0 0 0 100 /end COMPU_METHOD
/begin COMPU_METHOD COMP_0230_S "1/(4*128)Å|" RAT_FUNC "%8.4" "Å|" COEFFS 0 1 0 0 0 0.00195313 /end COMPU_METHOD
/begin COMPU_METHOD COMP_0278_S "fixed axis Åé" RAT_FUNC "%8.2" "Åé" COEFFS 0 1 40 0 0 20 /end COMPU_METHOD
/begin COMPU_METHOD COMP_0271_S "fixed axis rpm" RAT_FUNC "%8.2" "rpm" COEFFS 0 1 0 0 0 400 /end COMPU_METHOD
/begin COMPU_METHOD COMP_0088 "1/4096Å|" RAT_FUNC "%8.5" "Å|" COEFFS 0 1 0 0 0 0.000244141 /end COMPU_METHOD
/begin COMPU_METHOD COMP_0279_S "fixed axis %" RAT_FUNC "%8.2" "%" COEFFS 0 1 0 0 0 12.5 /end COMPU_METHOD
/begin COMPU_METHOD COMP_0042 "0.0008cm**2" RAT_FUNC "%8.5" "cm**2" COEFFS 0 1 0 0 0 0.0008 /end COMPU_METHOD
/begin COMPU_METHOD COMP_0501_S "fixed axis cm^2/(rp" RAT_FUNC "%8.2" "cm^2/(rp" COEFFS 0 1 -0.000001 0 0 3.719 /end COMPU_METHOD
/begin COMPU_METHOD COMP_0502_S "fixed axis cm^2/(rp" RAT_FUNC "%8.2" "cm^2/(rp" COEFFS 0 1 0 0 0 9.297 /end COMPU_METHOD
/begin COMPU_METHOD COMP_0298_S "fixed axis deg" RAT_FUNC "%8.2" "deg" COEFFS 0 1 0 0 0 2.8125 /end COMPU_METHOD
/begin COMPU_METHOD COMP_0304_S "6.25E-10cm**2/rp" RAT_FUNC "%8.6" "cm**2/rp" COEFFS 0 1 0 0 0 0.000000000625 /end COMPU_METHOD
/begin COMPU_METHOD COMP_0303_S "3.90625E-11cm**2/rp" RAT_FUNC "%8.6" "cm**2/rp" COEFFS 0 1 0 0 0 3.90625E-11 /end COMPU_METHOD
/begin COMPU_METHOD COMP_0506_S "fixed axis rpm" RAT_FUNC "%8.2" "rpm" COEFFS 0 1 -1200 0 0 800 /end COMPU_METHOD
/begin COMPU_METHOD COMP_0128_S "ÅéÅé" RAT_FUNC "%8.2" "Åé" COEFFS 0 1 30 0 0 5 /end COMPU_METHOD
/begin COMPU_METHOD COMP_0476 "12.5/64rpm" RAT_FUNC "%8.2" "rpm" COEFFS 0 1 0 0 0 0.1953125 /end COMPU_METHOD
/begin COMPU_METHOD COMP_0283 "1flag" RAT_FUNC "%8.2" "flag" COEFFS 0 1 0 0 0 1 /end COMPU_METHOD
/begin COMPU_METHOD COMP_0201_S "1s1s" RAT_FUNC "%8.2" "1s" COEFFS 0 1 0 0 0 1 /end COMPU_METHOD
/begin COMPU_METHOD COMP_0202_S "100ms100ms" RAT_FUNC "%8.2" "100ms" COEFFS 0 1 0 0 0 1 /end COMPU_METHOD
/begin COMPU_METHOD COMP_0203_S "10ms10ms" RAT_FUNC "%8.2" "10ms" COEFFS 0 1 0 0 0 1 /end COMPU_METHOD
/begin COMPU_METHOD COMP_0000_S "%%" RAT_FUNC "%8.2" "%" COEFFS 0 1 0 0 0 1 /end COMPU_METHOD
/begin COMPU_METHOD COMP_0031_S "mm^3mm^3" RAT_FUNC "%8.2" "mm^3" COEFFS 0 1 0 0 0 80 /end COMPU_METHOD
/begin COMPU_METHOD COMP_0034_S "mm^3mm^3" RAT_FUNC "%8.2" "mm^3" COEFFS 0 1 0 0 0 0.3125 /end COMPU_METHOD
/begin COMPU_METHOD COMP_0001_S "km/hkm/h" RAT_FUNC "%8.6" "km/h" COEFFS 0 1 0 0 0 0.000000858 /end COMPU_METHOD
/begin COMPU_METHOD COMP_0209_S "3.6*2^-22km/h" RAT_FUNC "%8.6" "km/h" COEFFS 0 1 0 0 0 0.000000858307 /end COMPU_METHOD
/begin COMPU_METHOD COMP_0006_S "cm^2/rpmcccm^2/rpm" RAT_FUNC "%8.6" "cm^2/rpm" COEFFS 0 1 0 0 0 0.0000000000454 /end COMPU_METHOD
/begin COMPU_METHOD COMP_0539_S "cm^2/(rpm*cc)cm^2/(rp" RAT_FUNC "%8.6" "cm^2/(rp" COEFFS 0 1 0 0 0 0.0000000000908 /end COMPU_METHOD
/begin COMPU_METHOD COMP_0264 "1Å|" RAT_FUNC "%8.2" "Å|" COEFFS 0 1 0 0 0 1 /end COMPU_METHOD
/begin COMPU_METHOD COMP_0374 "0.0002cm**2" RAT_FUNC "%8.5" "cm**2" COEFFS 0 1 0 0 0 0.0002 /end COMPU_METHOD
/begin COMPU_METHOD COMP_0118 "40mV" RAT_FUNC "%8.2" "mV" COEFFS 0 1 0 0 0 40 /end COMPU_METHOD
/begin COMPU_METHOD COMP_0189 "3.2É S" RAT_FUNC "%8.2" "É S" COEFFS 0 1 0 0 0 3.2 /end COMPU_METHOD
/begin COMPU_METHOD COMP_0389 "1/2548km" RAT_FUNC "%8.5" "km" COEFFS 0 1 0 0 0 0.000392465 /end COMPU_METHOD
/begin COMPU_METHOD COMP_0390 "10deg" RAT_FUNC "%8.2" "deg" COEFFS 0 1 0 0 0 10 /end COMPU_METHOD
/begin COMPU_METHOD COMP_0567_S "cyl(BITà íu)cyl(BIT" RAT_FUNC "%8.2" "cyl(BIT" COEFFS 0 1 0 0 0 1 /end COMPU_METHOD
/begin COMPU_METHOD COMP_0582_S "rpmrpm" RAT_FUNC "%8.3" "rpm" COEFFS 0 1 0 0 0 0.0488281 /end COMPU_METHOD
/begin COMPU_METHOD COMP_0236 "0.25km/h" RAT_FUNC "%8.2" "km/h" COEFFS 0 1 0 0 0 0.25 /end COMPU_METHOD
/begin COMPU_METHOD COMP_0587_S "kmkm" RAT_FUNC "%8.2" "km" COEFFS 0 1 0 0 0 0.100503 /end COMPU_METHOD
/begin COMPU_METHOD COMP_0597_S "1/rpmÅEcc1/rpmÅEc" RAT_FUNC "%8.6" "1/rpmÅEc" COEFFS 0 1 0 0 0 0.0000000002218 /end COMPU_METHOD
/begin COMPU_METHOD COMP_0479 "312.5rpmÅEcc" RAT_FUNC "%8.2" "rpmÅEcc" COEFFS 0 1 0 0 0 312.5 /end COMPU_METHOD
/begin COMPU_METHOD COMP_0480 "6.25rpm" RAT_FUNC "%8.2" "rpm" COEFFS 0 1 0 0 0 6.25 /end COMPU_METHOD
/begin COMPU_METHOD COMP_0157_S "É SÉ S" RAT_FUNC "%8.2" "É S" COEFFS 0 1 0 0 0 32 /end COMPU_METHOD
/begin COMPU_METHOD COMP_0320 "1.6É S" RAT_FUNC "%8.2" "É S" COEFFS 0 1 0 0 0 1.6 /end COMPU_METHOD
/begin COMPU_METHOD COMP_0098 "1.6us" RAT_FUNC "%8.2" "us" COEFFS 0 1 0 0 0 1.6 /end COMPU_METHOD
/begin COMPU_METHOD COMP_0512 "1/512ms" RAT_FUNC "%8.4" "ms" COEFFS 0 1 0 0 0 0.001953125 /end COMPU_METHOD
/begin COMPU_METHOD COMP_0369 "3.2É s" RAT_FUNC "%8.2" "É s" COEFFS 0 1 0 0 0 3.2 /end COMPU_METHOD
/begin COMPU_METHOD COMP_0515 "1/2048ms" RAT_FUNC "%8.5" "ms" COEFFS 0 1 0 0 0 0.000488281 /end COMPU_METHOD
/begin COMPU_METHOD COMP_0519 "5/256mV" RAT_FUNC "%8.3" "mV" COEFFS 0 1 0 0 0 0.0195313 /end COMPU_METHOD
/begin COMPU_METHOD COMP_0266 "64/128deg" RAT_FUNC "%8.2" "deg" COEFFS 0 1 0 0 0 0.5 /end COMPU_METHOD
/* RECORD_LAYOUT ------------------------------------------------------ */
/begin RECORD_LAYOUT REC_UBYTE_C FNC_VALUES 1 UBYTE COLUMN_DIR DIRECT /end RECORD_LAYOUT
/begin RECORD_LAYOUT REC_UWORD_C FNC_VALUES 1 UWORD COLUMN_DIR DIRECT /end RECORD_LAYOUT
/begin RECORD_LAYOUT REC_SBYTE_C FNC_VALUES 1 SBYTE COLUMN_DIR DIRECT /end RECORD_LAYOUT
/begin RECORD_LAYOUT REC_AXIS_UBYTE AXIS_PTS_X 1 UBYTE INDEX_INCR DIRECT /end RECORD_LAYOUT
/begin RECORD_LAYOUT REC_AXIS_UWORD AXIS_PTS_X 1 UWORD INDEX_INCR DIRECT /end RECORD_LAYOUT
/end MODULE
/end PROJECT
