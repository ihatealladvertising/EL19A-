ASAP2_VERSION 1 3_BETA
/begin PROJECT TK_X91_EUR_VC ""
/begin HEADER "" /* key HEADER ++ "comment" Ç… Par.scomment */ PROJECT_NO TK_X91_EUR_VC /* key PROJECT_NO ++ project number Ç… car_eng_desti_lot */ VERSION "7V4YHZEB2" /* key VERSION ++ version number Ç… mProgver */ /end HEADER
/begin MODULE DIM ""
/begin MOD_COMMON "" DEPOSIT ABSOLUTE BYTE_ORDER MSB_FIRST /* ﬁ≤ƒµ∞¿ﬁ∞Ç™ÿÃﬂ⁄∞ΩÇ≥ÇÍÇÈ */ /end MOD_COMMON
/begin MEASUREMENT wvCABSENT_C#13_R#1 "Array of volatile counters accounting for current failures  Absent unit " UBYTE COMP_0068 1 100 0 255 ECU_ADDRESS 0xFFFF4800 /begin FUNCTION_LIST /end FUNCTION_LIST /end MEASUREMENT
/begin MEASUREMENT wvCABSENT_C#14_R#1 "Array of volatile counters accounting for current failures  Absent unit " UBYTE COMP_0068 1 100 0 255 ECU_ADDRESS 0xFFFF4801 /begin FUNCTION_LIST /end FUNCTION_LIST /end MEASUREMENT
/begin MEASUREMENT wvCABSENT_C#15_R#1 "Array of volatile counters accounting for current failures  Absent unit " UBYTE COMP_0068 1 100 0 255 ECU_ADDRESS 0xFFFF4802 /begin FUNCTION_LIST /end FUNCTION_LIST /end MEASUREMENT
/begin MEASUREMENT wvCABSENT_C#16_R#1 "Array of volatile counters accounting for current failures  Absent unit " UBYTE COMP_0068 1 100 0 255 ECU_ADDRESS 0xFFFF4803 /begin FUNCTION_LIST /end FUNCTION_LIST /end MEASUREMENT
/begin MEASUREMENT wvCABSENT_C#17_R#1 "Array of volatile counters accounting for current failures  Absent unit " UBYTE COMP_0068 1 100 0 255 ECU_ADDRESS 0xFFFF4804 /begin FUNCTION_LIST /end FUNCTION_LIST /end MEASUREMENT
/begin MEASUREMENT wvCABSENT_C#18_R#1 "Array of volatile counters accounting for current failures  Absent unit " UBYTE COMP_0068 1 100 0 255 ECU_ADDRESS 0xFFFF4805 /begin FUNCTION_LIST /end FUNCTION_LIST /end MEASUREMENT
/begin MEASUREMENT wvCABSENT_C#19_R#1 "Array of volatile counters accounting for current failures  Absent unit " UBYTE COMP_0068 1 100 0 255 ECU_ADDRESS 0xFFFF4806 /begin FUNCTION_LIST /end FUNCTION_LIST /end MEASUREMENT
/begin MEASUREMENT wvCABSENT_C#20_R#1 "Array of volatile counters accounting for current failures  Absent unit " UBYTE COMP_0068 1 100 0 255 ECU_ADDRESS 0xFFFF4807 /begin FUNCTION_LIST /end FUNCTION_LIST /end MEASUREMENT
/begin MEASUREMENT wvCABSENT_C#21_R#1 "Array of volatile counters accounting for current failures  Absent unit " UBYTE COMP_0068 1 100 0 255 ECU_ADDRESS 0xFFFF4808 /begin FUNCTION_LIST /end FUNCTION_LIST /end MEASUREMENT
/begin MEASUREMENT wvCABSENT_C#22_R#1 "Array of volatile counters accounting for current failures  Absent unit " UBYTE COMP_0068 1 100 0 255 ECU_ADDRESS 0xFFFF4809 /begin FUNCTION_LIST /end FUNCTION_LIST /end MEASUREMENT
/begin MEASUREMENT wvCABSENT_C#23_R#1 "Array of volatile counters accounting for current failures  Absent unit " UBYTE COMP_0068 1 100 0 255 ECU_ADDRESS 0xFFFF480A /begin FUNCTION_LIST /end FUNCTION_LIST /end MEASUREMENT
/begin MEASUREMENT wvCABSENT_C#24_R#1 "Array of volatile counters accounting for current failures  Absent unit " UBYTE COMP_0068 1 100 0 255 ECU_ADDRESS 0xFFFF480B /begin FUNCTION_LIST /end FUNCTION_LIST /end MEASUREMENT
/begin MEASUREMENT wvCABSENT_C#25_R#1 "Array of volatile counters accounting for current failures  Absent unit " UBYTE COMP_0068 1 100 0 255 ECU_ADDRESS 0xFFFF480C /begin FUNCTION_LIST /end FUNCTION_LIST /end MEASUREMENT
/begin MEASUREMENT wvCABSENT_C#26_R#1 "Array of volatile counters accounting for current failures  Absent unit " UBYTE COMP_0068 1 100 0 255 ECU_ADDRESS 0xFFFF480D /begin FUNCTION_LIST /end FUNCTION_LIST /end MEASUREMENT
/begin MEASUREMENT wvCABSENT_C#27_R#1 "Array of volatile counters accounting for current failures  Absent unit " UBYTE COMP_0068 1 100 0 255 ECU_ADDRESS 0xFFFF480E /begin FUNCTION_LIST /end FUNCTION_LIST /end MEASUREMENT
/begin MEASUREMENT wvCABSENT_C#28_R#1 "Array of volatile counters accounting for current failures  Absent unit " UBYTE COMP_0068 1 100 0 255 ECU_ADDRESS 0xFFFF480F /begin FUNCTION_LIST /end FUNCTION_LIST /end MEASUREMENT
/begin MEASUREMENT wvCABSENT_C#29_R#1 "Array of volatile counters accounting for current failures  Absent unit " UBYTE COMP_0068 1 100 0 255 ECU_ADDRESS 0xFFFF4810 /begin FUNCTION_LIST /end FUNCTION_LIST /end MEASUREMENT
/begin MEASUREMENT wvCABSENT_C#30_R#1 "Array of volatile counters accounting for current failures  Absent unit " UBYTE COMP_0068 1 100 0 255 ECU_ADDRESS 0xFFFF4811 /begin FUNCTION_LIST /end FUNCTION_LIST /end MEASUREMENT
/begin MEASUREMENT wvCCEPMCTR "Counter of root cause and mileage EEPROM write-on-the-flight" ULONG COMP_0068 1 100 0 4294967295 ECU_ADDRESS 0xFFFF9F4C /begin FUNCTION_LIST /end FUNCTION_LIST /end MEASUREMENT
/begin MEASUREMENT wvCCSLIBF "Buffer of the 16 last" UBYTE COMP_0068 1 100 0 255 ECU_ADDRESS 0xFFFF9F50 /begin FUNCTION_LIST /end FUNCTION_LIST /end MEASUREMENT
/begin MEASUREMENT wvCCSLIBF_C#1_R#1 "Buffer of the 16 last" UBYTE COMP_0068 1 100 0 255 ECU_ADDRESS 0xFFFF9F50 /begin FUNCTION_LIST /end FUNCTION_LIST /end MEASUREMENT
/begin MEASUREMENT wvCCSLIBF_C#2_R#1 "Buffer of the 16 last" UBYTE COMP_0068 1 100 0 255 ECU_ADDRESS 0xFFFF9F51 /begin FUNCTION_LIST /end FUNCTION_LIST /end MEASUREMENT
/begin MEASUREMENT wvCCSLIBF_C#3_R#1 "Buffer of the 16 last" UBYTE COMP_0068 1 100 0 255 ECU_ADDRESS 0xFFFF9F52 /begin FUNCTION_LIST /end FUNCTION_LIST /end MEASUREMENT
/begin MEASUREMENT wvCCSLIBF_C#4_R#1 "Buffer of the 16 last" UBYTE COMP_0068 1 100 0 255 ECU_ADDRESS 0xFFFF9F53 /begin FUNCTION_LIST /end FUNCTION_LIST /end MEASUREMENT
/begin MEASUREMENT wvCCSLIBF_C#5_R#1 "Buffer of the 16 last" UBYTE COMP_0068 1 100 0 255 ECU_ADDRESS 0xFFFF9F54 /begin FUNCTION_LIST /end FUNCTION_LIST /end MEASUREMENT
/begin MEASUREMENT wvCCSLIBF_C#6_R#1 "Buffer of the 16 last" UBYTE COMP_0068 1 100 0 255 ECU_ADDRESS 0xFFFF9F55 /begin FUNCTION_LIST /end FUNCTION_LIST /end MEASUREMENT
/begin MEASUREMENT wvCCSLIBF_C#7_R#1 "Buffer of the 16 last" UBYTE COMP_0068 1 100 0 255 ECU_ADDRESS 0xFFFF9F56 /begin FUNCTION_LIST /end FUNCTION_LIST /end MEASUREMENT
/begin MEASUREMENT wvCCSLIBF_C#8_R#1 "Buffer of the 16 last" UBYTE COMP_0068 1 100 0 255 ECU_ADDRESS 0xFFFF9F57 /begin FUNCTION_LIST /end FUNCTION_LIST /end MEASUREMENT
/begin MEASUREMENT wvCCSLIBF_C#9_R#1 "Buffer of the 16 last" UBYTE COMP_0068 1 100 0 255 ECU_ADDRESS 0xFFFF9F58 /begin FUNCTION_LIST /end FUNCTION_LIST /end MEASUREMENT
/begin MEASUREMENT wvCCSLIBF_C#10_R#1 "Buffer of the 16 last" UBYTE COMP_0068 1 100 0 255 ECU_ADDRESS 0xFFFF9F59 /begin FUNCTION_LIST /end FUNCTION_LIST /end MEASUREMENT
/begin MEASUREMENT wvCCSLIBF_C#11_R#1 "Buffer of the 16 last" UBYTE COMP_0068 1 100 0 255 ECU_ADDRESS 0xFFFF9F5A /begin FUNCTION_LIST /end FUNCTION_LIST /end MEASUREMENT
/begin MEASUREMENT wvCCSLIBF_C#12_R#1 "Buffer of the 16 last" UBYTE COMP_0068 1 100 0 255 ECU_ADDRESS 0xFFFF9F5B /begin FUNCTION_LIST /end FUNCTION_LIST /end MEASUREMENT
/begin MEASUREMENT wvCCSLIBF_C#13_R#1 "Buffer of the 16 last" UBYTE COMP_0068 1 100 0 255 ECU_ADDRESS 0xFFFF9F5C /begin FUNCTION_LIST /end FUNCTION_LIST /end MEASUREMENT
/begin MEASUREMENT wvCCSLIBF_C#14_R#1 "Buffer of the 16 last" UBYTE COMP_0068 1 100 0 255 ECU_ADDRESS 0xFFFF9F5D /begin FUNCTION_LIST /end FUNCTION_LIST /end MEASUREMENT
/begin MEASUREMENT wvCCSLIBF_C#15_R#1 "Buffer of the 16 last" UBYTE COMP_0068 1 100 0 255 ECU_ADDRESS 0xFFFF9F5E /begin FUNCTION_LIST /end FUNCTION_LIST /end MEASUREMENT
/begin MEASUREMENT wvCCSLIBF_C#16_R#1 "Buffer of the 16 last" UBYTE COMP_0068 1 100 0 255 ECU_ADDRESS 0xFFFF9F5F /begin FUNCTION_LIST /end FUNCTION_LIST /end MEASUREMENT
/begin MEASUREMENT wvCCSLIBF_C#17_R#1 "Buffer of the 16 last" UBYTE COMP_0068 1 100 0 255 ECU_ADDRESS 0xFFFF9F60 /begin FUNCTION_LIST /end FUNCTION_LIST /end MEASUREMENT
/begin MEASUREMENT wvCCSLIBF_C#18_R#1 "Buffer of the 16 last" UBYTE COMP_0068 1 100 0 255 ECU_ADDRESS 0xFFFF9F61 /begin FUNCTION_LIST /end FUNCTION_LIST /end MEASUREMENT
/begin MEASUREMENT wvCCSLIBF_C#19_R#1 "Buffer of the 16 last" UBYTE COMP_0068 1 100 0 255 ECU_ADDRESS 0xFFFF9F62 /begin FUNCTION_LIST /end FUNCTION_LIST /end MEASUREMENT
/begin MEASUREMENT wvCCSLIBF_C#20_R#1 "Buffer of the 16 last" UBYTE COMP_0068 1 100 0 255 ECU_ADDRESS 0xFFFF9F63 /begin FUNCTION_LIST /end FUNCTION_LIST /end MEASUREMENT
/begin MEASUREMENT wvCCSLIBF_C#21_R#1 "Buffer of the 16 last" UBYTE COMP_0068 1 100 0 255 ECU_ADDRESS 0xFFFF9F64 /begin FUNCTION_LIST /end FUNCTION_LIST /end MEASUREMENT
/begin MEASUREMENT wvCCSLIBF_C#22_R#1 "Buffer of the 16 last" UBYTE COMP_0068 1 100 0 255 ECU_ADDRESS 0xFFFF9F65 /begin FUNCTION_LIST /end FUNCTION_LIST /end MEASUREMENT
/begin MEASUREMENT wvCLUMINMX "Begin stroke clutch pedal switch" UBYTE COMP_0068 1 100 0 255 ECU_ADDRESS 0xFFFF4762 /begin FUNCTION_LIST /end FUNCTION_LIST /end MEASUREMENT
/begin MEASUREMENT wvCNTRIP "Mileage for the fuel level gauge diagnosis" ULONG COMP_0389 1 100 0 1685624.33943218 ECU_ADDRESS 0xFFFF9F68 /begin FUNCTION_LIST /end FUNCTION_LIST /end MEASUREMENT
/begin MEASUREMENT wvCOUPST "Coupler state (1 : closed ; 2 : sliding ; 8 : open)" UBYTE COMP_0068 1 100 0 255 ECU_ADDRESS 0xFFFF49AC /begin FUNCTION_LIST /end FUNCTION_LIST /end MEASUREMENT
/begin MEASUREMENT wvCRT1BUP "The ID condition data that I/O for the TCS fuel cut is local" UBYTE COMP_0004 1 100 0 255 ECU_ADDRESS 0xFFFF4812 /begin FUNCTION_LIST /end FUNCTION_LIST /end MEASUREMENT
/begin MEASUREMENT wvCVTCCHKf "CVTC solenoid check signal (L)" UBYTE COMP_0004 1 100 0 255 ECU_ADDRESS 0xFFFF4813 /begin FUNCTION_LIST /end FUNCTION_LIST /end MEASUREMENT
/begin MEASUREMENT wvCVTFLEVL "CAN receiving data (CK) load change signal" UBYTE COMP_0068 1 100 0 255 ECU_ADDRESS 0xFFFF4814 /begin FUNCTION_LIST /end FUNCTION_LIST /end MEASUREMENT
/begin MEASUREMENT wvCVTMSG1T "CVTMSG1 reception interval counter" UBYTE COMP_0014 1 100 0 2550 ECU_ADDRESS 0xFFFF4815 /begin FUNCTION_LIST /end FUNCTION_LIST /end MEASUREMENT
/begin MEASUREMENT wvCVTMSG2T "CVTMSG2 reception interval counter" UBYTE COMP_0014 1 100 0 2550 ECU_ADDRESS 0xFFFF4816 /begin FUNCTION_LIST /end FUNCTION_LIST /end MEASUREMENT
/begin MEASUREMENT wvCVTMSG3T "CVTMSG3 reception interval counter" UBYTE COMP_0014 1 100 0 2550 ECU_ADDRESS 0xFFFF4817 /begin FUNCTION_LIST /end FUNCTION_LIST /end MEASUREMENT
/begin MEASUREMENT wvDLTMN "A MNRPM change (rise side) before 100mS" UBYTE COMP_0000 1 100 0 6375 ECU_ADDRESS 0xFFFF8A01 /begin FUNCTION_LIST /end FUNCTION_LIST /end MEASUREMENT
/begin MEASUREMENT wvDLTV100 "The amount of change of TVO for 100mS" UBYTE COMP_0584_S 1 100 0 89.25 ECU_ADDRESS 0xFFFF481B /begin FUNCTION_LIST /end FUNCTION_LIST /end MEASUREMENT
/begin MEASUREMENT wvDLTVS2 "VSP computed every delta-VSP absolute value" UBYTE COMP_0229 1 100 -256 254 ECU_ADDRESS 0xFFFF481C /begin FUNCTION_LIST /end FUNCTION_LIST /end MEASUREMENT
/begin MEASUREMENT wvDLTVSP "VSP computed every delta-VSP (80H center)" UBYTE COMP_0007 1 100 0 510 ECU_ADDRESS 0xFFFF481D /begin FUNCTION_LIST /end FUNCTION_LIST /end MEASUREMENT
/begin MEASUREMENT wvDTEGR "É¢TEGR (for 10s)" UBYTE COMP_0403 1 100 0 255 ECU_ADDRESS 0xFFFF4820 /begin FUNCTION_LIST /end FUNCTION_LIST /end MEASUREMENT
/begin MEASUREMENT wvEGRINT "At the time of the start, EGR temperature" UBYTE COMP_0035 1 100 -50 205 ECU_ADDRESS 0xFFFF4826 /begin FUNCTION_LIST /end FUNCTION_LIST /end MEASUREMENT
/begin MEASUREMENT wvEPARBGRQ "airbag request" UBYTE COMP_0068 1 100 0 255 ECU_ADDRESS 0xFFFF4827 /begin FUNCTION_LIST /end FUNCTION_LIST /end MEASUREMENT
/begin MEASUREMENT wvESPTQTYP "Torque control type acquired on the MUX" UBYTE COMP_0068 1 100 0 255 ECU_ADDRESS 0xFFFF4828 /begin FUNCTION_LIST /end FUNCTION_LIST /end MEASUREMENT
/begin MEASUREMENT wvETAMOTMX "Engine states" UBYTE COMP_0068 1 100 0 255 ECU_ADDRESS 0xFFFF4829 /begin FUNCTION_LIST /end FUNCTION_LIST /end MEASUREMENT
/begin MEASUREMENT wvETAMXABS "ABS ECU status for CAN" UBYTE COMP_0068 1 100 0 255 ECU_ADDRESS 0xFFFF482A /begin FUNCTION_LIST /end FUNCTION_LIST /end MEASUREMENT
/begin MEASUREMENT wvETAMXBVA "State of AGB Control Unit for CAN" UBYTE COMP_0068 1 100 0 255 ECU_ADDRESS 0xFFFF482B /begin FUNCTION_LIST /end FUNCTION_LIST /end MEASUREMENT
/begin MEASUREMENT wvETAMXCLM "ABS ECU status for CAN" UBYTE COMP_0068 1 100 0 255 ECU_ADDRESS 0xFFFF482C /begin FUNCTION_LIST /end FUNCTION_LIST /end MEASUREMENT
/begin MEASUREMENT wvETAMXCLU "cluster ECU status for CAN" UBYTE COMP_0068 1 100 0 255 ECU_ADDRESS 0xFFFF482D /begin FUNCTION_LIST /end FUNCTION_LIST /end MEASUREMENT
/begin MEASUREMENT wvETAMXUCH "UCH (Body Controller) status for CAN" UBYTE COMP_0068 1 100 0 255 ECU_ADDRESS 0xFFFF482E /begin FUNCTION_LIST /end FUNCTION_LIST /end MEASUREMENT
/begin MEASUREMENT wvETAMXUPC "UPC ECU status for CAN" UBYTE COMP_0068 1 100 0 255 ECU_ADDRESS 0xFFFF482F /begin FUNCTION_LIST /end FUNCTION_LIST /end MEASUREMENT
/begin MEASUREMENT wvETSMSG0T "ETSMSG0 reception interval counter" UBYTE COMP_0014 1 100 0 2550 ECU_ADDRESS 0xFFFF4835 /begin FUNCTION_LIST /end FUNCTION_LIST /end MEASUREMENT
/begin MEASUREMENT wvETSTQCTT "ETS_TorqueControl reception interval counter" UBYTE COMP_0014 1 100 0 2550 ECU_ADDRESS 0xFFFF4837 /begin FUNCTION_LIST /end FUNCTION_LIST /end MEASUREMENT
/begin MEASUREMENT wvEVPRES2 "PEVAP weighted average value 2" UWORD COMP_0050 1 100 0 5119.921875 ECU_ADDRESS 0xFFFF890C /begin FUNCTION_LIST /end FUNCTION_LIST /end MEASUREMENT
/begin MEASUREMENT wvEVTCCHKf "Electromagnetism VTC check signal" UBYTE COMP_0004 1 100 0 255 ECU_ADDRESS 0xFFFF4754 /begin FUNCTION_LIST /end FUNCTION_LIST /end MEASUREMENT
/begin MEASUREMENT wvFAFSACTf "A/F sensor activated judgement flag" UBYTE COMP_0004 1 100 0 255 ECU_ADDRESS 0xFFFF890E /begin FUNCTION_LIST /end FUNCTION_LIST /end MEASUREMENT
/begin MEASUREMENT wvFGAGE2 "Fuel level gauge weighted average value 2" UWORD COMP_0050 1 100 0 5119.921875 ECU_ADDRESS 0xFFFF4838 /begin FUNCTION_LIST /end FUNCTION_LIST /end MEASUREMENT
/begin MEASUREMENT wvFGN "Fuel level gauge voltage normalize value" UWORD COMP_0050 1 100 0 5119.921875 ECU_ADDRESS 0xFFFF483C /begin FUNCTION_LIST /end FUNCTION_LIST /end MEASUREMENT
/begin MEASUREMENT wvFMAD "A voltage for the fuel level gauge breakage diagnosis" UWORD COMP_0023 1 100 0 327675 ECU_ADDRESS 0xFFFF483E /begin FUNCTION_LIST /end FUNCTION_LIST /end MEASUREMENT
/begin MEASUREMENT wvFMRCPC1f "A purge cut requirement from the fuel system diagnosis" UBYTE COMP_0004 1 100 0 255 ECU_ADDRESS 0xFFFF4840 /begin FUNCTION_LIST /end FUNCTION_LIST /end MEASUREMENT
/begin MEASUREMENT wvFMRCPC2f "A purge cut requirement from the fuel system diagnosis" UBYTE COMP_0004 1 100 0 255 ECU_ADDRESS 0xFFFF4777 /begin FUNCTION_LIST /end FUNCTION_LIST /end MEASUREMENT
/begin MEASUREMENT wvFO2HMf "A former O2 heater CPU input signal" UBYTE COMP_0004 1 100 0 255 ECU_ADDRESS 0xFFFF4842 /begin FUNCTION_LIST /end FUNCTION_LIST /end MEASUREMENT
/begin MEASUREMENT wvFRWIP "Front wiper status" UBYTE COMP_0068 1 100 0 255 ECU_ADDRESS 0xFFFF8914 /begin FUNCTION_LIST /end FUNCTION_LIST /end MEASUREMENT
/begin MEASUREMENT wvFSO2NGf "O2 sensor NG judgement (It isn't cleared in OK.)" UBYTE COMP_0004 1 100 0 255 ECU_ADDRESS 0xFFFF8A04 /begin FUNCTION_LIST /end FUNCTION_LIST /end MEASUREMENT
/begin MEASUREMENT wvFSO2Sf "O2 sensor failsafe flag" UBYTE COMP_0004 1 100 0 255 ECU_ADDRESS 0xFFFF8A05 /begin FUNCTION_LIST /end FUNCTION_LIST /end MEASUREMENT
/begin MEASUREMENT wvGBMNISMX "Automatic Transmission idle speed setpoint acceleration required" UWORD COMP_0443 1 100 0 65535 ECU_ADDRESS 0xFFFF4844 /begin FUNCTION_LIST /end FUNCTION_LIST /end MEASUREMENT
/begin MEASUREMENT wvHNRPM10Z "100mS previous value of HNRPM10" UBYTE COMP_0020 1 100 0 12750 ECU_ADDRESS 0xFFFF8919 /begin FUNCTION_LIST /end FUNCTION_LIST /end MEASUREMENT
/begin MEASUREMENT wvHT "Work RAM for the 5-times collation" UBYTE COMP_0068 1 100 0 255 ECU_ADDRESS 0xFFFF4846 /begin FUNCTION_LIST /end FUNCTION_LIST /end MEASUREMENT
/begin MEASUREMENT wvHT_R#1 "Work RAM for the 5-times collation" UBYTE COMP_0068 1 100 0 255 ECU_ADDRESS 0xFFFF4846 /begin FUNCTION_LIST /end FUNCTION_LIST /end MEASUREMENT
/begin MEASUREMENT wvHT_R#2 "Work RAM for the 5-times collation" UBYTE COMP_0068 1 100 0 255 ECU_ADDRESS 0xFFFF4847 /begin FUNCTION_LIST /end FUNCTION_LIST /end MEASUREMENT
/begin MEASUREMENT wvHT_R#3 "Work RAM for the 5-times collation" UBYTE COMP_0068 1 100 0 255 ECU_ADDRESS 0xFFFF4848 /begin FUNCTION_LIST /end FUNCTION_LIST /end MEASUREMENT
/begin MEASUREMENT wvHT_R#4 "Work RAM for the 5-times collation" UBYTE COMP_0068 1 100 0 255 ECU_ADDRESS 0xFFFF4849 /begin FUNCTION_LIST /end FUNCTION_LIST /end MEASUREMENT
/begin MEASUREMENT wvHT_R#5 "Work RAM for the 5-times collation" UBYTE COMP_0068 1 100 0 255 ECU_ADDRESS 0xFFFF484A /begin FUNCTION_LIST /end FUNCTION_LIST /end MEASUREMENT
/begin MEASUREMENT wvMEANPF "ON- Average fuel pressure for off P/REG control" UWORD COMP_0164 1 100 0 19.988175 ECU_ADDRESS 0xFFFF884C /begin FUNCTION_LIST /end FUNCTION_LIST /end MEASUREMENT
/begin MEASUREMENT wvMILEMEM "Total vehicle distance secured" ULONG COMP_0470 1 100 0 4294967295 ECU_ADDRESS 0xFFFF9F70 /begin FUNCTION_LIST /end FUNCTION_LIST /end MEASUREMENT
/begin MEASUREMENT wvMLGBFRNG "Buffer of the 20 last" UBYTE COMP_0068 1 100 0 255 ECU_ADDRESS 0xFFFF9F74 /begin FUNCTION_LIST /end FUNCTION_LIST /end MEASUREMENT
/begin MEASUREMENT wvMLGBFRNG_C#1_R#1 "Buffer of the 20 last" UBYTE COMP_0068 1 100 0 255 ECU_ADDRESS 0xFFFF9F74 /begin FUNCTION_LIST /end FUNCTION_LIST /end MEASUREMENT
/begin MEASUREMENT wvMLGBFRNG_C#2_R#1 "Buffer of the 20 last" UBYTE COMP_0068 1 100 0 255 ECU_ADDRESS 0xFFFF9F75 /begin FUNCTION_LIST /end FUNCTION_LIST /end MEASUREMENT
/begin MEASUREMENT wvMLGBFRNG_C#3_R#1 "Buffer of the 20 last" UBYTE COMP_0068 1 100 0 255 ECU_ADDRESS 0xFFFF9F76 /begin FUNCTION_LIST /end FUNCTION_LIST /end MEASUREMENT
/begin MEASUREMENT wvMLGBFRNG_C#4_R#1 "Buffer of the 20 last" UBYTE COMP_0068 1 100 0 255 ECU_ADDRESS 0xFFFF9F77 /begin FUNCTION_LIST /end FUNCTION_LIST /end MEASUREMENT
/begin MEASUREMENT wvMLGBFRNG_C#5_R#1 "Buffer of the 20 last" UBYTE COMP_0068 1 100 0 255 ECU_ADDRESS 0xFFFF9F78 /begin FUNCTION_LIST /end FUNCTION_LIST /end MEASUREMENT
/begin MEASUREMENT wvMLGBFRNG_C#6_R#1 "Buffer of the 20 last" UBYTE COMP_0068 1 100 0 255 ECU_ADDRESS 0xFFFF9F79 /begin FUNCTION_LIST /end FUNCTION_LIST /end MEASUREMENT
/begin MEASUREMENT wvMLGBFRNG_C#7_R#1 "Buffer of the 20 last" UBYTE COMP_0068 1 100 0 255 ECU_ADDRESS 0xFFFF9F7A /begin FUNCTION_LIST /end FUNCTION_LIST /end MEASUREMENT
/begin MEASUREMENT wvMLGBFRNG_C#8_R#1 "Buffer of the 20 last" UBYTE COMP_0068 1 100 0 255 ECU_ADDRESS 0xFFFF9F7B /begin FUNCTION_LIST /end FUNCTION_LIST /end MEASUREMENT
/begin MEASUREMENT wvMLGBFRNG_C#9_R#1 "Buffer of the 20 last" UBYTE COMP_0068 1 100 0 255 ECU_ADDRESS 0xFFFF9F7C /begin FUNCTION_LIST /end FUNCTION_LIST /end MEASUREMENT
/begin MEASUREMENT wvMLGBFRNG_C#10_R#1 "Buffer of the 20 last" UBYTE COMP_0068 1 100 0 255 ECU_ADDRESS 0xFFFF9F7D /begin FUNCTION_LIST /end FUNCTION_LIST /end MEASUREMENT
/begin MEASUREMENT wvMLGBFRNG_C#11_R#1 "Buffer of the 20 last" UBYTE COMP_0068 1 100 0 255 ECU_ADDRESS 0xFFFF9F7E /begin FUNCTION_LIST /end FUNCTION_LIST /end MEASUREMENT
/begin MEASUREMENT wvMLGBFRNG_C#12_R#1 "Buffer of the 20 last" UBYTE COMP_0068 1 100 0 255 ECU_ADDRESS 0xFFFF9F7F /begin FUNCTION_LIST /end FUNCTION_LIST /end MEASUREMENT
/begin MEASUREMENT wvMLGBFRNG_C#13_R#1 "Buffer of the 20 last" UBYTE COMP_0068 1 100 0 255 ECU_ADDRESS 0xFFFF9F80 /begin FUNCTION_LIST /end FUNCTION_LIST /end MEASUREMENT
/begin MEASUREMENT wvMLGBFRNG_C#14_R#1 "Buffer of the 20 last" UBYTE COMP_0068 1 100 0 255 ECU_ADDRESS 0xFFFF9F81 /begin FUNCTION_LIST /end FUNCTION_LIST /end MEASUREMENT
/begin MEASUREMENT wvMLGBFRNG_C#15_R#1 "Buffer of the 20 last" UBYTE COMP_0068 1 100 0 255 ECU_ADDRESS 0xFFFF9F82 /begin FUNCTION_LIST /end FUNCTION_LIST /end MEASUREMENT
/begin MEASUREMENT wvMLGBFRNG_C#16_R#1 "Buffer of the 20 last" UBYTE COMP_0068 1 100 0 255 ECU_ADDRESS 0xFFFF9F83 /begin FUNCTION_LIST /end FUNCTION_LIST /end MEASUREMENT
/begin MEASUREMENT wvMLGBFRNG_C#17_R#1 "Buffer of the 20 last" UBYTE COMP_0068 1 100 0 255 ECU_ADDRESS 0xFFFF9F84 /begin FUNCTION_LIST /end FUNCTION_LIST /end MEASUREMENT
/begin MEASUREMENT wvMLGBFRNG_C#18_R#1 "Buffer of the 20 last" UBYTE COMP_0068 1 100 0 255 ECU_ADDRESS 0xFFFF9F85 /begin FUNCTION_LIST /end FUNCTION_LIST /end MEASUREMENT
/begin MEASUREMENT wvMLGBFRNG_C#19_R#1 "Buffer of the 20 last" UBYTE COMP_0068 1 100 0 255 ECU_ADDRESS 0xFFFF9F86 /begin FUNCTION_LIST /end FUNCTION_LIST /end MEASUREMENT
/begin MEASUREMENT wvMLGBFRNG_C#20_R#1 "Buffer of the 20 last" UBYTE COMP_0068 1 100 0 255 ECU_ADDRESS 0xFFFF9F87 /begin FUNCTION_LIST /end FUNCTION_LIST /end MEASUREMENT
/begin MEASUREMENT wvMLGBFRNG_C#21_R#1 "Buffer of the 20 last" UBYTE COMP_0068 1 100 0 255 ECU_ADDRESS 0xFFFF9F88 /begin FUNCTION_LIST /end FUNCTION_LIST /end MEASUREMENT
/begin MEASUREMENT wvMLGBFRNG_C#22_R#1 "Buffer of the 20 last" UBYTE COMP_0068 1 100 0 255 ECU_ADDRESS 0xFFFF9F89 /begin FUNCTION_LIST /end FUNCTION_LIST /end MEASUREMENT
/begin MEASUREMENT wvMLGBFRNG_C#23_R#1 "Buffer of the 20 last" UBYTE COMP_0068 1 100 0 255 ECU_ADDRESS 0xFFFF9F8A /begin FUNCTION_LIST /end FUNCTION_LIST /end MEASUREMENT
/begin MEASUREMENT wvMLGBFRNG_C#24_R#1 "Buffer of the 20 last" UBYTE COMP_0068 1 100 0 255 ECU_ADDRESS 0xFFFF9F8B /begin FUNCTION_LIST /end FUNCTION_LIST /end MEASUREMENT
/begin MEASUREMENT wvMLGBFRNG_C#25_R#1 "Buffer of the 20 last" UBYTE COMP_0068 1 100 0 255 ECU_ADDRESS 0xFFFF9F8C /begin FUNCTION_LIST /end FUNCTION_LIST /end MEASUREMENT
/begin MEASUREMENT wvMLGBFRNG_C#26_R#1 "Buffer of the 20 last" UBYTE COMP_0068 1 100 0 255 ECU_ADDRESS 0xFFFF9F8D /begin FUNCTION_LIST /end FUNCTION_LIST /end MEASUREMENT
/begin MEASUREMENT wvMLGBFRNG_C#27_R#1 "Buffer of the 20 last" UBYTE COMP_0068 1 100 0 255 ECU_ADDRESS 0xFFFF9F8E /begin FUNCTION_LIST /end FUNCTION_LIST /end MEASUREMENT
/begin MEASUREMENT wvMLGBFRNG_C#28_R#1 "Buffer of the 20 last" UBYTE COMP_0068 1 100 0 255 ECU_ADDRESS 0xFFFF9F8F /begin FUNCTION_LIST /end FUNCTION_LIST /end MEASUREMENT
/begin MEASUREMENT wvMLGBFRNG_C#29_R#1 "Buffer of the 20 last" UBYTE COMP_0068 1 100 0 255 ECU_ADDRESS 0xFFFF9F90 /begin FUNCTION_LIST /end FUNCTION_LIST /end MEASUREMENT
/begin MEASUREMENT wvMLGBFRNG_C#30_R#1 "Buffer of the 20 last" UBYTE COMP_0068 1 100 0 255 ECU_ADDRESS 0xFFFF9F91 /begin FUNCTION_LIST /end FUNCTION_LIST /end MEASUREMENT
/begin MEASUREMENT wvMLGBFRNG_C#31_R#1 "Buffer of the 20 last" UBYTE COMP_0068 1 100 0 255 ECU_ADDRESS 0xFFFF9F92 /begin FUNCTION_LIST /end FUNCTION_LIST /end MEASUREMENT
/begin MEASUREMENT wvMLGBFRNG_C#32_R#1 "Buffer of the 20 last" UBYTE COMP_0068 1 100 0 255 ECU_ADDRESS 0xFFFF9F93 /begin FUNCTION_LIST /end FUNCTION_LIST /end MEASUREMENT
/begin MEASUREMENT wvMLGBFRNG_C#33_R#1 "Buffer of the 20 last" UBYTE COMP_0068 1 100 0 255 ECU_ADDRESS 0xFFFF9F94 /begin FUNCTION_LIST /end FUNCTION_LIST /end MEASUREMENT
/begin MEASUREMENT wvMLGBFRNG_C#34_R#1 "Buffer of the 20 last" UBYTE COMP_0068 1 100 0 255 ECU_ADDRESS 0xFFFF9F95 /begin FUNCTION_LIST /end FUNCTION_LIST /end MEASUREMENT
/begin MEASUREMENT wvMLGBFRNG_C#35_R#1 "Buffer of the 20 last" UBYTE COMP_0068 1 100 0 255 ECU_ADDRESS 0xFFFF9F96 /begin FUNCTION_LIST /end FUNCTION_LIST /end MEASUREMENT
/begin MEASUREMENT wvMLGBFRNG_C#36_R#1 "Buffer of the 20 last" UBYTE COMP_0068 1 100 0 255 ECU_ADDRESS 0xFFFF9F97 /begin FUNCTION_LIST /end FUNCTION_LIST /end MEASUREMENT
/begin MEASUREMENT wvMLGBFRNG_C#37_R#1 "Buffer of the 20 last" UBYTE COMP_0068 1 100 0 255 ECU_ADDRESS 0xFFFF9F98 /begin FUNCTION_LIST /end FUNCTION_LIST /end MEASUREMENT
/begin MEASUREMENT wvMLGBFRNG_C#38_R#1 "Buffer of the 20 last" UBYTE COMP_0068 1 100 0 255 ECU_ADDRESS 0xFFFF9F99 /begin FUNCTION_LIST /end FUNCTION_LIST /end MEASUREMENT
/begin MEASUREMENT wvMLGBFRNG_C#39_R#1 "Buffer of the 20 last" UBYTE COMP_0068 1 100 0 255 ECU_ADDRESS 0xFFFF9F9A /begin FUNCTION_LIST /end FUNCTION_LIST /end MEASUREMENT
/begin MEASUREMENT wvMLGBFRNG_C#40_R#1 "Buffer of the 20 last" UBYTE COMP_0068 1 100 0 255 ECU_ADDRESS 0xFFFF9F9B /begin FUNCTION_LIST /end FUNCTION_LIST /end MEASUREMENT
/begin MEASUREMENT wvMLGBFRNG_C#41_R#1 "Buffer of the 20 last" UBYTE COMP_0068 1 100 0 255 ECU_ADDRESS 0xFFFF9F9C /begin FUNCTION_LIST /end FUNCTION_LIST /end MEASUREMENT
/begin MEASUREMENT wvMLGBFRNG_C#42_R#1 "Buffer of the 20 last" UBYTE COMP_0068 1 100 0 255 ECU_ADDRESS 0xFFFF9F9D /begin FUNCTION_LIST /end FUNCTION_LIST /end MEASUREMENT
/begin MEASUREMENT wvMLGBFRNG_C#43_R#1 "Buffer of the 20 last" UBYTE COMP_0068 1 100 0 255 ECU_ADDRESS 0xFFFF9F9E /begin FUNCTION_LIST /end FUNCTION_LIST /end MEASUREMENT
/begin MEASUREMENT wvMLGBFRNG_C#44_R#1 "Buffer of the 20 last" UBYTE COMP_0068 1 100 0 255 ECU_ADDRESS 0xFFFF9F9F /begin FUNCTION_LIST /end FUNCTION_LIST /end MEASUREMENT
/begin MEASUREMENT wvMLGBFRNG_C#45_R#1 "Buffer of the 20 last" UBYTE COMP_0068 1 100 0 255 ECU_ADDRESS 0xFFFF9FA0 /begin FUNCTION_LIST /end FUNCTION_LIST /end MEASUREMENT
/begin MEASUREMENT wvMLGBFRNG_C#46_R#1 "Buffer of the 20 last" UBYTE COMP_0068 1 100 0 255 ECU_ADDRESS 0xFFFF9FA1 /begin FUNCTION_LIST /end FUNCTION_LIST /end MEASUREMENT
/begin MEASUREMENT wvMLGBFRNG_C#47_R#1 "Buffer of the 20 last" UBYTE COMP_0068 1 100 0 255 ECU_ADDRESS 0xFFFF9FA2 /begin FUNCTION_LIST /end FUNCTION_LIST /end MEASUREMENT
/begin MEASUREMENT wvMLGBFRNG_C#48_R#1 "Buffer of the 20 last" UBYTE COMP_0068 1 100 0 255 ECU_ADDRESS 0xFFFF9FA3 /begin FUNCTION_LIST /end FUNCTION_LIST /end MEASUREMENT
/begin MEASUREMENT wvMLGBFRNG_C#49_R#1 "Buffer of the 20 last" UBYTE COMP_0068 1 100 0 255 ECU_ADDRESS 0xFFFF9FA4 /begin FUNCTION_LIST /end FUNCTION_LIST /end MEASUREMENT
/begin MEASUREMENT wvMLGBFRNG_C#50_R#1 "Buffer of the 20 last" UBYTE COMP_0068 1 100 0 255 ECU_ADDRESS 0xFFFF9FA5 /begin FUNCTION_LIST /end FUNCTION_LIST /end MEASUREMENT
/begin MEASUREMENT wvMLGBFRNG_C#51_R#1 "Buffer of the 20 last" UBYTE COMP_0068 1 100 0 255 ECU_ADDRESS 0xFFFF9FA6 /begin FUNCTION_LIST /end FUNCTION_LIST /end MEASUREMENT
/begin MEASUREMENT wvMLGBFRNG_C#52_R#1 "Buffer of the 20 last" UBYTE COMP_0068 1 100 0 255 ECU_ADDRESS 0xFFFF9FA7 /begin FUNCTION_LIST /end FUNCTION_LIST /end MEASUREMENT
/begin MEASUREMENT wvMLGBFRNG_C#53_R#1 "Buffer of the 20 last" UBYTE COMP_0068 1 100 0 255 ECU_ADDRESS 0xFFFF9FA8 /begin FUNCTION_LIST /end FUNCTION_LIST /end MEASUREMENT
/begin MEASUREMENT wvMLGBFRNG_C#54_R#1 "Buffer of the 20 last" UBYTE COMP_0068 1 100 0 255 ECU_ADDRESS 0xFFFF9FA9 /begin FUNCTION_LIST /end FUNCTION_LIST /end MEASUREMENT
/begin MEASUREMENT wvMLGBFRNG_C#55_R#1 "Buffer of the 20 last" UBYTE COMP_0068 1 100 0 255 ECU_ADDRESS 0xFFFF9FAA /begin FUNCTION_LIST /end FUNCTION_LIST /end MEASUREMENT
/begin MEASUREMENT wvMLGBFRNG_C#56_R#1 "Buffer of the 20 last" UBYTE COMP_0068 1 100 0 255 ECU_ADDRESS 0xFFFF9FAB /begin FUNCTION_LIST /end FUNCTION_LIST /end MEASUREMENT
/begin MEASUREMENT wvMLGBFRNG_C#57_R#1 "Buffer of the 20 last" UBYTE COMP_0068 1 100 0 255 ECU_ADDRESS 0xFFFF9FAC /begin FUNCTION_LIST /end FUNCTION_LIST /end MEASUREMENT
/begin MEASUREMENT wvMLGBFRNG_C#58_R#1 "Buffer of the 20 last" UBYTE COMP_0068 1 100 0 255 ECU_ADDRESS 0xFFFF9FAD /begin FUNCTION_LIST /end FUNCTION_LIST /end MEASUREMENT
/begin MEASUREMENT wvMLGBFRNG_C#59_R#1 "Buffer of the 20 last" UBYTE COMP_0068 1 100 0 255 ECU_ADDRESS 0xFFFF9FAE /begin FUNCTION_LIST /end FUNCTION_LIST /end MEASUREMENT
/begin MEASUREMENT wvMLGBFRNG_C#60_R#1 "Buffer of the 20 last" UBYTE COMP_0068 1 100 0 255 ECU_ADDRESS 0xFFFF9FAF /begin FUNCTION_LIST /end FUNCTION_LIST /end MEASUREMENT
/begin MEASUREMENT wvMLGBFRNG_C#61_R#1 "Buffer of the 20 last" UBYTE COMP_0068 1 100 0 255 ECU_ADDRESS 0xFFFF9FB0 /begin FUNCTION_LIST /end FUNCTION_LIST /end MEASUREMENT
/begin MEASUREMENT wvMLGBFRNG_C#62_R#1 "Buffer of the 20 last" UBYTE COMP_0068 1 100 0 255 ECU_ADDRESS 0xFFFF9FB1 /begin FUNCTION_LIST /end FUNCTION_LIST /end MEASUREMENT
/begin MEASUREMENT wvMLGBFRNG_C#63_R#1 "Buffer of the 20 last" UBYTE COMP_0068 1 100 0 255 ECU_ADDRESS 0xFFFF9FB2 /begin FUNCTION_LIST /end FUNCTION_LIST /end MEASUREMENT
/begin MEASUREMENT wvMLGBFRNG_C#64_R#1 "Buffer of the 20 last" UBYTE COMP_0068 1 100 0 255 ECU_ADDRESS 0xFFFF9FB3 /begin FUNCTION_LIST /end FUNCTION_LIST /end MEASUREMENT
/begin MEASUREMENT wvMLGBFRNG_C#65_R#1 "Buffer of the 20 last" UBYTE COMP_0068 1 100 0 255 ECU_ADDRESS 0xFFFF9FB4 /begin FUNCTION_LIST /end FUNCTION_LIST /end MEASUREMENT
/begin MEASUREMENT wvMLGBFRNG_C#66_R#1 "Buffer of the 20 last" UBYTE COMP_0068 1 100 0 255 ECU_ADDRESS 0xFFFF9FB5 /begin FUNCTION_LIST /end FUNCTION_LIST /end MEASUREMENT
/begin MEASUREMENT wvMLGBFRNG_C#67_R#1 "Buffer of the 20 last" UBYTE COMP_0068 1 100 0 255 ECU_ADDRESS 0xFFFF9FB6 /begin FUNCTION_LIST /end FUNCTION_LIST /end MEASUREMENT
/begin MEASUREMENT wvMLGBFRNG_C#68_R#1 "Buffer of the 20 last" UBYTE COMP_0068 1 100 0 255 ECU_ADDRESS 0xFFFF9FB7 /begin FUNCTION_LIST /end FUNCTION_LIST /end MEASUREMENT
/begin MEASUREMENT wvMLGBFRNG_C#69_R#1 "Buffer of the 20 last" UBYTE COMP_0068 1 100 0 255 ECU_ADDRESS 0xFFFF9FB8 /begin FUNCTION_LIST /end FUNCTION_LIST /end MEASUREMENT
/begin MEASUREMENT wvMLGBFRNG_C#70_R#1 "Buffer of the 20 last" UBYTE COMP_0068 1 100 0 255 ECU_ADDRESS 0xFFFF9FB9 /begin FUNCTION_LIST /end FUNCTION_LIST /end MEASUREMENT
/begin MEASUREMENT wvMLGBFRNG_C#71_R#1 "Buffer of the 20 last" UBYTE COMP_0068 1 100 0 255 ECU_ADDRESS 0xFFFF9FBA /begin FUNCTION_LIST /end FUNCTION_LIST /end MEASUREMENT
/begin MEASUREMENT wvMLGBFRNG_C#72_R#1 "Buffer of the 20 last" UBYTE COMP_0068 1 100 0 255 ECU_ADDRESS 0xFFFF9FBB /begin FUNCTION_LIST /end FUNCTION_LIST /end MEASUREMENT
/begin MEASUREMENT wvMLGBFRNG_C#73_R#1 "Buffer of the 20 last" UBYTE COMP_0068 1 100 0 255 ECU_ADDRESS 0xFFFF9FBC /begin FUNCTION_LIST /end FUNCTION_LIST /end MEASUREMENT
/begin MEASUREMENT wvMLGBFRNG_C#74_R#1 "Buffer of the 20 last" UBYTE COMP_0068 1 100 0 255 ECU_ADDRESS 0xFFFF9FBD /begin FUNCTION_LIST /end FUNCTION_LIST /end MEASUREMENT
/begin MEASUREMENT wvMLGBFRNG_C#75_R#1 "Buffer of the 20 last" UBYTE COMP_0068 1 100 0 255 ECU_ADDRESS 0xFFFF9FBE /begin FUNCTION_LIST /end FUNCTION_LIST /end MEASUREMENT
/begin MEASUREMENT wvMLGBFRNG_C#76_R#1 "Buffer of the 20 last" UBYTE COMP_0068 1 100 0 255 ECU_ADDRESS 0xFFFF9FBF /begin FUNCTION_LIST /end FUNCTION_LIST /end MEASUREMENT
/begin MEASUREMENT wvMLGBFRNG_C#77_R#1 "Buffer of the 20 last" UBYTE COMP_0068 1 100 0 255 ECU_ADDRESS 0xFFFF9FC0 /begin FUNCTION_LIST /end FUNCTION_LIST /end MEASUREMENT
/begin MEASUREMENT wvMLGBFRNG_C#78_R#1 "Buffer of the 20 last" UBYTE COMP_0068 1 100 0 255 ECU_ADDRESS 0xFFFF9FC1 /begin FUNCTION_LIST /end FUNCTION_LIST /end MEASUREMENT
/begin MEASUREMENT wvMLGBFRNG_C#79_R#1 "Buffer of the 20 last" UBYTE COMP_0068 1 100 0 255 ECU_ADDRESS 0xFFFF9FC2 /begin FUNCTION_LIST /end FUNCTION_LIST /end MEASUREMENT
/begin MEASUREMENT wvMLGBFRNG_C#80_R#1 "Buffer of the 20 last" UBYTE COMP_0068 1 100 0 255 ECU_ADDRESS 0xFFFF9FC3 /begin FUNCTION_LIST /end FUNCTION_LIST /end MEASUREMENT
/begin MEASUREMENT wvMLGBFRNG_C#81_R#1 "Buffer of the 20 last" UBYTE COMP_0068 1 100 0 255 ECU_ADDRESS 0xFFFF9FC4 /begin FUNCTION_LIST /end FUNCTION_LIST /end MEASUREMENT
/begin MEASUREMENT wvMLGBFRNG_C#82_R#1 "Buffer of the 20 last" UBYTE COMP_0068 1 100 0 255 ECU_ADDRESS 0xFFFF9FC5 /begin FUNCTION_LIST /end FUNCTION_LIST /end MEASUREMENT
/begin MEASUREMENT wvMLGBFRNG_C#83_R#1 "Buffer of the 20 last" UBYTE COMP_0068 1 100 0 255 ECU_ADDRESS 0xFFFF9FC6 /begin FUNCTION_LIST /end FUNCTION_LIST /end MEASUREMENT
/begin MEASUREMENT wvMLGBFRNG_C#84_R#1 "Buffer of the 20 last" UBYTE COMP_0068 1 100 0 255 ECU_ADDRESS 0xFFFF9FC7 /begin FUNCTION_LIST /end FUNCTION_LIST /end MEASUREMENT
/begin MEASUREMENT wvMLGBFRNG_C#85_R#1 "Buffer of the 20 last" UBYTE COMP_0068 1 100 0 255 ECU_ADDRESS 0xFFFF9FC8 /begin FUNCTION_LIST /end FUNCTION_LIST /end MEASUREMENT
/begin MEASUREMENT wvMLGBFRNG_C#86_R#1 "Buffer of the 20 last" UBYTE COMP_0068 1 100 0 255 ECU_ADDRESS 0xFFFF9FC9 /begin FUNCTION_LIST /end FUNCTION_LIST /end MEASUREMENT
/begin MEASUREMENT wvMLGBFRNG_C#87_R#1 "Buffer of the 20 last" UBYTE COMP_0068 1 100 0 255 ECU_ADDRESS 0xFFFF9FCA /begin FUNCTION_LIST /end FUNCTION_LIST /end MEASUREMENT
/begin MEASUREMENT wvMLGBFRNG_C#88_R#1 "Buffer of the 20 last" UBYTE COMP_0068 1 100 0 255 ECU_ADDRESS 0xFFFF9FCB /begin FUNCTION_LIST /end FUNCTION_LIST /end MEASUREMENT
/begin MEASUREMENT wvMLGBFRNG_C#89_R#1 "Buffer of the 20 last" UBYTE COMP_0068 1 100 0 255 ECU_ADDRESS 0xFFFF9FCC /begin FUNCTION_LIST /end FUNCTION_LIST /end MEASUREMENT
/begin MEASUREMENT wvMLGBFRNG_C#90_R#1 "Buffer of the 20 last" UBYTE COMP_0068 1 100 0 255 ECU_ADDRESS 0xFFFF9FCD /begin FUNCTION_LIST /end FUNCTION_LIST /end MEASUREMENT
/begin MEASUREMENT wvMLGBFRNG_C#91_R#1 "Buffer of the 20 last" UBYTE COMP_0068 1 100 0 255 ECU_ADDRESS 0xFFFF9FCE /begin FUNCTION_LIST /end FUNCTION_LIST /end MEASUREMENT
/begin MEASUREMENT wvMLGBFRNG_C#92_R#1 "Buffer of the 20 last" UBYTE COMP_0068 1 100 0 255 ECU_ADDRESS 0xFFFF9FCF /begin FUNCTION_LIST /end FUNCTION_LIST /end MEASUREMENT
/begin MEASUREMENT wvMLGBFRNG_C#93_R#1 "Buffer of the 20 last" UBYTE COMP_0068 1 100 0 255 ECU_ADDRESS 0xFFFF9FD0 /begin FUNCTION_LIST /end FUNCTION_LIST /end MEASUREMENT
/begin MEASUREMENT wvMLGBFRNG_C#94_R#1 "Buffer of the 20 last" UBYTE COMP_0068 1 100 0 255 ECU_ADDRESS 0xFFFF9FD1 /begin FUNCTION_LIST /end FUNCTION_LIST /end MEASUREMENT
/begin MEASUREMENT wvMLGBFRNG_C#95_R#1 "Buffer of the 20 last" UBYTE COMP_0068 1 100 0 255 ECU_ADDRESS 0xFFFF9FD2 /begin FUNCTION_LIST /end FUNCTION_LIST /end MEASUREMENT
/begin MEASUREMENT wvMLGBFRNG_C#96_R#1 "Buffer of the 20 last" UBYTE COMP_0068 1 100 0 255 ECU_ADDRESS 0xFFFF9FD3 /begin FUNCTION_LIST /end FUNCTION_LIST /end MEASUREMENT
/begin MEASUREMENT wvMLGBFRNG_C#97_R#1 "Buffer of the 20 last" UBYTE COMP_0068 1 100 0 255 ECU_ADDRESS 0xFFFF9FD4 /begin FUNCTION_LIST /end FUNCTION_LIST /end MEASUREMENT
/begin MEASUREMENT wvMLGBFRNG_C#98_R#1 "Buffer of the 20 last" UBYTE COMP_0068 1 100 0 255 ECU_ADDRESS 0xFFFF9FD5 /begin FUNCTION_LIST /end FUNCTION_LIST /end MEASUREMENT
/begin MEASUREMENT wvMLGBFRNG_C#99_R#1 "Buffer of the 20 last" UBYTE COMP_0068 1 100 0 255 ECU_ADDRESS 0xFFFF9FD6 /begin FUNCTION_LIST /end FUNCTION_LIST /end MEASUREMENT
/begin MEASUREMENT wvMLGBFRNG_C#100_R#1 "Buffer of the 20 last" UBYTE COMP_0068 1 100 0 255 ECU_ADDRESS 0xFFFF9FD7 /begin FUNCTION_LIST /end FUNCTION_LIST /end MEASUREMENT
/begin MEASUREMENT wvMNRPMz10 "Before 100mS, wvMNRPM" UBYTE COMP_0000 1 100 0 6375 ECU_ADDRESS 0xFFFF8A0C /begin FUNCTION_LIST /end FUNCTION_LIST /end MEASUREMENT
/begin MEASUREMENT wvMSRTRQ "MSR torque setting acquired on the MUX" UWORD COMP_0345_S 1 100 -400 1647.96875 ECU_ADDRESS 0xFFFF484C /begin FUNCTION_LIST /end FUNCTION_LIST /end MEASUREMENT
/begin MEASUREMENT wvMSRTRQR "MSR torque setting" UWORD COMP_0068 1 100 0 65535 ECU_ADDRESS 0xFFFF484E /begin FUNCTION_LIST /end FUNCTION_LIST /end MEASUREMENT
/begin MEASUREMENT wvNEUTMUX "Neutral contact" UBYTE COMP_0068 1 100 0 255 ECU_ADDRESS 0xFFFF4850 /begin FUNCTION_LIST /end FUNCTION_LIST /end MEASUREMENT
/begin MEASUREMENT wvNRPMz5 "Before 50mS, wvNRPM" UWORD COMP_0006 1 100 0 819187.5 ECU_ADDRESS 0xFFFF8A16 /begin FUNCTION_LIST /end FUNCTION_LIST /end MEASUREMENT
/begin MEASUREMENT wvO2HCUR "Former O sensor heater voltage conversion value" UBYTE COMP_0054 1 100 0 5100 ECU_ADDRESS 0xFFFF4851 /begin FUNCTION_LIST /end FUNCTION_LIST /end MEASUREMENT
/begin MEASUREMENT wvOFF5 "Work RAM for the 5-times collation" UBYTE COMP_0068 1 100 0 255 ECU_ADDRESS 0xFFFF4853 /begin FUNCTION_LIST /end FUNCTION_LIST /end MEASUREMENT
/begin MEASUREMENT wvON5 "Work RAM for the 5-times collation" UBYTE COMP_0068 1 100 0 255 ECU_ADDRESS 0xFFFF4854 /begin FUNCTION_LIST /end FUNCTION_LIST /end MEASUREMENT
/begin MEASUREMENT wvOTORIVL "Engine running authorisation dependent on the anti theft strategy" UBYTE COMP_0068 1 100 0 255 ECU_ADDRESS 0xFFFF4855 /begin FUNCTION_LIST /end FUNCTION_LIST /end MEASUREMENT
/begin MEASUREMENT wvPTCPOW "Information de la puissance de commande des CTP" UBYTE COMP_0519_S 1 100 0 25500 ECU_ADDRESS 0xFFFF4763 /begin FUNCTION_LIST /end FUNCTION_LIST /end MEASUREMENT
/begin MEASUREMENT wvRAPFSR_S "Normalized accelerator pedal position (Sub)" UWORD COMP_0451_S 1 100 0 81.91875 ECU_ADDRESS 0xFFFF48A2 /begin FUNCTION_LIST /end FUNCTION_LIST /end MEASUREMENT
/begin MEASUREMENT wvRAPOFSR "Sportivity factor sent by AT on CAN" UWORD COMP_0451_S 1 100 0 81.91875 ECU_ADDRESS 0xFFFF485C /begin FUNCTION_LIST /end FUNCTION_LIST /end MEASUREMENT
/begin MEASUREMENT wvRAPORENG "Engaged gear ratio input table" UBYTE COMP_0068 1 100 0 255 ECU_ADDRESS 0xFFFF485E /begin FUNCTION_LIST /end FUNCTION_LIST /end MEASUREMENT
/begin MEASUREMENT wvRATIOMT "MT ASCD gear ratio" UWORD COMP_0450 1 100 0 63.999056205 ECU_ADDRESS 0xFFFF4860 /begin FUNCTION_LIST /end FUNCTION_LIST /end MEASUREMENT
/begin MEASUREMENT wvRCNTRIP "Mileage for the fuel level gauge diagnosis frequency" ULONG COMP_0389 1 100 0 1685624.33943218 ECU_ADDRESS 0xFFFF9FE0 /begin FUNCTION_LIST /end FUNCTION_LIST /end MEASUREMENT
/begin MEASUREMENT wvREG01 "Engine speed" UWORD COMP_0443 1 100 0 65535 ECU_ADDRESS 0xFFFF8A1A /begin FUNCTION_LIST /end FUNCTION_LIST /end MEASUREMENT
/begin MEASUREMENT wvREGRALOF "Idle Speed tuning target from Diagnostic tool" SBYTE COMP_0263 1 100 -128 127 ECU_ADDRESS 0xFFFF4862 /begin FUNCTION_LIST /end FUNCTION_LIST /end MEASUREMENT
/begin MEASUREMENT wvRESCNTOK "RAM value wvRESCNTOK" UBYTE COMP_0004 1 100 0 255 ECU_ADDRESS 0xFFFF4760 /begin FUNCTION_LIST /end FUNCTION_LIST /end MEASUREMENT
/begin MEASUREMENT wvREVGZN "Speed for the GZTP renewal" UBYTE COMP_0071 1 100 0 255 ECU_ADDRESS 0xFFFF8A70 /begin FUNCTION_LIST /end FUNCTION_LIST /end MEASUREMENT
/begin MEASUREMENT wvREVSWMUX "Rear gear engaged" UBYTE COMP_0068 1 100 0 255 ECU_ADDRESS 0xFFFF4863 /begin FUNCTION_LIST /end FUNCTION_LIST /end MEASUREMENT
/begin MEASUREMENT wvRO2HMf "The rest O2 heater CPU input signal" UBYTE COMP_0004 1 100 0 255 ECU_ADDRESS 0xFFFF893A /begin FUNCTION_LIST /end FUNCTION_LIST /end MEASUREMENT
/begin MEASUREMENT wvSDLCTYP "ACC control type Acquired on CAN" UBYTE COMP_0068 1 100 0 255 ECU_ADDRESS 0xFFFF486A /begin FUNCTION_LIST /end FUNCTION_LIST /end MEASUREMENT
/begin MEASUREMENT wvSFTVCTR "Gear shift pattern signal" UBYTE COMP_0068 1 100 0 255 ECU_ADDRESS 0xFFFF486B /begin FUNCTION_LIST /end FUNCTION_LIST /end MEASUREMENT
/begin MEASUREMENT wvSTSWACTR "Counter : increment at each START button" UBYTE COMP_0068 1 100 0 255 ECU_ADDRESS 0xFFFF486E /begin FUNCTION_LIST /end FUNCTION_LIST /end MEASUREMENT
/begin MEASUREMENT wvTF "Fuel temperature sensor voltage" UBYTE COMP_0054 1 100 0 5100 ECU_ADDRESS 0xFFFF893D /begin FUNCTION_LIST /end FUNCTION_LIST /end MEASUREMENT
/begin MEASUREMENT wvTFEND "At the time of the key off, fuel temperature" UBYTE COMP_0035 1 100 -50 205 ECU_ADDRESS 0xFFFF9FE5 /begin FUNCTION_LIST /end FUNCTION_LIST /end MEASUREMENT
/begin MEASUREMENT wvTFK "A fuel temperature for the table reference" UBYTE COMP_0356 1 100 -40 119.375 ECU_ADDRESS 0xFFFF893F /begin FUNCTION_LIST /end FUNCTION_LIST /end MEASUREMENT
/begin MEASUREMENT wvTMLNTC "The judgement time when LAN communication TCS is unusual" UBYTE COMP_0014 1 100 0 2550 ECU_ADDRESS 0xFFFF4755 /begin FUNCTION_LIST /end FUNCTION_LIST /end MEASUREMENT
/begin MEASUREMENT wvTO "Oil temperature sensor output voltage" UBYTE COMP_0054 1 100 0 5100 ECU_ADDRESS 0xFFFF8940 /begin FUNCTION_LIST /end FUNCTION_LIST /end MEASUREMENT
/begin MEASUREMENT wvTQGBCSMX "Converter friction Torque" UWORD COMP_0345_S 1 100 -400 1647.96875 ECU_ADDRESS 0xFFFF4886 /begin FUNCTION_LIST /end FUNCTION_LIST /end MEASUREMENT
/begin MEASUREMENT wvTQRQASRF "ASR requirement FAST torque" SWORD COMP_0228 1 100 -3276.8 3276.7 ECU_ADDRESS 0xFFFF4888 /begin FUNCTION_LIST /end FUNCTION_LIST /end MEASUREMENT
/begin MEASUREMENT wvTQRQASRS "ASR requirement SLOW torque" SWORD COMP_0228 1 100 -3276.8 3276.7 ECU_ADDRESS 0xFFFF488A /begin FUNCTION_LIST /end FUNCTION_LIST /end MEASUREMENT
/begin MEASUREMENT wvTQRQMSR "MSR requested torque" SWORD COMP_0228 1 100 -3276.8 3276.7 ECU_ADDRESS 0xFFFF488C /begin FUNCTION_LIST /end FUNCTION_LIST /end MEASUREMENT
/begin MEASUREMENT wvTREF15 "REF15_B period" ULONG COMP_0073 1 100 0 13743895344 ECU_ADDRESS 0xFFFF8A20 /begin FUNCTION_LIST /end FUNCTION_LIST /end MEASUREMENT
/begin MEASUREMENT wvTRQAGBF "AGB requirement FAST torque" SWORD COMP_0228 1 100 -3276.8 3276.7 ECU_ADDRESS 0xFFFF4890 /begin FUNCTION_LIST /end FUNCTION_LIST /end MEASUREMENT
/begin MEASUREMENT wvTRQAGBS "AGB requirement SLOW torque" SWORD COMP_0228 1 100 -3276.8 3276.7 ECU_ADDRESS 0xFFFF4892 /begin FUNCTION_LIST /end FUNCTION_LIST /end MEASUREMENT
/begin MEASUREMENT wvTVSPASCD "Vehicle speed signal pulse period" ULONG COMP_0181_S 1 100 0 429496729.5 ECU_ADDRESS 0xFFFF49B0 /begin FUNCTION_LIST /end FUNCTION_LIST /end MEASUREMENT
/begin MEASUREMENT wvTWK2 "The water temperature for referring to the table2" UBYTE COMP_0640_S 1 100 -30 129.375 ECU_ADDRESS 0xFFFF894C /begin FUNCTION_LIST /end FUNCTION_LIST /end MEASUREMENT
/begin MEASUREMENT wvTWKINT2 "At the time of the start for the table reference, coolant temperature 2" UBYTE COMP_0640_S 1 100 -30 129.375 ECU_ADDRESS 0xFFFF88A1 /begin FUNCTION_LIST /end FUNCTION_LIST /end MEASUREMENT
/begin MEASUREMENT wvUF28DGN "RAM for the ST micro-IC UF28" UWORD COMP_0004 1 100 0 65535 ECU_ADDRESS 0xFFFF4894 /begin FUNCTION_LIST /end FUNCTION_LIST /end MEASUREMENT
/begin MEASUREMENT wvVDCMSG1T "VDCMSG1 reception interval counter" UBYTE COMP_0014 1 100 0 2550 ECU_ADDRESS 0xFFFF4896 /begin FUNCTION_LIST /end FUNCTION_LIST /end MEASUREMENT
/begin MEASUREMENT wvVFUEL "Fuel pressure sensor voltage" UWORD COMP_0023 1 100 0 327675 ECU_ADDRESS 0xFFFF8850 /begin FUNCTION_LIST /end FUNCTION_LIST /end MEASUREMENT
/begin MEASUREMENT wvVITESDSP "Displayed speed" UWORD COMP_0373 1 100 0 655.35 ECU_ADDRESS 0xFFFF4898 /begin FUNCTION_LIST /end FUNCTION_LIST /end MEASUREMENT
/begin MEASUREMENT wvVITESMUX "Vehicle speed that enters in the cruise control and speed limiter strategy" UWORD COMP_0375_S 1 100 0 655.35 ECU_ADDRESS 0xFFFF489A /begin FUNCTION_LIST /end FUNCTION_LIST /end MEASUREMENT
/begin MEASUREMENT wvVMAVR1_S "VMV1 weighted average SubCpu calculation" UWORD COMP_0050 1 100 0 5119.921875 ECU_ADDRESS 0xFFFF48A4 /begin FUNCTION_LIST /end FUNCTION_LIST /end MEASUREMENT
/begin MEASUREMENT wvVPKRF "Reference electric potential" UWORD COMP_0023 1 100 0 327675 ECU_ADDRESS 0xFFFF8A26 /begin FUNCTION_LIST /end FUNCTION_LIST /end MEASUREMENT
/begin MEASUREMENT wvVSP1 "Vehicle speed" UBYTE COMP_0007 1 100 0 510 ECU_ADDRESS 0xFFFF8852 /begin FUNCTION_LIST /end FUNCTION_LIST /end MEASUREMENT
/begin MEASUREMENT wvVSP2 "Vehicle speed" UBYTE COMP_0007 1 100 0 510 ECU_ADDRESS 0xFFFF8853 /begin FUNCTION_LIST /end FUNCTION_LIST /end MEASUREMENT
/begin MEASUREMENT wvVSPm2 "A vehicle speed with -2 hysteresis" UBYTE COMP_0007 1 100 0 510 ECU_ADDRESS 0xFFFF8957 /begin FUNCTION_LIST /end FUNCTION_LIST /end MEASUREMENT
/begin MEASUREMENT wvVSPm4 "A vehicle speed with -4 hysteresis" UBYTE COMP_0007 1 100 0 510 ECU_ADDRESS 0xFFFF8958 /begin FUNCTION_LIST /end FUNCTION_LIST /end MEASUREMENT
/begin MEASUREMENT wvVSPp2 "A vehicle speed with ÅE2 hysteresis" UBYTE COMP_0007 1 100 0 510 ECU_ADDRESS 0xFFFF8959 /begin FUNCTION_LIST /end FUNCTION_LIST /end MEASUREMENT
/begin MEASUREMENT wvVSSFCHK "Vehicle speed" UWORD COMP_0375_S 1 100 0 655.35 ECU_ADDRESS 0xFFFF895A /begin FUNCTION_LIST /end FUNCTION_LIST /end MEASUREMENT
/begin MEASUREMENT wvVTCPOSE "Between the VTC reference signal - the cam target signal, measuring angle" UBYTE COMP_0048 1 100 0 127.5 ECU_ADDRESS 0xFFFF8A28 /begin FUNCTION_LIST /end FUNCTION_LIST /end MEASUREMENT
/begin MEASUREMENT wvVTCPOSE_R#1 "Between the VTC reference signal - the cam target signal, measuring angle" UBYTE COMP_0048 1 100 0 127.5 ECU_ADDRESS 0xFFFF8A28 /begin FUNCTION_LIST /end FUNCTION_LIST /end MEASUREMENT
/begin MEASUREMENT wvVTCPOSE_R#2 "Between the VTC reference signal - the cam target signal, measuring angle" UBYTE COMP_0048 1 100 0 127.5 ECU_ADDRESS 0xFFFF8A29 /begin FUNCTION_LIST /end FUNCTION_LIST /end MEASUREMENT
/begin MEASUREMENT wvVTCPOSEz "RAM value wvVTCPOSEz" UBYTE COMP_0048 1 100 0 127.5 ECU_ADDRESS 0xFFFF8A2A /begin FUNCTION_LIST /end FUNCTION_LIST /end MEASUREMENT
/begin MEASUREMENT wvVTCPOSEz_1 "RAM value wvVTCPOSEz" UBYTE COMP_0048 1 100 0 127.5 ECU_ADDRESS 0xFFFF8A2C /begin FUNCTION_LIST /end FUNCTION_LIST /end MEASUREMENT
/begin MEASUREMENT wvVTCPOSI "Between the VTC reference signal - the cam target signal, measuring angle" UBYTE COMP_0048 1 100 0 127.5 ECU_ADDRESS 0xFFFF8A2E /begin FUNCTION_LIST /end FUNCTION_LIST /end MEASUREMENT
/begin MEASUREMENT wvVTCPOSI_R#1 "Between the VTC reference signal - the cam target signal, measuring angle" UBYTE COMP_0048 1 100 0 127.5 ECU_ADDRESS 0xFFFF8A2E /begin FUNCTION_LIST /end FUNCTION_LIST /end MEASUREMENT
/begin MEASUREMENT wvVTCPOSI_R#2 "Between the VTC reference signal - the cam target signal, measuring angle" UBYTE COMP_0048 1 100 0 127.5 ECU_ADDRESS 0xFFFF8A2F /begin FUNCTION_LIST /end FUNCTION_LIST /end MEASUREMENT
/begin MEASUREMENT wvVTCPOSIz "RAM value wvVTCPOSIz" UBYTE COMP_0048 1 100 0 127.5 ECU_ADDRESS 0xFFFF8A30 /begin FUNCTION_LIST /end FUNCTION_LIST /end MEASUREMENT
/begin MEASUREMENT wvVTCPOSIz_1 "RAM value wvVTCPOSIz" UBYTE COMP_0048 1 100 0 127.5 ECU_ADDRESS 0xFFFF8A32 /begin FUNCTION_LIST /end FUNCTION_LIST /end MEASUREMENT
/begin MEASUREMENT vCANDAT000 "RAM value vCANDAT000" UBYTE COMP_0068 1 100 0 255 ECU_ADDRESS 0xFFFF394B /begin FUNCTION_LIST /end FUNCTION_LIST /end MEASUREMENT
/begin MEASUREMENT vCANDAT001 "RAM value vCANDAT001" UBYTE COMP_0068 1 100 0 255 ECU_ADDRESS 0xFFFF394C /begin FUNCTION_LIST /end FUNCTION_LIST /end MEASUREMENT
/begin MEASUREMENT vCANDAT002 "RAM value vCANDAT002" UBYTE COMP_0068 1 100 0 255 ECU_ADDRESS 0xFFFF394D /begin FUNCTION_LIST /end FUNCTION_LIST /end MEASUREMENT
/begin MEASUREMENT vCANDAT003 "RAM value vCANDAT003" UBYTE COMP_0068 1 100 0 255 ECU_ADDRESS 0xFFFF394E /begin FUNCTION_LIST /end FUNCTION_LIST /end MEASUREMENT
/begin MEASUREMENT vCANDAT004 "RAM value vCANDAT004" UBYTE COMP_0068 1 100 0 255 ECU_ADDRESS 0xFFFF394F /begin FUNCTION_LIST /end FUNCTION_LIST /end MEASUREMENT
/begin MEASUREMENT vCANDAT005 "RAM value vCANDAT005" UBYTE COMP_0068 1 100 0 255 ECU_ADDRESS 0xFFFF3950 /begin FUNCTION_LIST /end FUNCTION_LIST /end MEASUREMENT
/begin MEASUREMENT vCANDAT006 "RAM value vCANDAT006" UBYTE COMP_0068 1 100 0 255 ECU_ADDRESS 0xFFFF3951 /begin FUNCTION_LIST /end FUNCTION_LIST /end MEASUREMENT
/begin MEASUREMENT vCANDAT007 "RAM value vCANDAT007" UBYTE COMP_0068 1 100 0 255 ECU_ADDRESS 0xFFFF3952 /begin FUNCTION_LIST /end FUNCTION_LIST /end MEASUREMENT
/begin MEASUREMENT vCANDAT008 "RAM value vCANDAT008" UBYTE COMP_0068 1 100 0 255 ECU_ADDRESS 0xFFFF3953 /begin FUNCTION_LIST /end FUNCTION_LIST /end MEASUREMENT
/begin MEASUREMENT vCANDAT009 "RAM value vCANDAT009" UBYTE COMP_0068 1 100 0 255 ECU_ADDRESS 0xFFFF3954 /begin FUNCTION_LIST /end FUNCTION_LIST /end MEASUREMENT
/begin MEASUREMENT vCANDAT010 "RAM value vCANDAT010" UBYTE COMP_0068 1 100 0 255 ECU_ADDRESS 0xFFFF3955 /begin FUNCTION_LIST /end FUNCTION_LIST /end MEASUREMENT
/begin MEASUREMENT vCANDAT011 "RAM value vCANDAT011" UBYTE COMP_0068 1 100 0 255 ECU_ADDRESS 0xFFFF3956 /begin FUNCTION_LIST /end FUNCTION_LIST /end MEASUREMENT
/begin MEASUREMENT vCANDAT012 "RAM value vCANDAT012" UBYTE COMP_0068 1 100 0 255 ECU_ADDRESS 0xFFFF3957 /begin FUNCTION_LIST /end FUNCTION_LIST /end MEASUREMENT
/begin MEASUREMENT vCANDAT013 "RAM value vCANDAT013" UBYTE COMP_0068 1 100 0 255 ECU_ADDRESS 0xFFFF3958 /begin FUNCTION_LIST /end FUNCTION_LIST /end MEASUREMENT
/begin MEASUREMENT vCANDAT014 "RAM value vCANDAT014" UBYTE COMP_0068 1 100 0 255 ECU_ADDRESS 0xFFFF3959 /begin FUNCTION_LIST /end FUNCTION_LIST /end MEASUREMENT
/begin MEASUREMENT vCANDAT015 "RAM value vCANDAT015" UBYTE COMP_0068 1 100 0 255 ECU_ADDRESS 0xFFFF395A /begin FUNCTION_LIST /end FUNCTION_LIST /end MEASUREMENT
/begin MEASUREMENT vCANDAT016 "RAM value vCANDAT016" UBYTE COMP_0068 1 100 0 255 ECU_ADDRESS 0xFFFF395B /begin FUNCTION_LIST /end FUNCTION_LIST /end MEASUREMENT
/begin MEASUREMENT vCANDAT017 "RAM value vCANDAT017" UBYTE COMP_0068 1 100 0 255 ECU_ADDRESS 0xFFFF395C /begin FUNCTION_LIST /end FUNCTION_LIST /end MEASUREMENT
/begin MEASUREMENT vCANDAT018 "RAM value vCANDAT018" UBYTE COMP_0068 1 100 0 255 ECU_ADDRESS 0xFFFF395D /begin FUNCTION_LIST /end FUNCTION_LIST /end MEASUREMENT
/begin MEASUREMENT vCANDAT019 "RAM value vCANDAT019" UBYTE COMP_0068 1 100 0 255 ECU_ADDRESS 0xFFFF395E /begin FUNCTION_LIST /end FUNCTION_LIST /end MEASUREMENT
/begin MEASUREMENT vCANDAT020 "RAM value vCANDAT020" UBYTE COMP_0068 1 100 0 255 ECU_ADDRESS 0xFFFF395F /begin FUNCTION_LIST /end FUNCTION_LIST /end MEASUREMENT
/begin MEASUREMENT vCANDAT021 "RAM value vCANDAT021" UBYTE COMP_0068 1 100 0 255 ECU_ADDRESS 0xFFFF3960 /begin FUNCTION_LIST /end FUNCTION_LIST /end MEASUREMENT
/begin MEASUREMENT vCANDAT022 "RAM value vCANDAT022" UBYTE COMP_0068 1 100 0 255 ECU_ADDRESS 0xFFFF3961 /begin FUNCTION_LIST /end FUNCTION_LIST /end MEASUREMENT
/begin MEASUREMENT vCANDAT023 "RAM value vCANDAT023" UBYTE COMP_0068 1 100 0 255 ECU_ADDRESS 0xFFFF3962 /begin FUNCTION_LIST /end FUNCTION_LIST /end MEASUREMENT
/begin MEASUREMENT vCANDAT024 "RAM value vCANDAT024" UBYTE COMP_0068 1 100 0 255 ECU_ADDRESS 0xFFFF3963 /begin FUNCTION_LIST /end FUNCTION_LIST /end MEASUREMENT
/begin MEASUREMENT vCANDAT025 "RAM value vCANDAT025" UBYTE COMP_0068 1 100 0 255 ECU_ADDRESS 0xFFFF3964 /begin FUNCTION_LIST /end FUNCTION_LIST /end MEASUREMENT
/begin MEASUREMENT vCANDAT026 "RAM value vCANDAT026" UBYTE COMP_0068 1 100 0 255 ECU_ADDRESS 0xFFFF3965 /begin FUNCTION_LIST /end FUNCTION_LIST /end MEASUREMENT
/begin MEASUREMENT vCANDAT027 "RAM value vCANDAT027" UBYTE COMP_0068 1 100 0 255 ECU_ADDRESS 0xFFFF3966 /begin FUNCTION_LIST /end FUNCTION_LIST /end MEASUREMENT
/begin MEASUREMENT vCANDAT028 "RAM value vCANDAT028" UBYTE COMP_0068 1 100 0 255 ECU_ADDRESS 0xFFFF3967 /begin FUNCTION_LIST /end FUNCTION_LIST /end MEASUREMENT
/begin MEASUREMENT vCANDAT029 "RAM value vCANDAT029" UBYTE COMP_0068 1 100 0 255 ECU_ADDRESS 0xFFFF3968 /begin FUNCTION_LIST /end FUNCTION_LIST /end MEASUREMENT
/begin MEASUREMENT vCANDAT030 "RAM value vCANDAT030" UBYTE COMP_0068 1 100 0 255 ECU_ADDRESS 0xFFFF3969 /begin FUNCTION_LIST /end FUNCTION_LIST /end MEASUREMENT
/begin MEASUREMENT vCANDAT031 "RAM value vCANDAT031" UBYTE COMP_0068 1 100 0 255 ECU_ADDRESS 0xFFFF396A /begin FUNCTION_LIST /end FUNCTION_LIST /end MEASUREMENT
/begin MEASUREMENT vCANDAT032 "RAM value vCANDAT032" UBYTE COMP_0068 1 100 0 255 ECU_ADDRESS 0xFFFF396B /begin FUNCTION_LIST /end FUNCTION_LIST /end MEASUREMENT
/begin MEASUREMENT vCANDAT033 "RAM value vCANDAT033" UBYTE COMP_0068 1 100 0 255 ECU_ADDRESS 0xFFFF396C /begin FUNCTION_LIST /end FUNCTION_LIST /end MEASUREMENT
/begin MEASUREMENT vCANDAT034 "RAM value vCANDAT034" UBYTE COMP_0068 1 100 0 255 ECU_ADDRESS 0xFFFF396D /begin FUNCTION_LIST /end FUNCTION_LIST /end MEASUREMENT
/begin MEASUREMENT vCANDAT035 "RAM value vCANDAT035" UBYTE COMP_0068 1 100 0 255 ECU_ADDRESS 0xFFFF396E /begin FUNCTION_LIST /end FUNCTION_LIST /end MEASUREMENT
/begin MEASUREMENT vCANDAT036 "RAM value vCANDAT036" UBYTE COMP_0068 1 100 0 255 ECU_ADDRESS 0xFFFF396F /begin FUNCTION_LIST /end FUNCTION_LIST /end MEASUREMENT
/begin MEASUREMENT vCANDAT037 "RAM value vCANDAT037" UBYTE COMP_0068 1 100 0 255 ECU_ADDRESS 0xFFFF3970 /begin FUNCTION_LIST /end FUNCTION_LIST /end MEASUREMENT
/begin MEASUREMENT vCANDAT038 "RAM value vCANDAT038" UBYTE COMP_0068 1 100 0 255 ECU_ADDRESS 0xFFFF3971 /begin FUNCTION_LIST /end FUNCTION_LIST /end MEASUREMENT
/begin MEASUREMENT vCANDAT039 "RAM value vCANDAT039" UBYTE COMP_0068 1 100 0 255 ECU_ADDRESS 0xFFFF3972 /begin FUNCTION_LIST /end FUNCTION_LIST /end MEASUREMENT
/begin MEASUREMENT vCANDAT040 "RAM value vCANDAT040" UBYTE COMP_0068 1 100 0 255 ECU_ADDRESS 0xFFFF3973 /begin FUNCTION_LIST /end FUNCTION_LIST /end MEASUREMENT
/begin MEASUREMENT vCANDAT041 "RAM value vCANDAT041" UBYTE COMP_0068 1 100 0 255 ECU_ADDRESS 0xFFFF3974 /begin FUNCTION_LIST /end FUNCTION_LIST /end MEASUREMENT
/begin MEASUREMENT vCANDAT042 "RAM value vCANDAT042" UBYTE COMP_0068 1 100 0 255 ECU_ADDRESS 0xFFFF3975 /begin FUNCTION_LIST /end FUNCTION_LIST /end MEASUREMENT
/begin MEASUREMENT vCANDAT043 "RAM value vCANDAT043" UBYTE COMP_0068 1 100 0 255 ECU_ADDRESS 0xFFFF3976 /begin FUNCTION_LIST /end FUNCTION_LIST /end MEASUREMENT
/begin MEASUREMENT vCANDAT044 "RAM value vCANDAT044" UBYTE COMP_0068 1 100 0 255 ECU_ADDRESS 0xFFFF3977 /begin FUNCTION_LIST /end FUNCTION_LIST /end MEASUREMENT
/begin MEASUREMENT vCANDAT045 "RAM value vCANDAT045" UBYTE COMP_0068 1 100 0 255 ECU_ADDRESS 0xFFFF3978 /begin FUNCTION_LIST /end FUNCTION_LIST /end MEASUREMENT
/begin MEASUREMENT vCANDAT046 "RAM value vCANDAT046" UBYTE COMP_0068 1 100 0 255 ECU_ADDRESS 0xFFFF3979 /begin FUNCTION_LIST /end FUNCTION_LIST /end MEASUREMENT
/begin MEASUREMENT vCANDAT047 "RAM value vCANDAT047" UBYTE COMP_0068 1 100 0 255 ECU_ADDRESS 0xFFFF397A /begin FUNCTION_LIST /end FUNCTION_LIST /end MEASUREMENT
/begin MEASUREMENT vCANDAT048 "RAM value vCANDAT048" UBYTE COMP_0068 1 100 0 255 ECU_ADDRESS 0xFFFF397B /begin FUNCTION_LIST /end FUNCTION_LIST /end MEASUREMENT
/begin MEASUREMENT vCANDAT049 "RAM value vCANDAT049" UBYTE COMP_0068 1 100 0 255 ECU_ADDRESS 0xFFFF397C /begin FUNCTION_LIST /end FUNCTION_LIST /end MEASUREMENT
/begin MEASUREMENT vCANDAT050 "RAM value vCANDAT050" UBYTE COMP_0068 1 100 0 255 ECU_ADDRESS 0xFFFF397D /begin FUNCTION_LIST /end FUNCTION_LIST /end MEASUREMENT
/begin MEASUREMENT vCANDAT051 "RAM value vCANDAT051" UBYTE COMP_0068 1 100 0 255 ECU_ADDRESS 0xFFFF397E /begin FUNCTION_LIST /end FUNCTION_LIST /end MEASUREMENT
/begin MEASUREMENT vCANDAT052 "RAM value vCANDAT052" UBYTE COMP_0068 1 100 0 255 ECU_ADDRESS 0xFFFF397F /begin FUNCTION_LIST /end FUNCTION_LIST /end MEASUREMENT
/begin MEASUREMENT vCANDAT053 "RAM value vCANDAT053" UBYTE COMP_0068 1 100 0 255 ECU_ADDRESS 0xFFFF3980 /begin FUNCTION_LIST /end FUNCTION_LIST /end MEASUREMENT
/begin MEASUREMENT vCANDAT054 "RAM value vCANDAT054" UBYTE COMP_0068 1 100 0 255 ECU_ADDRESS 0xFFFF3981 /begin FUNCTION_LIST /end FUNCTION_LIST /end MEASUREMENT
/begin MEASUREMENT vCANDAT055 "RAM value vCANDAT055" UBYTE COMP_0068 1 100 0 255 ECU_ADDRESS 0xFFFF3982 /begin FUNCTION_LIST /end FUNCTION_LIST /end MEASUREMENT
/begin MEASUREMENT vCANDAT056 "RAM value vCANDAT056" UBYTE COMP_0068 1 100 0 255 ECU_ADDRESS 0xFFFF3983 /begin FUNCTION_LIST /end FUNCTION_LIST /end MEASUREMENT
/begin MEASUREMENT vCANDAT057 "RAM value vCANDAT057" UBYTE COMP_0068 1 100 0 255 ECU_ADDRESS 0xFFFF3984 /begin FUNCTION_LIST /end FUNCTION_LIST /end MEASUREMENT
/begin MEASUREMENT vCANDAT058 "RAM value vCANDAT058" UBYTE COMP_0068 1 100 0 255 ECU_ADDRESS 0xFFFF3985 /begin FUNCTION_LIST /end FUNCTION_LIST /end MEASUREMENT
/begin MEASUREMENT vCANDAT059 "RAM value vCANDAT059" UBYTE COMP_0068 1 100 0 255 ECU_ADDRESS 0xFFFF3986 /begin FUNCTION_LIST /end FUNCTION_LIST /end MEASUREMENT
/begin MEASUREMENT vCANDAT060 "RAM value vCANDAT060" UBYTE COMP_0068 1 100 0 255 ECU_ADDRESS 0xFFFF3987 /begin FUNCTION_LIST /end FUNCTION_LIST /end MEASUREMENT
/begin MEASUREMENT vCANDAT061 "RAM value vCANDAT061" UBYTE COMP_0068 1 100 0 255 ECU_ADDRESS 0xFFFF3988 /begin FUNCTION_LIST /end FUNCTION_LIST /end MEASUREMENT
/begin MEASUREMENT vCANDAT062 "RAM value vCANDAT062" UBYTE COMP_0068 1 100 0 255 ECU_ADDRESS 0xFFFF3989 /begin FUNCTION_LIST /end FUNCTION_LIST /end MEASUREMENT
/begin MEASUREMENT vCANDAT063 "RAM value vCANDAT063" UBYTE COMP_0068 1 100 0 255 ECU_ADDRESS 0xFFFF398A /begin FUNCTION_LIST /end FUNCTION_LIST /end MEASUREMENT
/begin MEASUREMENT vCANDAT064 "RAM value vCANDAT064" UBYTE COMP_0068 1 100 0 255 ECU_ADDRESS 0xFFFF398B /begin FUNCTION_LIST /end FUNCTION_LIST /end MEASUREMENT
/begin MEASUREMENT vCANDAT065 "RAM value vCANDAT065" UBYTE COMP_0068 1 100 0 255 ECU_ADDRESS 0xFFFF398C /begin FUNCTION_LIST /end FUNCTION_LIST /end MEASUREMENT
/begin MEASUREMENT vCANDAT066 "RAM value vCANDAT066" UBYTE COMP_0068 1 100 0 255 ECU_ADDRESS 0xFFFF398D /begin FUNCTION_LIST /end FUNCTION_LIST /end MEASUREMENT
/begin MEASUREMENT vCANDAT067 "RAM value vCANDAT067" UBYTE COMP_0068 1 100 0 255 ECU_ADDRESS 0xFFFF398E /begin FUNCTION_LIST /end FUNCTION_LIST /end MEASUREMENT
/begin MEASUREMENT vCANDAT068 "RAM value vCANDAT068" UBYTE COMP_0068 1 100 0 255 ECU_ADDRESS 0xFFFF398F /begin FUNCTION_LIST /end FUNCTION_LIST /end MEASUREMENT
/begin MEASUREMENT vCANDAT069 "RAM value vCANDAT069" UBYTE COMP_0068 1 100 0 255 ECU_ADDRESS 0xFFFF3990 /begin FUNCTION_LIST /end FUNCTION_LIST /end MEASUREMENT
/begin MEASUREMENT vCANDAT070 "RAM value vCANDAT070" UBYTE COMP_0068 1 100 0 255 ECU_ADDRESS 0xFFFF3991 /begin FUNCTION_LIST /end FUNCTION_LIST /end MEASUREMENT
/begin MEASUREMENT vCANDAT071 "RAM value vCANDAT071" UBYTE COMP_0068 1 100 0 255 ECU_ADDRESS 0xFFFF3992 /begin FUNCTION_LIST /end FUNCTION_LIST /end MEASUREMENT
/begin MEASUREMENT vCANDAT072 "RAM value vCANDAT072" UBYTE COMP_0068 1 100 0 255 ECU_ADDRESS 0xFFFF3993 /begin FUNCTION_LIST /end FUNCTION_LIST /end MEASUREMENT
/begin MEASUREMENT vCANDAT073 "RAM value vCANDAT073" UBYTE COMP_0068 1 100 0 255 ECU_ADDRESS 0xFFFF3994 /begin FUNCTION_LIST /end FUNCTION_LIST /end MEASUREMENT
/begin MEASUREMENT vCANDAT074 "RAM value vCANDAT074" UBYTE COMP_0068 1 100 0 255 ECU_ADDRESS 0xFFFF3995 /begin FUNCTION_LIST /end FUNCTION_LIST /end MEASUREMENT
/begin MEASUREMENT vCANDAT075 "RAM value vCANDAT075" UBYTE COMP_0068 1 100 0 255 ECU_ADDRESS 0xFFFF3996 /begin FUNCTION_LIST /end FUNCTION_LIST /end MEASUREMENT
/begin MEASUREMENT vCANDAT076 "RAM value vCANDAT076" UBYTE COMP_0068 1 100 0 255 ECU_ADDRESS 0xFFFF3997 /begin FUNCTION_LIST /end FUNCTION_LIST /end MEASUREMENT
/begin MEASUREMENT vCANDAT077 "RAM value vCANDAT077" UBYTE COMP_0068 1 100 0 255 ECU_ADDRESS 0xFFFF3998 /begin FUNCTION_LIST /end FUNCTION_LIST /end MEASUREMENT
/begin MEASUREMENT vCANDAT078 "RAM value vCANDAT078" UBYTE COMP_0068 1 100 0 255 ECU_ADDRESS 0xFFFF3999 /begin FUNCTION_LIST /end FUNCTION_LIST /end MEASUREMENT
/begin MEASUREMENT vCANDAT079 "RAM value vCANDAT079" UBYTE COMP_0068 1 100 0 255 ECU_ADDRESS 0xFFFF399A /begin FUNCTION_LIST /end FUNCTION_LIST /end MEASUREMENT
/begin MEASUREMENT vCANDAT080 "RAM value vCANDAT080" UBYTE COMP_0068 1 100 0 255 ECU_ADDRESS 0xFFFF399B /begin FUNCTION_LIST /end FUNCTION_LIST /end MEASUREMENT
/begin MEASUREMENT vCANDAT081 "RAM value vCANDAT081" UBYTE COMP_0068 1 100 0 255 ECU_ADDRESS 0xFFFF399C /begin FUNCTION_LIST /end FUNCTION_LIST /end MEASUREMENT
/begin MEASUREMENT vCANDAT082 "RAM value vCANDAT082" UBYTE COMP_0068 1 100 0 255 ECU_ADDRESS 0xFFFF399D /begin FUNCTION_LIST /end FUNCTION_LIST /end MEASUREMENT
/begin MEASUREMENT vCANDAT083 "RAM value vCANDAT083" UBYTE COMP_0068 1 100 0 255 ECU_ADDRESS 0xFFFF399E /begin FUNCTION_LIST /end FUNCTION_LIST /end MEASUREMENT
/begin MEASUREMENT vCANDAT084 "RAM value vCANDAT084" UBYTE COMP_0068 1 100 0 255 ECU_ADDRESS 0xFFFF399F /begin FUNCTION_LIST /end FUNCTION_LIST /end MEASUREMENT
/begin MEASUREMENT vCANDAT085 "RAM value vCANDAT085" UBYTE COMP_0068 1 100 0 255 ECU_ADDRESS 0xFFFF39A0 /begin FUNCTION_LIST /end FUNCTION_LIST /end MEASUREMENT
/begin MEASUREMENT vCANDAT086 "RAM value vCANDAT086" UBYTE COMP_0068 1 100 0 255 ECU_ADDRESS 0xFFFF39A1 /begin FUNCTION_LIST /end FUNCTION_LIST /end MEASUREMENT
/begin MEASUREMENT vCANDAT087 "RAM value vCANDAT087" UBYTE COMP_0068 1 100 0 255 ECU_ADDRESS 0xFFFF39A2 /begin FUNCTION_LIST /end FUNCTION_LIST /end MEASUREMENT
/begin MEASUREMENT vCANDAT088 "RAM value vCANDAT088" UBYTE COMP_0068 1 100 0 255 ECU_ADDRESS 0xFFFF39A3 /begin FUNCTION_LIST /end FUNCTION_LIST /end MEASUREMENT
/begin MEASUREMENT vCANDAT089 "RAM value vCANDAT089" UBYTE COMP_0068 1 100 0 255 ECU_ADDRESS 0xFFFF39A4 /begin FUNCTION_LIST /end FUNCTION_LIST /end MEASUREMENT
/begin MEASUREMENT vCANDAT090 "RAM value vCANDAT090" UBYTE COMP_0068 1 100 0 255 ECU_ADDRESS 0xFFFF39A5 /begin FUNCTION_LIST /end FUNCTION_LIST /end MEASUREMENT
/begin MEASUREMENT vCANDAT091 "RAM value vCANDAT091" UBYTE COMP_0068 1 100 0 255 ECU_ADDRESS 0xFFFF39A6 /begin FUNCTION_LIST /end FUNCTION_LIST /end MEASUREMENT
/begin MEASUREMENT vCANDAT092 "RAM value vCANDAT092" UBYTE COMP_0068 1 100 0 255 ECU_ADDRESS 0xFFFF39A7 /begin FUNCTION_LIST /end FUNCTION_LIST /end MEASUREMENT
/begin MEASUREMENT vCANDAT093 "RAM value vCANDAT093" UBYTE COMP_0068 1 100 0 255 ECU_ADDRESS 0xFFFF39A8 /begin FUNCTION_LIST /end FUNCTION_LIST /end MEASUREMENT
/begin MEASUREMENT vCANDAT094 "RAM value vCANDAT094" UBYTE COMP_0068 1 100 0 255 ECU_ADDRESS 0xFFFF39A9 /begin FUNCTION_LIST /end FUNCTION_LIST /end MEASUREMENT
/begin MEASUREMENT vCANDAT095 "RAM value vCANDAT095" UBYTE COMP_0068 1 100 0 255 ECU_ADDRESS 0xFFFF39AA /begin FUNCTION_LIST /end FUNCTION_LIST /end MEASUREMENT
/begin MEASUREMENT vCANDAT096 "RAM value vCANDAT096" UBYTE COMP_0068 1 100 0 255 ECU_ADDRESS 0xFFFF39AB /begin FUNCTION_LIST /end FUNCTION_LIST /end MEASUREMENT
/begin MEASUREMENT vCANDAT097 "RAM value vCANDAT097" UBYTE COMP_0068 1 100 0 255 ECU_ADDRESS 0xFFFF39AC /begin FUNCTION_LIST /end FUNCTION_LIST /end MEASUREMENT
/begin MEASUREMENT vCANDAT098 "RAM value vCANDAT098" UBYTE COMP_0068 1 100 0 255 ECU_ADDRESS 0xFFFF39AD /begin FUNCTION_LIST /end FUNCTION_LIST /end MEASUREMENT
/begin MEASUREMENT vCANDAT099 "RAM value vCANDAT099" UBYTE COMP_0068 1 100 0 255 ECU_ADDRESS 0xFFFF39AE /begin FUNCTION_LIST /end FUNCTION_LIST /end MEASUREMENT
/begin MEASUREMENT vCANDAT0A0 "RAM value vCANDAT0A0" UBYTE COMP_0068 1 100 0 255 ECU_ADDRESS 0xFFFF39AF /begin FUNCTION_LIST /end FUNCTION_LIST /end MEASUREMENT
/begin MEASUREMENT vCANDAT0A1 "RAM value vCANDAT0A1" UBYTE COMP_0068 1 100 0 255 ECU_ADDRESS 0xFFFF39B0 /begin FUNCTION_LIST /end FUNCTION_LIST /end MEASUREMENT
/begin MEASUREMENT vCANDAT0A2 "RAM value vCANDAT0A2" UBYTE COMP_0068 1 100 0 255 ECU_ADDRESS 0xFFFF39B1 /begin FUNCTION_LIST /end FUNCTION_LIST /end MEASUREMENT
/begin MEASUREMENT vCANDAT0A3 "RAM value vCANDAT0A3" UBYTE COMP_0068 1 100 0 255 ECU_ADDRESS 0xFFFF39B2 /begin FUNCTION_LIST /end FUNCTION_LIST /end MEASUREMENT
/begin MEASUREMENT vCANDAT0A4 "RAM value vCANDAT0A4" UBYTE COMP_0068 1 100 0 255 ECU_ADDRESS 0xFFFF39B3 /begin FUNCTION_LIST /end FUNCTION_LIST /end MEASUREMENT
/begin MEASUREMENT vCANDAT0A5 "RAM value vCANDAT0A5" UBYTE COMP_0068 1 100 0 255 ECU_ADDRESS 0xFFFF39B4 /begin FUNCTION_LIST /end FUNCTION_LIST /end MEASUREMENT
/begin MEASUREMENT vCANDAT0A6 "RAM value vCANDAT0A6" UBYTE COMP_0068 1 100 0 255 ECU_ADDRESS 0xFFFF39B5 /begin FUNCTION_LIST /end FUNCTION_LIST /end MEASUREMENT
/begin MEASUREMENT vCANDAT0A7 "RAM value vCANDAT0A7" UBYTE COMP_0068 1 100 0 255 ECU_ADDRESS 0xFFFF39B6 /begin FUNCTION_LIST /end FUNCTION_LIST /end MEASUREMENT
/begin MEASUREMENT vCANDAT0A8 "RAM value vCANDAT0A8" UBYTE COMP_0068 1 100 0 255 ECU_ADDRESS 0xFFFF39B7 /begin FUNCTION_LIST /end FUNCTION_LIST /end MEASUREMENT
/begin MEASUREMENT vCANDAT0A9 "RAM value vCANDAT0A9" UBYTE COMP_0068 1 100 0 255 ECU_ADDRESS 0xFFFF39B8 /begin FUNCTION_LIST /end FUNCTION_LIST /end MEASUREMENT
/begin MEASUREMENT vCANDAT0B0 "RAM value vCANDAT0B0" UBYTE COMP_0068 1 100 0 255 ECU_ADDRESS 0xFFFF39B9 /begin FUNCTION_LIST /end FUNCTION_LIST /end MEASUREMENT
/begin MEASUREMENT vCANDAT0B1 "RAM value vCANDAT0B1" UBYTE COMP_0068 1 100 0 255 ECU_ADDRESS 0xFFFF39BA /begin FUNCTION_LIST /end FUNCTION_LIST /end MEASUREMENT
/begin MEASUREMENT vCANDAT0B2 "RAM value vCANDAT0B2" UBYTE COMP_0068 1 100 0 255 ECU_ADDRESS 0xFFFF39BB /begin FUNCTION_LIST /end FUNCTION_LIST /end MEASUREMENT
/begin MEASUREMENT vCANDAT0B3 "RAM value vCANDAT0B3" UBYTE COMP_0068 1 100 0 255 ECU_ADDRESS 0xFFFF39BC /begin FUNCTION_LIST /end FUNCTION_LIST /end MEASUREMENT
/begin MEASUREMENT vCANDAT0B4 "RAM value vCANDAT0B4" UBYTE COMP_0068 1 100 0 255 ECU_ADDRESS 0xFFFF39BD /begin FUNCTION_LIST /end FUNCTION_LIST /end MEASUREMENT
/begin MEASUREMENT vCANDAT0B5 "RAM value vCANDAT0B5" UBYTE COMP_0068 1 100 0 255 ECU_ADDRESS 0xFFFF39BE /begin FUNCTION_LIST /end FUNCTION_LIST /end MEASUREMENT
/begin MEASUREMENT vCANDAT0B6 "RAM value vCANDAT0B6" UBYTE COMP_0068 1 100 0 255 ECU_ADDRESS 0xFFFF39BF /begin FUNCTION_LIST /end FUNCTION_LIST /end MEASUREMENT
/begin MEASUREMENT vCANDAT0B7 "RAM value vCANDAT0B7" UBYTE COMP_0068 1 100 0 255 ECU_ADDRESS 0xFFFF39C0 /begin FUNCTION_LIST /end FUNCTION_LIST /end MEASUREMENT
/begin MEASUREMENT vCANDAT0B8 "RAM value vCANDAT0B8" UBYTE COMP_0068 1 100 0 255 ECU_ADDRESS 0xFFFF39C1 /begin FUNCTION_LIST /end FUNCTION_LIST /end MEASUREMENT
/begin MEASUREMENT vCANDAT0B9 "RAM value vCANDAT0B9" UBYTE COMP_0068 1 100 0 255 ECU_ADDRESS 0xFFFF39C2 /begin FUNCTION_LIST /end FUNCTION_LIST /end MEASUREMENT
/begin MEASUREMENT vCANDAT0C0 "RAM value vCANDAT0C0" UBYTE COMP_0068 1 100 0 255 ECU_ADDRESS 0xFFFF39C3 /begin FUNCTION_LIST /end FUNCTION_LIST /end MEASUREMENT
/begin MEASUREMENT vCANDAT0C1 "RAM value vCANDAT0C1" UBYTE COMP_0068 1 100 0 255 ECU_ADDRESS 0xFFFF39C4 /begin FUNCTION_LIST /end FUNCTION_LIST /end MEASUREMENT
/begin MEASUREMENT vCANDAT0C2 "RAM value vCANDAT0C2" UBYTE COMP_0068 1 100 0 255 ECU_ADDRESS 0xFFFF39C5 /begin FUNCTION_LIST /end FUNCTION_LIST /end MEASUREMENT
/begin MEASUREMENT vCANDAT0C3 "RAM value vCANDAT0C3" UBYTE COMP_0068 1 100 0 255 ECU_ADDRESS 0xFFFF39C6 /begin FUNCTION_LIST /end FUNCTION_LIST /end MEASUREMENT
/begin MEASUREMENT vCANDAT0C4 "RAM value vCANDAT0C4" UBYTE COMP_0068 1 100 0 255 ECU_ADDRESS 0xFFFF39C7 /begin FUNCTION_LIST /end FUNCTION_LIST /end MEASUREMENT
/begin MEASUREMENT vCANDAT0C5 "RAM value vCANDAT0C5" UBYTE COMP_0068 1 100 0 255 ECU_ADDRESS 0xFFFF39C8 /begin FUNCTION_LIST /end FUNCTION_LIST /end MEASUREMENT
/begin MEASUREMENT vCANDAT0C6 "RAM value vCANDAT0C6" UBYTE COMP_0068 1 100 0 255 ECU_ADDRESS 0xFFFF39C9 /begin FUNCTION_LIST /end FUNCTION_LIST /end MEASUREMENT
/begin MEASUREMENT vCANDAT0C7 "RAM value vCANDAT0C7" UBYTE COMP_0068 1 100 0 255 ECU_ADDRESS 0xFFFF39CA /begin FUNCTION_LIST /end FUNCTION_LIST /end MEASUREMENT
/begin MEASUREMENT vCANDAT0C8 "RAM value vCANDAT0C8" UBYTE COMP_0068 1 100 0 255 ECU_ADDRESS 0xFFFF39CB /begin FUNCTION_LIST /end FUNCTION_LIST /end MEASUREMENT
/begin MEASUREMENT vCANDAT0C9 "RAM value vCANDAT0C9" UBYTE COMP_0068 1 100 0 255 ECU_ADDRESS 0xFFFF39CC /begin FUNCTION_LIST /end FUNCTION_LIST /end MEASUREMENT
/begin MEASUREMENT vCANDAT0D0 "RAM value vCANDAT0D0" UBYTE COMP_0068 1 100 0 255 ECU_ADDRESS 0xFFFF39CD /begin FUNCTION_LIST /end FUNCTION_LIST /end MEASUREMENT
/begin MEASUREMENT vCANDAT0D1 "RAM value vCANDAT0D1" UBYTE COMP_0068 1 100 0 255 ECU_ADDRESS 0xFFFF39CE /begin FUNCTION_LIST /end FUNCTION_LIST /end MEASUREMENT
/begin MEASUREMENT vCANDAT0D2 "RAM value vCANDAT0D2" UBYTE COMP_0068 1 100 0 255 ECU_ADDRESS 0xFFFF39CF /begin FUNCTION_LIST /end FUNCTION_LIST /end MEASUREMENT
/begin MEASUREMENT vCANDAT0D3 "RAM value vCANDAT0D3" UBYTE COMP_0068 1 100 0 255 ECU_ADDRESS 0xFFFF39D0 /begin FUNCTION_LIST /end FUNCTION_LIST /end MEASUREMENT
/begin MEASUREMENT vCANDAT0D4 "RAM value vCANDAT0D4" UBYTE COMP_0068 1 100 0 255 ECU_ADDRESS 0xFFFF39D1 /begin FUNCTION_LIST /end FUNCTION_LIST /end MEASUREMENT
/begin MEASUREMENT vCANDAT0D5 "RAM value vCANDAT0D5" UBYTE COMP_0068 1 100 0 255 ECU_ADDRESS 0xFFFF39D2 /begin FUNCTION_LIST /end FUNCTION_LIST /end MEASUREMENT
/begin MEASUREMENT vCANDAT0D6 "RAM value vCANDAT0D6" UBYTE COMP_0068 1 100 0 255 ECU_ADDRESS 0xFFFF39D3 /begin FUNCTION_LIST /end FUNCTION_LIST /end MEASUREMENT
/begin MEASUREMENT vCANDAT0D7 "RAM value vCANDAT0D7" UBYTE COMP_0068 1 100 0 255 ECU_ADDRESS 0xFFFF39D4 /begin FUNCTION_LIST /end FUNCTION_LIST /end MEASUREMENT
/begin MEASUREMENT vCANDAT0D8 "RAM value vCANDAT0D8" UBYTE COMP_0068 1 100 0 255 ECU_ADDRESS 0xFFFF39D5 /begin FUNCTION_LIST /end FUNCTION_LIST /end MEASUREMENT
/begin MEASUREMENT vCANDAT0D9 "RAM value vCANDAT0D9" UBYTE COMP_0068 1 100 0 255 ECU_ADDRESS 0xFFFF39D6 /begin FUNCTION_LIST /end FUNCTION_LIST /end MEASUREMENT
/begin MEASUREMENT vCANDAT0E0 "RAM value vCANDAT0E0" UBYTE COMP_0068 1 100 0 255 ECU_ADDRESS 0xFFFF39D7 /begin FUNCTION_LIST /end FUNCTION_LIST /end MEASUREMENT
/begin MEASUREMENT vCANDAT0E1 "RAM value vCANDAT0E1" UBYTE COMP_0068 1 100 0 255 ECU_ADDRESS 0xFFFF39D8 /begin FUNCTION_LIST /end FUNCTION_LIST /end MEASUREMENT
/begin MEASUREMENT vCANDAT0E2 "RAM value vCANDAT0E2" UBYTE COMP_0068 1 100 0 255 ECU_ADDRESS 0xFFFF39D9 /begin FUNCTION_LIST /end FUNCTION_LIST /end MEASUREMENT
/begin MEASUREMENT vCANDAT0E3 "RAM value vCANDAT0E3" UBYTE COMP_0068 1 100 0 255 ECU_ADDRESS 0xFFFF39DA /begin FUNCTION_LIST /end FUNCTION_LIST /end MEASUREMENT
/begin MEASUREMENT vCANDAT0E4 "RAM value vCANDAT0E4" UBYTE COMP_0068 1 100 0 255 ECU_ADDRESS 0xFFFF39DB /begin FUNCTION_LIST /end FUNCTION_LIST /end MEASUREMENT
/begin MEASUREMENT vCANDAT0E5 "RAM value vCANDAT0E5" UBYTE COMP_0068 1 100 0 255 ECU_ADDRESS 0xFFFF39DC /begin FUNCTION_LIST /end FUNCTION_LIST /end MEASUREMENT
/begin MEASUREMENT vCANDAT0E6 "RAM value vCANDAT0E6" UBYTE COMP_0068 1 100 0 255 ECU_ADDRESS 0xFFFF39DD /begin FUNCTION_LIST /end FUNCTION_LIST /end MEASUREMENT
/begin MEASUREMENT vCANDAT0E7 "RAM value vCANDAT0E7" UBYTE COMP_0068 1 100 0 255 ECU_ADDRESS 0xFFFF39DE /begin FUNCTION_LIST /end FUNCTION_LIST /end MEASUREMENT
/begin MEASUREMENT vCANDAT0E8 "RAM value vCANDAT0E8" UBYTE COMP_0068 1 100 0 255 ECU_ADDRESS 0xFFFF39DF /begin FUNCTION_LIST /end FUNCTION_LIST /end MEASUREMENT
/begin MEASUREMENT vCANDAT0E9 "RAM value vCANDAT0E9" UBYTE COMP_0068 1 100 0 255 ECU_ADDRESS 0xFFFF39E0 /begin FUNCTION_LIST /end FUNCTION_LIST /end MEASUREMENT
/begin MEASUREMENT vCANDAT0F0 "RAM value vCANDAT0F0" UBYTE COMP_0068 1 100 0 255 ECU_ADDRESS 0xFFFF39E1 /begin FUNCTION_LIST /end FUNCTION_LIST /end MEASUREMENT
/begin MEASUREMENT vCANDAT0F1 "RAM value vCANDAT0F1" UBYTE COMP_0068 1 100 0 255 ECU_ADDRESS 0xFFFF39E2 /begin FUNCTION_LIST /end FUNCTION_LIST /end MEASUREMENT
/begin MEASUREMENT vCANDAT0F2 "RAM value vCANDAT0F2" UBYTE COMP_0068 1 100 0 255 ECU_ADDRESS 0xFFFF39E3 /begin FUNCTION_LIST /end FUNCTION_LIST /end MEASUREMENT
/begin MEASUREMENT vCANDAT0F3 "RAM value vCANDAT0F3" UBYTE COMP_0068 1 100 0 255 ECU_ADDRESS 0xFFFF39E4 /begin FUNCTION_LIST /end FUNCTION_LIST /end MEASUREMENT
/begin MEASUREMENT vCANDAT0F4 "RAM value vCANDAT0F4" UBYTE COMP_0068 1 100 0 255 ECU_ADDRESS 0xFFFF39E5 /begin FUNCTION_LIST /end FUNCTION_LIST /end MEASUREMENT
/begin MEASUREMENT vCANDAT0F5 "RAM value vCANDAT0F5" UBYTE COMP_0068 1 100 0 255 ECU_ADDRESS 0xFFFF39E6 /begin FUNCTION_LIST /end FUNCTION_LIST /end MEASUREMENT
/begin MEASUREMENT vCANDAT0F6 "RAM value vCANDAT0F6" UBYTE COMP_0068 1 100 0 255 ECU_ADDRESS 0xFFFF39E7 /begin FUNCTION_LIST /end FUNCTION_LIST /end MEASUREMENT
/begin MEASUREMENT vCANDAT0F7 "RAM value vCANDAT0F7" UBYTE COMP_0068 1 100 0 255 ECU_ADDRESS 0xFFFF39E8 /begin FUNCTION_LIST /end FUNCTION_LIST /end MEASUREMENT
/begin MEASUREMENT vCANDAT0F8 "RAM value vCANDAT0F8" UBYTE COMP_0068 1 100 0 255 ECU_ADDRESS 0xFFFF39E9 /begin FUNCTION_LIST /end FUNCTION_LIST /end MEASUREMENT
/begin MEASUREMENT vCANDAT0F9 "RAM value vCANDAT0F9" UBYTE COMP_0068 1 100 0 255 ECU_ADDRESS 0xFFFF39EA /begin FUNCTION_LIST /end FUNCTION_LIST /end MEASUREMENT
/begin MEASUREMENT vCANDAT100 "RAM value vCANDAT100" UBYTE COMP_0068 1 100 0 255 ECU_ADDRESS 0xFFFF39EB /begin FUNCTION_LIST /end FUNCTION_LIST /end MEASUREMENT
/begin MEASUREMENT vCANDAT101 "RAM value vCANDAT101" UBYTE COMP_0068 1 100 0 255 ECU_ADDRESS 0xFFFF39EC /begin FUNCTION_LIST /end FUNCTION_LIST /end MEASUREMENT
/begin MEASUREMENT vCANDAT102 "RAM value vCANDAT102" UBYTE COMP_0068 1 100 0 255 ECU_ADDRESS 0xFFFF39ED /begin FUNCTION_LIST /end FUNCTION_LIST /end MEASUREMENT
/begin MEASUREMENT vCANDAT103 "RAM value vCANDAT103" UBYTE COMP_0068 1 100 0 255 ECU_ADDRESS 0xFFFF39EE /begin FUNCTION_LIST /end FUNCTION_LIST /end MEASUREMENT
/begin MEASUREMENT vCANDAT104 "RAM value vCANDAT104" UBYTE COMP_0068 1 100 0 255 ECU_ADDRESS 0xFFFF39EF /begin FUNCTION_LIST /end FUNCTION_LIST /end MEASUREMENT
/begin MEASUREMENT vCANDAT105 "RAM value vCANDAT105" UBYTE COMP_0068 1 100 0 255 ECU_ADDRESS 0xFFFF39F0 /begin FUNCTION_LIST /end FUNCTION_LIST /end MEASUREMENT
/begin MEASUREMENT vCANDAT106 "RAM value vCANDAT106" UBYTE COMP_0068 1 100 0 255 ECU_ADDRESS 0xFFFF39F1 /begin FUNCTION_LIST /end FUNCTION_LIST /end MEASUREMENT
/begin MEASUREMENT vCANDAT107 "RAM value vCANDAT107" UBYTE COMP_0068 1 100 0 255 ECU_ADDRESS 0xFFFF39F2 /begin FUNCTION_LIST /end FUNCTION_LIST /end MEASUREMENT
/begin MEASUREMENT vCANDAT108 "RAM value vCANDAT108" UBYTE COMP_0068 1 100 0 255 ECU_ADDRESS 0xFFFF39F3 /begin FUNCTION_LIST /end FUNCTION_LIST /end MEASUREMENT
/begin MEASUREMENT vCANDAT109 "RAM value vCANDAT109" UBYTE COMP_0068 1 100 0 255 ECU_ADDRESS 0xFFFF39F4 /begin FUNCTION_LIST /end FUNCTION_LIST /end MEASUREMENT
/begin MEASUREMENT vCANDAT110 "RAM value vCANDAT110" UBYTE COMP_0068 1 100 0 255 ECU_ADDRESS 0xFFFF39F5 /begin FUNCTION_LIST /end FUNCTION_LIST /end MEASUREMENT
/begin MEASUREMENT vCANDAT111 "RAM value vCANDAT111" UBYTE COMP_0068 1 100 0 255 ECU_ADDRESS 0xFFFF39F6 /begin FUNCTION_LIST /end FUNCTION_LIST /end MEASUREMENT
/begin MEASUREMENT vCANDAT112 "RAM value vCANDAT112" UBYTE COMP_0068 1 100 0 255 ECU_ADDRESS 0xFFFF39F7 /begin FUNCTION_LIST /end FUNCTION_LIST /end MEASUREMENT
/begin MEASUREMENT vCANDAT113 "RAM value vCANDAT113" UBYTE COMP_0068 1 100 0 255 ECU_ADDRESS 0xFFFF39F8 /begin FUNCTION_LIST /end FUNCTION_LIST /end MEASUREMENT
/begin MEASUREMENT vCANDAT114 "RAM value vCANDAT114" UBYTE COMP_0068 1 100 0 255 ECU_ADDRESS 0xFFFF39F9 /begin FUNCTION_LIST /end FUNCTION_LIST /end MEASUREMENT
/begin MEASUREMENT vCANDAT115 "RAM value vCANDAT115" UBYTE COMP_0068 1 100 0 255 ECU_ADDRESS 0xFFFF39FA /begin FUNCTION_LIST /end FUNCTION_LIST /end MEASUREMENT
/begin MEASUREMENT vCANDAT116 "RAM value vCANDAT116" UBYTE COMP_0068 1 100 0 255 ECU_ADDRESS 0xFFFF39FB /begin FUNCTION_LIST /end FUNCTION_LIST /end MEASUREMENT
/begin MEASUREMENT vCANDAT117 "RAM value vCANDAT117" UBYTE COMP_0068 1 100 0 255 ECU_ADDRESS 0xFFFF39FC /begin FUNCTION_LIST /end FUNCTION_LIST /end MEASUREMENT
/begin MEASUREMENT vCANDAT118 "RAM value vCANDAT118" UBYTE COMP_0068 1 100 0 255 ECU_ADDRESS 0xFFFF39FD /begin FUNCTION_LIST /end FUNCTION_LIST /end MEASUREMENT
/begin MEASUREMENT vCANDAT119 "RAM value vCANDAT119" UBYTE COMP_0068 1 100 0 255 ECU_ADDRESS 0xFFFF39FE /begin FUNCTION_LIST /end FUNCTION_LIST /end MEASUREMENT
/begin MEASUREMENT vCANDAT120 "RAM value vCANDAT120" UBYTE COMP_0068 1 100 0 255 ECU_ADDRESS 0xFFFF39FF /begin FUNCTION_LIST /end FUNCTION_LIST /end MEASUREMENT
/begin MEASUREMENT vCANDAT121 "RAM value vCANDAT121" UBYTE COMP_0068 1 100 0 255 ECU_ADDRESS 0xFFFF3A00 /begin FUNCTION_LIST /end FUNCTION_LIST /end MEASUREMENT
/begin MEASUREMENT vCANDAT122 "RAM value vCANDAT122" UBYTE COMP_0068 1 100 0 255 ECU_ADDRESS 0xFFFF3A01 /begin FUNCTION_LIST /end FUNCTION_LIST /end MEASUREMENT
/begin MEASUREMENT vCANDAT123 "RAM value vCANDAT123" UBYTE COMP_0068 1 100 0 255 ECU_ADDRESS 0xFFFF3A02 /begin FUNCTION_LIST /end FUNCTION_LIST /end MEASUREMENT
/begin MEASUREMENT vCANDAT124 "RAM value vCANDAT124" UBYTE COMP_0068 1 100 0 255 ECU_ADDRESS 0xFFFF3A03 /begin FUNCTION_LIST /end FUNCTION_LIST /end MEASUREMENT
/begin MEASUREMENT vCANDAT125 "RAM value vCANDAT125" UBYTE COMP_0068 1 100 0 255 ECU_ADDRESS 0xFFFF3A04 /begin FUNCTION_LIST /end FUNCTION_LIST /end MEASUREMENT
/begin MEASUREMENT vCANDAT126 "RAM value vCANDAT126" UBYTE COMP_0068 1 100 0 255 ECU_ADDRESS 0xFFFF3A05 /begin FUNCTION_LIST /end FUNCTION_LIST /end MEASUREMENT
/begin MEASUREMENT vCANDAT127 "RAM value vCANDAT127" UBYTE COMP_0068 1 100 0 255 ECU_ADDRESS 0xFFFF3A06 /begin FUNCTION_LIST /end FUNCTION_LIST /end MEASUREMENT
/begin MEASUREMENT vCANDAT128 "RAM value vCANDAT128" UBYTE COMP_0068 1 100 0 255 ECU_ADDRESS 0xFFFF3A07 /begin FUNCTION_LIST /end FUNCTION_LIST /end MEASUREMENT
/begin MEASUREMENT vCANDAT129 "RAM value vCANDAT129" UBYTE COMP_0068 1 100 0 255 ECU_ADDRESS 0xFFFF3A08 /begin FUNCTION_LIST /end FUNCTION_LIST /end MEASUREMENT
/begin MEASUREMENT vCANDAT130 "RAM value vCANDAT130" UBYTE COMP_0068 1 100 0 255 ECU_ADDRESS 0xFFFF3A09 /begin FUNCTION_LIST /end FUNCTION_LIST /end MEASUREMENT
/begin MEASUREMENT vCANDAT131 "RAM value vCANDAT131" UBYTE COMP_0068 1 100 0 255 ECU_ADDRESS 0xFFFF3A0A /begin FUNCTION_LIST /end FUNCTION_LIST /end MEASUREMENT
/begin MEASUREMENT vCANDAT132 "RAM value vCANDAT132" UBYTE COMP_0068 1 100 0 255 ECU_ADDRESS 0xFFFF3A0B /begin FUNCTION_LIST /end FUNCTION_LIST /end MEASUREMENT
/begin MEASUREMENT vCANDAT133 "RAM value vCANDAT133" UBYTE COMP_0068 1 100 0 255 ECU_ADDRESS 0xFFFF3A0C /begin FUNCTION_LIST /end FUNCTION_LIST /end MEASUREMENT
/begin MEASUREMENT vCANDAT134 "RAM value vCANDAT134" UBYTE COMP_0068 1 100 0 255 ECU_ADDRESS 0xFFFF3A0D /begin FUNCTION_LIST /end FUNCTION_LIST /end MEASUREMENT
/begin MEASUREMENT vCANDAT135 "RAM value vCANDAT135" UBYTE COMP_0068 1 100 0 255 ECU_ADDRESS 0xFFFF3A0E /begin FUNCTION_LIST /end FUNCTION_LIST /end MEASUREMENT
/begin MEASUREMENT vCANDAT136 "RAM value vCANDAT136" UBYTE COMP_0068 1 100 0 255 ECU_ADDRESS 0xFFFF3A0F /begin FUNCTION_LIST /end FUNCTION_LIST /end MEASUREMENT
/begin MEASUREMENT vCANDAT137 "RAM value vCANDAT137" UBYTE COMP_0068 1 100 0 255 ECU_ADDRESS 0xFFFF3A10 /begin FUNCTION_LIST /end FUNCTION_LIST /end MEASUREMENT
/begin MEASUREMENT vCANDAT138 "RAM value vCANDAT138" UBYTE COMP_0068 1 100 0 255 ECU_ADDRESS 0xFFFF3A11 /begin FUNCTION_LIST /end FUNCTION_LIST /end MEASUREMENT
/begin MEASUREMENT vCANDAT139 "RAM value vCANDAT139" UBYTE COMP_0068 1 100 0 255 ECU_ADDRESS 0xFFFF3A12 /begin FUNCTION_LIST /end FUNCTION_LIST /end MEASUREMENT
/begin MEASUREMENT vCANDAT140 "RAM value vCANDAT140" UBYTE COMP_0068 1 100 0 255 ECU_ADDRESS 0xFFFF3A13 /begin FUNCTION_LIST /end FUNCTION_LIST /end MEASUREMENT
/begin MEASUREMENT vCANDAT141 "RAM value vCANDAT141" UBYTE COMP_0068 1 100 0 255 ECU_ADDRESS 0xFFFF3A14 /begin FUNCTION_LIST /end FUNCTION_LIST /end MEASUREMENT
/begin MEASUREMENT vCANDAT142 "RAM value vCANDAT142" UBYTE COMP_0068 1 100 0 255 ECU_ADDRESS 0xFFFF3A15 /begin FUNCTION_LIST /end FUNCTION_LIST /end MEASUREMENT
/begin MEASUREMENT vCANDAT143 "RAM value vCANDAT143" UBYTE COMP_0068 1 100 0 255 ECU_ADDRESS 0xFFFF3A16 /begin FUNCTION_LIST /end FUNCTION_LIST /end MEASUREMENT
/begin MEASUREMENT vCANDAT144 "RAM value vCANDAT144" UBYTE COMP_0068 1 100 0 255 ECU_ADDRESS 0xFFFF3A17 /begin FUNCTION_LIST /end FUNCTION_LIST /end MEASUREMENT
/begin MEASUREMENT vCANDAT145 "RAM value vCANDAT145" UBYTE COMP_0068 1 100 0 255 ECU_ADDRESS 0xFFFF3A18 /begin FUNCTION_LIST /end FUNCTION_LIST /end MEASUREMENT
/begin MEASUREMENT vCANDAT146 "RAM value vCANDAT146" UBYTE COMP_0068 1 100 0 255 ECU_ADDRESS 0xFFFF3A19 /begin FUNCTION_LIST /end FUNCTION_LIST /end MEASUREMENT
/begin MEASUREMENT vCANDAT147 "RAM value vCANDAT147" UBYTE COMP_0068 1 100 0 255 ECU_ADDRESS 0xFFFF3A1A /begin FUNCTION_LIST /end FUNCTION_LIST /end MEASUREMENT
/begin MEASUREMENT vCANDAT148 "RAM value vCANDAT148" UBYTE COMP_0068 1 100 0 255 ECU_ADDRESS 0xFFFF3A1B /begin FUNCTION_LIST /end FUNCTION_LIST /end MEASUREMENT
/begin MEASUREMENT vCANDAT149 "RAM value vCANDAT149" UBYTE COMP_0068 1 100 0 255 ECU_ADDRESS 0xFFFF3A1C /begin FUNCTION_LIST /end FUNCTION_LIST /end MEASUREMENT
/begin MEASUREMENT vCANDAT150 "RAM value vCANDAT150" UBYTE COMP_0068 1 100 0 255 ECU_ADDRESS 0xFFFF3A1D /begin FUNCTION_LIST /end FUNCTION_LIST /end MEASUREMENT
/begin MEASUREMENT vCANDAT151 "RAM value vCANDAT151" UBYTE COMP_0068 1 100 0 255 ECU_ADDRESS 0xFFFF3A1E /begin FUNCTION_LIST /end FUNCTION_LIST /end MEASUREMENT
/begin MEASUREMENT vCANDAT152 "RAM value vCANDAT152" UBYTE COMP_0068 1 100 0 255 ECU_ADDRESS 0xFFFF3A1F /begin FUNCTION_LIST /end FUNCTION_LIST /end MEASUREMENT
/begin MEASUREMENT vCANDAT153 "RAM value vCANDAT153" UBYTE COMP_0068 1 100 0 255 ECU_ADDRESS 0xFFFF3A20 /begin FUNCTION_LIST /end FUNCTION_LIST /end MEASUREMENT
/begin MEASUREMENT vCANDAT154 "RAM value vCANDAT154" UBYTE COMP_0068 1 100 0 255 ECU_ADDRESS 0xFFFF3A21 /begin FUNCTION_LIST /end FUNCTION_LIST /end MEASUREMENT
/begin MEASUREMENT vCANDAT155 "RAM value vCANDAT155" UBYTE COMP_0068 1 100 0 255 ECU_ADDRESS 0xFFFF3A22 /begin FUNCTION_LIST /end FUNCTION_LIST /end MEASUREMENT
/begin MEASUREMENT vCANDAT156 "RAM value vCANDAT156" UBYTE COMP_0068 1 100 0 255 ECU_ADDRESS 0xFFFF3A23 /begin FUNCTION_LIST /end FUNCTION_LIST /end MEASUREMENT
/begin MEASUREMENT vCANDAT157 "RAM value vCANDAT157" UBYTE COMP_0068 1 100 0 255 ECU_ADDRESS 0xFFFF3A24 /begin FUNCTION_LIST /end FUNCTION_LIST /end MEASUREMENT
/begin MEASUREMENT vCANDAT158 "RAM value vCANDAT158" UBYTE COMP_0068 1 100 0 255 ECU_ADDRESS 0xFFFF3A25 /begin FUNCTION_LIST /end FUNCTION_LIST /end MEASUREMENT
/begin MEASUREMENT vCANDAT159 "RAM value vCANDAT159" UBYTE COMP_0068 1 100 0 255 ECU_ADDRESS 0xFFFF3A26 /begin FUNCTION_LIST /end FUNCTION_LIST /end MEASUREMENT
/begin MEASUREMENT vCANDAT160 "RAM value vCANDAT160" UBYTE COMP_0068 1 100 0 255 ECU_ADDRESS 0xFFFF3A27 /begin FUNCTION_LIST /end FUNCTION_LIST /end MEASUREMENT
/begin MEASUREMENT vCANDAT161 "RAM value vCANDAT161" UBYTE COMP_0068 1 100 0 255 ECU_ADDRESS 0xFFFF3A28 /begin FUNCTION_LIST /end FUNCTION_LIST /end MEASUREMENT
/begin MEASUREMENT vCANDAT162 "RAM value vCANDAT162" UBYTE COMP_0068 1 100 0 255 ECU_ADDRESS 0xFFFF3A29 /begin FUNCTION_LIST /end FUNCTION_LIST /end MEASUREMENT
/begin MEASUREMENT vCANDAT163 "RAM value vCANDAT163" UBYTE COMP_0068 1 100 0 255 ECU_ADDRESS 0xFFFF3A2A /begin FUNCTION_LIST /end FUNCTION_LIST /end MEASUREMENT
/begin MEASUREMENT vCANDAT164 "RAM value vCANDAT164" UBYTE COMP_0068 1 100 0 255 ECU_ADDRESS 0xFFFF3A2B /begin FUNCTION_LIST /end FUNCTION_LIST /end MEASUREMENT
/begin MEASUREMENT vCANDAT165 "RAM value vCANDAT165" UBYTE COMP_0068 1 100 0 255 ECU_ADDRESS 0xFFFF3A2C /begin FUNCTION_LIST /end FUNCTION_LIST /end MEASUREMENT
/begin MEASUREMENT vCANDAT166 "RAM value vCANDAT166" UBYTE COMP_0068 1 100 0 255 ECU_ADDRESS 0xFFFF3A2D /begin FUNCTION_LIST /end FUNCTION_LIST /end MEASUREMENT
/begin MEASUREMENT vCANDAT167 "RAM value vCANDAT167" UBYTE COMP_0068 1 100 0 255 ECU_ADDRESS 0xFFFF3A2E /begin FUNCTION_LIST /end FUNCTION_LIST /end MEASUREMENT
/begin MEASUREMENT vCANDAT168 "RAM value vCANDAT168" UBYTE COMP_0068 1 100 0 255 ECU_ADDRESS 0xFFFF3A2F /begin FUNCTION_LIST /end FUNCTION_LIST /end MEASUREMENT
/begin MEASUREMENT vCANDAT169 "RAM value vCANDAT169" UBYTE COMP_0068 1 100 0 255 ECU_ADDRESS 0xFFFF3A30 /begin FUNCTION_LIST /end FUNCTION_LIST /end MEASUREMENT
/begin MEASUREMENT vCANDAT170 "RAM value vCANDAT170" UBYTE COMP_0068 1 100 0 255 ECU_ADDRESS 0xFFFF3A31 /begin FUNCTION_LIST /end FUNCTION_LIST /end MEASUREMENT
/begin MEASUREMENT vCANDAT171 "RAM value vCANDAT171" UBYTE COMP_0068 1 100 0 255 ECU_ADDRESS 0xFFFF3A32 /begin FUNCTION_LIST /end FUNCTION_LIST /end MEASUREMENT
/begin MEASUREMENT vCANDAT172 "RAM value vCANDAT172" UBYTE COMP_0068 1 100 0 255 ECU_ADDRESS 0xFFFF3A33 /begin FUNCTION_LIST /end FUNCTION_LIST /end MEASUREMENT
/begin MEASUREMENT vCANDAT173 "RAM value vCANDAT173" UBYTE COMP_0068 1 100 0 255 ECU_ADDRESS 0xFFFF3A34 /begin FUNCTION_LIST /end FUNCTION_LIST /end MEASUREMENT
/begin MEASUREMENT vCANDAT174 "RAM value vCANDAT174" UBYTE COMP_0068 1 100 0 255 ECU_ADDRESS 0xFFFF3A35 /begin FUNCTION_LIST /end FUNCTION_LIST /end MEASUREMENT
/begin MEASUREMENT vCANDAT175 "RAM value vCANDAT175" UBYTE COMP_0068 1 100 0 255 ECU_ADDRESS 0xFFFF3A36 /begin FUNCTION_LIST /end FUNCTION_LIST /end MEASUREMENT
/begin MEASUREMENT vCANDAT176 "RAM value vCANDAT176" UBYTE COMP_0068 1 100 0 255 ECU_ADDRESS 0xFFFF3A37 /begin FUNCTION_LIST /end FUNCTION_LIST /end MEASUREMENT
/begin MEASUREMENT vCANDAT177 "RAM value vCANDAT177" UBYTE COMP_0068 1 100 0 255 ECU_ADDRESS 0xFFFF3A38 /begin FUNCTION_LIST /end FUNCTION_LIST /end MEASUREMENT
/begin MEASUREMENT vCANDAT178 "RAM value vCANDAT178" UBYTE COMP_0068 1 100 0 255 ECU_ADDRESS 0xFFFF3A39 /begin FUNCTION_LIST /end FUNCTION_LIST /end MEASUREMENT
/begin MEASUREMENT vCANDAT179 "RAM value vCANDAT179" UBYTE COMP_0068 1 100 0 255 ECU_ADDRESS 0xFFFF3A3A /begin FUNCTION_LIST /end FUNCTION_LIST /end MEASUREMENT
/begin MEASUREMENT vCANDAT180 "RAM value vCANDAT180" UBYTE COMP_0068 1 100 0 255 ECU_ADDRESS 0xFFFF3A3B /begin FUNCTION_LIST /end FUNCTION_LIST /end MEASUREMENT
/begin MEASUREMENT vCANDAT181 "RAM value vCANDAT181" UBYTE COMP_0068 1 100 0 255 ECU_ADDRESS 0xFFFF3A3C /begin FUNCTION_LIST /end FUNCTION_LIST /end MEASUREMENT
/begin MEASUREMENT vCANDAT182 "RAM value vCANDAT182" UBYTE COMP_0068 1 100 0 255 ECU_ADDRESS 0xFFFF3A3D /begin FUNCTION_LIST /end FUNCTION_LIST /end MEASUREMENT
/begin MEASUREMENT vCANDAT183 "RAM value vCANDAT183" UBYTE COMP_0068 1 100 0 255 ECU_ADDRESS 0xFFFF3A3E /begin FUNCTION_LIST /end FUNCTION_LIST /end MEASUREMENT
/begin MEASUREMENT vCANDAT184 "RAM value vCANDAT184" UBYTE COMP_0068 1 100 0 255 ECU_ADDRESS 0xFFFF3A3F /begin FUNCTION_LIST /end FUNCTION_LIST /end MEASUREMENT
/begin MEASUREMENT vCANDAT185 "RAM value vCANDAT185" UBYTE COMP_0068 1 100 0 255 ECU_ADDRESS 0xFFFF3A40 /begin FUNCTION_LIST /end FUNCTION_LIST /end MEASUREMENT
/begin MEASUREMENT vCANDAT186 "RAM value vCANDAT186" UBYTE COMP_0068 1 100 0 255 ECU_ADDRESS 0xFFFF3A41 /begin FUNCTION_LIST /end FUNCTION_LIST /end MEASUREMENT
/begin MEASUREMENT vCANDAT187 "RAM value vCANDAT187" UBYTE COMP_0068 1 100 0 255 ECU_ADDRESS 0xFFFF3A42 /begin FUNCTION_LIST /end FUNCTION_LIST /end MEASUREMENT
/begin MEASUREMENT vCANDAT188 "RAM value vCANDAT188" UBYTE COMP_0068 1 100 0 255 ECU_ADDRESS 0xFFFF3A43 /begin FUNCTION_LIST /end FUNCTION_LIST /end MEASUREMENT
/begin MEASUREMENT vCANDAT189 "RAM value vCANDAT189" UBYTE COMP_0068 1 100 0 255 ECU_ADDRESS 0xFFFF3A44 /begin FUNCTION_LIST /end FUNCTION_LIST /end MEASUREMENT
/begin MEASUREMENT vCANDAT190 "RAM value vCANDAT190" UBYTE COMP_0068 1 100 0 255 ECU_ADDRESS 0xFFFF3A45 /begin FUNCTION_LIST /end FUNCTION_LIST /end MEASUREMENT
/begin MEASUREMENT vCANDAT191 "RAM value vCANDAT191" UBYTE COMP_0068 1 100 0 255 ECU_ADDRESS 0xFFFF3A46 /begin FUNCTION_LIST /end FUNCTION_LIST /end MEASUREMENT
/begin MEASUREMENT vCANDAT192 "RAM value vCANDAT192" UBYTE COMP_0068 1 100 0 255 ECU_ADDRESS 0xFFFF3A47 /begin FUNCTION_LIST /end FUNCTION_LIST /end MEASUREMENT
/begin MEASUREMENT vCANDAT193 "RAM value vCANDAT193" UBYTE COMP_0068 1 100 0 255 ECU_ADDRESS 0xFFFF3A48 /begin FUNCTION_LIST /end FUNCTION_LIST /end MEASUREMENT
/begin MEASUREMENT vCANDAT194 "RAM value vCANDAT194" UBYTE COMP_0068 1 100 0 255 ECU_ADDRESS 0xFFFF3A49 /begin FUNCTION_LIST /end FUNCTION_LIST /end MEASUREMENT
/begin MEASUREMENT vCANDAT195 "RAM value vCANDAT195" UBYTE COMP_0068 1 100 0 255 ECU_ADDRESS 0xFFFF3A4A /begin FUNCTION_LIST /end FUNCTION_LIST /end MEASUREMENT
/begin MEASUREMENT vCANDAT196 "RAM value vCANDAT196" UBYTE COMP_0068 1 100 0 255 ECU_ADDRESS 0xFFFF3A4B /begin FUNCTION_LIST /end FUNCTION_LIST /end MEASUREMENT
/begin MEASUREMENT vCANDAT197 "RAM value vCANDAT197" UBYTE COMP_0068 1 100 0 255 ECU_ADDRESS 0xFFFF3A4C /begin FUNCTION_LIST /end FUNCTION_LIST /end MEASUREMENT
/begin MEASUREMENT vCANDAT198 "RAM value vCANDAT198" UBYTE COMP_0068 1 100 0 255 ECU_ADDRESS 0xFFFF3A4D /begin FUNCTION_LIST /end FUNCTION_LIST /end MEASUREMENT
/begin MEASUREMENT vCANDAT199 "RAM value vCANDAT199" UBYTE COMP_0068 1 100 0 255 ECU_ADDRESS 0xFFFF3A4E /begin FUNCTION_LIST /end FUNCTION_LIST /end MEASUREMENT
/begin MEASUREMENT vCANDAT1A0 "RAM value vCANDAT1A0" UBYTE COMP_0068 1 100 0 255 ECU_ADDRESS 0xFFFF3A4F /begin FUNCTION_LIST /end FUNCTION_LIST /end MEASUREMENT
/begin MEASUREMENT vCANDAT1A1 "RAM value vCANDAT1A1" UBYTE COMP_0068 1 100 0 255 ECU_ADDRESS 0xFFFF3A50 /begin FUNCTION_LIST /end FUNCTION_LIST /end MEASUREMENT
/begin MEASUREMENT vCANDAT1A2 "RAM value vCANDAT1A2" UBYTE COMP_0068 1 100 0 255 ECU_ADDRESS 0xFFFF3A51 /begin FUNCTION_LIST /end FUNCTION_LIST /end MEASUREMENT
/begin MEASUREMENT vCANDAT1A3 "RAM value vCANDAT1A3" UBYTE COMP_0068 1 100 0 255 ECU_ADDRESS 0xFFFF3A52 /begin FUNCTION_LIST /end FUNCTION_LIST /end MEASUREMENT
/begin MEASUREMENT vCANDAT1A4 "RAM value vCANDAT1A4" UBYTE COMP_0068 1 100 0 255 ECU_ADDRESS 0xFFFF3A53 /begin FUNCTION_LIST /end FUNCTION_LIST /end MEASUREMENT
/begin MEASUREMENT vCANDAT1A5 "RAM value vCANDAT1A5" UBYTE COMP_0068 1 100 0 255 ECU_ADDRESS 0xFFFF3A54 /begin FUNCTION_LIST /end FUNCTION_LIST /end MEASUREMENT
/begin MEASUREMENT vCANDAT1A6 "RAM value vCANDAT1A6" UBYTE COMP_0068 1 100 0 255 ECU_ADDRESS 0xFFFF3A55 /begin FUNCTION_LIST /end FUNCTION_LIST /end MEASUREMENT
/begin MEASUREMENT vCANDAT1A7 "RAM value vCANDAT1A7" UBYTE COMP_0068 1 100 0 255 ECU_ADDRESS 0xFFFF3A56 /begin FUNCTION_LIST /end FUNCTION_LIST /end MEASUREMENT
/begin MEASUREMENT vCANDAT1A8 "RAM value vCANDAT1A8" UBYTE COMP_0068 1 100 0 255 ECU_ADDRESS 0xFFFF3A57 /begin FUNCTION_LIST /end FUNCTION_LIST /end MEASUREMENT
/begin MEASUREMENT vCANDAT1A9 "RAM value vCANDAT1A9" UBYTE COMP_0068 1 100 0 255 ECU_ADDRESS 0xFFFF3A58 /begin FUNCTION_LIST /end FUNCTION_LIST /end MEASUREMENT
/begin MEASUREMENT vCANDAT1B0 "RAM value vCANDAT1B0" UBYTE COMP_0068 1 100 0 255 ECU_ADDRESS 0xFFFF3A59 /begin FUNCTION_LIST /end FUNCTION_LIST /end MEASUREMENT
/begin MEASUREMENT vCANDAT1B1 "RAM value vCANDAT1B1" UBYTE COMP_0068 1 100 0 255 ECU_ADDRESS 0xFFFF3A5A /begin FUNCTION_LIST /end FUNCTION_LIST /end MEASUREMENT
/begin MEASUREMENT vCANDAT1B2 "RAM value vCANDAT1B2" UBYTE COMP_0068 1 100 0 255 ECU_ADDRESS 0xFFFF3A5B /begin FUNCTION_LIST /end FUNCTION_LIST /end MEASUREMENT
/begin MEASUREMENT vCANDAT1B3 "RAM value vCANDAT1B3" UBYTE COMP_0068 1 100 0 255 ECU_ADDRESS 0xFFFF3A5C /begin FUNCTION_LIST /end FUNCTION_LIST /end MEASUREMENT
/begin MEASUREMENT vCANDAT1B4 "RAM value vCANDAT1B4" UBYTE COMP_0068 1 100 0 255 ECU_ADDRESS 0xFFFF3A5D /begin FUNCTION_LIST /end FUNCTION_LIST /end MEASUREMENT
/begin MEASUREMENT vCANDAT1B5 "RAM value vCANDAT1B5" UBYTE COMP_0068 1 100 0 255 ECU_ADDRESS 0xFFFF3A5E /begin FUNCTION_LIST /end FUNCTION_LIST /end MEASUREMENT
/begin MEASUREMENT vCANDAT1B6 "RAM value vCANDAT1B6" UBYTE COMP_0068 1 100 0 255 ECU_ADDRESS 0xFFFF3A5F /begin FUNCTION_LIST /end FUNCTION_LIST /end MEASUREMENT
/begin MEASUREMENT vCANDAT1B7 "RAM value vCANDAT1B7" UBYTE COMP_0068 1 100 0 255 ECU_ADDRESS 0xFFFF3A60 /begin FUNCTION_LIST /end FUNCTION_LIST /end MEASUREMENT
/begin MEASUREMENT vCANDAT1B8 "RAM value vCANDAT1B8" UBYTE COMP_0068 1 100 0 255 ECU_ADDRESS 0xFFFF3A61 /begin FUNCTION_LIST /end FUNCTION_LIST /end MEASUREMENT
/begin MEASUREMENT vCANDAT1B9 "RAM value vCANDAT1B9" UBYTE COMP_0068 1 100 0 255 ECU_ADDRESS 0xFFFF3A62 /begin FUNCTION_LIST /end FUNCTION_LIST /end MEASUREMENT
/begin MEASUREMENT vCANDAT1C0 "RAM value vCANDAT1C0" UBYTE COMP_0068 1 100 0 255 ECU_ADDRESS 0xFFFF3A63 /begin FUNCTION_LIST /end FUNCTION_LIST /end MEASUREMENT
/begin MEASUREMENT vCANDAT1C1 "RAM value vCANDAT1C1" UBYTE COMP_0068 1 100 0 255 ECU_ADDRESS 0xFFFF3A64 /begin FUNCTION_LIST /end FUNCTION_LIST /end MEASUREMENT
/begin MEASUREMENT vCANDAT1C2 "RAM value vCANDAT1C2" UBYTE COMP_0068 1 100 0 255 ECU_ADDRESS 0xFFFF3A65 /begin FUNCTION_LIST /end FUNCTION_LIST /end MEASUREMENT
/begin MEASUREMENT vCANDAT1C3 "RAM value vCANDAT1C3" UBYTE COMP_0068 1 100 0 255 ECU_ADDRESS 0xFFFF3A66 /begin FUNCTION_LIST /end FUNCTION_LIST /end MEASUREMENT
/begin MEASUREMENT vCANDAT1C4 "RAM value vCANDAT1C4" UBYTE COMP_0068 1 100 0 255 ECU_ADDRESS 0xFFFF3A67 /begin FUNCTION_LIST /end FUNCTION_LIST /end MEASUREMENT
/begin MEASUREMENT vCANDAT1C5 "RAM value vCANDAT1C5" UBYTE COMP_0068 1 100 0 255 ECU_ADDRESS 0xFFFF3A68 /begin FUNCTION_LIST /end FUNCTION_LIST /end MEASUREMENT
/begin MEASUREMENT vCANDAT1C6 "RAM value vCANDAT1C6" UBYTE COMP_0068 1 100 0 255 ECU_ADDRESS 0xFFFF3A69 /begin FUNCTION_LIST /end FUNCTION_LIST /end MEASUREMENT
/begin MEASUREMENT vCANDAT1C7 "RAM value vCANDAT1C7" UBYTE COMP_0068 1 100 0 255 ECU_ADDRESS 0xFFFF3A6A /begin FUNCTION_LIST /end FUNCTION_LIST /end MEASUREMENT
/begin MEASUREMENT vCANDAT1C8 "RAM value vCANDAT1C8" UBYTE COMP_0068 1 100 0 255 ECU_ADDRESS 0xFFFF3A6B /begin FUNCTION_LIST /end FUNCTION_LIST /end MEASUREMENT
/begin MEASUREMENT vCANDAT1C9 "RAM value vCANDAT1C9" UBYTE COMP_0068 1 100 0 255 ECU_ADDRESS 0xFFFF3A6C /begin FUNCTION_LIST /end FUNCTION_LIST /end MEASUREMENT
/begin MEASUREMENT vCANDAT1D0 "RAM value vCANDAT1D0" UBYTE COMP_0068 1 100 0 255 ECU_ADDRESS 0xFFFF3A6D /begin FUNCTION_LIST /end FUNCTION_LIST /end MEASUREMENT
/begin MEASUREMENT vCANDAT1D1 "RAM value vCANDAT1D1" UBYTE COMP_0068 1 100 0 255 ECU_ADDRESS 0xFFFF3A6E /begin FUNCTION_LIST /end FUNCTION_LIST /end MEASUREMENT
/begin MEASUREMENT vCANDAT1D2 "RAM value vCANDAT1D2" UBYTE COMP_0068 1 100 0 255 ECU_ADDRESS 0xFFFF3A6F /begin FUNCTION_LIST /end FUNCTION_LIST /end MEASUREMENT
/begin MEASUREMENT vCANDAT1D3 "RAM value vCANDAT1D3" UBYTE COMP_0068 1 100 0 255 ECU_ADDRESS 0xFFFF3A70 /begin FUNCTION_LIST /end FUNCTION_LIST /end MEASUREMENT
/begin MEASUREMENT vCANDAT1D4 "RAM value vCANDAT1D4" UBYTE COMP_0068 1 100 0 255 ECU_ADDRESS 0xFFFF3A71 /begin FUNCTION_LIST /end FUNCTION_LIST /end MEASUREMENT
/begin MEASUREMENT vCANDAT1D5 "RAM value vCANDAT1D5" UBYTE COMP_0068 1 100 0 255 ECU_ADDRESS 0xFFFF3A72 /begin FUNCTION_LIST /end FUNCTION_LIST /end MEASUREMENT
/begin MEASUREMENT vCANDAT1D6 "RAM value vCANDAT1D6" UBYTE COMP_0068 1 100 0 255 ECU_ADDRESS 0xFFFF3A73 /begin FUNCTION_LIST /end FUNCTION_LIST /end MEASUREMENT
/begin MEASUREMENT vCANDAT1D7 "RAM value vCANDAT1D7" UBYTE COMP_0068 1 100 0 255 ECU_ADDRESS 0xFFFF3A74 /begin FUNCTION_LIST /end FUNCTION_LIST /end MEASUREMENT
/begin MEASUREMENT vCANDAT1D8 "RAM value vCANDAT1D8" UBYTE COMP_0068 1 100 0 255 ECU_ADDRESS 0xFFFF3A75 /begin FUNCTION_LIST /end FUNCTION_LIST /end MEASUREMENT
/begin MEASUREMENT vCANDAT1D9 "RAM value vCANDAT1D9" UBYTE COMP_0068 1 100 0 255 ECU_ADDRESS 0xFFFF3A76 /begin FUNCTION_LIST /end FUNCTION_LIST /end MEASUREMENT
/begin MEASUREMENT vM1MIN1 "RAM value vM1MIN1" ULONG COMP_0068 1 100 0 4294967295 ECU_ADDRESS 0xFFFFAA46 /begin FUNCTION_LIST /end FUNCTION_LIST /end MEASUREMENT
/begin MEASUREMENT vM1MIN2 "RAM value vM1MIN2" ULONG COMP_0068 1 100 0 4294967295 ECU_ADDRESS 0xFFFFAA4A /begin FUNCTION_LIST /end FUNCTION_LIST /end MEASUREMENT
/begin MEASUREMENT vM1MIN3 "RAM value vM1MIN3" ULONG COMP_0068 1 100 0 4294967295 ECU_ADDRESS 0xFFFFAA4E /begin FUNCTION_LIST /end FUNCTION_LIST /end MEASUREMENT
/begin MEASUREMENT vM1MIN4 "RAM value vM1MIN4" ULONG COMP_0068 1 100 0 4294967295 ECU_ADDRESS 0xFFFFAA52 /begin FUNCTION_LIST /end FUNCTION_LIST /end MEASUREMENT
/begin MEASUREMENT vM1MAX1 "RAM value vM1MAX1" ULONG COMP_0068 1 100 0 4294967295 ECU_ADDRESS 0xFFFFAA56 /begin FUNCTION_LIST /end FUNCTION_LIST /end MEASUREMENT
/begin MEASUREMENT vM1MAX2 "RAM value vM1MAX2" ULONG COMP_0068 1 100 0 4294967295 ECU_ADDRESS 0xFFFFAA5A /begin FUNCTION_LIST /end FUNCTION_LIST /end MEASUREMENT
/begin MEASUREMENT vM1MAX3 "RAM value vM1MAX3" ULONG COMP_0068 1 100 0 4294967295 ECU_ADDRESS 0xFFFFAA5E /begin FUNCTION_LIST /end FUNCTION_LIST /end MEASUREMENT
/begin MEASUREMENT vM1MAX4 "RAM value vM1MAX4" ULONG COMP_0068 1 100 0 4294967295 ECU_ADDRESS 0xFFFFAA62 /begin FUNCTION_LIST /end FUNCTION_LIST /end MEASUREMENT
/begin MEASUREMENT vM2MIN1 "RAM value vM2MIN1" ULONG COMP_0068 1 100 0 4294967295 ECU_ADDRESS 0xFFFFAA66 /begin FUNCTION_LIST /end FUNCTION_LIST /end MEASUREMENT
/begin MEASUREMENT vM2MIN2 "RAM value vM2MIN2" ULONG COMP_0068 1 100 0 4294967295 ECU_ADDRESS 0xFFFFAA6A /begin FUNCTION_LIST /end FUNCTION_LIST /end MEASUREMENT
/begin MEASUREMENT vM2MIN3 "RAM value vM2MIN3" ULONG COMP_0068 1 100 0 4294967295 ECU_ADDRESS 0xFFFFAA6E /begin FUNCTION_LIST /end FUNCTION_LIST /end MEASUREMENT
/begin MEASUREMENT vM2MIN4 "RAM value vM2MIN4" ULONG COMP_0068 1 100 0 4294967295 ECU_ADDRESS 0xFFFFAA72 /begin FUNCTION_LIST /end FUNCTION_LIST /end MEASUREMENT
/begin MEASUREMENT vM2MIN5 "RAM value vM2MIN5" ULONG COMP_0068 1 100 0 4294967295 ECU_ADDRESS 0xFFFFAA76 /begin FUNCTION_LIST /end FUNCTION_LIST /end MEASUREMENT
/begin MEASUREMENT vM2MIN6 "RAM value vM2MIN6" ULONG COMP_0068 1 100 0 4294967295 ECU_ADDRESS 0xFFFFAA7A /begin FUNCTION_LIST /end FUNCTION_LIST /end MEASUREMENT
/begin MEASUREMENT vM2MIN7 "RAM value vM2MIN7" ULONG COMP_0068 1 100 0 4294967295 ECU_ADDRESS 0xFFFFAA7E /begin FUNCTION_LIST /end FUNCTION_LIST /end MEASUREMENT
/begin MEASUREMENT vM2MIN8 "RAM value vM2MIN8" ULONG COMP_0068 1 100 0 4294967295 ECU_ADDRESS 0xFFFFAA82 /begin FUNCTION_LIST /end FUNCTION_LIST /end MEASUREMENT
/begin MEASUREMENT vM2MAX1 "RAM value vM2MAX1" ULONG COMP_0068 1 100 0 4294967295 ECU_ADDRESS 0xFFFFAA86 /begin FUNCTION_LIST /end FUNCTION_LIST /end MEASUREMENT
/begin MEASUREMENT vM2MAX2 "RAM value vM2MAX2" ULONG COMP_0068 1 100 0 4294967295 ECU_ADDRESS 0xFFFFAA8A /begin FUNCTION_LIST /end FUNCTION_LIST /end MEASUREMENT
/begin MEASUREMENT vM2MAX3 "RAM value vM2MAX3" ULONG COMP_0068 1 100 0 4294967295 ECU_ADDRESS 0xFFFFAA8E /begin FUNCTION_LIST /end FUNCTION_LIST /end MEASUREMENT
/begin MEASUREMENT vM2MAX4 "RAM value vM2MAX4" ULONG COMP_0068 1 100 0 4294967295 ECU_ADDRESS 0xFFFFAA92 /begin FUNCTION_LIST /end FUNCTION_LIST /end MEASUREMENT
/begin MEASUREMENT vM2MAX5 "RAM value vM2MAX5" ULONG COMP_0068 1 100 0 4294967295 ECU_ADDRESS 0xFFFFAA96 /begin FUNCTION_LIST /end FUNCTION_LIST /end MEASUREMENT
/begin MEASUREMENT vM2MAX6 "RAM value vM2MAX6" ULONG COMP_0068 1 100 0 4294967295 ECU_ADDRESS 0xFFFFAA9A /begin FUNCTION_LIST /end FUNCTION_LIST /end MEASUREMENT
/begin MEASUREMENT vM2MAX7 "RAM value vM2MAX7" ULONG COMP_0068 1 100 0 4294967295 ECU_ADDRESS 0xFFFFAA9E /begin FUNCTION_LIST /end FUNCTION_LIST /end MEASUREMENT
/begin MEASUREMENT vM2MAX8 "RAM value vM2MAX8" ULONG COMP_0068 1 100 0 4294967295 ECU_ADDRESS 0xFFFFAAA2 /begin FUNCTION_LIST /end FUNCTION_LIST /end MEASUREMENT
/begin MEASUREMENT vVSPNG1 "RAM value vVSPNG1" UBYTE COMP_0068 1 100 0 255 ECU_ADDRESS 0xFFFF9C6D /begin FUNCTION_LIST /end FUNCTION_LIST /end MEASUREMENT
/begin MEASUREMENT vVSPNG2 "RAM value vVSPNG2" UBYTE COMP_0068 1 100 0 255 ECU_ADDRESS 0xFFFF9C6E /begin FUNCTION_LIST /end FUNCTION_LIST /end MEASUREMENT
/begin MEASUREMENT vCUNG1 "RAM value vCUNG1" UBYTE COMP_0068 1 100 0 255 ECU_ADDRESS 0xFFFF9C73 /begin FUNCTION_LIST /end FUNCTION_LIST /end MEASUREMENT
/begin MEASUREMENT vCUNG2 "RAM value vCUNG2" UBYTE COMP_0068 1 100 0 255 ECU_ADDRESS 0xFFFF9C74 /begin FUNCTION_LIST /end FUNCTION_LIST /end MEASUREMENT
/begin MEASUREMENT vO2CLB21 "RAM value vO2CLB21" UBYTE COMP_0068 1 100 0 255 ECU_ADDRESS 0xFFFF9C79 /begin FUNCTION_LIST /end FUNCTION_LIST /end MEASUREMENT
/begin MEASUREMENT vO2CLB22 "RAM value vO2CLB22" UBYTE COMP_0068 1 100 0 255 ECU_ADDRESS 0xFFFF9C7A /begin FUNCTION_LIST /end FUNCTION_LIST /end MEASUREMENT
/begin MEASUREMENT vMF5NG1 "RAM value vMF5NG1" UBYTE COMP_0068 1 100 0 255 ECU_ADDRESS 0xFFFF9C7F /begin FUNCTION_LIST /end FUNCTION_LIST /end MEASUREMENT
/begin MEASUREMENT vMF5NG2 "RAM value vMF5NG2" UBYTE COMP_0068 1 100 0 255 ECU_ADDRESS 0xFFFF9C80 /begin FUNCTION_LIST /end FUNCTION_LIST /end MEASUREMENT
/begin MEASUREMENT vMF3NG1 "RAM value vMF3NG1" UBYTE COMP_0068 1 100 0 255 ECU_ADDRESS 0xFFFF9C85 /begin FUNCTION_LIST /end FUNCTION_LIST /end MEASUREMENT
/begin MEASUREMENT vMF3NG2 "RAM value vMF3NG2" UBYTE COMP_0068 1 100 0 255 ECU_ADDRESS 0xFFFF9C86 /begin FUNCTION_LIST /end FUNCTION_LIST /end MEASUREMENT
/begin MEASUREMENT vMF1NG1 "RAM value vMF1NG1" UBYTE COMP_0068 1 100 0 255 ECU_ADDRESS 0xFFFF9C8B /begin FUNCTION_LIST /end FUNCTION_LIST /end MEASUREMENT
/begin MEASUREMENT vMF1NG2 "RAM value vMF1NG2" UBYTE COMP_0068 1 100 0 255 ECU_ADDRESS 0xFFFF9C8C /begin FUNCTION_LIST /end FUNCTION_LIST /end MEASUREMENT
/begin MEASUREMENT vCAT1NG1 "RAM value vCAT1NG1" UBYTE COMP_0068 1 100 0 255 ECU_ADDRESS 0xFFFF9C91 /begin FUNCTION_LIST /end FUNCTION_LIST /end MEASUREMENT
/begin MEASUREMENT vCAT1NG2 "RAM value vCAT1NG2" UBYTE COMP_0068 1 100 0 255 ECU_ADDRESS 0xFFFF9C92 /begin FUNCTION_LIST /end FUNCTION_LIST /end MEASUREMENT
/begin MEASUREMENT vMRNG1 "RAM value vMRNG1" UBYTE COMP_0068 1 100 0 255 ECU_ADDRESS 0xFFFF9C97 /begin FUNCTION_LIST /end FUNCTION_LIST /end MEASUREMENT
/begin MEASUREMENT vMRNG2_1 "RAM value vMRNG2" UWORD COMP_0068 1 100 0 65535 ECU_ADDRESS 0xFFFF9C9A /begin FUNCTION_LIST /end FUNCTION_LIST /end MEASUREMENT
/begin MEASUREMENT vTWCLNG1 "RAM value vTWCLNG1" UBYTE COMP_0068 1 100 0 255 ECU_ADDRESS 0xFFFF9C9D /begin FUNCTION_LIST /end FUNCTION_LIST /end MEASUREMENT
/begin MEASUREMENT vTWCLNG2 "RAM value vTWCLNG2" UBYTE COMP_0068 1 100 0 255 ECU_ADDRESS 0xFFFF9C9E /begin FUNCTION_LIST /end FUNCTION_LIST /end MEASUREMENT
/begin MEASUREMENT vVTCSV11 "RAM value vVTCSV11" UBYTE COMP_0068 1 100 0 255 ECU_ADDRESS 0xFFFF9CA3 /begin FUNCTION_LIST /end FUNCTION_LIST /end MEASUREMENT
/begin MEASUREMENT vVTCSV12 "RAM value vVTCSV12" UBYTE COMP_0068 1 100 0 255 ECU_ADDRESS 0xFFFF9CA4 /begin FUNCTION_LIST /end FUNCTION_LIST /end MEASUREMENT
/begin MEASUREMENT vVIASDN1 "RAM value vVIASDN1" UBYTE COMP_0068 1 100 0 255 ECU_ADDRESS 0xFFFF9CA9 /begin FUNCTION_LIST /end FUNCTION_LIST /end MEASUREMENT
/begin MEASUREMENT vVIASDN2 "RAM value vVIASDN2" UBYTE COMP_0068 1 100 0 255 ECU_ADDRESS 0xFFFF9CAA /begin FUNCTION_LIST /end FUNCTION_LIST /end MEASUREMENT
/begin MEASUREMENT vDCS2NG1 "RAM value vDCS2NG1" UBYTE COMP_0068 1 100 0 255 ECU_ADDRESS 0xFFFF9CAF /begin FUNCTION_LIST /end FUNCTION_LIST /end MEASUREMENT
/begin MEASUREMENT vDCS2NG2 "RAM value vDCS2NG2" UBYTE COMP_0068 1 100 0 255 ECU_ADDRESS 0xFFFF9CB0 /begin FUNCTION_LIST /end FUNCTION_LIST /end MEASUREMENT
/begin MEASUREMENT vDPS1NG1 "RAM value vDPS1NG1" UBYTE COMP_0068 1 100 0 255 ECU_ADDRESS 0xFFFF9CB5 /begin FUNCTION_LIST /end FUNCTION_LIST /end MEASUREMENT
/begin MEASUREMENT vDPS1NG2 "RAM value vDPS1NG2" UBYTE COMP_0068 1 100 0 255 ECU_ADDRESS 0xFFFF9CB6 /begin FUNCTION_LIST /end FUNCTION_LIST /end MEASUREMENT
/begin MEASUREMENT vDPS3NG1 "RAM value vDPS3NG1" UBYTE COMP_0068 1 100 0 255 ECU_ADDRESS 0xFFFF9CBB /begin FUNCTION_LIST /end FUNCTION_LIST /end MEASUREMENT
/begin MEASUREMENT vDPS3NG2 "RAM value vDPS3NG2" UBYTE COMP_0068 1 100 0 255 ECU_ADDRESS 0xFFFF9CBC /begin FUNCTION_LIST /end FUNCTION_LIST /end MEASUREMENT
/begin MEASUREMENT vSYNCNG1 "RAM value vSYNCNG1" UBYTE COMP_0068 1 100 0 255 ECU_ADDRESS 0xFFFF9CC1 /begin FUNCTION_LIST /end FUNCTION_LIST /end MEASUREMENT
/begin MEASUREMENT vSYNCNG2 "RAM value vSYNCNG2" UBYTE COMP_0068 1 100 0 255 ECU_ADDRESS 0xFFFF9CC2 /begin FUNCTION_LIST /end FUNCTION_LIST /end MEASUREMENT
/begin MEASUREMENT vQCKNG1 "RAM value vQCKNG1" UBYTE COMP_0068 1 100 0 255 ECU_ADDRESS 0xFFFF9CC7 /begin FUNCTION_LIST /end FUNCTION_LIST /end MEASUREMENT
/begin MEASUREMENT vQCKNG2 "RAM value vQCKNG2" UBYTE COMP_0068 1 100 0 255 ECU_ADDRESS 0xFFFF9CC8 /begin FUNCTION_LIST /end FUNCTION_LIST /end MEASUREMENT
/begin MEASUREMENT vADNG1 "RAM value vADNG1" UBYTE COMP_0068 1 100 0 255 ECU_ADDRESS 0xFFFF9CCD /begin FUNCTION_LIST /end FUNCTION_LIST /end MEASUREMENT
/begin MEASUREMENT vADNG2 "RAM value vADNG2" UBYTE COMP_0068 1 100 0 255 ECU_ADDRESS 0xFFFF9CCE /begin FUNCTION_LIST /end FUNCTION_LIST /end MEASUREMENT
/begin MEASUREMENT vTPS4NG1 "RAM value vTPS4NG1" UBYTE COMP_0068 1 100 0 255 ECU_ADDRESS 0xFFFF9CD3 /begin FUNCTION_LIST /end FUNCTION_LIST /end MEASUREMENT
/begin MEASUREMENT vTPS4NG2 "RAM value vTPS4NG2" UBYTE COMP_0068 1 100 0 255 ECU_ADDRESS 0xFFFF9CD4 /begin FUNCTION_LIST /end FUNCTION_LIST /end MEASUREMENT
/begin MEASUREMENT vVAPXNG1 "RAM value vVAPXNG1" UBYTE COMP_0068 1 100 0 255 ECU_ADDRESS 0xFFFF9CD9 /begin FUNCTION_LIST /end FUNCTION_LIST /end MEASUREMENT
/begin MEASUREMENT vVAPXNG2 "RAM value vVAPXNG2" UBYTE COMP_0068 1 100 0 255 ECU_ADDRESS 0xFFFF9CDA /begin FUNCTION_LIST /end FUNCTION_LIST /end MEASUREMENT
/begin MEASUREMENT vTGTXNG1 "RAM value vTGTXNG1" UBYTE COMP_0068 1 100 0 255 ECU_ADDRESS 0xFFFF9CDF /begin FUNCTION_LIST /end FUNCTION_LIST /end MEASUREMENT
/begin MEASUREMENT vTGTXNG2 "RAM value vTGTXNG2" UBYTE COMP_0068 1 100 0 255 ECU_ADDRESS 0xFFFF9CE0 /begin FUNCTION_LIST /end FUNCTION_LIST /end MEASUREMENT
/begin MEASUREMENT vASTRNG1 "RAM value vASTRNG1" UBYTE COMP_0068 1 100 0 255 ECU_ADDRESS 0xFFFF9CE5 /begin FUNCTION_LIST /end FUNCTION_LIST /end MEASUREMENT
/begin MEASUREMENT vASTRNG2 "RAM value vASTRNG2" UBYTE COMP_0068 1 100 0 255 ECU_ADDRESS 0xFFFF9CE6 /begin FUNCTION_LIST /end FUNCTION_LIST /end MEASUREMENT
/begin MEASUREMENT vTEPDNG1 "RAM value vTEPDNG1" UBYTE COMP_0068 1 100 0 255 ECU_ADDRESS 0xFFFF9CEB /begin FUNCTION_LIST /end FUNCTION_LIST /end MEASUREMENT
/begin MEASUREMENT vTEPDNG2 "RAM value vTEPDNG2" UBYTE COMP_0068 1 100 0 255 ECU_ADDRESS 0xFFFF9CEC /begin FUNCTION_LIST /end FUNCTION_LIST /end MEASUREMENT
/begin MEASUREMENT vTTEPNG1 "RAM value vTTEPNG1" UBYTE COMP_0068 1 100 0 255 ECU_ADDRESS 0xFFFF9CF1 /begin FUNCTION_LIST /end FUNCTION_LIST /end MEASUREMENT
/begin MEASUREMENT vTTEPNG2 "RAM value vTTEPNG2" UBYTE COMP_0068 1 100 0 255 ECU_ADDRESS 0xFFFF9CF2 /begin FUNCTION_LIST /end FUNCTION_LIST /end MEASUREMENT
/begin MEASUREMENT vRLOFNG1 "RAM value vRLOFNG1" UBYTE COMP_0068 1 100 0 255 ECU_ADDRESS 0xFFFF9CF7 /begin FUNCTION_LIST /end FUNCTION_LIST /end MEASUREMENT
/begin MEASUREMENT vRLOFNG2 "RAM value vRLOFNG2" UBYTE COMP_0068 1 100 0 255 ECU_ADDRESS 0xFFFF9CF8 /begin FUNCTION_LIST /end FUNCTION_LIST /end MEASUREMENT
/begin MEASUREMENT vVSPRNG1 "RAM value vVSPRNG1" UBYTE COMP_0068 1 100 0 255 ECU_ADDRESS 0xFFFF9CFD /begin FUNCTION_LIST /end FUNCTION_LIST /end MEASUREMENT
/begin MEASUREMENT vVSPRNG2 "RAM value vVSPRNG2" UBYTE COMP_0068 1 100 0 255 ECU_ADDRESS 0xFFFF9CFE /begin FUNCTION_LIST /end FUNCTION_LIST /end MEASUREMENT
/begin MEASUREMENT vRTSPNG1 "RAM value vRTSPNG1" UBYTE COMP_0068 1 100 0 255 ECU_ADDRESS 0xFFFF9D03 /begin FUNCTION_LIST /end FUNCTION_LIST /end MEASUREMENT
/begin MEASUREMENT vRTSPNG2 "RAM value vRTSPNG2" UBYTE COMP_0068 1 100 0 255 ECU_ADDRESS 0xFFFF9D04 /begin FUNCTION_LIST /end FUNCTION_LIST /end MEASUREMENT
/begin MEASUREMENT vTHOPNG1 "RAM value vTHOPNG1" UBYTE COMP_0068 1 100 0 255 ECU_ADDRESS 0xFFFF9D09 /begin FUNCTION_LIST /end FUNCTION_LIST /end MEASUREMENT
/begin MEASUREMENT vTHOPNG2 "RAM value vTHOPNG2" UBYTE COMP_0068 1 100 0 255 ECU_ADDRESS 0xFFFF9D0A /begin FUNCTION_LIST /end FUNCTION_LIST /end MEASUREMENT
/begin MEASUREMENT vSSOFNG1 "RAM value vSSOFNG1" UBYTE COMP_0068 1 100 0 255 ECU_ADDRESS 0xFFFF9D0F /begin FUNCTION_LIST /end FUNCTION_LIST /end MEASUREMENT
/begin MEASUREMENT vSSOFNG2 "RAM value vSSOFNG2" UBYTE COMP_0068 1 100 0 255 ECU_ADDRESS 0xFFFF9D10 /begin FUNCTION_LIST /end FUNCTION_LIST /end MEASUREMENT
/begin MEASUREMENT vROMNGM1 "RAM value vROMNGM1" UBYTE COMP_0068 1 100 0 255 ECU_ADDRESS 0xFFFF9D15 /begin FUNCTION_LIST /end FUNCTION_LIST /end MEASUREMENT
/begin MEASUREMENT vROMNGM2 "RAM value vROMNGM2" UBYTE COMP_0068 1 100 0 255 ECU_ADDRESS 0xFFFF9D16 /begin FUNCTION_LIST /end FUNCTION_LIST /end MEASUREMENT
/begin MEASUREMENT vWDTNGM1 "RAM value vWDTNGM1" UBYTE COMP_0068 1 100 0 255 ECU_ADDRESS 0xFFFF9D1B /begin FUNCTION_LIST /end FUNCTION_LIST /end MEASUREMENT
/begin MEASUREMENT vWDTNGM2 "RAM value vWDTNGM2" UBYTE COMP_0068 1 100 0 255 ECU_ADDRESS 0xFFFF9D1C /begin FUNCTION_LIST /end FUNCTION_LIST /end MEASUREMENT
/begin MEASUREMENT vEPWNGM1 "RAM value vEPWNGM1" UBYTE COMP_0068 1 100 0 255 ECU_ADDRESS 0xFFFF9D21 /begin FUNCTION_LIST /end FUNCTION_LIST /end MEASUREMENT
/begin MEASUREMENT vEPWNGM2 "RAM value vEPWNGM2" UBYTE COMP_0068 1 100 0 255 ECU_ADDRESS 0xFFFF9D22 /begin FUNCTION_LIST /end FUNCTION_LIST /end MEASUREMENT
/begin MEASUREMENT vRANGM21 "RAM value vRANGM21" UBYTE COMP_0068 1 100 0 255 ECU_ADDRESS 0xFFFF9D27 /begin FUNCTION_LIST /end FUNCTION_LIST /end MEASUREMENT
/begin MEASUREMENT vRANGM22 "RAM value vRANGM22" UBYTE COMP_0068 1 100 0 255 ECU_ADDRESS 0xFFFF9D28 /begin FUNCTION_LIST /end FUNCTION_LIST /end MEASUREMENT
/begin MEASUREMENT vDC22NG1 "RAM value vDC22NG1" UBYTE COMP_0068 1 100 0 255 ECU_ADDRESS 0xFFFF9D2D /begin FUNCTION_LIST /end FUNCTION_LIST /end MEASUREMENT
/begin MEASUREMENT vDC22NG2 "RAM value vDC22NG2" UBYTE COMP_0068 1 100 0 255 ECU_ADDRESS 0xFFFF9D2E /begin FUNCTION_LIST /end FUNCTION_LIST /end MEASUREMENT
/begin MEASUREMENT vAFLNG11 "RAM value vAFLNG11" UBYTE COMP_0068 1 100 0 255 ECU_ADDRESS 0xFFFF9D33 /begin FUNCTION_LIST /end FUNCTION_LIST /end MEASUREMENT
/begin MEASUREMENT vAFLNG12 "RAM value vAFLNG12" UBYTE COMP_0068 1 100 0 255 ECU_ADDRESS 0xFFFF9D34 /begin FUNCTION_LIST /end FUNCTION_LIST /end MEASUREMENT
/begin MEASUREMENT vAFLLS1 "RAM value vAFLLS1" UBYTE COMP_0068 1 100 0 255 ECU_ADDRESS 0xFFFF9D39 /begin FUNCTION_LIST /end FUNCTION_LIST /end MEASUREMENT
/begin MEASUREMENT vAFLLS2 "RAM value vAFLLS2" UBYTE COMP_0068 1 100 0 255 ECU_ADDRESS 0xFFFF9D3A /begin FUNCTION_LIST /end FUNCTION_LIST /end MEASUREMENT
/begin MEASUREMENT vAFLAV1 "RAM value vAFLAV1" UBYTE COMP_0068 1 100 0 255 ECU_ADDRESS 0xFFFF9D3F /begin FUNCTION_LIST /end FUNCTION_LIST /end MEASUREMENT
/begin MEASUREMENT vAFLAV2 "RAM value vAFLAV2" UBYTE COMP_0068 1 100 0 255 ECU_ADDRESS 0xFFFF9D40 /begin FUNCTION_LIST /end FUNCTION_LIST /end MEASUREMENT
/begin MEASUREMENT vAFRNG21 "RAM value vAFRNG21" UBYTE COMP_0068 1 100 0 255 ECU_ADDRESS 0xFFFF9D45 /begin FUNCTION_LIST /end FUNCTION_LIST /end MEASUREMENT
/begin MEASUREMENT vAFRNG22 "RAM value vAFRNG22" UBYTE COMP_0068 1 100 0 255 ECU_ADDRESS 0xFFFF9D46 /begin FUNCTION_LIST /end FUNCTION_LIST /end MEASUREMENT
/begin MEASUREMENT vAFRRS1 "RAM value vAFRRS1" UBYTE COMP_0068 1 100 0 255 ECU_ADDRESS 0xFFFF9D4B /begin FUNCTION_LIST /end FUNCTION_LIST /end MEASUREMENT
/begin MEASUREMENT vAFRRS2 "RAM value vAFRRS2" UBYTE COMP_0068 1 100 0 255 ECU_ADDRESS 0xFFFF9D4C /begin FUNCTION_LIST /end FUNCTION_LIST /end MEASUREMENT
/begin MEASUREMENT vISCNGL1 "RAM value vISCNGL1" UBYTE COMP_0068 1 100 0 255 ECU_ADDRESS 0xFFFF9D51 /begin FUNCTION_LIST /end FUNCTION_LIST /end MEASUREMENT
/begin MEASUREMENT vISCNGL2 "RAM value vISCNGL2" UBYTE COMP_0068 1 100 0 255 ECU_ADDRESS 0xFFFF9D52 /begin FUNCTION_LIST /end FUNCTION_LIST /end MEASUREMENT
/begin MEASUREMENT vO2R1O1 "RAM value vO2R1O1" UBYTE COMP_0068 1 100 0 255 ECU_ADDRESS 0xFFFF9D57 /begin FUNCTION_LIST /end FUNCTION_LIST /end MEASUREMENT
/begin MEASUREMENT vO2R1O2 "RAM value vO2R1O2" UBYTE COMP_0068 1 100 0 255 ECU_ADDRESS 0xFFFF9D58 /begin FUNCTION_LIST /end FUNCTION_LIST /end MEASUREMENT
/begin MEASUREMENT vO2R1L1 "RAM value vO2R1L1" UBYTE COMP_0068 1 100 0 255 ECU_ADDRESS 0xFFFF9D5D /begin FUNCTION_LIST /end FUNCTION_LIST /end MEASUREMENT
/begin MEASUREMENT vO2R1L2 "RAM value vO2R1L2" UBYTE COMP_0068 1 100 0 255 ECU_ADDRESS 0xFFFF9D5E /begin FUNCTION_LIST /end FUNCTION_LIST /end MEASUREMENT
/begin MEASUREMENT vO2R1R1 "RAM value vO2R1R1" UBYTE COMP_0068 1 100 0 255 ECU_ADDRESS 0xFFFF9D63 /begin FUNCTION_LIST /end FUNCTION_LIST /end MEASUREMENT
/begin MEASUREMENT vO2R1R2 "RAM value vO2R1R2" UBYTE COMP_0068 1 100 0 255 ECU_ADDRESS 0xFFFF9D64 /begin FUNCTION_LIST /end FUNCTION_LIST /end MEASUREMENT
/begin MEASUREMENT vO2R1H1 "RAM value vO2R1H1" UBYTE COMP_0068 1 100 0 255 ECU_ADDRESS 0xFFFF9D69 /begin FUNCTION_LIST /end FUNCTION_LIST /end MEASUREMENT
/begin MEASUREMENT vO2R1H2 "RAM value vO2R1H2" UBYTE COMP_0068 1 100 0 255 ECU_ADDRESS 0xFFFF9D6A /begin FUNCTION_LIST /end FUNCTION_LIST /end MEASUREMENT
/begin MEASUREMENT vRO2HH11 "RAM value vRO2HH11" UBYTE COMP_0068 1 100 0 255 ECU_ADDRESS 0xFFFF9D6F /begin FUNCTION_LIST /end FUNCTION_LIST /end MEASUREMENT
/begin MEASUREMENT vRO2HH12 "RAM value vRO2HH12" UBYTE COMP_0068 1 100 0 255 ECU_ADDRESS 0xFFFF9D70 /begin FUNCTION_LIST /end FUNCTION_LIST /end MEASUREMENT
/begin MEASUREMENT vRO2HL11 "RAM value vRO2HL11" UBYTE COMP_0068 1 100 0 255 ECU_ADDRESS 0xFFFF9D75 /begin FUNCTION_LIST /end FUNCTION_LIST /end MEASUREMENT
/begin MEASUREMENT vRO2HL12 "RAM value vRO2HL12" UBYTE COMP_0068 1 100 0 255 ECU_ADDRESS 0xFFFF9D76 /begin FUNCTION_LIST /end FUNCTION_LIST /end MEASUREMENT
/begin MEASUREMENT vKN1NGL1 "RAM value vKN1NGL1" UBYTE COMP_0068 1 100 0 255 ECU_ADDRESS 0xFFFF9D7B /begin FUNCTION_LIST /end FUNCTION_LIST /end MEASUREMENT
/begin MEASUREMENT vKN1NGL2 "RAM value vKN1NGL2" UBYTE COMP_0068 1 100 0 255 ECU_ADDRESS 0xFFFF9D7C /begin FUNCTION_LIST /end FUNCTION_LIST /end MEASUREMENT
/begin MEASUREMENT vKN2NGL1 "RAM value vKN2NGL1" UBYTE COMP_0068 1 100 0 255 ECU_ADDRESS 0xFFFF9D81 /begin FUNCTION_LIST /end FUNCTION_LIST /end MEASUREMENT
/begin MEASUREMENT vKN2NGL2 "RAM value vKN2NGL2" UBYTE COMP_0068 1 100 0 255 ECU_ADDRESS 0xFFFF9D82 /begin FUNCTION_LIST /end FUNCTION_LIST /end MEASUREMENT
/begin MEASUREMENT vAFMNGR1 "RAM value vAFMNGR1" UBYTE COMP_0068 1 100 0 255 ECU_ADDRESS 0xFFFF9D87 /begin FUNCTION_LIST /end FUNCTION_LIST /end MEASUREMENT
/begin MEASUREMENT vAFMNGR2 "RAM value vAFMNGR2" UBYTE COMP_0068 1 100 0 255 ECU_ADDRESS 0xFFFF9D88 /begin FUNCTION_LIST /end FUNCTION_LIST /end MEASUREMENT
/begin MEASUREMENT vAFMNGH1 "RAM value vAFMNGH1" UBYTE COMP_0068 1 100 0 255 ECU_ADDRESS 0xFFFF9D8D /begin FUNCTION_LIST /end FUNCTION_LIST /end MEASUREMENT
/begin MEASUREMENT vAFMNGH2 "RAM value vAFMNGH2" UBYTE COMP_0068 1 100 0 255 ECU_ADDRESS 0xFFFF9D8E /begin FUNCTION_LIST /end FUNCTION_LIST /end MEASUREMENT
/begin MEASUREMENT vTWNGL1 "RAM value vTWNGL1" UBYTE COMP_0068 1 100 0 255 ECU_ADDRESS 0xFFFF9D93 /begin FUNCTION_LIST /end FUNCTION_LIST /end MEASUREMENT
/begin MEASUREMENT vTWNGL2 "RAM value vTWNGL2" UBYTE COMP_0068 1 100 0 255 ECU_ADDRESS 0xFFFF9D94 /begin FUNCTION_LIST /end FUNCTION_LIST /end MEASUREMENT
/begin MEASUREMENT vTANGL1 "RAM value vTANGL1" UBYTE COMP_0068 1 100 0 255 ECU_ADDRESS 0xFFFF9D99 /begin FUNCTION_LIST /end FUNCTION_LIST /end MEASUREMENT
/begin MEASUREMENT vTANGL2 "RAM value vTANGL2" UBYTE COMP_0068 1 100 0 255 ECU_ADDRESS 0xFFFF9D9A /begin FUNCTION_LIST /end FUNCTION_LIST /end MEASUREMENT
/begin MEASUREMENT vTANGR1 "RAM value vTANGR1" UBYTE COMP_0068 1 100 0 255 ECU_ADDRESS 0xFFFF9D9F /begin FUNCTION_LIST /end FUNCTION_LIST /end MEASUREMENT
/begin MEASUREMENT vTANGR2 "RAM value vTANGR2" UBYTE COMP_0068 1 100 0 255 ECU_ADDRESS 0xFFFF9DA0 /begin FUNCTION_LIST /end FUNCTION_LIST /end MEASUREMENT
/begin MEASUREMENT vEVCNGS1 "RAM value vEVCNGS1" UBYTE COMP_0068 1 100 0 255 ECU_ADDRESS 0xFFFF9DA5 /begin FUNCTION_LIST /end FUNCTION_LIST /end MEASUREMENT
/begin MEASUREMENT vEVCNGS2 "RAM value vEVCNGS2" UBYTE COMP_0068 1 100 0 255 ECU_ADDRESS 0xFFFF9DA6 /begin FUNCTION_LIST /end FUNCTION_LIST /end MEASUREMENT
/begin MEASUREMENT vMRNR1 "RAM value vMRNR1" UBYTE COMP_0068 1 100 0 255 ECU_ADDRESS 0xFFFF9DAB /begin FUNCTION_LIST /end FUNCTION_LIST /end MEASUREMENT
/begin MEASUREMENT vMRNR21 "RAM value vMRNR21" UBYTE COMP_0068 1 100 0 255 ECU_ADDRESS 0xFFFF9DB1 /begin FUNCTION_LIST /end FUNCTION_LIST /end MEASUREMENT
/begin MEASUREMENT vMRNR22 "RAM value vMRNR22" UBYTE COMP_0068 1 100 0 255 ECU_ADDRESS 0xFFFF9DB2 /begin FUNCTION_LIST /end FUNCTION_LIST /end MEASUREMENT
/begin MEASUREMENT vVTCI1R1 "RAM value vVTCI1R1" UBYTE COMP_0068 1 100 0 255 ECU_ADDRESS 0xFFFF9DB7 /begin FUNCTION_LIST /end FUNCTION_LIST /end MEASUREMENT
/begin MEASUREMENT vVTCI1R2 "RAM value vVTCI1R2" UBYTE COMP_0068 1 100 0 255 ECU_ADDRESS 0xFFFF9DB8 /begin FUNCTION_LIST /end FUNCTION_LIST /end MEASUREMENT
/begin MEASUREMENT vPRSNGL1 "RAM value vPRSNGL1" UBYTE COMP_0068 1 100 0 255 ECU_ADDRESS 0xFFFF9DBD /begin FUNCTION_LIST /end FUNCTION_LIST /end MEASUREMENT
/begin MEASUREMENT vPRSNGL2 "RAM value vPRSNGL2" UBYTE COMP_0068 1 100 0 255 ECU_ADDRESS 0xFFFF9DBE /begin FUNCTION_LIST /end FUNCTION_LIST /end MEASUREMENT
/begin MEASUREMENT vAVCCSH1 "RAM value vAVCCSH1" UBYTE COMP_0068 1 100 0 255 ECU_ADDRESS 0xFFFF9DC3 /begin FUNCTION_LIST /end FUNCTION_LIST /end MEASUREMENT
/begin MEASUREMENT vAVCCSH2 "RAM value vAVCCSH2" UBYTE COMP_0068 1 100 0 255 ECU_ADDRESS 0xFFFF9DC4 /begin FUNCTION_LIST /end FUNCTION_LIST /end MEASUREMENT
/begin MEASUREMENT vTP1NGL1 "RAM value vTP1NGL1" UBYTE COMP_0068 1 100 0 255 ECU_ADDRESS 0xFFFF9DC9 /begin FUNCTION_LIST /end FUNCTION_LIST /end MEASUREMENT
/begin MEASUREMENT vTP1NGL2 "RAM value vTP1NGL2" UBYTE COMP_0068 1 100 0 255 ECU_ADDRESS 0xFFFF9DCA /begin FUNCTION_LIST /end FUNCTION_LIST /end MEASUREMENT
/begin MEASUREMENT vTP2NGL1 "RAM value vTP2NGL1" UBYTE COMP_0068 1 100 0 255 ECU_ADDRESS 0xFFFF9DCF /begin FUNCTION_LIST /end FUNCTION_LIST /end MEASUREMENT
/begin MEASUREMENT vTP2NGL2 "RAM value vTP2NGL2" UBYTE COMP_0068 1 100 0 255 ECU_ADDRESS 0xFFFF9DD0 /begin FUNCTION_LIST /end FUNCTION_LIST /end MEASUREMENT
/begin MEASUREMENT vTPLRLO1 "RAM value vTPLRLO1" UBYTE COMP_0068 1 100 0 255 ECU_ADDRESS 0xFFFF9DD5 /begin FUNCTION_LIST /end FUNCTION_LIST /end MEASUREMENT
/begin MEASUREMENT vTPLRLO2 "RAM value vTPLRLO2" UBYTE COMP_0068 1 100 0 255 ECU_ADDRESS 0xFFFF9DD6 /begin FUNCTION_LIST /end FUNCTION_LIST /end MEASUREMENT
/begin MEASUREMENT vVMOOPN1 "RAM value vVMOOPN1" UBYTE COMP_0068 1 100 0 255 ECU_ADDRESS 0xFFFF9DDB /begin FUNCTION_LIST /end FUNCTION_LIST /end MEASUREMENT
/begin MEASUREMENT vVMOOPN2 "RAM value vVMOOPN2" UBYTE COMP_0068 1 100 0 255 ECU_ADDRESS 0xFFFF9DDC /begin FUNCTION_LIST /end FUNCTION_LIST /end MEASUREMENT
/begin MEASUREMENT vMOTSHT1 "RAM value vMOTSHT1" UBYTE COMP_0068 1 100 0 255 ECU_ADDRESS 0xFFFF9DE1 /begin FUNCTION_LIST /end FUNCTION_LIST /end MEASUREMENT
/begin MEASUREMENT vMOTSHT2 "RAM value vMOTSHT2" UBYTE COMP_0068 1 100 0 255 ECU_ADDRESS 0xFFFF9DE2 /begin FUNCTION_LIST /end FUNCTION_LIST /end MEASUREMENT
/begin MEASUREMENT vAFLHZL1 "RAM value vAFLHZL1" UBYTE COMP_0068 1 100 0 255 ECU_ADDRESS 0xFFFF9DE7 /begin FUNCTION_LIST /end FUNCTION_LIST /end MEASUREMENT
/begin MEASUREMENT vAFLHZL2 "RAM value vAFLHZL2" UBYTE COMP_0068 1 100 0 255 ECU_ADDRESS 0xFFFF9DE8 /begin FUNCTION_LIST /end FUNCTION_LIST /end MEASUREMENT
/begin MEASUREMENT vAFRHZL1 "RAM value vAFRHZL1" UBYTE COMP_0068 1 100 0 255 ECU_ADDRESS 0xFFFF9DED /begin FUNCTION_LIST /end FUNCTION_LIST /end MEASUREMENT
/begin MEASUREMENT vAFRHZL2 "RAM value vAFRHZL2" UBYTE COMP_0068 1 100 0 255 ECU_ADDRESS 0xFFFF9DEE /begin FUNCTION_LIST /end FUNCTION_LIST /end MEASUREMENT
/begin MEASUREMENT vAFHF1H1 "RAM value vAFHF1H1" UBYTE COMP_0068 1 100 0 255 ECU_ADDRESS 0xFFFF9DF3 /begin FUNCTION_LIST /end FUNCTION_LIST /end MEASUREMENT
/begin MEASUREMENT vAFHF1H2 "RAM value vAFHF1H2" UBYTE COMP_0068 1 100 0 255 ECU_ADDRESS 0xFFFF9DF4 /begin FUNCTION_LIST /end FUNCTION_LIST /end MEASUREMENT
/begin MEASUREMENT vAFHF2H1 "RAM value vAFHF2H1" UBYTE COMP_0068 1 100 0 255 ECU_ADDRESS 0xFFFF9DF9 /begin FUNCTION_LIST /end FUNCTION_LIST /end MEASUREMENT
/begin MEASUREMENT vAFHF2H2 "RAM value vAFHF2H2" UBYTE COMP_0068 1 100 0 255 ECU_ADDRESS 0xFFFF9DFA /begin FUNCTION_LIST /end FUNCTION_LIST /end MEASUREMENT
/begin MEASUREMENT vAFLRD11 "RAM value vAFLRD11" UBYTE COMP_0068 1 100 0 255 ECU_ADDRESS 0xFFFF9DFF /begin FUNCTION_LIST /end FUNCTION_LIST /end MEASUREMENT
/begin MEASUREMENT vAFLRD12 "RAM value vAFLRD12" UBYTE COMP_0068 1 100 0 255 ECU_ADDRESS 0xFFFF9E00 /begin FUNCTION_LIST /end FUNCTION_LIST /end MEASUREMENT
/begin MEASUREMENT vAFLRD21 "RAM value vAFLRD21" UBYTE COMP_0068 1 100 0 255 ECU_ADDRESS 0xFFFF9E05 /begin FUNCTION_LIST /end FUNCTION_LIST /end MEASUREMENT
/begin MEASUREMENT vAFLRD22 "RAM value vAFLRD22" UBYTE COMP_0068 1 100 0 255 ECU_ADDRESS 0xFFFF9E06 /begin FUNCTION_LIST /end FUNCTION_LIST /end MEASUREMENT
/begin MEASUREMENT vAPSC "RAM value vAPSC" UWORD COMP_0068 1 100 0 65535 ECU_ADDRESS 0xFFFF9E08 /begin FUNCTION_LIST /end FUNCTION_LIST /end MEASUREMENT
/begin MEASUREMENT vAPSOC11 "RAM value vAPSOC11" UBYTE COMP_0068 1 100 0 255 ECU_ADDRESS 0xFFFF9E0B /begin FUNCTION_LIST /end FUNCTION_LIST /end MEASUREMENT
/begin MEASUREMENT vAPSOC12 "RAM value vAPSOC12" UBYTE COMP_0068 1 100 0 255 ECU_ADDRESS 0xFFFF9E0C /begin FUNCTION_LIST /end FUNCTION_LIST /end MEASUREMENT
/begin MEASUREMENT vAPSSC1 "RAM value vAPSSC1" UWORD COMP_0068 1 100 0 65535 ECU_ADDRESS 0xFFFF9E0E /begin FUNCTION_LIST /end FUNCTION_LIST /end MEASUREMENT
/begin MEASUREMENT vAPSOC21 "RAM value vAPSOC21" UBYTE COMP_0068 1 100 0 255 ECU_ADDRESS 0xFFFF9E11 /begin FUNCTION_LIST /end FUNCTION_LIST /end MEASUREMENT
/begin MEASUREMENT vAPSOC22 "RAM value vAPSOC22" UBYTE COMP_0068 1 100 0 255 ECU_ADDRESS 0xFFFF9E12 /begin FUNCTION_LIST /end FUNCTION_LIST /end MEASUREMENT
/begin MEASUREMENT vAPSSC2 "RAM value vAPSSC2" UWORD COMP_0068 1 100 0 65535 ECU_ADDRESS 0xFFFF9E14 /begin FUNCTION_LIST /end FUNCTION_LIST /end MEASUREMENT
/begin MEASUREMENT vAP121 "RAM value vAP121" UBYTE COMP_0068 1 100 0 255 ECU_ADDRESS 0xFFFF9E17 /begin FUNCTION_LIST /end FUNCTION_LIST /end MEASUREMENT
/begin MEASUREMENT vAP122 "RAM value vAP122" UBYTE COMP_0068 1 100 0 255 ECU_ADDRESS 0xFFFF9E18 /begin FUNCTION_LIST /end FUNCTION_LIST /end MEASUREMENT
/begin MEASUREMENT vAPCHR "RAM value vAPCHR" UWORD COMP_0068 1 100 0 65535 ECU_ADDRESS 0xFFFF9E1A /begin FUNCTION_LIST /end FUNCTION_LIST /end MEASUREMENT
/begin MEASUREMENT vAPSC11 "RAM value vAPSC11" UBYTE COMP_0068 1 100 0 255 ECU_ADDRESS 0xFFFF9E1D /begin FUNCTION_LIST /end FUNCTION_LIST /end MEASUREMENT
/begin MEASUREMENT vAPSC12 "RAM value vAPSC12" UBYTE COMP_0068 1 100 0 255 ECU_ADDRESS 0xFFFF9E1E /begin FUNCTION_LIST /end FUNCTION_LIST /end MEASUREMENT
/begin MEASUREMENT vAVCC1 "RAM value vAVCC1" UWORD COMP_0068 1 100 0 65535 ECU_ADDRESS 0xFFFF9E20 /begin FUNCTION_LIST /end FUNCTION_LIST /end MEASUREMENT
/begin MEASUREMENT vAVCC21 "RAM value vAVCC21" UBYTE COMP_0068 1 100 0 255 ECU_ADDRESS 0xFFFF9E23 /begin FUNCTION_LIST /end FUNCTION_LIST /end MEASUREMENT
/begin MEASUREMENT vAVCC22 "RAM value vAVCC22" UBYTE COMP_0068 1 100 0 255 ECU_ADDRESS 0xFFFF9E24 /begin FUNCTION_LIST /end FUNCTION_LIST /end MEASUREMENT
/begin MEASUREMENT vPRSSC "RAM value vPRSSC" UWORD COMP_0068 1 100 0 65535 ECU_ADDRESS 0xFFFF9E26 /begin FUNCTION_LIST /end FUNCTION_LIST /end MEASUREMENT
/begin MEASUREMENT vPRSOC1 "RAM value vPRSOC1" UBYTE COMP_0068 1 100 0 255 ECU_ADDRESS 0xFFFF9E29 /begin FUNCTION_LIST /end FUNCTION_LIST /end MEASUREMENT
/begin MEASUREMENT vPRSOC2 "RAM value vPRSOC2" UBYTE COMP_0068 1 100 0 255 ECU_ADDRESS 0xFFFF9E2A /begin FUNCTION_LIST /end FUNCTION_LIST /end MEASUREMENT
/begin MEASUREMENT vUPCRCV "RAM value vUPCRCV" UWORD COMP_0068 1 100 0 65535 ECU_ADDRESS 0xFFFF9E2C /begin FUNCTION_LIST /end FUNCTION_LIST /end MEASUREMENT
/begin MEASUREMENT vAPMUX1 "RAM value vAPMUX1" UBYTE COMP_0068 1 100 0 255 ECU_ADDRESS 0xFFFF9E2F /begin FUNCTION_LIST /end FUNCTION_LIST /end MEASUREMENT
/begin MEASUREMENT vAPMUX2 "RAM value vAPMUX2" UBYTE COMP_0068 1 100 0 255 ECU_ADDRESS 0xFFFF9E30 /begin FUNCTION_LIST /end FUNCTION_LIST /end MEASUREMENT
/begin MEASUREMENT vESPLNK "RAM value vESPLNK" UWORD COMP_0068 1 100 0 65535 ECU_ADDRESS 0xFFFF9E32 /begin FUNCTION_LIST /end FUNCTION_LIST /end MEASUREMENT
/begin MEASUREMENT vAGBLNK1 "RAM value vAGBLNK1" UBYTE COMP_0068 1 100 0 255 ECU_ADDRESS 0xFFFF9E35 /begin FUNCTION_LIST /end FUNCTION_LIST /end MEASUREMENT
/begin MEASUREMENT vAGBLNK2 "RAM value vAGBLNK2" UBYTE COMP_0068 1 100 0 255 ECU_ADDRESS 0xFFFF9E36 /begin FUNCTION_LIST /end FUNCTION_LIST /end MEASUREMENT
/begin MEASUREMENT vAGBCLK "RAM value vAGBCLK" UWORD COMP_0068 1 100 0 65535 ECU_ADDRESS 0xFFFF9E38 /begin FUNCTION_LIST /end FUNCTION_LIST /end MEASUREMENT
/begin MEASUREMENT vESPCPL1 "RAM value vESPCPL1" UBYTE COMP_0068 1 100 0 255 ECU_ADDRESS 0xFFFF9E3B /begin FUNCTION_LIST /end FUNCTION_LIST /end MEASUREMENT
/begin MEASUREMENT vESPCPL2 "RAM value vESPCPL2" UBYTE COMP_0068 1 100 0 255 ECU_ADDRESS 0xFFFF9E3C /begin FUNCTION_LIST /end FUNCTION_LIST /end MEASUREMENT
/begin MEASUREMENT vESPCLK "RAM value vESPCLK" UWORD COMP_0068 1 100 0 65535 ECU_ADDRESS 0xFFFF9E3E /begin FUNCTION_LIST /end FUNCTION_LIST /end MEASUREMENT
/begin MEASUREMENT vAGBDLY1 "RAM value vAGBDLY1" UBYTE COMP_0068 1 100 0 255 ECU_ADDRESS 0xFFFF9E41 /begin FUNCTION_LIST /end FUNCTION_LIST /end MEASUREMENT
/begin MEASUREMENT vAGBDLY2 "RAM value vAGBDLY2" UBYTE COMP_0068 1 100 0 255 ECU_ADDRESS 0xFFFF9E42 /begin FUNCTION_LIST /end FUNCTION_LIST /end MEASUREMENT
/begin MEASUREMENT vAGBINT "RAM value vAGBINT" UWORD COMP_0068 1 100 0 65535 ECU_ADDRESS 0xFFFF9E44 /begin FUNCTION_LIST /end FUNCTION_LIST /end MEASUREMENT
/begin MEASUREMENT vCSCHR1 "RAM value vCSCHR1" UBYTE COMP_0068 1 100 0 255 ECU_ADDRESS 0xFFFF9E47 /begin FUNCTION_LIST /end FUNCTION_LIST /end MEASUREMENT
/begin MEASUREMENT vCSCHR2 "RAM value vCSCHR2" UBYTE COMP_0068 1 100 0 255 ECU_ADDRESS 0xFFFF9E48 /begin FUNCTION_LIST /end FUNCTION_LIST /end MEASUREMENT
/begin MEASUREMENT vCSTOT "RAM value vCSTOT" UWORD COMP_0068 1 100 0 65535 ECU_ADDRESS 0xFFFF9E4A /begin FUNCTION_LIST /end FUNCTION_LIST /end MEASUREMENT
/begin MEASUREMENT vVSCMP1 "RAM value vVSCMP1" UBYTE COMP_0068 1 100 0 255 ECU_ADDRESS 0xFFFF9E4D /begin FUNCTION_LIST /end FUNCTION_LIST /end MEASUREMENT
/begin MEASUREMENT vVSCMP2 "RAM value vVSCMP2" UBYTE COMP_0068 1 100 0 255 ECU_ADDRESS 0xFFFF9E4E /begin FUNCTION_LIST /end FUNCTION_LIST /end MEASUREMENT
/begin MEASUREMENT vCSOOR "RAM value vCSOOR" UWORD COMP_0068 1 100 0 65535 ECU_ADDRESS 0xFFFF9E50 /begin FUNCTION_LIST /end FUNCTION_LIST /end MEASUREMENT
/begin MEASUREMENT vCSOCS1 "RAM value vCSOCS1" UBYTE COMP_0068 1 100 0 255 ECU_ADDRESS 0xFFFF9E53 /begin FUNCTION_LIST /end FUNCTION_LIST /end MEASUREMENT
/begin MEASUREMENT vCSOCS2 "RAM value vCSOCS2" UBYTE COMP_0068 1 100 0 255 ECU_ADDRESS 0xFFFF9E54 /begin FUNCTION_LIST /end FUNCTION_LIST /end MEASUREMENT
/begin MEASUREMENT vCSNOK "RAM value vCSNOK" UWORD COMP_0068 1 100 0 65535 ECU_ADDRESS 0xFFFF9E56 /begin FUNCTION_LIST /end FUNCTION_LIST /end MEASUREMENT
/begin MEASUREMENT vCLUCMP1 "RAM value vCLUCMP1" UBYTE COMP_0068 1 100 0 255 ECU_ADDRESS 0xFFFF9E59 /begin FUNCTION_LIST /end FUNCTION_LIST /end MEASUREMENT
/begin MEASUREMENT vCLUCMP2 "RAM value vCLUCMP2" UBYTE COMP_0068 1 100 0 255 ECU_ADDRESS 0xFFFF9E5A /begin FUNCTION_LIST /end FUNCTION_LIST /end MEASUREMENT
/begin MEASUREMENT vBRKCMP "RAM value vBRKCMP" UWORD COMP_0068 1 100 0 65535 ECU_ADDRESS 0xFFFF9E5C /begin FUNCTION_LIST /end FUNCTION_LIST /end MEASUREMENT
/begin MEASUREMENT vCRUCMP1 "RAM value vCRUCMP1" UBYTE COMP_0068 1 100 0 255 ECU_ADDRESS 0xFFFF9E5F /begin FUNCTION_LIST /end FUNCTION_LIST /end MEASUREMENT
/begin MEASUREMENT vCRUCMP2 "RAM value vCRUCMP2" UBYTE COMP_0068 1 100 0 255 ECU_ADDRESS 0xFFFF9E60 /begin FUNCTION_LIST /end FUNCTION_LIST /end MEASUREMENT
/begin MEASUREMENT vCLSW "RAM value vCLSW" UWORD COMP_0068 1 100 0 65535 ECU_ADDRESS 0xFFFF9E62 /begin FUNCTION_LIST /end FUNCTION_LIST /end MEASUREMENT
/begin MEASUREMENT vINHNG61 "RAM value vINHNG61" UBYTE COMP_0068 1 100 0 255 ECU_ADDRESS 0xFFFF9E65 /begin FUNCTION_LIST /end FUNCTION_LIST /end MEASUREMENT
/begin MEASUREMENT vINHNG62 "RAM value vINHNG62" UBYTE COMP_0068 1 100 0 255 ECU_ADDRESS 0xFFFF9E66 /begin FUNCTION_LIST /end FUNCTION_LIST /end MEASUREMENT
/begin MEASUREMENT vINHNG5 "RAM value vINHNG5" UWORD COMP_0068 1 100 0 65535 ECU_ADDRESS 0xFFFF9E68 /begin FUNCTION_LIST /end FUNCTION_LIST /end MEASUREMENT
/begin MEASUREMENT vINHNG41 "RAM value vINHNG41" UBYTE COMP_0068 1 100 0 255 ECU_ADDRESS 0xFFFF9E6B /begin FUNCTION_LIST /end FUNCTION_LIST /end MEASUREMENT
/begin MEASUREMENT vINHNG42 "RAM value vINHNG42" UBYTE COMP_0068 1 100 0 255 ECU_ADDRESS 0xFFFF9E6C /begin FUNCTION_LIST /end FUNCTION_LIST /end MEASUREMENT
/begin MEASUREMENT vINHNG3 "RAM value vINHNG3" UWORD COMP_0068 1 100 0 65535 ECU_ADDRESS 0xFFFF9E6E /begin FUNCTION_LIST /end FUNCTION_LIST /end MEASUREMENT
/begin MEASUREMENT vINHNG21 "RAM value vINHNG21" UBYTE COMP_0068 1 100 0 255 ECU_ADDRESS 0xFFFF9E71 /begin FUNCTION_LIST /end FUNCTION_LIST /end MEASUREMENT
/begin MEASUREMENT vINHNG22 "RAM value vINHNG22" UBYTE COMP_0068 1 100 0 255 ECU_ADDRESS 0xFFFF9E72 /begin FUNCTION_LIST /end FUNCTION_LIST /end MEASUREMENT
/begin MEASUREMENT vINHNG1 "RAM value vINHNG1" UWORD COMP_0068 1 100 0 65535 ECU_ADDRESS 0xFFFF9E74 /begin FUNCTION_LIST /end FUNCTION_LIST /end MEASUREMENT
/begin MEASUREMENT vINLNG61 "RAM value vINLNG61" UBYTE COMP_0068 1 100 0 255 ECU_ADDRESS 0xFFFF9E77 /begin FUNCTION_LIST /end FUNCTION_LIST /end MEASUREMENT
/begin MEASUREMENT vINLNG62 "RAM value vINLNG62" UBYTE COMP_0068 1 100 0 255 ECU_ADDRESS 0xFFFF9E78 /begin FUNCTION_LIST /end FUNCTION_LIST /end MEASUREMENT
/begin MEASUREMENT vINLNG5 "RAM value vINLNG5" UWORD COMP_0068 1 100 0 65535 ECU_ADDRESS 0xFFFF9E7A /begin FUNCTION_LIST /end FUNCTION_LIST /end MEASUREMENT
/begin MEASUREMENT vINLNG41 "RAM value vINLNG41" UBYTE COMP_0068 1 100 0 255 ECU_ADDRESS 0xFFFF9E7D /begin FUNCTION_LIST /end FUNCTION_LIST /end MEASUREMENT
/begin MEASUREMENT vINLNG42 "RAM value vINLNG42" UBYTE COMP_0068 1 100 0 255 ECU_ADDRESS 0xFFFF9E7E /begin FUNCTION_LIST /end FUNCTION_LIST /end MEASUREMENT
/begin MEASUREMENT vINLNG3 "RAM value vINLNG3" UWORD COMP_0068 1 100 0 65535 ECU_ADDRESS 0xFFFF9E80 /begin FUNCTION_LIST /end FUNCTION_LIST /end MEASUREMENT
/begin MEASUREMENT vINLNG21 "RAM value vINLNG21" UBYTE COMP_0068 1 100 0 255 ECU_ADDRESS 0xFFFF9E83 /begin FUNCTION_LIST /end FUNCTION_LIST /end MEASUREMENT
/begin MEASUREMENT vINLNG22 "RAM value vINLNG22" UBYTE COMP_0068 1 100 0 255 ECU_ADDRESS 0xFFFF9E84 /begin FUNCTION_LIST /end FUNCTION_LIST /end MEASUREMENT
/begin MEASUREMENT vINLNG1 "RAM value vINLNG1" UWORD COMP_0068 1 100 0 65535 ECU_ADDRESS 0xFFFF9E86 /begin FUNCTION_LIST /end FUNCTION_LIST /end MEASUREMENT
/begin MEASUREMENT vBUSDBMA "RAM value vBUSDBMA" UBYTE COMP_0068 1 100 0 255 ECU_ADDRESS 0xffff512b /begin FUNCTION_LIST /end FUNCTION_LIST /end MEASUREMENT
/begin MEASUREMENT P_HiROM_BG "RAM value P_HiROM_BG" ULONG COMP_0068 1 100 0 4294967295 ECU_ADDRESS 0x000227CC /begin FUNCTION_LIST /end FUNCTION_LIST /end MEASUREMENT
/begin MEASUREMENT P_HiROM_EN "RAM value P_HiROM_EN" ULONG COMP_0068 1 100 0 4294967295 ECU_ADDRESS 0x000227D0 /begin FUNCTION_LIST /end FUNCTION_LIST /end MEASUREMENT
/begin MEASUREMENT vBUSDBSA "RAM value vBUSDBSA" UBYTE COMP_0068 1 100 0 255 ECU_ADDRESS 0xffff51bd /begin FUNCTION_LIST /end FUNCTION_LIST /end MEASUREMENT
/begin MEASUREMENT vTRIPMES "RAM value vTRIPMES" UBYTE COMP_0068 1 100 0 255 ECU_ADDRESS 0xFFFFB7D4 /begin FUNCTION_LIST /end FUNCTION_LIST /end MEASUREMENT
/begin COMPU_METHOD COMP_0068 "1-" RAT_FUNC "%8.2" "-" COEFFS 0 1 0 0 0 1 /end COMPU_METHOD
/begin COMPU_METHOD COMP_0004 "1Å|" RAT_FUNC "%8.2" "Å|" COEFFS 0 1 0 0 0 1 /end COMPU_METHOD
/begin COMPU_METHOD COMP_0023 "5mV" RAT_FUNC "%8.2" "mV" COEFFS 0 1 0 0 0 5 /end COMPU_METHOD
/begin COMPU_METHOD COMP_0020 "50rpm" RAT_FUNC "%8.2" "rpm" COEFFS 0 1 0 0 0 50 /end COMPU_METHOD
/begin COMPU_METHOD COMP_0014 "10ms" RAT_FUNC "%8.2" "ms" COEFFS 0 1 0 0 0 10 /end COMPU_METHOD
/begin COMPU_METHOD COMP_0006 "12.5rpm" RAT_FUNC "%8.2" "rpm" COEFFS 0 1 0 0 0 12.5 /end COMPU_METHOD
/begin COMPU_METHOD COMP_0000 "25rpm" RAT_FUNC "%8.2" "rpm" COEFFS 0 1 0 0 0 25 /end COMPU_METHOD
/begin COMPU_METHOD COMP_0007 "2km/h" RAT_FUNC "%8.2" "km/h" COEFFS 0 1 0 0 0 2 /end COMPU_METHOD
/begin COMPU_METHOD COMP_0443 "1rpm" RAT_FUNC "%8.2" "rpm" COEFFS 0 1 0 0 0 1 /end COMPU_METHOD
/begin COMPU_METHOD COMP_0345_S "1/32Nm" RAT_FUNC "%8.3" "Nm" COEFFS 0 1 400 0 0 0.03125 /end COMPU_METHOD
/begin COMPU_METHOD COMP_0048 "64/128degCA" RAT_FUNC "%8.2" "degCA" COEFFS 0 1 0 0 0 0.5 /end COMPU_METHOD
/begin COMPU_METHOD COMP_0054 "20mV" RAT_FUNC "%8.2" "mV" COEFFS 0 1 0 0 0 20 /end COMPU_METHOD
/begin COMPU_METHOD COMP_0373 "1/100-" RAT_FUNC "%8.3" "-" COEFFS 0 1 0 0 0 0.01 /end COMPU_METHOD
/begin COMPU_METHOD COMP_0050 "5/64mV" RAT_FUNC "%8.3" "mV" COEFFS 0 1 0 0 0 0.078125 /end COMPU_METHOD
/begin COMPU_METHOD COMP_0035 "X-50Åé" RAT_FUNC "%8.2" "Åé" COEFFS 0 1 50 0 0 1 /end COMPU_METHOD
/begin COMPU_METHOD COMP_0071 "1rev" RAT_FUNC "%8.2" "rev" COEFFS 0 1 0 0 0 1 /end COMPU_METHOD
/begin COMPU_METHOD COMP_0375_S "0.01km/h" RAT_FUNC "%8.3" "km/h" COEFFS 0 1 0 0 0 0.01 /end COMPU_METHOD
/begin COMPU_METHOD COMP_0228 "0.1Nm" RAT_FUNC "%8.2" "Nm" COEFFS 0 1 0 0 0 0.1 /end COMPU_METHOD
/begin COMPU_METHOD COMP_0450 "1/1024-" RAT_FUNC "%8.5" "-" COEFFS 0 1 0 0 0 0.000976563 /end COMPU_METHOD
/begin COMPU_METHOD COMP_0073 "3.2us" RAT_FUNC "%8.2" "us" COEFFS 0 1 0 0 0 3.2 /end COMPU_METHOD
/begin COMPU_METHOD COMP_0229 "2km/h" RAT_FUNC "%8.2" "km/h" COEFFS 0 1 256 0 0 2 /end COMPU_METHOD
/begin COMPU_METHOD COMP_0263 "1-" RAT_FUNC "%8.2" "-" COEFFS 0 1 0 0 0 1 /end COMPU_METHOD
/begin COMPU_METHOD COMP_0356 "0.625X-40Åé" RAT_FUNC "%8.2" "Åé" COEFFS 0 1 40 0 0 0.625 /end COMPU_METHOD
/begin COMPU_METHOD COMP_0451_S "0.00125ratio" RAT_FUNC "%8.4" "ratio" COEFFS 0 1 0 0 0 0.00125 /end COMPU_METHOD
/begin COMPU_METHOD COMP_0519_S "100W" RAT_FUNC "%8.2" "W" COEFFS 0 1 0 0 0 100 /end COMPU_METHOD
/begin COMPU_METHOD COMP_0470 "1km" RAT_FUNC "%8.2" "km" COEFFS 0 1 0 0 0 1 /end COMPU_METHOD
/begin COMPU_METHOD COMP_0164 "0.000305MPa" RAT_FUNC "%8.5" "MPa" COEFFS 0 1 0 0 0 0.000305 /end COMPU_METHOD
/begin COMPU_METHOD COMP_0389 "1/2548km" RAT_FUNC "%8.5" "km" COEFFS 0 1 0 0 0 0.000392465 /end COMPU_METHOD
/begin COMPU_METHOD COMP_0584_S "deg/100nsdeg/100n" RAT_FUNC "%8.2" "deg/100n" COEFFS 0 1 0 0 0 0.35 /end COMPU_METHOD
/begin COMPU_METHOD COMP_0403 "1Åé/10s" RAT_FUNC "%8.2" "Åé/10s" COEFFS 0 1 0 0 0 1 /end COMPU_METHOD
/begin COMPU_METHOD COMP_0181_S "É sÉ s" RAT_FUNC "%8.2" "É s" COEFFS 0 1 0 0 0 0.1 /end COMPU_METHOD
/begin COMPU_METHOD COMP_0640_S "ÅéÅé" RAT_FUNC "%8.2" "Åé" COEFFS 0 1 30 0 0 0.625 /end COMPU_METHOD
/end MODULE
/end PROJECT
