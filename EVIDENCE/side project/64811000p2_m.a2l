ASAP2_VERSION 1 3_BETA
/begin PROJECT TK_X91_EUR_VC ""
/begin HEADER "" /* key HEADER ++ "comment" Ç… Par.scomment */ PROJECT_NO TK_X91_EUR_VC /* key PROJECT_NO ++ project number Ç… car_eng_desti_lot */ VERSION "7V4YHZEB2" /* key VERSION ++ version number Ç… mProgver */ /end HEADER
/begin MODULE DIM ""
/begin MOD_COMMON "" DEPOSIT ABSOLUTE BYTE_ORDER MSB_FIRST /* ﬁ≤ƒµ∞¿ﬁ∞Ç™ÿÃﬂ⁄∞ΩÇ≥ÇÍÇÈ */ /end MOD_COMMON
/begin FUNCTION KF7-450.50[10] "Software limp home " /end FUNCTION
/begin FUNCTION KF7-460.1[6] "Variable control (for MPI)" /end FUNCTION
/begin FUNCTION KF7-500.1[54] "Integrated type self-diagnosis regulation " /end FUNCTION
/begin FUNCTION KF7-500.2A[29] "Unified type NG code chart" /end FUNCTION
/begin FUNCTION KF7-500.3[2] "Code switching chart" /end FUNCTION
/begin FUNCTION KF7-500.6D[9] "Crank angle sensor diagnosis (designated for crank angle sensor (for C-VTC))" /end FUNCTION
/begin FUNCTION KF7-500.7[12] "Air flow meter diagnosis" /end FUNCTION
/begin FUNCTION KF7-500.8[5] "Coolant temperature sensor diagnosis " /end FUNCTION
/begin FUNCTION KF7-500.10[3] "Ignition primary signal diagnosis" /end FUNCTION
/begin FUNCTION KF7-500.12[3] "Knock sensor diagnosis " /end FUNCTION
/begin FUNCTION KF7-500.16[4] "Vehicle speed sensor diagnosis" /end FUNCTION
/begin FUNCTION KF7-500.20B[4] "Fuel system diagnosis (A/F sensor type)" /end FUNCTION
/begin CHARACTERISTIC mAFMNGV "AFM power supply NG judgement upper limit value" VALUE 0x00008FCA REC_UWORD_C 0 COMP_0023 0 327675 /begin FUNCTION_LIST KF7-500.7[12] /end FUNCTION_LIST /end CHARACTERISTIC
/begin CHARACTERISTIC mAFMRCGL "AFM function lower limit diagnosis diagnosis criteria gain" VALUE 0x00008224 REC_UBYTE_C 0 COMP_0063 0 0.99609375 /begin FUNCTION_LIST KF7-500.7[12] /end FUNCTION_LIST /end CHARACTERISTIC
/begin CHARACTERISTIC mAFMRNEH "AFM function upper limit diagnosis diagnosis upper limit speed" VALUE 0x00008225 REC_UBYTE_C 0 COMP_0006 0 3187.5 /begin FUNCTION_LIST KF7-500.7[12] /end FUNCTION_LIST /end CHARACTERISTIC
/begin CHARACTERISTIC mAFMRNEL "AFM function lower limit diagnosis diagnosis lower limit speed" VALUE 0x00008226 REC_UBYTE_C 0 COMP_0006 0 3187.5 /begin FUNCTION_LIST KF7-500.7[12] /end FUNCTION_LIST /end CHARACTERISTIC
/begin CHARACTERISTIC mAFMRTPOH "AFM function upper limit diagnosis diagnosis upper limit throttle open-degree" VALUE 0x00008FCC REC_UWORD_C 0 COMP_0130 0 1802.2125 /begin FUNCTION_LIST KF7-500.7[12] /end FUNCTION_LIST /end CHARACTERISTIC
/begin CHARACTERISTIC mAFMRTPOL "AFM function lower limit diagnosis diagnosis lower limit throttle open-degree" VALUE 0x00008FCE REC_UWORD_C 0 COMP_0130 0 1802.2125 /begin FUNCTION_LIST KF7-500.7[12] /end FUNCTION_LIST /end CHARACTERISTIC
/begin CHARACTERISTIC mAFNGT "Trouble judgement delay time" VALUE 0x00008228 REC_UBYTE_C 0 COMP_0024 0 12750 /begin FUNCTION_LIST KF7-500.7[12] /end FUNCTION_LIST /end CHARACTERISTIC
/begin CHARACTERISTIC mAFONNG "AFM power supply NG judgement lower limit value" VALUE 0x00008FD0 REC_UWORD_C 0 COMP_0023 0 327675 /begin FUNCTION_LIST KF7-500.7[12] /end FUNCTION_LIST /end CHARACTERISTIC
/begin CHARACTERISTIC mCMOIM1 "Monitor clamp counter 1" VALUE 0x0000833C REC_UBYTE_C 0 COMP_0016 0 255 /begin FUNCTION_LIST KF7-500.20B[4] /end FUNCTION_LIST /end CHARACTERISTIC
/begin CHARACTERISTIC mCMOIM2 "Monitor clamp counter 2" VALUE 0x0000833D REC_UBYTE_C 0 COMP_0016 0 255 /begin FUNCTION_LIST KF7-500.20B[4] /end FUNCTION_LIST /end CHARACTERISTIC
/begin CHARACTERISTIC mCMOIM3 "Monitor clamp counter 3" VALUE 0x0000833E REC_UBYTE_C 0 COMP_0016 0 255 /begin FUNCTION_LIST KF7-500.20B[4] R904.1.Gst_on_can_1_0_1 /end FUNCTION_LIST /end CHARACTERISTIC
/begin CHARACTERISTIC mCMOIM4 "Monitor clamp counter 4" VALUE 0x0000833F REC_UBYTE_C 0 COMP_0016 0 255 /begin FUNCTION_LIST KF7-500.20B[4] /end FUNCTION_LIST /end CHARACTERISTIC
/begin CHARACTERISTIC mCSNGDC "CAM breakage diagnosis NG judgement delay" VALUE 0x00008379 REC_UBYTE_C 0 COMP_0014 0 2550 /begin FUNCTION_LIST KF7-500.6D[9] /end FUNCTION_LIST /end CHARACTERISTIC
/begin CHARACTERISTIC mCSNGDP "POS10 breakage diagnosis NG judgement delay" VALUE 0x0000837A REC_UBYTE_C 0 COMP_0014 0 2550 /begin FUNCTION_LIST KF7-500.6D[9] /end FUNCTION_LIST /end CHARACTERISTIC
/begin CHARACTERISTIC mCSNGRC "CAM diagnosis NG judgement delay" VALUE 0x0000837D REC_UBYTE_C 0 COMP_0016 0 255 /begin FUNCTION_LIST KF7-500.6D[9] KF7-500.47B[15] /end FUNCTION_LIST /end CHARACTERISTIC
/begin CHARACTERISTIC mCSNGRP "POS10 diagnosis NG judgement delay" VALUE 0x0000837E REC_UBYTE_C 0 COMP_0016 0 255 /begin FUNCTION_LIST KF7-500.6D[9] /end FUNCTION_LIST /end CHARACTERISTIC
/begin CHARACTERISTIC mCSNGSTC "At the time of the start, CAM breakage judgement delay" VALUE 0x0000837F REC_UBYTE_C 0 COMP_0014 0 2550 /begin FUNCTION_LIST KF7-500.6D[9] /end FUNCTION_LIST /end CHARACTERISTIC
/begin CHARACTERISTIC mCSNGSTP "At the time of the start, POS10 breakage judgement delay" VALUE 0x00008381 REC_UBYTE_C 0 COMP_0014 0 2550 /begin FUNCTION_LIST KF7-500.6D[9] /end FUNCTION_LIST /end CHARACTERISTIC
/begin CHARACTERISTIC mCSTQA "Mass airflow meter characteristic coefficient" VALUE 0x00008389 REC_UBYTE_C 0 COMP_0004 0 255
 /begin FUNCTION_LIST KF7-500.1[54] KF7-500.21[19] KF7-580.1[8] R904.1.Gst_on_can_1_0_1 /end FUNCTION_LIST
/end CHARACTERISTIC
/begin CHARACTERISTIC mDVADV "An ignition timing for the digital variable" VALUE 0x00008191 REC_SBYTE_C 0 COMP_0018 -128 127 /begin FUNCTION_LIST KF7-460.1[6] /end FUNCTION_LIST /end CHARACTERISTIC
/begin CHARACTERISTIC mDVBCS "START SW At the time of on, for the battery voltage descent" VALUE 0x00008510 REC_UBYTE_C 0 COMP_0033 0 20400 /begin FUNCTION_LIST KF7-500.6D[9] /end FUNCTION_LIST /end CHARACTERISTIC
/begin CHARACTERISTIC mDVFBYA "Target air-fuel ratio basic value for the digital variable" VALUE 0x00009154 REC_UWORD_C 0 COMP_0004_S 0 3.997635 /begin FUNCTION_LIST KF7-460.1[6] /end FUNCTION_LIST /end CHARACTERISTIC
/begin CHARACTERISTIC mDVKADV "The amount of ignition timing compensation by the cylinder for digital variable" VALUE 0x00008192 REC_SBYTE_C 0 COMP_0018 -128 127 /begin FUNCTION_LIST KF7-460.1[6] /end FUNCTION_LIST /end CHARACTERISTIC
/begin CHARACTERISTIC mDVKTRM "At the time of the digital variable, KTRM value" VALUE 0x00008515 REC_UBYTE_C 0 COMP_0044 0 1.9921875 /begin FUNCTION_LIST KF7-460.1[6] /end FUNCTION_LIST /end CHARACTERISTIC
/begin CHARACTERISTIC mDVTIM "A homogeneous injection timing for the digital variable" VALUE 0x0000915A REC_UWORD_C 0 COMP_0190 0 131070 /begin FUNCTION_LIST KF7-460.1[6] /end FUNCTION_LIST /end CHARACTERISTIC
/begin CHARACTERISTIC mDVVTC "A VTC target operation angle for the digital variable" VALUE 0x00008518 REC_UBYTE_C 0 COMP_0256 -64 63.5 /begin FUNCTION_LIST KF7-460.1[6] /end FUNCTION_LIST /end CHARACTERISTIC
/begin CHARACTERISTIC mERRTIM "The response diagnosis judgement deviation" VALUE 0x00008553 REC_UBYTE_C 0 COMP_0008 0 25500 /begin FUNCTION_LIST KF7-500.6D[9] KF7-500.47B[15] /end FUNCTION_LIST /end CHARACTERISTIC
/begin CHARACTERISTIC mEVCLD1 "KDUTY UP EVPTR condition 1" VALUE 0x00008572 REC_UBYTE_C 0 COMP_0013 0 255 /begin FUNCTION_LIST KF7-500.1[54] /end FUNCTION_LIST /end CHARACTERISTIC
/begin CHARACTERISTIC mEVPVSL "Vehicle speed condition lower limit" VALUE 0x000085A3 REC_UBYTE_C 0 COMP_0007 0 510 /begin FUNCTION_LIST KF7-500.1[54] KF7-500.2A[29] KF7-500.30[8] /end FUNCTION_LIST /end CHARACTERISTIC
/begin CHARACTERISTIC mFGTP1 "Slosh diagnosis delay" VALUE 0x00008601 REC_UBYTE_C 0 COMP_0008 0 25500 /begin FUNCTION_LIST KF7-500.1[54] /end FUNCTION_LIST /end CHARACTERISTIC
/begin CHARACTERISTIC mFGTP2 "Slosh judgement release delay" VALUE 0x000091B0 REC_UWORD_C 0 COMP_0008 0 6553500 /begin FUNCTION_LIST KF7-500.1[54] /end FUNCTION_LIST /end CHARACTERISTIC
/begin CHARACTERISTIC mFVCYLS "A cylinder for the variable control by cylinder" VALUE 0x00008651 REC_UBYTE_C 0 COMP_0004 0 255 /begin FUNCTION_LIST KF7-460.1[6] /end FUNCTION_LIST /end CHARACTERISTIC
/begin CHARACTERISTIC mIERRTIM "At the time of the VTC idle, offset diagnosis prohibition time" VALUE 0x00008702 REC_UBYTE_C 0 COMP_0008 0 25500 /begin FUNCTION_LIST KF7-500.6D[9] KF7-500.47B[15] /end FUNCTION_LIST /end CHARACTERISTIC
/begin CHARACTERISTIC mIOFANGB "Steady state deviation allowable value (for the idle, a retard side)" VALUE 0x00008746 REC_UBYTE_C 0 COMP_0048 0 127.5 /begin FUNCTION_LIST KF7-500.6D[9] KF7-500.47B[15] /end FUNCTION_LIST /end CHARACTERISTIC
/begin CHARACTERISTIC mIOFANGF "Steady state deviation allowable value (for the idle, an advance side)" VALUE 0x00008747 REC_UBYTE_C 0 COMP_0048 0 127.5 /begin FUNCTION_LIST KF7-500.6D[9] KF7-500.47B[15] /end FUNCTION_LIST /end CHARACTERISTIC
/begin CHARACTERISTIC mISCDDLY "Diagnosis permission coolant temperature condition lower limit delay" VALUE 0x00008753 REC_UBYTE_C 0 COMP_0013 0 255 /begin FUNCTION_LIST KF7-500.1[54] KF7-500.38A[4] /end FUNCTION_LIST /end CHARACTERISTIC
/begin CHARACTERISTIC mISCSN "A weighted average rate for the ISC diagnosis" VALUE 0x00008762 REC_UBYTE_C 0 COMP_0016 0 255 /begin FUNCTION_LIST KF7-500.8[5] /end FUNCTION_LIST /end CHARACTERISTIC
/begin CHARACTERISTIC mKNKNGH "An upper limit voltage for the knock sensor diagnosis" VALUE 0x000087D5 REC_UBYTE_C 0 COMP_0054 0 5100 /begin FUNCTION_LIST KF7-500.12[3] /end FUNCTION_LIST /end CHARACTERISTIC
/begin CHARACTERISTIC mKNKNGL "A lower limit voltage for the knock sensor diagnosis" VALUE 0x000087D6 REC_UBYTE_C 0 COMP_0054 0 5100 /begin FUNCTION_LIST KF7-500.12[3] /end FUNCTION_LIST /end CHARACTERISTIC
/begin CHARACTERISTIC mKYUYU "In the key off, lubrication judgement criteria" VALUE 0x0000935A REC_UWORD_C 0 COMP_0050 0 5119.921875 /begin FUNCTION_LIST KF7-500.1[54] KF7-580.1[8] /end FUNCTION_LIST /end CHARACTERISTIC
/begin CHARACTERISTIC mMRTH1H "At the time of the KBLRC lean, judgement reference" VALUE 0x0000886C REC_UBYTE_C 0 COMP_0027 0 255 /begin FUNCTION_LIST KF7-500.20B[4] R904.1.Gst_on_can_1_0_1 /end FUNCTION_LIST /end CHARACTERISTIC
/begin CHARACTERISTIC mMRTH1L "At the time of the KBLRC rich, judgement reference" VALUE 0x0000886D REC_UBYTE_C 0 COMP_0027 0 255 /begin FUNCTION_LIST KF7-500.20B[4] R904.1.Gst_on_can_1_0_1 /end FUNCTION_LIST /end CHARACTERISTIC
/begin CHARACTERISTIC mMRTH2H "At the time of the MALPHA lean, judgement reference" VALUE 0x0000886E REC_UBYTE_C 0 COMP_0027 0 255 /begin FUNCTION_LIST KF7-500.20B[4] /end FUNCTION_LIST /end CHARACTERISTIC
/begin CHARACTERISTIC mMRTH2L "At the time of the MALPHA rich, judgement reference" VALUE 0x0000886F REC_UBYTE_C 0 COMP_0027 0 255 /begin FUNCTION_LIST KF7-500.20B[4] /end FUNCTION_LIST /end CHARACTERISTIC
/begin CHARACTERISTIC mNGDCAM "CAM signal breakage judgement time" VALUE 0x000088B0 REC_UBYTE_C 0 COMP_0014 0 2550 /begin FUNCTION_LIST KF7-500.6D[9] /end FUNCTION_LIST /end CHARACTERISTIC
/begin CHARACTERISTIC mNGDCAM2 "POS10 diagnosis permission CAM signal input period" VALUE 0x000088B1 REC_UBYTE_C 0 COMP_0014 0 2550 /begin FUNCTION_LIST KF7-500.6D[9] /end FUNCTION_LIST /end CHARACTERISTIC
/begin CHARACTERISTIC mNGDPOS "POS10 signal breakage judgement time" VALUE 0x000088B2 REC_UBYTE_C 0 COMP_0014 0 2550 /begin FUNCTION_LIST KF7-500.6D[9] /end FUNCTION_LIST /end CHARACTERISTIC
/begin CHARACTERISTIC mNNGCAM "CAM signal breakage judgement speed" VALUE 0x000088C8 REC_UBYTE_C 0 COMP_0006 0 3187.5 /begin FUNCTION_LIST KF7-500.6D[9] /end FUNCTION_LIST /end CHARACTERISTIC
/begin CHARACTERISTIC mOFANGOB "Steady state deviation allowable value (for usual, retard side)" VALUE 0x0000893F REC_UBYTE_C 0 COMP_0048 0 127.5 /begin FUNCTION_LIST KF7-500.6D[9] KF7-500.47B[15] /end FUNCTION_LIST /end CHARACTERISTIC
/begin CHARACTERISTIC mOFANGOF "Steady state deviation allowable value (for usual, advance side)" VALUE 0x00008940 REC_UBYTE_C 0 COMP_0048 0 127.5 /begin FUNCTION_LIST KF7-500.6D[9] KF7-500.47B[15] /end FUNCTION_LIST /end CHARACTERISTIC
/begin CHARACTERISTIC mREVH "High rotation judgement speed" VALUE 0x00008A4D REC_UBYTE_C 0 COMP_0006 0 3187.5 /begin FUNCTION_LIST KF7-500.7[12] /end FUNCTION_LIST /end CHARACTERISTIC
/begin CHARACTERISTIC mREVL "Low rotation judgement speed" VALUE 0x00008A4F REC_UBYTE_C 0 COMP_0006 0 3187.5 /begin FUNCTION_LIST KF7-500.7[12] /end FUNCTION_LIST /end CHARACTERISTIC
/begin CHARACTERISTIC mRPMMNC "CAM signal diagnosis permission speed" VALUE 0x00008ACE REC_UBYTE_C 0 COMP_0006 0 3187.5 /begin FUNCTION_LIST KF7-500.6D[9] /end FUNCTION_LIST /end CHARACTERISTIC
/begin CHARACTERISTIC mSENRPMH "Engine speed (for the hysteresis)" VALUE 0x000094FA REC_UWORD_C 0 COMP_0006 0 819187.5 /begin FUNCTION_LIST KF7-450.50[10] /end FUNCTION_LIST /end CHARACTERISTIC
/begin CHARACTERISTIC mTHRNGH "Throttle open-degree judgement voltage upper limit value" VALUE 0x00008BE7 REC_UBYTE_C 0 COMP_0054 0 5100 /begin FUNCTION_LIST KF7-500.7[12] /end FUNCTION_LIST /end CHARACTERISTIC
/begin CHARACTERISTIC mTHRNGL "Throttle open-degree judgement voltage lower limit value" VALUE 0x00008BE8 REC_UBYTE_C 0 COMP_0054 0 5100 /begin FUNCTION_LIST KF7-500.7[12] /end FUNCTION_LIST /end CHARACTERISTIC
/begin CHARACTERISTIC mTMCMON "MONT CPC NG judgement delay" VALUE 0x00008C29 REC_UBYTE_C 0 COMP_0234 0 2550 /begin FUNCTION_LIST KF7-500.20B[4] /end FUNCTION_LIST /end CHARACTERISTIC
/begin CHARACTERISTIC mTMLOF "After the start, compulsion MIL lights out" VALUE 0x00008C5A REC_UBYTE_C 0 COMP_0014 0 2550 /begin FUNCTION_LIST KF7-500.1[54] /end FUNCTION_LIST /end CHARACTERISTIC
/begin CHARACTERISTIC mTMRND2 "Fuel diagnosis LEAN CPC NG judgement delay" VALUE 0x00008C7C REC_UBYTE_C 0 COMP_0049 0 255 /begin FUNCTION_LIST KF7-500.20B[4] /end FUNCTION_LIST /end CHARACTERISTIC
/begin CHARACTERISTIC mTMRNGD "Fuel diagnosis RICH CPC NG judgement delay" VALUE 0x00008C7D REC_UBYTE_C 0 COMP_0049 0 255 /begin FUNCTION_LIST KF7-500.20B[4] /end FUNCTION_LIST /end CHARACTERISTIC
/begin CHARACTERISTIC mTMRNGF "Fuel diagnosis NG judgement delay" VALUE 0x00008C7E REC_UBYTE_C 0 COMP_0049 0 255 /begin FUNCTION_LIST KF7-500.20B[4] /end FUNCTION_LIST /end CHARACTERISTIC
/begin CHARACTERISTIC mTMTRIP "Engine rotation continuation time" VALUE 0x00008CA8 REC_UBYTE_C 0 COMP_0234 0 2550 /begin FUNCTION_LIST KF7-500.1[54] /end FUNCTION_LIST /end CHARACTERISTIC
/begin CHARACTERISTIC mTMVSNG "Vehicle speed sensor NG judgement time" VALUE 0x00008CAF REC_UBYTE_C 0 COMP_0013 0 255 /begin FUNCTION_LIST KF7-500.16[4] KF7-505.49[3] /end FUNCTION_LIST /end CHARACTERISTIC
/begin CHARACTERISTIC mTPDEFO "Fuel injection quantity lower limit value" VALUE 0x0000977C REC_ULONG_C 0 COMP_0263_S 0 26214418.7843784 /begin FUNCTION_LIST KF7-450.50[10] /end FUNCTION_LIST /end CHARACTERISTIC
/begin CHARACTERISTIC mTPSLMT "TPS the second-fold trouble judgement TP deviation" VALUE 0x00009600 REC_UWORD_C 0 COMP_0144 0 31.999495335 /begin FUNCTION_LIST KF7-450.50[10] /end FUNCTION_LIST /end CHARACTERISTIC
/begin CHARACTERISTIC mTRCADV "At the time of the torque control, ignition timing" VALUE 0x00008CE5 REC_UBYTE_C 0 COMP_0017 0 255 /begin FUNCTION_LIST KF7-450.50[10] /end FUNCTION_LIST /end CHARACTERISTIC
/begin CHARACTERISTIC mTTRIP1 "Trip 1 rush condition continuation time" VALUE 0x00008CF8 REC_UBYTE_C 0 COMP_0049 0 255 /begin FUNCTION_LIST KF7-500.1[54] /end FUNCTION_LIST /end CHARACTERISTIC
/begin CHARACTERISTIC mTTRIP2 "Trip 2 rush condition continuation time" VALUE 0x00008CF9 REC_UBYTE_C 0 COMP_0049 0 255 /begin FUNCTION_LIST KF7-500.1[54] /end FUNCTION_LIST /end CHARACTERISTIC
/begin CHARACTERISTIC mTTRIP3 "Trip 3 rush condition continuation time" VALUE 0x00008CFA REC_UBYTE_C 0 COMP_0049 0 255 /begin FUNCTION_LIST KF7-500.1[54] /end FUNCTION_LIST /end CHARACTERISTIC
/begin CHARACTERISTIC mTWDOWN "At the time of the fuel cut, diagnosis timing counter subtraction fee" VALUE 0x00008D23 REC_UBYTE_C 0 COMP_0355 0 0.99609375 /begin FUNCTION_LIST KF7-500.8[5] /end FUNCTION_LIST /end CHARACTERISTIC
/begin CHARACTERISTIC mTWNOK "Coolant temperature sensor trouble judgement temperature" VALUE 0x00008D57 REC_UBYTE_C 0 COMP_0035 -50 205 /begin FUNCTION_LIST KF7-500.1[54] KF7-500.8[5] /end FUNCTION_LIST /end CHARACTERISTIC
/begin CHARACTERISTIC mTWTIME "At the time of lack of the inhalation air, diagnosis timing counter addition value" VALUE 0x00008D73 REC_UBYTE_C 0 COMP_0355 0 0.99609375 /begin FUNCTION_LIST KF7-500.8[5] /end FUNCTION_LIST /end CHARACTERISTIC
/begin CHARACTERISTIC mTWTTYU "A TWTMR table is cut up, at least, a degree of an intake air temperature" VALUE 0x00008D74 REC_UBYTE_C 0 COMP_0035 -50 205 /begin FUNCTION_LIST KF7-500.8[5] /end FUNCTION_LIST /end CHARACTERISTIC
/begin CHARACTERISTIC mUSNGH "The AFM trouble judgement voltage high side" VALUE 0x00009642 REC_UWORD_C 0 COMP_0023 0 327675 /begin FUNCTION_LIST KF7-500.7[12] /end FUNCTION_LIST /end CHARACTERISTIC
/begin CHARACTERISTIC mUSNGL "The AFM trouble judgement voltage low side" VALUE 0x00009644 REC_UWORD_C 0 COMP_0023 0 327675 /begin FUNCTION_LIST KF7-500.7[12] /end FUNCTION_LIST /end CHARACTERISTIC
/begin CHARACTERISTIC mVBCS "START SW Just before on, battery voltage lower limit" VALUE 0x00008D98 REC_UBYTE_C 0 COMP_0033 0 20400 /begin FUNCTION_LIST KF7-500.6D[9] /end FUNCTION_LIST /end CHARACTERISTIC
/begin CHARACTERISTIC mVBCSMN "START SW At the time of on, battery voltage lower limit" VALUE 0x00008D99 REC_UBYTE_C 0 COMP_0033 0 20400 /begin FUNCTION_LIST KF7-500.6D[9] /end FUNCTION_LIST /end CHARACTERISTIC
/begin CHARACTERISTIC mVBCSTH "Effect voltage lower limit value with the crank corner sensor" VALUE 0x00008D9A REC_UBYTE_C 0 COMP_0033 0 20400 /begin FUNCTION_LIST KF7-500.6D[9] /end FUNCTION_LIST /end CHARACTERISTIC
/begin CHARACTERISTIC mVSNGD1 "NG judgement timer count rise delay" VALUE 0x00008DFD REC_UBYTE_C 0 COMP_0013 0 255 /begin FUNCTION_LIST KF7-500.16[4] /end FUNCTION_LIST /end CHARACTERISTIC
/begin CHARACTERISTIC mVSNGD2 "NG judgement timer count rise delay" VALUE 0x00008DFE REC_UBYTE_C 0 COMP_0013 0 255 /begin FUNCTION_LIST KF7-500.16[4] /end FUNCTION_LIST /end CHARACTERISTIC
/begin CHARACTERISTIC mVSPJN "Speed lower limit for the vehicle speed sensor diagnosis judgement" VALUE 0x00008E0E REC_UBYTE_C 0 COMP_0020 0 12750 /begin FUNCTION_LIST KF7-500.16[4] /end FUNCTION_LIST /end CHARACTERISTIC
/begin CHARACTERISTIC mVSPJTW "A coolant temperature lower limit for the vehicle speed sensor diagnosis judgement" VALUE 0x00008E10 REC_UBYTE_C 0 COMP_0035 -50 205 /begin FUNCTION_LIST KF7-500.16[4] /end FUNCTION_LIST /end CHARACTERISTIC
/begin CHARACTERISTIC mVTCINEL "At the time of the VTC idle, offset diagnosis permission engine rotation lower limit" VALUE 0x00008E2F REC_UBYTE_C 0 COMP_0006 0 3187.5 /begin FUNCTION_LIST KF7-500.6D[9] KF7-500.47B[15] /end FUNCTION_LIST /end CHARACTERISTIC
/begin CHARACTERISTIC mVTCITWL "At the time of the VTC idle, offset diagnosis permission coolant temperature lower limit" VALUE 0x00008E30 REC_UBYTE_C 0 COMP_0210_S -50 205 /begin FUNCTION_LIST KF7-500.6D[9] KF7-500.47B[15] /end FUNCTION_LIST /end CHARACTERISTIC
/begin CHARACTERISTIC mVTCMLDLY "A NG judgement delay for MIL lighting" VALUE 0x00008E35 REC_UBYTE_C 0 COMP_0295 0 25500 /begin FUNCTION_LIST KF7-500.6D[9] KF7-500.47B[15] /end FUNCTION_LIST /end CHARACTERISTIC
/begin CHARACTERISTIC mVTCNGDLY "NG judgement delay" VALUE 0x00008E3F REC_UBYTE_C 0 COMP_0008 0 25500 /begin FUNCTION_LIST KF7-500.6D[9] KF7-500.47B[15] /end FUNCTION_LIST /end CHARACTERISTIC
/begin CHARACTERISTIC mVTCONEH "VTC offset diagnosis permission engine speed upper limit" VALUE 0x00008E40 REC_UBYTE_C 0 COMP_0006 0 3187.5 /begin FUNCTION_LIST KF7-500.6D[9] KF7-500.47B[15] /end FUNCTION_LIST /end CHARACTERISTIC
/begin CHARACTERISTIC mVTCONEL "VTC offset diagnosis permission engine speed lower limit" VALUE 0x00008E41 REC_UBYTE_C 0 COMP_0006 0 3187.5 /begin FUNCTION_LIST KF7-500.6D[9] KF7-500.47B[15] /end FUNCTION_LIST /end CHARACTERISTIC
/begin CHARACTERISTIC mVTCOTWH "VTC offset diagnosis permission coolant temperature upper limit" VALUE 0x00008E44 REC_UBYTE_C 0 COMP_0035 -50 205 /begin FUNCTION_LIST KF7-500.6D[9] KF7-500.47B[15] /end FUNCTION_LIST /end CHARACTERISTIC
/begin CHARACTERISTIC mVTCOTWL "VTC offset diagnosis permission coolant temperature lower limit" VALUE 0x00008E45 REC_UBYTE_C 0 COMP_0035 -50 205 /begin FUNCTION_LIST KF7-500.6D[9] KF7-500.47B[15] /end FUNCTION_LIST /end CHARACTERISTIC
/begin CHARACTERISTIC mVTCSDLY "After the start, diagnosis start delay" VALUE 0x00008E48 REC_UBYTE_C 0 COMP_0008 0 25500 /begin FUNCTION_LIST KF7-500.6D[9] KF7-500.47B[15] /end FUNCTION_LIST /end CHARACTERISTIC
/begin CHARACTERISTIC mVTCVSP "VTC control vehicle speed lower limit" VALUE 0x00008E5C REC_UBYTE_C 0 COMP_0007 0 510 /begin FUNCTION_LIST KF7-500.6D[9] KF7-500.47B[15] /end FUNCTION_LIST /end CHARACTERISTIC
/begin CHARACTERISTIC mVTRP1H "TRIP1 operation condition formation vehicle speed upper limit" VALUE 0x00008E88 REC_UBYTE_C 0 COMP_0007 0 510 /begin FUNCTION_LIST KF7-500.1[54] /end FUNCTION_LIST /end CHARACTERISTIC
/begin CHARACTERISTIC mVTRP1L "TRIP1 operation condition formation vehicle speed lower limit" VALUE 0x00008E89 REC_UBYTE_C 0 COMP_0007 0 510 /begin FUNCTION_LIST KF7-500.1[54] /end FUNCTION_LIST /end CHARACTERISTIC
/begin CHARACTERISTIC mTCCLV "A TP maximum value reference table for the operation load value computation" CURVE 0x0000E7CA REC_UWORD_C 0 COMP_0052 0 31.99956087
 /begin AXIS_DESCR FIX_AXIS NO_INPUT_QUANTITY COMP_0271_S 16 0 6000 FIX_AXIS_PAR_DIST 0 1 16 /end AXIS_DESCR
 /begin FUNCTION_LIST KF7-500.1[54] /end FUNCTION_LIST
/end CHARACTERISTIC
/begin CHARACTERISTIC mTITAC0WO "At the time of WOT, a standard condition filling up efficiency speed table" CURVE 0x0000D2FA REC_UBYTE_C 0 COMP_0009 0 199.21875
 /begin AXIS_DESCR FIX_AXIS NO_INPUT_QUANTITY COMP_0273_S 16 400 6400 FIX_AXIS_PAR_DIST 0 1 16 /end AXIS_DESCR
 /begin FUNCTION_LIST KF7-500.7[12] /end FUNCTION_LIST
/end CHARACTERISTIC
/begin CHARACTERISTIC mTQZIKI "QZIKKI table" CURVE 0x0000EEC2 REC_UWORD_C 0 COMP_0004 0 65535
 /begin AXIS_DESCR FIX_AXIS NO_INPUT_QUANTITY COMP_0280_S 16 -40 110 FIX_AXIS_PAR_DIST 0 1 16 /end AXIS_DESCR
 /begin FUNCTION_LIST KF7-500.8[5] /end FUNCTION_LIST
/end CHARACTERISTIC
/begin CHARACTERISTIC mTRPAMB "RPAMB reference table" CURVE 0x0000D862 REC_UBYTE_C 0 COMP_0044 0 1.9921875
 /begin AXIS_DESCR COM_AXIS NO_INPUT_QUANTITY COMP_0054 16 0 5100 AXIS_PTS_REF mLPAMB /end AXIS_DESCR
 /begin FUNCTION_LIST KF7-500.1[54] KF7-500.30[8] /end FUNCTION_LIST
/end CHARACTERISTIC
/begin CHARACTERISTIC mTVSTHH "An injection quantity upper limit table for the vehicle speed sensor diagnosis judgement" CURVE 0x0000DCAA REC_UBYTE_C 0 COMP_0001 0 31.875
 /begin AXIS_DESCR FIX_AXIS NO_INPUT_QUANTITY COMP_0271_S 16 0 6000 FIX_AXIS_PAR_DIST 0 1 16 /end AXIS_DESCR
 /begin FUNCTION_LIST KF7-500.16[4] /end FUNCTION_LIST
/end CHARACTERISTIC
/begin CHARACTERISTIC mTVSTLL "An injection quantity lower limit table for the vehicle speed sensor diagnosis judgement" CURVE 0x0000DCBA REC_UBYTE_C 0 COMP_0001 0 31.875
 /begin AXIS_DESCR FIX_AXIS NO_INPUT_QUANTITY COMP_0271_S 16 0 6000 FIX_AXIS_PAR_DIST 0 1 16 /end AXIS_DESCR
 /begin FUNCTION_LIST KF7-500.16[4] /end FUNCTION_LIST
/end CHARACTERISTIC
/begin CHARACTERISTIC mTAFMRCGH "AFM function upper limit diagnosis diagnosis criteria gain table" CURVE 0x0000CE0E REC_UBYTE_C 0 COMP_0435 0 7.96875
 /begin AXIS_DESCR FIX_AXIS NO_INPUT_QUANTITY COMP_0504_S 4 0.55 4.84 FIX_AXIS_PAR_DIST 0 1 4 /end AXIS_DESCR
 /begin FUNCTION_LIST KF7-500.7[12] /end FUNCTION_LIST
/end CHARACTERISTIC
/begin CHARACTERISTIC mTPAMBHK "At the time of WOT, filling up efficiency atomospheric pressure compensation coefficient table value" CURVE 0x0000D6E0 REC_UBYTE_C 0 COMP_0045 0 1.9921875
 /begin AXIS_DESCR FIX_AXIS NO_INPUT_QUANTITY COMP_0522_S 8 0 112 FIX_AXIS_PAR_DIST 0 1 8 /end AXIS_DESCR
 /begin FUNCTION_LIST KF7-500.7[12] /end FUNCTION_LIST
/end CHARACTERISTIC
/begin CHARACTERISTIC mTSENNRPM "Engine speed limiter table" CURVE 0x0000D8B2 REC_UBYTE_C 0 COMP_0000 0 6375
 /begin AXIS_DESCR FIX_AXIS NO_INPUT_QUANTITY COMP_0329_S 8 0 112 FIX_AXIS_PAR_DIST 0 1 8 /end AXIS_DESCR
 /begin FUNCTION_LIST KF7-450.50[10] /end FUNCTION_LIST
/end CHARACTERISTIC
/begin CHARACTERISTIC mTTAMBHK "At the time of WOT, filling up efficiency intake air temperature compensation coefficient table value" CURVE 0x0000D93A REC_UBYTE_C 0 COMP_0045 0 1.9921875
 /begin AXIS_DESCR FIX_AXIS NO_INPUT_QUANTITY COMP_0278_S 8 -40 100 FIX_AXIS_PAR_DIST 0 1 8 /end AXIS_DESCR
 /begin FUNCTION_LIST KF7-500.7[12] /end FUNCTION_LIST
/end CHARACTERISTIC
/begin CHARACTERISTIC mTWTKOU "At least, intake air temperature high time TWTMR table" CURVE 0x0000DDBE REC_UBYTE_C 0 COMP_0096 0 2550
 /begin AXIS_DESCR FIX_AXIS NO_INPUT_QUANTITY COMP_0280_S 8 -40 30 FIX_AXIS_PAR_DIST 0 1 8 /end AXIS_DESCR
 /begin FUNCTION_LIST KF7-500.8[5] /end FUNCTION_LIST
/end CHARACTERISTIC
/begin CHARACTERISTIC mTWTTEI "At least, intake air temperature low time TWTMR table" CURVE 0x0000DDC6 REC_UBYTE_C 0 COMP_0096 0 2550
 /begin AXIS_DESCR FIX_AXIS NO_INPUT_QUANTITY COMP_0280_S 8 -40 30 FIX_AXIS_PAR_DIST 0 1 8 /end AXIS_DESCR
 /begin FUNCTION_LIST KF7-500.8[5] /end FUNCTION_LIST
/end CHARACTERISTIC
/begin CHARACTERISTIC mfTWNG "Fuel temperature sensor diagnosis coolant temperature criteria" VALUE 0x0001020C REC_UBYTE_C 0 COMP_0283 0 1 BIT_MASK 0x0020 /begin FUNCTION_LIST KF7-500.2A[29] KF7-500.8[5] KF7-525.2[6] /end FUNCTION_LIST /end CHARACTERISTIC
/begin CHARACTERISTIC mfIGNG "0:Not DGN  1:DGN" VALUE 0x0001020D REC_UBYTE_C 0 COMP_0283 0 1 BIT_MASK 0x0080 /begin FUNCTION_LIST KF7-500.2A[29] KF7-500.10[3] KF7-525.2[6] /end FUNCTION_LIST /end CHARACTERISTIC
/begin CHARACTERISTIC mfISCNG "0:Not DGN  1:DGN" VALUE 0x0001020D REC_UBYTE_C 0 COMP_0283 0 1 BIT_MASK 0x0008 /begin FUNCTION_LIST KF7-500.2A[29] KF7-500.38A[4] /end FUNCTION_LIST /end CHARACTERISTIC
/begin CHARACTERISTIC mfCUNG "0:Not DGN  1:DGN" VALUE 0x0001020E REC_UBYTE_C 0 COMP_0283 0 1 BIT_MASK 0x0080 /begin FUNCTION_LIST KF7-500.2A[29] /end FUNCTION_LIST /end CHARACTERISTIC
/begin CHARACTERISTIC mfEGRNG "0:Not DGN  1:DGN" VALUE 0x0001020E REC_UBYTE_C 0 COMP_0283 0 1 BIT_MASK 0x0040 /begin FUNCTION_LIST KF7-500.2A[29] KF7-500.47B[15] R904.1.Gst_on_can_1_0_1 /end FUNCTION_LIST /end CHARACTERISTIC
/begin CHARACTERISTIC mfKNKNG "0:Not DGN  1:DGN" VALUE 0x0001020E REC_UBYTE_C 0 COMP_0283 0 1 BIT_MASK 0x0010 /begin FUNCTION_LIST KF7-500.2A[29] KF7-500.12[3] /end FUNCTION_LIST /end CHARACTERISTIC
/begin CHARACTERISTIC mfEGRSNG "0:Not DGN  1:DGN" VALUE 0x0001020E REC_UBYTE_C 0 COMP_0283 0 1 BIT_MASK 0x0008 /begin FUNCTION_LIST KF7-500.2A[29] /end FUNCTION_LIST /end CHARACTERISTIC
/begin CHARACTERISTIC mfEGRFNG "0:Not DGN  1:DGN" VALUE 0x0001020E REC_UBYTE_C 0 COMP_0283 0 1 BIT_MASK 0x0004 /begin FUNCTION_LIST KF7-500.2A[29] /end FUNCTION_LIST /end CHARACTERISTIC
/begin CHARACTERISTIC mfO2CLB1 "0:Not DGN  1:DGN" VALUE 0x0001020E REC_UBYTE_C 0 COMP_0283 0 1 BIT_MASK 0x0002 /begin FUNCTION_LIST KF7-500.2A[29] KF7-500.39[5] /end FUNCTION_LIST /end CHARACTERISTIC
/begin CHARACTERISTIC mfO2CLB2 "0:Not DGN  1:DGN" VALUE 0x0001020E REC_UBYTE_C 0 COMP_0283 0 1 BIT_MASK 0x0001 /begin FUNCTION_LIST KF7-500.2A[29] KF7-500.39[5] /end FUNCTION_LIST /end CHARACTERISTIC
/begin CHARACTERISTIC mfTANG "Fuel temperature sensor diagnosis intake air temperature criteria" VALUE 0x0001020F REC_UBYTE_C 0 COMP_0283 0 1 BIT_MASK 0x0080 /begin FUNCTION_LIST KF7-500.2A[29] KF7-500.44[3] /end FUNCTION_LIST /end CHARACTERISTIC
/begin CHARACTERISTIC mfMF6NG "0:Not DGN  1:DGN" VALUE 0x00010211 REC_UBYTE_C 0 COMP_0283 0 1 BIT_MASK 0x0020 /begin FUNCTION_LIST KF7-500.2A[29] /end FUNCTION_LIST /end CHARACTERISTIC
/begin CHARACTERISTIC mfMF5NG "0:Not DGN  1:DGN" VALUE 0x00010211 REC_UBYTE_C 0 COMP_0283 0 1 BIT_MASK 0x0010 /begin FUNCTION_LIST KF7-500.2A[29] /end FUNCTION_LIST /end CHARACTERISTIC
/begin CHARACTERISTIC mfMF4NG "0:Not DGN  1:DGN" VALUE 0x00010211 REC_UBYTE_C 0 COMP_0283 0 1 BIT_MASK 0x0008 /begin FUNCTION_LIST KF7-500.2A[29] /end FUNCTION_LIST /end CHARACTERISTIC
/begin CHARACTERISTIC mfMF3NG "0:Not DGN  1:DGN" VALUE 0x00010211 REC_UBYTE_C 0 COMP_0283 0 1 BIT_MASK 0x0004 /begin FUNCTION_LIST KF7-500.2A[29] /end FUNCTION_LIST /end CHARACTERISTIC
/begin CHARACTERISTIC mfMF2NG "0:Not DGN  1:DGN" VALUE 0x00010211 REC_UBYTE_C 0 COMP_0283 0 1 BIT_MASK 0x0002 /begin FUNCTION_LIST KF7-500.2A[29] /end FUNCTION_LIST /end CHARACTERISTIC
/begin CHARACTERISTIC mfMF1NG "0:Not DGN  1:DGN" VALUE 0x00010211 REC_UBYTE_C 0 COMP_0283 0 1 BIT_MASK 0x0001 /begin FUNCTION_LIST KF7-500.2A[29] /end FUNCTION_LIST /end CHARACTERISTIC
/begin CHARACTERISTIC mfMFMCNG "0:Not DGN  1:DGN" VALUE 0x00010212 REC_UBYTE_C 0 COMP_0283 0 1 BIT_MASK 0x0080 /begin FUNCTION_LIST KF7-500.2A[29] KF7-500.26[17] R904.1.Gst_on_can_1_0_1 /end FUNCTION_LIST /end CHARACTERISTIC
/begin CHARACTERISTIC mfEPRSNG "0:Not DGN  1:DGN" VALUE 0x00010212 REC_UBYTE_C 0 COMP_0283 0 1 BIT_MASK 0x0010 /begin FUNCTION_LIST KF7-500.2A[29] /end FUNCTION_LIST /end CHARACTERISTIC
/begin CHARACTERISTIC mfEVPNG "0:Not DGN  1:DGN" VALUE 0x00010212 REC_UBYTE_C 0 COMP_0283 0 1 BIT_MASK 0x0008 /begin FUNCTION_LIST KF7-500.2A[29] /end FUNCTION_LIST /end CHARACTERISTIC
/begin CHARACTERISTIC mfMRNG "0:Not DGN  1:DGN" VALUE 0x00010212 REC_UBYTE_C 0 COMP_0283 0 1 BIT_MASK 0x0004 /begin FUNCTION_LIST KF7-500.2A[29] /end FUNCTION_LIST /end CHARACTERISTIC
/begin CHARACTERISTIC mfO2R1NG "0:Not DGN  1:DGN" VALUE 0x00010212 REC_UBYTE_C 0 COMP_0283 0 1 BIT_MASK 0x0002 /begin FUNCTION_LIST KF7-500.2A[29] /end FUNCTION_LIST /end CHARACTERISTIC
/begin CHARACTERISTIC mfO2R2NG "0:Not DGN  1:DGN" VALUE 0x00010212 REC_UBYTE_C 0 COMP_0283 0 1 BIT_MASK 0x0001 /begin FUNCTION_LIST KF7-500.2A[29] /end FUNCTION_LIST /end CHARACTERISTIC
/begin CHARACTERISTIC mfPRESNG "0:Not DGN  1:DGN" VALUE 0x00010213 REC_UBYTE_C 0 COMP_0283 0 1 BIT_MASK 0x0020 /begin FUNCTION_LIST KF7-500.2A[29] KF7-500.51[3] /end FUNCTION_LIST /end CHARACTERISTIC
/begin CHARACTERISTIC mfMRNG2 "0:Not DGN  1:DGN" VALUE 0x00010213 REC_UBYTE_C 0 COMP_0283 0 1 BIT_MASK 0x0004 /begin FUNCTION_LIST KF7-500.2A[29] /end FUNCTION_LIST /end CHARACTERISTIC
/begin CHARACTERISTIC mfO2HR1 "0:Not DGN  1:DGN" VALUE 0x00010214 REC_UBYTE_C 0 COMP_0283 0 1 BIT_MASK 0x0040 /begin FUNCTION_LIST KF7-500.2A[29] KF7-500.25A[7] /end FUNCTION_LIST /end CHARACTERISTIC
/begin CHARACTERISTIC mfCDCNG "0:Not DGN  1:DGN" VALUE 0x00010214 REC_UBYTE_C 0 COMP_0283 0 1 BIT_MASK 0x0020 /begin FUNCTION_LIST KF7-500.2A[29] /end FUNCTION_LIST /end CHARACTERISTIC
/begin CHARACTERISTIC mfTWCLNG "0:Not DGN  1:DGN" VALUE 0x00010214 REC_UBYTE_C 0 COMP_0283 0 1 BIT_MASK 0x0001 /begin FUNCTION_LIST KF7-500.2A[29] KF7-500.8[5] /end FUNCTION_LIST /end CHARACTERISTIC
/begin CHARACTERISTIC mfO2HR2 "0:Not DGN  1:DGN" VALUE 0x00010215 REC_UBYTE_C 0 COMP_0283 0 1 BIT_MASK 0x0040 /begin FUNCTION_LIST KF7-500.2A[29] KF7-500.25A[7] /end FUNCTION_LIST /end CHARACTERISTIC
/begin CHARACTERISTIC mfNSNG "0:Not DGN  1:DGN" VALUE 0x00010215 REC_UBYTE_C 0 COMP_0283 0 1 BIT_MASK 0x0020 /begin FUNCTION_LIST KF7-500.2A[29] KF7-500.28[4] KF7-505.23[2] /end FUNCTION_LIST /end CHARACTERISTIC
/begin CHARACTERISTIC mfEGCSNG "0:Not DGN  1:DGN" VALUE 0x00010215 REC_UBYTE_C 0 COMP_0283 0 1 BIT_MASK 0x0008 /begin FUNCTION_LIST KF7-500.2A[29] /end FUNCTION_LIST /end CHARACTERISTIC
/begin CHARACTERISTIC mfSAIRCS "0:Not DGN  1:DGN" VALUE 0x00010215 REC_UBYTE_C 0 COMP_0283 0 1 BIT_MASK 0x0004 /begin FUNCTION_LIST KF7-500.2A[29] R904.1.Gst_on_can_1_0_1 /end FUNCTION_LIST /end CHARACTERISTIC
/begin CHARACTERISTIC mfEVCNNG "0:Not DGN  1:DGN" VALUE 0x00010215 REC_UBYTE_C 0 COMP_0283 0 1 BIT_MASK 0x0001 /begin FUNCTION_LIST KF7-500.2A[29] KF7-500.30[8] /end FUNCTION_LIST /end CHARACTERISTIC
/begin CHARACTERISTIC mfO2PH1 "0:Not DGN  1:DGN" VALUE 0x00010219 REC_UBYTE_C 0 COMP_0283 0 1 BIT_MASK 0x0080 /begin FUNCTION_LIST KF7-500.2A[29] /end FUNCTION_LIST /end CHARACTERISTIC
/begin CHARACTERISTIC mfO2PH2 "0:Not DGN  1:DGN" VALUE 0x00010219 REC_UBYTE_C 0 COMP_0283 0 1 BIT_MASK 0x0040 /begin FUNCTION_LIST KF7-500.2A[29] /end FUNCTION_LIST /end CHARACTERISTIC
/begin CHARACTERISTIC mfEVPSYS "0:Not DGN  1:DGN" VALUE 0x0001021A REC_UBYTE_C 0 COMP_0283 0 1 BIT_MASK 0x0020 /begin FUNCTION_LIST KF7-500.2A[29] /end FUNCTION_LIST /end CHARACTERISTIC
/begin CHARACTERISTIC mfEVPNG3 "0:Not DGN  1:DGN" VALUE 0x0001021A REC_UBYTE_C 0 COMP_0283 0 1 BIT_MASK 0x0001 /begin FUNCTION_LIST KF7-500.2A[29] /end FUNCTION_LIST /end CHARACTERISTIC
/begin CHARACTERISTIC mfKNKNG2 "0:Not DGN  1:DGN" VALUE 0x0001021B REC_UBYTE_C 0 COMP_0283 0 1 BIT_MASK 0x0010 /begin FUNCTION_LIST KF7-500.2A[29] /end FUNCTION_LIST /end CHARACTERISTIC
/begin CHARACTERISTIC mfEVPNG2 "0:Not DGN  1:DGN" VALUE 0x0001021B REC_UBYTE_C 0 COMP_0283 0 1 BIT_MASK 0x0008 /begin FUNCTION_LIST KF7-500.2A[29] /end FUNCTION_LIST /end CHARACTERISTIC
/begin CHARACTERISTIC mfEVCN2 "0:Not DGN  1:DGN" VALUE 0x0001021B REC_UBYTE_C 0 COMP_0283 0 1 BIT_MASK 0x0004 /begin FUNCTION_LIST KF7-500.2A[29] KF7-500.30[8] /end FUNCTION_LIST /end CHARACTERISTIC
/begin CHARACTERISTIC mfO2R2RO "0:Not DGN  1:DGN" VALUE 0x0001021C REC_UBYTE_C 0 COMP_0283 0 1 BIT_MASK 0x0008 /begin FUNCTION_LIST KF7-500.2A[29] /end FUNCTION_LIST /end CHARACTERISTIC
/begin CHARACTERISTIC mfO2R2LO "0:Not DGN  1:DGN" VALUE 0x0001021C REC_UBYTE_C 0 COMP_0283 0 1 BIT_MASK 0x0004 /begin FUNCTION_LIST KF7-500.2A[29] /end FUNCTION_LIST /end CHARACTERISTIC
/begin CHARACTERISTIC mfO2R2AV "0:Not DGN  1:DGN" VALUE 0x0001021C REC_UBYTE_C 0 COMP_0283 0 1 BIT_MASK 0x0002 /begin FUNCTION_LIST KF7-500.2A[29] KF7-500.24[10] /end FUNCTION_LIST /end CHARACTERISTIC
/begin CHARACTERISTIC mfO2R1RO "0:Not DGN  1:DGN" VALUE 0x0001021E REC_UBYTE_C 0 COMP_0283 0 1 BIT_MASK 0x0040 /begin FUNCTION_LIST KF7-500.2A[29] /end FUNCTION_LIST /end CHARACTERISTIC
/begin CHARACTERISTIC mfO2R1LO "0:Not DGN  1:DGN" VALUE 0x0001021E REC_UBYTE_C 0 COMP_0283 0 1 BIT_MASK 0x0020 /begin FUNCTION_LIST KF7-500.2A[29] /end FUNCTION_LIST /end CHARACTERISTIC
/begin CHARACTERISTIC mfO2R1AV "0:Not DGN  1:DGN" VALUE 0x0001021E REC_UBYTE_C 0 COMP_0283 0 1 BIT_MASK 0x0010 /begin FUNCTION_LIST KF7-500.2A[29] KF7-500.24[10] /end FUNCTION_LIST /end CHARACTERISTIC
/begin CHARACTERISTIC mfEGRNG2 "0:Not DGN  1:DGN" VALUE 0x0001021E REC_UBYTE_C 0 COMP_0283 0 1 BIT_MASK 0x0004 /begin FUNCTION_LIST KF7-500.2A[29] /end FUNCTION_LIST /end CHARACTERISTIC
/begin CHARACTERISTIC mfISCDN "0:Not DGN  1:DGN" VALUE 0x0001021E REC_UBYTE_C 0 COMP_0283 0 1 BIT_MASK 0x0002 /begin FUNCTION_LIST KF7-500.2A[29] /end FUNCTION_LIST /end CHARACTERISTIC
/begin CHARACTERISTIC mfTHMNG "0:Not DGN  1:DGN" VALUE 0x0001021E REC_UBYTE_C 0 COMP_0283 0 1 BIT_MASK 0x0001 /begin FUNCTION_LIST KF7-500.2A[29] KF7-500.60[5] /end FUNCTION_LIST /end CHARACTERISTIC
/begin CHARACTERISTIC mfEGRDN "0:Not DGN  1:DGN" VALUE 0x0001021F REC_UBYTE_C 0 COMP_0283 0 1 BIT_MASK 0x0080 /begin FUNCTION_LIST KF7-500.2A[29] /end FUNCTION_LIST /end CHARACTERISTIC
/begin CHARACTERISTIC mfVTCSV1 "0:Not DGN  1:DGN" VALUE 0x0001021F REC_UBYTE_C 0 COMP_0283 0 1 BIT_MASK 0x0010 /begin FUNCTION_LIST KF7-500.2A[29] KF7-500.47B[15] /end FUNCTION_LIST /end CHARACTERISTIC
/begin CHARACTERISTIC mfVTCSV2 "0:Not DGN  1:DGN" VALUE 0x0001021F REC_UBYTE_C 0 COMP_0283 0 1 BIT_MASK 0x0008 /begin FUNCTION_LIST KF7-500.2A[29] KF7-500.47B[15] /end FUNCTION_LIST /end CHARACTERISTIC
/begin CHARACTERISTIC mfVIASDN "0:Not DGN  1:DGN" VALUE 0x00010220 REC_UBYTE_C 0 COMP_0283 0 1 BIT_MASK 0x0080 /begin FUNCTION_LIST KF7-500.2A[29] KF7-500.56[2] /end FUNCTION_LIST /end CHARACTERISTIC
/begin CHARACTERISTIC mfEVP2NG "0:Not DGN  1:DGN" VALUE 0x00010223 REC_UBYTE_C 0 COMP_0283 0 1 BIT_MASK 0x0080 /begin FUNCTION_LIST KF7-500.2A[29] /end FUNCTION_LIST /end CHARACTERISTIC
/begin CHARACTERISTIC mfDCS1NG "0:Not DGN  1:DGN" VALUE 0x00010224 REC_UBYTE_C 0 COMP_0283 0 1 BIT_MASK 0x0020 /begin FUNCTION_LIST KF7-500.2A[29] KF7-500.6D[9] /end FUNCTION_LIST /end CHARACTERISTIC
/begin CHARACTERISTIC mfDCS2NG "0:Not DGN  1:DGN" VALUE 0x00010224 REC_UBYTE_C 0 COMP_0283 0 1 BIT_MASK 0x0010 /begin FUNCTION_LIST KF7-500.2A[29] KF7-500.6D[9] /end FUNCTION_LIST /end CHARACTERISTIC
/begin CHARACTERISTIC mfDCS3NG "0:Not DGN  1:DGN" VALUE 0x00010224 REC_UBYTE_C 0 COMP_0283 0 1 BIT_MASK 0x0008 /begin FUNCTION_LIST KF7-500.2A[29] KF7-500.6D[9] /end FUNCTION_LIST /end CHARACTERISTIC
/begin CHARACTERISTIC mfDPS1NG "0:Not DGN  1:DGN" VALUE 0x00010224 REC_UBYTE_C 0 COMP_0283 0 1 BIT_MASK 0x0004 /begin FUNCTION_LIST KF7-500.2A[29] KF7-500.6D[9] /end FUNCTION_LIST /end CHARACTERISTIC
/begin CHARACTERISTIC mfDPS2NG "0:Not DGN  1:DGN" VALUE 0x00010224 REC_UBYTE_C 0 COMP_0283 0 1 BIT_MASK 0x0002 /begin FUNCTION_LIST KF7-500.2A[29] KF7-500.6D[9] /end FUNCTION_LIST /end CHARACTERISTIC
/begin CHARACTERISTIC mfDPS3NG "0:Not DGN  1:DGN" VALUE 0x00010224 REC_UBYTE_C 0 COMP_0283 0 1 BIT_MASK 0x0001 /begin FUNCTION_LIST KF7-500.2A[29] KF7-500.6D[9] /end FUNCTION_LIST /end CHARACTERISTIC
/begin CHARACTERISTIC mfPPSNG "0:Not DGN  1:DGN" VALUE 0x00010226 REC_UBYTE_C 0 COMP_0283 0 1 BIT_MASK 0x0001 /begin FUNCTION_LIST KF7-500.2A[29] KF7-500.73[1] /end FUNCTION_LIST /end CHARACTERISTIC
/begin CHARACTERISTIC mfALUNG "0:Not DGN  1:DGN" VALUE 0x00010227 REC_UBYTE_C 0 COMP_0283 0 1 BIT_MASK 0x0040
 /begin FUNCTION_LIST KF7-500.2A[29] KF7-505.39[2] KF7-505.41[2] KF7-525.2[6] KF7-525.2S[10] /end FUNCTION_LIST
/end CHARACTERISTIC
/begin CHARACTERISTIC mfQCKNG "0:Not DGN  1:DGN" VALUE 0x00010227 REC_UBYTE_C 0 COMP_0283 0 1 BIT_MASK 0x0020 /begin FUNCTION_LIST KF7-500.2A[29] KF7-505.40[1] KF7-525.2[6] KF7-525.2S[10] /end FUNCTION_LIST /end CHARACTERISTIC
/begin CHARACTERISTIC mfADNG "0:Not DGN  1:DGN" VALUE 0x00010227 REC_UBYTE_C 0 COMP_0283 0 1 BIT_MASK 0x0004 /begin FUNCTION_LIST KF7-500.2A[29] KF7-505.38[4] /end FUNCTION_LIST /end CHARACTERISTIC
/begin CHARACTERISTIC mfIC3NG "0:Not DGN  1:DGN" VALUE 0x00010227 REC_UBYTE_C 0 COMP_0283 0 1 BIT_MASK 0x0002 /begin FUNCTION_LIST KF7-500.2A[29] /end FUNCTION_LIST /end CHARACTERISTIC
/begin CHARACTERISTIC mfAVCCNG "0:Not DGN  1:DGN" VALUE 0x0001022A REC_UBYTE_C 0 COMP_0283 0 1 BIT_MASK 0x0001
 /begin FUNCTION_LIST KF7-500.2A[29] KF7-505.32[6] KF7-505.34[3] KF7-525.2[6] KF7-525.2S[10] /end FUNCTION_LIST
/end CHARACTERISTIC
/begin CHARACTERISTIC mfTPCLNG "0:Not DGN  1:DGN" VALUE 0x0001022B REC_UBYTE_C 0 COMP_0283 0 1 BIT_MASK 0x0002 /begin FUNCTION_LIST KF7-500.2A[29] KF7-505.29[4] KF7-525.2[6] KF7-525.2S[10] /end FUNCTION_LIST /end CHARACTERISTIC
/begin CHARACTERISTIC mfTHFBNG "0:Not DGN  1:DGN" VALUE 0x0001022C REC_UBYTE_C 0 COMP_0283 0 1 BIT_MASK 0x0080 /begin FUNCTION_LIST KF7-500.2A[29] KF7-505.15[4] KF7-525.2[6] KF7-525.2S[10] /end FUNCTION_LIST /end CHARACTERISTIC
/begin CHARACTERISTIC mfVAPXNG "0:Not DGN  1:DGN" VALUE 0x0001022C REC_UBYTE_C 0 COMP_0283 0 1 BIT_MASK 0x0020
 /begin FUNCTION_LIST KF7-500.2A[29] KF7-505.17[3] KF7-525.2[6] KF7-525.2S[10] R301.21.SafetyLevel2_1_0_2 /end FUNCTION_LIST
/end CHARACTERISTIC
/begin CHARACTERISTIC mfAPOXNG "0:Not DGN  1:DGN" VALUE 0x0001022C REC_UBYTE_C 0 COMP_0283 0 1 BIT_MASK 0x0010
 /begin FUNCTION_LIST KF7-500.2A[29] KF7-505.9[3] KF7-525.2[6] KF7-525.2S[10] R301.21.SafetyLevel2_1_0_2 /end FUNCTION_LIST
/end CHARACTERISTIC
/begin CHARACTERISTIC mfTGTXNG "0:Not DGN  1:DGN" VALUE 0x0001022C REC_UBYTE_C 0 COMP_0283 0 1 BIT_MASK 0x0008
 /begin FUNCTION_LIST KF7-500.2A[29] KF7-505.16[1] KF7-525.2[6] KF7-525.2S[10] R301.21.SafetyLevel2_1_0_2 /end FUNCTION_LIST
/end CHARACTERISTIC
/begin CHARACTERISTIC mfSERVNG "0:Not DGN  1:DGN" VALUE 0x0001022C REC_UBYTE_C 0 COMP_0283 0 1 BIT_MASK 0x0002 /begin FUNCTION_LIST KF7-500.2A[29] KF7-505.32[6] KF7-525.2[6] KF7-525.2S[10] /end FUNCTION_LIST /end CHARACTERISTIC
/begin CHARACTERISTIC mfASTRNG "0:Not DGN  1:DGN" VALUE 0x0001022C REC_UBYTE_C 0 COMP_0283 0 1 BIT_MASK 0x0001 /begin FUNCTION_LIST KF7-500.2A[29] KF7-505.17[3] R301.21.SafetyLevel2_1_0_2 /end FUNCTION_LIST /end CHARACTERISTIC
/begin CHARACTERISTIC mfQHAPNG "0:Not DGN  1:DGN" VALUE 0x0001022D REC_UBYTE_C 0 COMP_0283 0 1 BIT_MASK 0x0008
 /begin FUNCTION_LIST KF7-500.2A[29] KF7-505.90[N] KF7-525.2[6] KF7-525.2S[10] R301.21.SafetyLevel2_1_0_2 /end FUNCTION_LIST
/end CHARACTERISTIC
/begin CHARACTERISTIC mfTEPDNG "0:Not DGN  1:DGN" VALUE 0x0001022D REC_UBYTE_C 0 COMP_0283 0 1 BIT_MASK 0x0004 /begin FUNCTION_LIST KF7-500.2A[29] KF7-505.51[2] KF7-525.2[6] KF7-525.2S[10] /end FUNCTION_LIST /end CHARACTERISTIC
/begin CHARACTERISTIC mfTATENG "0:Not DGN  1:DGN" VALUE 0x0001022D REC_UBYTE_C 0 COMP_0283 0 1 BIT_MASK 0x0002
 /begin FUNCTION_LIST KF7-500.2A[29] KF7-505.52[1] KF7-525.2[6] KF7-525.2S[10] R301.21.SafetyLevel2_1_0_2 /end FUNCTION_LIST
/end CHARACTERISTIC
/begin CHARACTERISTIC mfTTEPNG "0:Not DGN  1:DGN" VALUE 0x0001022D REC_UBYTE_C 0 COMP_0283 0 1 BIT_MASK 0x0001
 /begin FUNCTION_LIST KF7-500.2A[29] KF7-505.53[1] KF7-525.2[6] KF7-525.2S[10] R301.21.SafetyLevel2_1_0_2 /end FUNCTION_LIST
/end CHARACTERISTIC
/begin CHARACTERISTIC mfRLONNG "0:Not DGN  1:DGN" VALUE 0x0001022E REC_UBYTE_C 0 COMP_0283 0 1 BIT_MASK 0x0080 /begin FUNCTION_LIST KF7-500.2A[29] KF7-505.31[5] KF7-525.2[6] KF7-525.2S[10] /end FUNCTION_LIST /end CHARACTERISTIC
/begin CHARACTERISTIC mfRLOFNG "0:Not DGN  1:DGN" VALUE 0x0001022E REC_UBYTE_C 0 COMP_0283 0 1 BIT_MASK 0x0040 /begin FUNCTION_LIST KF7-500.2A[29] KF7-505.31[5] KF7-525.2[6] KF7-525.2S[10] /end FUNCTION_LIST /end CHARACTERISTIC
/begin CHARACTERISTIC mfDTSPNG "0:Not DGN  1:DGN" VALUE 0x0001022E REC_UBYTE_C 0 COMP_0283 0 1 BIT_MASK 0x0020 /begin FUNCTION_LIST KF7-500.2A[29] KF7-505.54[2] R301.21.SafetyLevel2_1_0_2 /end FUNCTION_LIST /end CHARACTERISTIC
/begin CHARACTERISTIC mfBSOFNG "0:Not DGN  1:DGN" VALUE 0x0001022F REC_UBYTE_C 0 COMP_0283 0 1 BIT_MASK 0x0020
 /begin FUNCTION_LIST KF7-450.50[10] KF7-500.2A[29] KF7-505.27[4] KF7-525.2[6] KF7-525.2S[10] /end FUNCTION_LIST
/end CHARACTERISTIC
/begin CHARACTERISTIC mfTSKNGM "0:Not DGN  1:DGN" VALUE 0x00010230 REC_UBYTE_C 0 COMP_0283 0 1 BIT_MASK 0x0002 /begin FUNCTION_LIST KF7-500.2A[29] KF7-505.19[1] KF7-525.2[6] KF7-525.2S[10] /end FUNCTION_LIST /end CHARACTERISTIC
/begin CHARACTERISTIC mfROMNGM "0:Not DGN  1:DGN" VALUE 0x00010231 REC_UBYTE_C 0 COMP_0283 0 1 BIT_MASK 0x0080 /begin FUNCTION_LIST KF7-500.2A[29] KF7-505.35[2] KF7-525.2[6] KF7-525.2S[10] /end FUNCTION_LIST /end CHARACTERISTIC
/begin CHARACTERISTIC mfRAMNGM "0:Not DGN  1:DGN" VALUE 0x00010231 REC_UBYTE_C 0 COMP_0283 0 1 BIT_MASK 0x0040
 /begin FUNCTION_LIST KF7-500.2A[29] KF7-505.12[6] KF7-505.36[2] KF7-525.2[6] KF7-525.2S[10] /end FUNCTION_LIST
/end CHARACTERISTIC
/begin CHARACTERISTIC mfTIMNGM "0:Not DGN  1:DGN" VALUE 0x00010231 REC_UBYTE_C 0 COMP_0283 0 1 BIT_MASK 0x0004 /begin FUNCTION_LIST KF7-500.2A[29] KF7-505.37[1] /end FUNCTION_LIST /end CHARACTERISTIC
/begin CHARACTERISTIC mfROMNGS "0:Not DGN  1:DGN" VALUE 0x00010232 REC_UBYTE_C 0 COMP_0283 0 1 BIT_MASK 0x0080 /begin FUNCTION_LIST KF7-500.2A[29] KF7-505.35[2] KF7-525.2[6] KF7-525.2S[10] /end FUNCTION_LIST /end CHARACTERISTIC
/begin CHARACTERISTIC mfRANGM2 "0:Not DGN  1:DGN" VALUE 0x00010232 REC_UBYTE_C 0 COMP_0283 0 1 BIT_MASK 0x0010 /begin FUNCTION_LIST KF7-500.2A[29] /end FUNCTION_LIST /end CHARACTERISTIC
/begin CHARACTERISTIC mfVTCOF1 "0:Not DGN  1:DGN" VALUE 0x00010233 REC_UBYTE_C 0 COMP_0283 0 1 BIT_MASK 0x0008 /begin FUNCTION_LIST KF7-500.2A[29] KF7-500.6D[9] KF7-500.47B[15] /end FUNCTION_LIST /end CHARACTERISTIC
/begin CHARACTERISTIC mfVTCOF2 "0:Not DGN  1:DGN" VALUE 0x00010233 REC_UBYTE_C 0 COMP_0283 0 1 BIT_MASK 0x0004 /begin FUNCTION_LIST KF7-500.2A[29] KF7-500.6D[9] KF7-500.47B[15] /end FUNCTION_LIST /end CHARACTERISTIC
/begin CHARACTERISTIC mfVTCDR1 "0:Not DGN  1:DGN" VALUE 0x00010233 REC_UBYTE_C 0 COMP_0283 0 1 BIT_MASK 0x0002 /begin FUNCTION_LIST KF7-500.2A[29] KF7-500.47B[15] /end FUNCTION_LIST /end CHARACTERISTIC
/begin CHARACTERISTIC mfVTCDR2 "0:Not DGN  1:DGN" VALUE 0x00010233 REC_UBYTE_C 0 COMP_0283 0 1 BIT_MASK 0x0001 /begin FUNCTION_LIST KF7-500.2A[29] KF7-500.47B[15] /end FUNCTION_LIST /end CHARACTERISTIC
/begin CHARACTERISTIC mfVTOFE1 "0:Not DGN  1:DGN" VALUE 0x00010235 REC_UBYTE_C 0 COMP_0283 0 1 BIT_MASK 0x0008 /begin FUNCTION_LIST KF7-500.2A[29] /end FUNCTION_LIST /end CHARACTERISTIC
/begin CHARACTERISTIC mfVTOFE2 "0:Not DGN  1:DGN" VALUE 0x00010235 REC_UBYTE_C 0 COMP_0283 0 1 BIT_MASK 0x0004 /begin FUNCTION_LIST KF7-500.2A[29] /end FUNCTION_LIST /end CHARACTERISTIC
/begin CHARACTERISTIC mfVTDRE1 "0:Not DGN  1:DGN" VALUE 0x00010235 REC_UBYTE_C 0 COMP_0283 0 1 BIT_MASK 0x0002 /begin FUNCTION_LIST KF7-500.2A[29] /end FUNCTION_LIST /end CHARACTERISTIC
/begin CHARACTERISTIC mfVTDRE2 "0:Not DGN  1:DGN" VALUE 0x00010235 REC_UBYTE_C 0 COMP_0283 0 1 BIT_MASK 0x0001 /begin FUNCTION_LIST KF7-500.2A[29] /end FUNCTION_LIST /end CHARACTERISTIC
/begin CHARACTERISTIC mfDC21NG "0:Not DGN  1:DGN" VALUE 0x00010236 REC_UBYTE_C 0 COMP_0283 0 1 BIT_MASK 0x0004 /begin FUNCTION_LIST KF7-500.2A[29] KF7-500.6D[9] /end FUNCTION_LIST /end CHARACTERISTIC
/begin CHARACTERISTIC mfDC22NG "0:Not DGN  1:DGN" VALUE 0x00010236 REC_UBYTE_C 0 COMP_0283 0 1 BIT_MASK 0x0002 /begin FUNCTION_LIST KF7-500.2A[29] KF7-500.6D[9] /end FUNCTION_LIST /end CHARACTERISTIC
/begin CHARACTERISTIC mfDC23NG "0:Not DGN  1:DGN" VALUE 0x00010236 REC_UBYTE_C 0 COMP_0283 0 1 BIT_MASK 0x0001 /begin FUNCTION_LIST KF7-500.2A[29] KF7-500.6D[9] /end FUNCTION_LIST /end CHARACTERISTIC
/begin CHARACTERISTIC mfAFLNG1 "0:Not DGN  1:DGN" VALUE 0x00010237 REC_UBYTE_C 0 COMP_0283 0 1 BIT_MASK 0x0080 /begin FUNCTION_LIST KF7-500.2A[29] KF7-500.76[8] /end FUNCTION_LIST /end CHARACTERISTIC
/begin CHARACTERISTIC mfAFLNG2 "0:Not DGN  1:DGN" VALUE 0x00010237 REC_UBYTE_C 0 COMP_0283 0 1 BIT_MASK 0x0040 /begin FUNCTION_LIST KF7-500.2A[29] /end FUNCTION_LIST /end CHARACTERISTIC
/begin CHARACTERISTIC mfAFLLS "0:Not DGN  1:DGN" VALUE 0x00010237 REC_UBYTE_C 0 COMP_0283 0 1 BIT_MASK 0x0020 /begin FUNCTION_LIST KF7-500.2A[29] KF7-500.75[4] /end FUNCTION_LIST /end CHARACTERISTIC
/begin CHARACTERISTIC mfAFLRS "0:Not DGN  1:DGN" VALUE 0x00010237 REC_UBYTE_C 0 COMP_0283 0 1 BIT_MASK 0x0010 /begin FUNCTION_LIST KF7-500.2A[29] /end FUNCTION_LIST /end CHARACTERISTIC
/begin CHARACTERISTIC mfAFLHZ "0:Not DGN  1:DGN" VALUE 0x00010237 REC_UBYTE_C 0 COMP_0283 0 1 BIT_MASK 0x0008 /begin FUNCTION_LIST KF7-500.2A[29] /end FUNCTION_LIST /end CHARACTERISTIC
/begin CHARACTERISTIC mfAFLAV "0:Not DGN  1:DGN" VALUE 0x00010237 REC_UBYTE_C 0 COMP_0283 0 1 BIT_MASK 0x0004 /begin FUNCTION_LIST KF7-500.2A[29] KF7-500.74[11] /end FUNCTION_LIST /end CHARACTERISTIC
/begin CHARACTERISTIC mfAFHF1 "0:Not DGN  1:DGN" VALUE 0x00010237 REC_UBYTE_C 0 COMP_0283 0 1 BIT_MASK 0x0002 /begin FUNCTION_LIST KF7-500.2A[29] /end FUNCTION_LIST /end CHARACTERISTIC
/begin CHARACTERISTIC mfAFRNG1 "0:Not DGN  1:DGN" VALUE 0x00010238 REC_UBYTE_C 0 COMP_0283 0 1 BIT_MASK 0x0080 /begin FUNCTION_LIST KF7-500.2A[29] KF7-500.76[8] /end FUNCTION_LIST /end CHARACTERISTIC
/begin CHARACTERISTIC mfAFRNG2 "0:Not DGN  1:DGN" VALUE 0x00010238 REC_UBYTE_C 0 COMP_0283 0 1 BIT_MASK 0x0040 /begin FUNCTION_LIST KF7-500.2A[29] /end FUNCTION_LIST /end CHARACTERISTIC
/begin CHARACTERISTIC mfAFRLS "0:Not DGN  1:DGN" VALUE 0x00010238 REC_UBYTE_C 0 COMP_0283 0 1 BIT_MASK 0x0020 /begin FUNCTION_LIST KF7-500.2A[29] KF7-500.75[4] /end FUNCTION_LIST /end CHARACTERISTIC
/begin CHARACTERISTIC mfAFRRS "0:Not DGN  1:DGN" VALUE 0x00010238 REC_UBYTE_C 0 COMP_0283 0 1 BIT_MASK 0x0010 /begin FUNCTION_LIST KF7-500.2A[29] /end FUNCTION_LIST /end CHARACTERISTIC
/begin CHARACTERISTIC mfAFRHZ "0:Not DGN  1:DGN" VALUE 0x00010238 REC_UBYTE_C 0 COMP_0283 0 1 BIT_MASK 0x0008 /begin FUNCTION_LIST KF7-500.2A[29] /end FUNCTION_LIST /end CHARACTERISTIC
/begin CHARACTERISTIC mfAFRAV "0:Not DGN  1:DGN" VALUE 0x00010238 REC_UBYTE_C 0 COMP_0283 0 1 BIT_MASK 0x0004 /begin FUNCTION_LIST KF7-500.2A[29] KF7-500.74[11] /end FUNCTION_LIST /end CHARACTERISTIC
/begin CHARACTERISTIC mfAFHF2 "0:Not DGN  1:DGN" VALUE 0x00010238 REC_UBYTE_C 0 COMP_0283 0 1 BIT_MASK 0x0002 /begin FUNCTION_LIST KF7-500.2A[29] /end FUNCTION_LIST /end CHARACTERISTIC
/begin CHARACTERISTIC mfO2F1O "0:Not DGN  1:DGN" VALUE 0x0001023C REC_UBYTE_C 0 COMP_0283 0 1 BIT_MASK 0x0080 /begin FUNCTION_LIST KF7-500.2A[29] R904.1.Gst_on_can_1_0_1 /end FUNCTION_LIST /end CHARACTERISTIC
/begin CHARACTERISTIC mfO2F2O "0:Not DGN  1:DGN" VALUE 0x0001023C REC_UBYTE_C 0 COMP_0283 0 1 BIT_MASK 0x0040 /begin FUNCTION_LIST KF7-500.2A[29] R904.1.Gst_on_can_1_0_1 /end FUNCTION_LIST /end CHARACTERISTIC
/begin CHARACTERISTIC mfO2F1L "0:Not DGN  1:DGN" VALUE 0x0001023C REC_UBYTE_C 0 COMP_0283 0 1 BIT_MASK 0x0020 /begin FUNCTION_LIST KF7-500.2A[29] R904.1.Gst_on_can_1_0_1 /end FUNCTION_LIST /end CHARACTERISTIC
/begin CHARACTERISTIC mfO2F2L "0:Not DGN  1:DGN" VALUE 0x0001023C REC_UBYTE_C 0 COMP_0283 0 1 BIT_MASK 0x0010 /begin FUNCTION_LIST KF7-500.2A[29] R904.1.Gst_on_can_1_0_1 /end FUNCTION_LIST /end CHARACTERISTIC
/begin CHARACTERISTIC mfO2F1R "0:Not DGN  1:DGN" VALUE 0x0001023C REC_UBYTE_C 0 COMP_0283 0 1 BIT_MASK 0x0008 /begin FUNCTION_LIST KF7-500.2A[29] R904.1.Gst_on_can_1_0_1 /end FUNCTION_LIST /end CHARACTERISTIC
/begin CHARACTERISTIC mfO2F2R "0:Not DGN  1:DGN" VALUE 0x0001023C REC_UBYTE_C 0 COMP_0283 0 1 BIT_MASK 0x0004 /begin FUNCTION_LIST KF7-500.2A[29] R904.1.Gst_on_can_1_0_1 /end FUNCTION_LIST /end CHARACTERISTIC
/begin CHARACTERISTIC mfO2F1D "0:Not DGN  1:DGN" VALUE 0x0001023C REC_UBYTE_C 0 COMP_0283 0 1 BIT_MASK 0x0002 /begin FUNCTION_LIST KF7-500.2A[29] R904.1.Gst_on_can_1_0_1 /end FUNCTION_LIST /end CHARACTERISTIC
/begin CHARACTERISTIC mfO2F2D "0:Not DGN  1:DGN" VALUE 0x0001023C REC_UBYTE_C 0 COMP_0283 0 1 BIT_MASK 0x0001 /begin FUNCTION_LIST KF7-500.2A[29] R904.1.Gst_on_can_1_0_1 /end FUNCTION_LIST /end CHARACTERISTIC
/begin CHARACTERISTIC mfO2F1H "0:Not DGN  1:DGN" VALUE 0x0001023D REC_UBYTE_C 0 COMP_0283 0 1 BIT_MASK 0x0080 /begin FUNCTION_LIST KF7-500.2A[29] R904.1.Gst_on_can_1_0_1 /end FUNCTION_LIST /end CHARACTERISTIC
/begin CHARACTERISTIC mfO2F2H "0:Not DGN  1:DGN" VALUE 0x0001023D REC_UBYTE_C 0 COMP_0283 0 1 BIT_MASK 0x0040 /begin FUNCTION_LIST KF7-500.2A[29] R904.1.Gst_on_can_1_0_1 /end FUNCTION_LIST /end CHARACTERISTIC
/begin CHARACTERISTIC mfFO2HH1 "0:Not DGN  1:DGN" VALUE 0x0001023D REC_UBYTE_C 0 COMP_0283 0 1 BIT_MASK 0x0020 /begin FUNCTION_LIST KF7-500.2A[29] R904.1.Gst_on_can_1_0_1 /end FUNCTION_LIST /end CHARACTERISTIC
/begin CHARACTERISTIC mfFO2HH2 "0:Not DGN  1:DGN" VALUE 0x0001023D REC_UBYTE_C 0 COMP_0283 0 1 BIT_MASK 0x0010 /begin FUNCTION_LIST KF7-500.2A[29] R904.1.Gst_on_can_1_0_1 /end FUNCTION_LIST /end CHARACTERISTIC
/begin CHARACTERISTIC mfFO2HL1 "0:Not DGN  1:DGN" VALUE 0x0001023D REC_UBYTE_C 0 COMP_0283 0 1 BIT_MASK 0x0008 /begin FUNCTION_LIST KF7-500.2A[29] R904.1.Gst_on_can_1_0_1 /end FUNCTION_LIST /end CHARACTERISTIC
/begin CHARACTERISTIC mfFO2HL2 "0:Not DGN  1:DGN" VALUE 0x0001023D REC_UBYTE_C 0 COMP_0283 0 1 BIT_MASK 0x0004 /begin FUNCTION_LIST KF7-500.2A[29] R904.1.Gst_on_can_1_0_1 /end FUNCTION_LIST /end CHARACTERISTIC
/begin CHARACTERISTIC mfISCNGL "0:Not DGN  1:DGN" VALUE 0x0001023D REC_UBYTE_C 0 COMP_0283 0 1 BIT_MASK 0x0002 /begin FUNCTION_LIST KF7-500.2A[29] KF7-500.38A[4] /end FUNCTION_LIST /end CHARACTERISTIC
/begin CHARACTERISTIC mfISCNGH "0:Not DGN  1:DGN" VALUE 0x0001023D REC_UBYTE_C 0 COMP_0283 0 1 BIT_MASK 0x0001 /begin FUNCTION_LIST KF7-500.2A[29] KF7-500.38A[4] /end FUNCTION_LIST /end CHARACTERISTIC
/begin CHARACTERISTIC mfO2R1O "0:Not DGN  1:DGN" VALUE 0x0001023E REC_UBYTE_C 0 COMP_0283 0 1 BIT_MASK 0x0080 /begin FUNCTION_LIST KF7-500.2A[29] R904.1.Gst_on_can_1_0_1 /end FUNCTION_LIST /end CHARACTERISTIC
/begin CHARACTERISTIC mfO2R2O "0:Not DGN  1:DGN" VALUE 0x0001023E REC_UBYTE_C 0 COMP_0283 0 1 BIT_MASK 0x0040 /begin FUNCTION_LIST KF7-500.2A[29] R904.1.Gst_on_can_1_0_1 /end FUNCTION_LIST /end CHARACTERISTIC
/begin CHARACTERISTIC mfO2R1L "0:Not DGN  1:DGN" VALUE 0x0001023E REC_UBYTE_C 0 COMP_0283 0 1 BIT_MASK 0x0020 /begin FUNCTION_LIST KF7-500.2A[29] R904.1.Gst_on_can_1_0_1 /end FUNCTION_LIST /end CHARACTERISTIC
/begin CHARACTERISTIC mfO2R2L "0:Not DGN  1:DGN" VALUE 0x0001023E REC_UBYTE_C 0 COMP_0283 0 1 BIT_MASK 0x0010 /begin FUNCTION_LIST KF7-500.2A[29] R904.1.Gst_on_can_1_0_1 /end FUNCTION_LIST /end CHARACTERISTIC
/begin CHARACTERISTIC mfO2R1R "0:Not DGN  1:DGN" VALUE 0x0001023E REC_UBYTE_C 0 COMP_0283 0 1 BIT_MASK 0x0008 /begin FUNCTION_LIST KF7-500.2A[29] R904.1.Gst_on_can_1_0_1 /end FUNCTION_LIST /end CHARACTERISTIC
/begin CHARACTERISTIC mfO2R2R "0:Not DGN  1:DGN" VALUE 0x0001023E REC_UBYTE_C 0 COMP_0283 0 1 BIT_MASK 0x0004 /begin FUNCTION_LIST KF7-500.2A[29] R904.1.Gst_on_can_1_0_1 /end FUNCTION_LIST /end CHARACTERISTIC
/begin CHARACTERISTIC mfO2R1H "0:Not DGN  1:DGN" VALUE 0x0001023E REC_UBYTE_C 0 COMP_0283 0 1 BIT_MASK 0x0002 /begin FUNCTION_LIST KF7-500.2A[29] R904.1.Gst_on_can_1_0_1 /end FUNCTION_LIST /end CHARACTERISTIC
/begin CHARACTERISTIC mfO2R2H "0:Not DGN  1:DGN" VALUE 0x0001023E REC_UBYTE_C 0 COMP_0283 0 1 BIT_MASK 0x0001 /begin FUNCTION_LIST KF7-500.2A[29] R904.1.Gst_on_can_1_0_1 /end FUNCTION_LIST /end CHARACTERISTIC
/begin CHARACTERISTIC mfRO2HH1 "0:Not DGN  1:DGN" VALUE 0x0001023F REC_UBYTE_C 0 COMP_0283 0 1 BIT_MASK 0x0080 /begin FUNCTION_LIST KF7-500.2A[29] KF7-500.25A[7] R904.1.Gst_on_can_1_0_1 /end FUNCTION_LIST /end CHARACTERISTIC
/begin CHARACTERISTIC mfRO2HH2 "0:Not DGN  1:DGN" VALUE 0x0001023F REC_UBYTE_C 0 COMP_0283 0 1 BIT_MASK 0x0040 /begin FUNCTION_LIST KF7-500.2A[29] KF7-500.25A[7] R904.1.Gst_on_can_1_0_1 /end FUNCTION_LIST /end CHARACTERISTIC
/begin CHARACTERISTIC mfRO2HL1 "0:Not DGN  1:DGN" VALUE 0x0001023F REC_UBYTE_C 0 COMP_0283 0 1 BIT_MASK 0x0020 /begin FUNCTION_LIST KF7-500.2A[29] KF7-500.25A[7] R904.1.Gst_on_can_1_0_1 /end FUNCTION_LIST /end CHARACTERISTIC
/begin CHARACTERISTIC mfRO2HL2 "0:Not DGN  1:DGN" VALUE 0x0001023F REC_UBYTE_C 0 COMP_0283 0 1 BIT_MASK 0x0010 /begin FUNCTION_LIST KF7-500.2A[29] KF7-500.25A[7] R904.1.Gst_on_can_1_0_1 /end FUNCTION_LIST /end CHARACTERISTIC
/begin CHARACTERISTIC mfKN1NGL "0:Not DGN  1:DGN" VALUE 0x0001023F REC_UBYTE_C 0 COMP_0283 0 1 BIT_MASK 0x0008 /begin FUNCTION_LIST KF7-500.2A[29] KF7-500.12[3] /end FUNCTION_LIST /end CHARACTERISTIC
/begin CHARACTERISTIC mfKN1NGH "0:Not DGN  1:DGN" VALUE 0x0001023F REC_UBYTE_C 0 COMP_0283 0 1 BIT_MASK 0x0004 /begin FUNCTION_LIST KF7-500.2A[29] KF7-500.12[3] /end FUNCTION_LIST /end CHARACTERISTIC
/begin CHARACTERISTIC mfKN2NGL "0:Not DGN  1:DGN" VALUE 0x0001023F REC_UBYTE_C 0 COMP_0283 0 1 BIT_MASK 0x0002 /begin FUNCTION_LIST KF7-500.2A[29] KF7-500.12[3] /end FUNCTION_LIST /end CHARACTERISTIC
/begin CHARACTERISTIC mfKN2NGH "0:Not DGN  1:DGN" VALUE 0x0001023F REC_UBYTE_C 0 COMP_0283 0 1 BIT_MASK 0x0001 /begin FUNCTION_LIST KF7-500.2A[29] KF7-500.12[3] /end FUNCTION_LIST /end CHARACTERISTIC
/begin CHARACTERISTIC mfAFMNGR "0:Not DGN  1:DGN" VALUE 0x00010240 REC_UBYTE_C 0 COMP_0283 0 1 BIT_MASK 0x0010 /begin FUNCTION_LIST KF7-500.2A[29] KF7-500.7[12] /end FUNCTION_LIST /end CHARACTERISTIC
/begin CHARACTERISTIC mfAFMNGL "0:Not DGN  1:DGN" VALUE 0x00010240 REC_UBYTE_C 0 COMP_0283 0 1 BIT_MASK 0x0008 /begin FUNCTION_LIST KF7-500.2A[29] KF7-500.7[12] /end FUNCTION_LIST /end CHARACTERISTIC
/begin CHARACTERISTIC mfAFMNGH "0:Not DGN  1:DGN" VALUE 0x00010240 REC_UBYTE_C 0 COMP_0283 0 1 BIT_MASK 0x0004 /begin FUNCTION_LIST KF7-500.2A[29] KF7-500.7[12] /end FUNCTION_LIST /end CHARACTERISTIC
/begin CHARACTERISTIC mfIGNGR "0:Not DGN  1:DGN" VALUE 0x00010240 REC_UBYTE_C 0 COMP_0283 0 1 BIT_MASK 0x0001 /begin FUNCTION_LIST KF7-500.2A[29] KF7-500.10[3] /end FUNCTION_LIST /end CHARACTERISTIC
/begin CHARACTERISTIC mfTWNGL "0:Not DGN  1:DGN" VALUE 0x00010241 REC_UBYTE_C 0 COMP_0283 0 1 BIT_MASK 0x0080 /begin FUNCTION_LIST KF7-500.2A[29] KF7-500.8[5] /end FUNCTION_LIST /end CHARACTERISTIC
/begin CHARACTERISTIC mfTWNGH "0:Not DGN  1:DGN" VALUE 0x00010241 REC_UBYTE_C 0 COMP_0283 0 1 BIT_MASK 0x0040 /begin FUNCTION_LIST KF7-500.2A[29] KF7-500.8[5] /end FUNCTION_LIST /end CHARACTERISTIC
/begin CHARACTERISTIC mfEGSNGL "0:Not DGN  1:DGN" VALUE 0x00010241 REC_UBYTE_C 0 COMP_0283 0 1 BIT_MASK 0x0020 /begin FUNCTION_LIST KF7-500.2A[29] /end FUNCTION_LIST /end CHARACTERISTIC
/begin CHARACTERISTIC mfEGSNGH "0:Not DGN  1:DGN" VALUE 0x00010241 REC_UBYTE_C 0 COMP_0283 0 1 BIT_MASK 0x0010 /begin FUNCTION_LIST KF7-500.2A[29] /end FUNCTION_LIST /end CHARACTERISTIC
/begin CHARACTERISTIC mfEVCNGO "0:Not DGN  1:DGN" VALUE 0x00010242 REC_UBYTE_C 0 COMP_0283 0 1 BIT_MASK 0x0004 /begin FUNCTION_LIST KF7-500.2A[29] KF7-500.30[8] /end FUNCTION_LIST /end CHARACTERISTIC
/begin CHARACTERISTIC mfEVCNGS "0:Not DGN  1:DGN" VALUE 0x00010242 REC_UBYTE_C 0 COMP_0283 0 1 BIT_MASK 0x0002 /begin FUNCTION_LIST KF7-500.2A[29] KF7-500.30[8] /end FUNCTION_LIST /end CHARACTERISTIC
/begin CHARACTERISTIC mfTHMNGR "0:Not DGN  1:DGN" VALUE 0x00010242 REC_UBYTE_C 0 COMP_0283 0 1 BIT_MASK 0x0001 /begin FUNCTION_LIST KF7-500.2A[29] KF7-500.60[5] /end FUNCTION_LIST /end CHARACTERISTIC
/begin CHARACTERISTIC mfMRNR "0:Not DGN  1:DGN" VALUE 0x00010243 REC_UBYTE_C 0 COMP_0283 0 1 BIT_MASK 0x0080 /begin FUNCTION_LIST KF7-500.2A[29] KF7-500.20B[4] R904.1.Gst_on_can_1_0_1 /end FUNCTION_LIST /end CHARACTERISTIC
/begin CHARACTERISTIC mfMRNL "0:Not DGN  1:DGN" VALUE 0x00010243 REC_UBYTE_C 0 COMP_0283 0 1 BIT_MASK 0x0040 /begin FUNCTION_LIST KF7-500.2A[29] KF7-500.20B[4] R904.1.Gst_on_can_1_0_1 /end FUNCTION_LIST /end CHARACTERISTIC
/begin CHARACTERISTIC mfMRNR2 "0:Not DGN  1:DGN" VALUE 0x00010243 REC_UBYTE_C 0 COMP_0283 0 1 BIT_MASK 0x0020 /begin FUNCTION_LIST KF7-500.2A[29] KF7-500.20B[4] R904.1.Gst_on_can_1_0_1 /end FUNCTION_LIST /end CHARACTERISTIC
/begin CHARACTERISTIC mfMRNL2 "0:Not DGN  1:DGN" VALUE 0x00010243 REC_UBYTE_C 0 COMP_0283 0 1 BIT_MASK 0x0010 /begin FUNCTION_LIST KF7-500.2A[29] KF7-500.20B[4] R904.1.Gst_on_can_1_0_1 /end FUNCTION_LIST /end CHARACTERISTIC
/begin CHARACTERISTIC mfVTCI1R "0:Not DGN  1:DGN" VALUE 0x00010243 REC_UBYTE_C 0 COMP_0283 0 1 BIT_MASK 0x0008 /begin FUNCTION_LIST KF7-500.2A[29] KF7-500.6D[9] KF7-500.47B[15] /end FUNCTION_LIST /end CHARACTERISTIC
/begin CHARACTERISTIC mfVTCI2R "0:Not DGN  1:DGN" VALUE 0x00010243 REC_UBYTE_C 0 COMP_0283 0 1 BIT_MASK 0x0004 /begin FUNCTION_LIST KF7-500.2A[29] KF7-500.6D[9] KF7-500.47B[15] /end FUNCTION_LIST /end CHARACTERISTIC
/begin CHARACTERISTIC mfPRSNGR "0:Not DGN  1:DGN" VALUE 0x00010244 REC_UBYTE_C 0 COMP_0283 0 1 BIT_MASK 0x0080 /begin FUNCTION_LIST KF7-500.2A[29] KF7-500.51[3] /end FUNCTION_LIST /end CHARACTERISTIC
/begin CHARACTERISTIC mfPRSNGL "0:Not DGN  1:DGN" VALUE 0x00010244 REC_UBYTE_C 0 COMP_0283 0 1 BIT_MASK 0x0040 /begin FUNCTION_LIST KF7-500.2A[29] KF7-500.51[3] /end FUNCTION_LIST /end CHARACTERISTIC
/begin CHARACTERISTIC mfPRSNGH "0:Not DGN  1:DGN" VALUE 0x00010244 REC_UBYTE_C 0 COMP_0283 0 1 BIT_MASK 0x0020 /begin FUNCTION_LIST KF7-500.2A[29] KF7-500.51[3] /end FUNCTION_LIST /end CHARACTERISTIC
/begin CHARACTERISTIC mfEVPFLW "0:Not DGN  1:DGN" VALUE 0x00010244 REC_UBYTE_C 0 COMP_0283 0 1 BIT_MASK 0x0002 /begin FUNCTION_LIST KF7-500.2A[29] /end FUNCTION_LIST /end CHARACTERISTIC
/begin CHARACTERISTIC mfEVPVSL "0:Not DGN  1:DGN" VALUE 0x00010245 REC_UBYTE_C 0 COMP_0283 0 1 BIT_MASK 0x0080
 /begin FUNCTION_LIST KF7-500.1[54] KF7-500.2A[29] KF7-500.30[8] R904.1.Gst_on_can_1_0_1 /end FUNCTION_LIST
/end CHARACTERISTIC
/begin CHARACTERISTIC mfEVVSLP "0:Not DGN  1:DGN" VALUE 0x00010245 REC_UBYTE_C 0 COMP_0283 0 1 BIT_MASK 0x0040 /begin FUNCTION_LIST KF7-500.2A[29] R904.1.Gst_on_can_1_0_1 /end FUNCTION_LIST /end CHARACTERISTIC
/begin CHARACTERISTIC mfEVPSL "0:Not DGN  1:DGN" VALUE 0x00010245 REC_UBYTE_C 0 COMP_0283 0 1 BIT_MASK 0x0020 /begin FUNCTION_LIST KF7-500.1[54] KF7-500.2A[29] R904.1.Gst_on_can_1_0_1 /end FUNCTION_LIST /end CHARACTERISTIC
/begin CHARACTERISTIC mfEVPSLP "0:Not DGN  1:DGN" VALUE 0x00010245 REC_UBYTE_C 0 COMP_0283 0 1 BIT_MASK 0x0010 /begin FUNCTION_LIST KF7-500.2A[29] R904.1.Gst_on_can_1_0_1 /end FUNCTION_LIST /end CHARACTERISTIC
/begin CHARACTERISTIC mfAVCCSH "0:Not DGN  1:DGN" VALUE 0x00010246 REC_UBYTE_C 0 COMP_0283 0 1 BIT_MASK 0x0001 /begin FUNCTION_LIST KF7-500.2A[29] KF7-505.32[6] KF7-505.34[3] /end FUNCTION_LIST /end CHARACTERISTIC
/begin CHARACTERISTIC mfTPLRLO "0:Not DGN  1:DGN" VALUE 0x00010247 REC_UBYTE_C 0 COMP_0283 0 1 BIT_MASK 0x0002 /begin FUNCTION_LIST KF7-500.2A[29] KF7-505.29[4] /end FUNCTION_LIST /end CHARACTERISTIC
/begin CHARACTERISTIC mfTPLRNO "0:Not DGN  1:DGN" VALUE 0x00010247 REC_UBYTE_C 0 COMP_0283 0 1 BIT_MASK 0x0001 /begin FUNCTION_LIST KF7-500.2A[29] KF7-505.30[6] /end FUNCTION_LIST /end CHARACTERISTIC
/begin CHARACTERISTIC mfVMOOPN "0:Not DGN  1:DGN" VALUE 0x00010248 REC_UBYTE_C 0 COMP_0283 0 1 BIT_MASK 0x0080 /begin FUNCTION_LIST KF7-500.2A[29] KF7-505.32[6] /end FUNCTION_LIST /end CHARACTERISTIC
/begin CHARACTERISTIC mfVMOSHT "0:Not DGN  1:DGN" VALUE 0x00010248 REC_UBYTE_C 0 COMP_0283 0 1 BIT_MASK 0x0040 /begin FUNCTION_LIST KF7-500.2A[29] KF7-505.31[5] /end FUNCTION_LIST /end CHARACTERISTIC
/begin CHARACTERISTIC mfMOTSHT "0:Not DGN  1:DGN" VALUE 0x00010248 REC_UBYTE_C 0 COMP_0283 0 1 BIT_MASK 0x0010 /begin FUNCTION_LIST KF7-500.2A[29] KF7-505.32[6] /end FUNCTION_LIST /end CHARACTERISTIC
/begin CHARACTERISTIC mfAFLHZR "0:Not DGN  1:DGN" VALUE 0x00010249 REC_UBYTE_C 0 COMP_0283 0 1 BIT_MASK 0x0080 /begin FUNCTION_LIST KF7-500.2A[29] KF7-500.74[11] /end FUNCTION_LIST /end CHARACTERISTIC
/begin CHARACTERISTIC mfAFLHZL "0:Not DGN  1:DGN" VALUE 0x00010249 REC_UBYTE_C 0 COMP_0283 0 1 BIT_MASK 0x0040 /begin FUNCTION_LIST KF7-500.2A[29] KF7-500.74[11] /end FUNCTION_LIST /end CHARACTERISTIC
/begin CHARACTERISTIC mfAFRHZR "0:Not DGN  1:DGN" VALUE 0x00010249 REC_UBYTE_C 0 COMP_0283 0 1 BIT_MASK 0x0020 /begin FUNCTION_LIST KF7-500.2A[29] KF7-500.74[11] /end FUNCTION_LIST /end CHARACTERISTIC
/begin CHARACTERISTIC mfAFRHZL "0:Not DGN  1:DGN" VALUE 0x00010249 REC_UBYTE_C 0 COMP_0283 0 1 BIT_MASK 0x0010 /begin FUNCTION_LIST KF7-500.2A[29] KF7-500.74[11] /end FUNCTION_LIST /end CHARACTERISTIC
/begin CHARACTERISTIC mfAFHF1L "0:Not DGN  1:DGN" VALUE 0x00010249 REC_UBYTE_C 0 COMP_0283 0 1 BIT_MASK 0x0008 /begin FUNCTION_LIST KF7-500.2A[29] KF7-500.59[6] /end FUNCTION_LIST /end CHARACTERISTIC
/begin CHARACTERISTIC mfAFHF1H "0:Not DGN  1:DGN" VALUE 0x00010249 REC_UBYTE_C 0 COMP_0283 0 1 BIT_MASK 0x0004 /begin FUNCTION_LIST KF7-500.2A[29] KF7-500.59[6] /end FUNCTION_LIST /end CHARACTERISTIC
/begin CHARACTERISTIC mfAFHF2L "0:Not DGN  1:DGN" VALUE 0x00010249 REC_UBYTE_C 0 COMP_0283 0 1 BIT_MASK 0x0002 /begin FUNCTION_LIST KF7-500.2A[29] KF7-500.59[6] /end FUNCTION_LIST /end CHARACTERISTIC
/begin CHARACTERISTIC mfAFHF2H "0:Not DGN  1:DGN" VALUE 0x00010249 REC_UBYTE_C 0 COMP_0283 0 1 BIT_MASK 0x0001 /begin FUNCTION_LIST KF7-500.2A[29] KF7-500.59[6] /end FUNCTION_LIST /end CHARACTERISTIC
/begin CHARACTERISTIC mfAFRLD1 "0:Not DGN  1:DGN" VALUE 0x0001024A REC_UBYTE_C 0 COMP_0283 0 1 BIT_MASK 0x0080 /begin FUNCTION_LIST KF7-500.2A[29] KF7-500.74B[5] /end FUNCTION_LIST /end CHARACTERISTIC
/begin CHARACTERISTIC mfAFLRD1 "0:Not DGN  1:DGN" VALUE 0x0001024A REC_UBYTE_C 0 COMP_0283 0 1 BIT_MASK 0x0040 /begin FUNCTION_LIST KF7-500.2A[29] KF7-500.74B[5] /end FUNCTION_LIST /end CHARACTERISTIC
/begin CHARACTERISTIC mfAFRLD2 "0:Not DGN  1:DGN" VALUE 0x0001024A REC_UBYTE_C 0 COMP_0283 0 1 BIT_MASK 0x0020 /begin FUNCTION_LIST KF7-500.2A[29] KF7-500.74B[5] /end FUNCTION_LIST /end CHARACTERISTIC
/begin CHARACTERISTIC mfAFLRD2 "0:Not DGN  1:DGN" VALUE 0x0001024A REC_UBYTE_C 0 COMP_0283 0 1 BIT_MASK 0x0010 /begin FUNCTION_LIST KF7-500.2A[29] KF7-500.74B[5] /end FUNCTION_LIST /end CHARACTERISTIC
/begin AXIS_PTS mLPAMB "20mV" 0x0000CADF NO_INPUT_QUANTITY REC_AXIS_UBYTE 0 COMP_0054 16 0 5100 /end AXIS_PTS
/begin MEASUREMENT fFMRCPC1 "0:ñ≥Çµ  1:óLÇË" UBYTE COMP_0283 1 100 0 1 BIT_MASK 0x0002 ECU_ADDRESS 0xFFFF4942 /begin FUNCTION_LIST KF7-500.20B[4] /end FUNCTION_LIST /end MEASUREMENT
/begin MEASUREMENT wfFMRCPC1 "0:ñ≥Çµ  1:óLÇË" UBYTE COMP_0283 1 100 0 1 BIT_MASK 0x0002 ECU_ADDRESS 0xFFFF4840 /begin FUNCTION_LIST KF7-500.20B[4] /end FUNCTION_LIST /end MEASUREMENT
/begin MEASUREMENT fFMRCPC2 "0:ñ≥Çµ  1:óLÇË" UBYTE COMP_0283 1 100 0 1 BIT_MASK 0x0002 ECU_ADDRESS 0xFFFF4783 /begin FUNCTION_LIST KF7-500.20B[4] /end FUNCTION_LIST /end MEASUREMENT
/begin MEASUREMENT wfFMRCPC2 "0:ñ≥Çµ  1:óLÇË" UBYTE COMP_0283 1 100 0 1 BIT_MASK 0x0002 ECU_ADDRESS 0xFFFF4777 /begin FUNCTION_LIST KF7-500.20B[4] /end FUNCTION_LIST /end MEASUREMENT
/begin MEASUREMENT fLR "0:A/FÉZÉìÉTÅ[ópÉäÉbÉ`ÅAÉäÅ[ÉìêMçÜ  1:ÿØ¡" UBYTE COMP_0283 1 100 0 1 BIT_MASK 0x0002 ECU_ADDRESS 0xFFFF4071 /begin FUNCTION_LIST KF7-500.2A[29] /end FUNCTION_LIST /end MEASUREMENT
/begin MEASUREMENT fVTCDGN3S "0:êfífïsãñâ¬  1:êfífãñâ¬" UBYTE COMP_0283 1 100 0 1 BIT_MASK 0x0002 ECU_ADDRESS 0xFFFF34AE /begin FUNCTION_LIST KF7-500.6D[9] KF7-500.47B[15] /end FUNCTION_LIST /end MEASUREMENT
/begin MEASUREMENT fDAP1NG "APS1 trouble judgement meeting flag" UBYTE COMP_0283 1 100 0 1 BIT_MASK 0x0001 ECU_ADDRESS 0xFFFF4291 /begin FUNCTION_LIST KF7-450.50[10] R000.1.RS_Integ_1_10_2 /end FUNCTION_LIST /end MEASUREMENT
/begin MEASUREMENT fDAP2NG "APS2 trouble judgement meeting flag" UBYTE COMP_0283 1 100 0 1 BIT_MASK 0x0080 ECU_ADDRESS 0xFFFF4292 /begin FUNCTION_LIST KF7-450.50[10] R000.1.RS_Integ_1_10_2 /end FUNCTION_LIST /end MEASUREMENT
/begin MEASUREMENT fDCPUNG "CPU system NG" UBYTE COMP_0283 1 100 0 1 BIT_MASK 0x0001 ECU_ADDRESS 0xFFFF4292
 /begin FUNCTION_LIST KF7-500.6D[9] KF7-505.2[9] KF7-505.19[1] KF7-505.23[2] KF7-505.24[1] KF7-505.25[3] KF7-505.28[1] KF7-505.29[4] KF7-505.30[6] KF7-505.31[5] KF7-505.32[6] KF7-505.33[8] KF7-505.90[N] /end FUNCTION_LIST
/end MEASUREMENT
/begin MEASUREMENT fDTP1NG "TPS1 trouble judgement meeting flag" UBYTE COMP_0283 1 100 0 1 BIT_MASK 0x0010 ECU_ADDRESS 0xFFFF4295 /begin FUNCTION_LIST KF7-450.50[10] R000.1.RS_Integ_1_10_2 /end FUNCTION_LIST /end MEASUREMENT
/begin MEASUREMENT fDTP2NG "TPS2 trouble judgement meeting flag" UBYTE COMP_0283 1 100 0 1 BIT_MASK 0x0008 ECU_ADDRESS 0xFFFF4295 /begin FUNCTION_LIST KF7-450.50[10] R000.1.RS_Integ_1_10_2 /end FUNCTION_LIST /end MEASUREMENT
/begin MEASUREMENT fFEGTLC "At the time of the low fuel temperature, EGR cut flag" UBYTE COMP_0283 1 100 0 1 BIT_MASK 0x0004 ECU_ADDRESS 0xFFFF42B0 /begin FUNCTION_LIST KF7-500.1[54] /end FUNCTION_LIST /end MEASUREMENT
/begin MEASUREMENT fFMLTNC "The second level self-diagnosis NG detection condition distinction" UBYTE COMP_0283 1 100 0 1 BIT_MASK 0x0004 ECU_ADDRESS 0xFFFF42BA /begin FUNCTION_LIST KF7-500.1[54] /end FUNCTION_LIST /end MEASUREMENT
/begin MEASUREMENT fFSMILON "At the time of the fail, MIL lighting" UBYTE COMP_0283 1 100 0 1 BIT_MASK 0x0010 ECU_ADDRESS 0xFFFF42C0 /begin FUNCTION_LIST KF7-500.1[54] /end FUNCTION_LIST /end MEASUREMENT
/begin MEASUREMENT fFTRIP4 "Trip 4 rush condition distinction" UBYTE COMP_0283 1 100 0 1 BIT_MASK 0x0001 ECU_ADDRESS 0xFFFF42C2 /begin FUNCTION_LIST KF7-500.1[54] /end FUNCTION_LIST /end MEASUREMENT
/begin MEASUREMENT fFTRIP5 "Trip 5 rush condition distinction" UBYTE COMP_0283 1 100 0 1 BIT_MASK 0x0040 ECU_ADDRESS 0xFFFF42C3 /begin FUNCTION_LIST KF7-500.1[54] /end FUNCTION_LIST /end MEASUREMENT
/begin MEASUREMENT fFTRIP6 "Trip 6 rush condition distinction" UBYTE COMP_0283 1 100 0 1 BIT_MASK 0x0010 ECU_ADDRESS 0xFFFF42C3 /begin FUNCTION_LIST KF7-500.1[54] /end FUNCTION_LIST /end MEASUREMENT
/begin MEASUREMENT fFTRIP7 "Trip 7 rush condition distinction" UBYTE COMP_0283 1 100 0 1 BIT_MASK 0x0008 ECU_ADDRESS 0xFFFF42C3 /begin FUNCTION_LIST KF7-500.1[54] /end FUNCTION_LIST /end MEASUREMENT
/begin MEASUREMENT fFTRIP7A "Trip 7 rush condition distinction (work for the setup)" UBYTE COMP_0283 1 100 0 1 BIT_MASK 0x0004 ECU_ADDRESS 0xFFFF42C3 /begin FUNCTION_LIST KF7-500.1[54] /end FUNCTION_LIST /end MEASUREMENT
/begin MEASUREMENT fFTRIP8 "Trip 8 rush condition distinction" UBYTE COMP_0283 1 100 0 1 BIT_MASK 0x0002 ECU_ADDRESS 0xFFFF42C3 /begin FUNCTION_LIST KF7-500.1[54] /end FUNCTION_LIST /end MEASUREMENT
/begin MEASUREMENT fFTRIP8A "Trip 8 rush condition distinction (work for the setup)" UBYTE COMP_0283 1 100 0 1 BIT_MASK 0x0001 ECU_ADDRESS 0xFFFF42C3 /begin FUNCTION_LIST KF7-500.1[54] /end FUNCTION_LIST /end MEASUREMENT
/begin MEASUREMENT fMRDNCL "Fuel system diagnosis LEAN side NG detection condition distinction" UBYTE COMP_0283 1 100 0 1 BIT_MASK 0x0010 ECU_ADDRESS 0xFFFF42D6 /begin FUNCTION_LIST KF7-500.20B[4] /end FUNCTION_LIST /end MEASUREMENT
/begin MEASUREMENT fMRDNCR "Fuel system diagnosis RICH side NG detection condition distinction" UBYTE COMP_0283 1 100 0 1 BIT_MASK 0x0008 ECU_ADDRESS 0xFFFF42D6 /begin FUNCTION_LIST KF7-500.20B[4] /end FUNCTION_LIST /end MEASUREMENT
/begin MEASUREMENT fTMLOF "MIL lights-out condition formation experience flag" UBYTE COMP_0283 1 100 0 1 BIT_MASK 0x0020 ECU_ADDRESS 0xFFFF42F4 /begin FUNCTION_LIST KF7-500.1[54] /end FUNCTION_LIST /end MEASUREMENT
/begin MEASUREMENT fVTCINEL "VTC offset diagnosis permission engine speed lower limit judgement (for the idle)" UBYTE COMP_0283 1 100 0 1 BIT_MASK 0x0020 ECU_ADDRESS 0xFFFF42FB /begin FUNCTION_LIST KF7-500.6D[9] KF7-500.47B[15] /end FUNCTION_LIST /end MEASUREMENT
/begin MEASUREMENT fVTCITWL "VTC offset diagnosis permission coolant temperature lower limit judgement (for the idle)" UBYTE COMP_0283 1 100 0 1 BIT_MASK 0x0004 ECU_ADDRESS 0xFFFF42FB /begin FUNCTION_LIST KF7-500.6D[9] KF7-500.47B[15] /end FUNCTION_LIST /end MEASUREMENT
/begin MEASUREMENT fVTCONEL "VTC offset diagnosis permission engine speed lower limit judgement" UBYTE COMP_0283 1 100 0 1 BIT_MASK 0x0040 ECU_ADDRESS 0xFFFF42FC /begin FUNCTION_LIST KF7-500.6D[9] KF7-500.47B[15] /end FUNCTION_LIST /end MEASUREMENT
/begin MEASUREMENT fVTCOTWH "VTC offset diagnosis permission coolant temperature upper limit judgement" UBYTE COMP_0283 1 100 0 1 BIT_MASK 0x0008 ECU_ADDRESS 0xFFFF42FC /begin FUNCTION_LIST KF7-500.6D[9] KF7-500.47B[15] /end FUNCTION_LIST /end MEASUREMENT
/begin MEASUREMENT fVTCOTWL "VTC offset diagnosis permission coolant temperature lower limit judgement" UBYTE COMP_0283 1 100 0 1 BIT_MASK 0x0002 ECU_ADDRESS 0xFFFF42FC /begin FUNCTION_LIST KF7-500.6D[9] KF7-500.47B[15] /end FUNCTION_LIST /end MEASUREMENT
/begin MEASUREMENT fFCLOS "Fuel control condition CLOSE switchover condition distinction" UBYTE COMP_0283 1 100 0 1 BIT_MASK 0x0020 ECU_ADDRESS 0xFFFF4326 /begin FUNCTION_LIST KF7-500.1[54] /end FUNCTION_LIST /end MEASUREMENT
/begin MEASUREMENT fFTMTRP "Engine rotation continuation time distinction" UBYTE COMP_0283 1 100 0 1 BIT_MASK 0x0040 ECU_ADDRESS 0xFFFF432A /begin FUNCTION_LIST KF7-500.1[54] /end FUNCTION_LIST /end MEASUREMENT
/begin MEASUREMENT fFTRIP1 "Trip 1 rush condition distinction" UBYTE COMP_0283 1 100 0 1 BIT_MASK 0x0020 ECU_ADDRESS 0xFFFF432A /begin FUNCTION_LIST KF7-500.1[54] /end FUNCTION_LIST /end MEASUREMENT
/begin MEASUREMENT fFTRIP2 "Trip 2 rush condition distinction" UBYTE COMP_0283 1 100 0 1 BIT_MASK 0x0010 ECU_ADDRESS 0xFFFF432A /begin FUNCTION_LIST KF7-500.1[54] /end FUNCTION_LIST /end MEASUREMENT
/begin MEASUREMENT fFTRIP3 "Trip 3 rush condition distinction" UBYTE COMP_0283 1 100 0 1 BIT_MASK 0x0008 ECU_ADDRESS 0xFFFF432A /begin FUNCTION_LIST KF7-500.1[54] KF7-500.24[10] KF7-580.1[8] /end FUNCTION_LIST /end MEASUREMENT
/begin MEASUREMENT afDATACLR "Diagnosis parameter elimination requirement distinction" UBYTE COMP_0283 1 100 0 1 BIT_MASK 0x0010 ECU_ADDRESS 0xFFFF4351 /begin FUNCTION_LIST KF7-500.1[54] KF7-505.26[2] /end FUNCTION_LIST /end MEASUREMENT
/begin MEASUREMENT fDATACLR "Diagnosis parameter elimination requirement distinction" UBYTE COMP_0283 1 100 0 1 BIT_MASK 0x0010 ECU_ADDRESS 0xFFFF4362 /begin FUNCTION_LIST KF7-500.1[54] KF7-505.26[2] /end FUNCTION_LIST /end MEASUREMENT
/begin MEASUREMENT wfMISFFAL "Misfire diagnosis OK/NG" UBYTE COMP_0283 1 100 0 1 BIT_MASK 0x0020 ECU_ADDRESS 0xFFFF8A90 /begin FUNCTION_LIST KF7-500.1[54] /end FUNCTION_LIST /end MEASUREMENT
/begin MEASUREMENT fMISFFAL "Misfire diagnosis OK/NG" UBYTE COMP_0283 1 100 0 1 BIT_MASK 0x0020 ECU_ADDRESS 0xFFFF8A93 /begin FUNCTION_LIST KF7-500.1[54] /end FUNCTION_LIST /end MEASUREMENT
/begin MEASUREMENT fSENNRPM "At the time of the ETC sensor trouble, LH control F/C engine rotation hysteresis flag" UBYTE COMP_0283 1 100 0 1 BIT_MASK 0x0020 ECU_ADDRESS 0xFFFF249B /begin FUNCTION_LIST KF7-450.50[10] /end FUNCTION_LIST /end MEASUREMENT
/begin MEASUREMENT fVTCONEH "VTC offset diagnosis engine speed upper limit hysteresis flag" UBYTE COMP_0283 1 100 0 1 BIT_MASK 0x0010 ECU_ADDRESS 0xFFFF24A8 /begin FUNCTION_LIST KF7-500.6D[9] KF7-500.47B[15] /end FUNCTION_LIST /end MEASUREMENT
/begin MEASUREMENT fVTCVSP "Hysteresis flag" UBYTE COMP_0283 1 100 0 1 BIT_MASK 0x0004 ECU_ADDRESS 0xFFFF24A9 /begin FUNCTION_LIST KF7-500.6D[9] KF7-500.47B[15] /end FUNCTION_LIST /end MEASUREMENT
/begin MEASUREMENT afTRCCTRLN "N range control judgement flag" UBYTE COMP_0283 1 100 0 1 BIT_MASK 0x0020 ECU_ADDRESS 0xFFFF24D2 /begin FUNCTION_LIST KF7-450.50[10] /end FUNCTION_LIST /end MEASUREMENT
/begin MEASUREMENT fTRCCTRLN "N range control judgement flag" UBYTE COMP_0283 1 100 0 1 BIT_MASK 0x0020 ECU_ADDRESS 0xFFFF24D9 /begin FUNCTION_LIST KF7-450.50[10] R000.1.RS_Integ_1_10_2 /end FUNCTION_LIST /end MEASUREMENT
/begin MEASUREMENT fFFDTRGW "Reverse side trigger flag (a joint flag)" UBYTE COMP_0283 1 100 0 1 BIT_MASK 0x0080 ECU_ADDRESS 0xFFFFB7DE /begin FUNCTION_LIST KF7-500.1[54] KF7-525.1[4] /end FUNCTION_LIST /end MEASUREMENT
/begin MEASUREMENT fFFUEL "Fuel system diagnosis F.F. memory condition distinction" UBYTE COMP_0283 1 100 0 1 BIT_MASK 0x0040 ECU_ADDRESS 0xFFFFB7DE /begin FUNCTION_LIST KF7-500.1[54] R000.4.EepAlloc_1_2_2 /end FUNCTION_LIST /end MEASUREMENT
/begin MEASUREMENT fFLGFSW "Failsafe executive flag (a joint flag)" UBYTE COMP_0283 1 100 0 1 BIT_MASK 0x0020 ECU_ADDRESS 0xFFFFB7DE /begin FUNCTION_LIST KF7-500.1[54] /end FUNCTION_LIST /end MEASUREMENT
/begin MEASUREMENT fFMILONW "Trouble alarm indication flag (a joint flag)" UBYTE COMP_0283 1 100 0 1 BIT_MASK 0x0010 ECU_ADDRESS 0xFFFFB7DE /begin FUNCTION_LIST KF7-500.1[54] R904.1.Gst_on_can_1_0_1 /end FUNCTION_LIST /end MEASUREMENT
/begin MEASUREMENT fFMISF "Misfire diagnosis F.F. memory condition distinction" UBYTE COMP_0283 1 100 0 1 BIT_MASK 0x0008 ECU_ADDRESS 0xFFFFB7DE /begin FUNCTION_LIST KF7-500.1[54] R000.4.EepAlloc_1_2_2 /end FUNCTION_LIST /end MEASUREMENT
/begin MEASUREMENT fFPRI2 "The second level diagnosis F.F. memory condition distinction" UBYTE COMP_0283 1 100 0 1 BIT_MASK 0x0080 ECU_ADDRESS 0xFFFFB7DF /begin FUNCTION_LIST KF7-500.1[54] R000.4.EepAlloc_1_2_2 /end FUNCTION_LIST /end MEASUREMENT
/begin MEASUREMENT fFSENST_0 "Engine stall prevention failsafe control (a joint flag)" UBYTE COMP_0283 1 100 0 1 BIT_MASK 0x0010 ECU_ADDRESS 0xFFFFB7DF /begin FUNCTION_LIST KF7-500.1[54] /end FUNCTION_LIST /end MEASUREMENT
/begin MEASUREMENT fFSMIL_0 "MIL is turned on. (a joint flag)" UBYTE COMP_0283 1 100 0 1 BIT_MASK 0x0008 ECU_ADDRESS 0xFFFFB7DF /begin FUNCTION_LIST KF7-500.1[54] /end FUNCTION_LIST /end MEASUREMENT
/begin MEASUREMENT fNGBUW "Pending trouble condition memory flag (a joint flag)" UBYTE COMP_0283 1 100 0 1 BIT_MASK 0x0001 ECU_ADDRESS 0xFFFFB7E1 /begin FUNCTION_LIST KF7-500.1[54] /end FUNCTION_LIST /end MEASUREMENT
/begin MEASUREMENT fNGMEMW "Trouble memory one's personal history flag (a joint flag)" UBYTE COMP_0283 1 100 0 1 BIT_MASK 0x0080 ECU_ADDRESS 0xFFFFB7E2 /begin FUNCTION_LIST KF7-500.1[54] /end FUNCTION_LIST /end MEASUREMENT
/begin MEASUREMENT fMCLPNGJL "A LEAN side NG judgement flag by the monitor clamp" UBYTE COMP_0283 1 100 0 1 BIT_MASK 0x0080 ECU_ADDRESS 0xFFFFB7E7 /begin FUNCTION_LIST KF7-500.20B[4] R000.4.EepAlloc_1_2_2 /end FUNCTION_LIST /end MEASUREMENT
/begin MEASUREMENT fMCLPNGJR "A RICH side NG judgement flag by the monitor clamp" UBYTE COMP_0283 1 100 0 1 BIT_MASK 0x0040 ECU_ADDRESS 0xFFFFB7E7 /begin FUNCTION_LIST KF7-500.20B[4] R000.4.EepAlloc_1_2_2 /end FUNCTION_LIST /end MEASUREMENT
/begin MEASUREMENT afFFPEND "F.F. buffer use condition distinction" UBYTE COMP_0283 1 100 0 1 BIT_MASK 0x0010 ECU_ADDRESS 0xFFFFB7EA /begin FUNCTION_LIST KF7-500.1[54] /end FUNCTION_LIST /end MEASUREMENT
/begin MEASUREMENT fFFPEND "F.F. buffer use condition distinction" UBYTE COMP_0283 1 100 0 1 BIT_MASK 0x0010 ECU_ADDRESS 0xFFFFB7EC /begin FUNCTION_LIST KF7-500.1[54] R000.4.EepAlloc_1_2_2 /end FUNCTION_LIST /end MEASUREMENT
/begin MEASUREMENT tAFONNG "AFM breakage NG timer" UBYTE COMP_0201_S 1 100 0 255 ECU_ADDRESS 0xFFFF4370 /begin FUNCTION_LIST KF7-500.7[12] /end FUNCTION_LIST /end MEASUREMENT
/begin MEASUREMENT tISCDDLY "After the diagnosis permission coolant temperature condition lower limit formation, delay" UBYTE COMP_0201_S 1 100 0 255 ECU_ADDRESS 0xFFFF439B /begin FUNCTION_LIST KF7-500.1[54] KF7-500.38A[4] /end FUNCTION_LIST /end MEASUREMENT
/begin MEASUREMENT tTMRND2 "Fuel diagnosis LEAN NG judgement delay timer" UBYTE COMP_0201_S 1 100 0 255 ECU_ADDRESS 0xFFFF441E /begin FUNCTION_LIST KF7-500.20B[4] /end FUNCTION_LIST /end MEASUREMENT
/begin MEASUREMENT tTMRNGD "Fuel diagnosis RICH NG judgement delay timer" UBYTE COMP_0201_S 1 100 0 255 ECU_ADDRESS 0xFFFF4420 /begin FUNCTION_LIST KF7-500.20B[4] /end FUNCTION_LIST /end MEASUREMENT
/begin MEASUREMENT tTMRNGF "Fuel diagnosis CPC NG judgement delay timer" UBYTE COMP_0201_S 1 100 0 255 ECU_ADDRESS 0xFFFF4422 /begin FUNCTION_LIST KF7-500.20B[4] /end FUNCTION_LIST /end MEASUREMENT
/begin MEASUREMENT tTMVSNG "VS Unusual judgement" UBYTE COMP_0201_S 1 100 0 255 ECU_ADDRESS 0xFFFF442C /begin FUNCTION_LIST KF7-500.16[4] /end FUNCTION_LIST /end MEASUREMENT
/begin MEASUREMENT tERRTIM "Alignment check diagnosis permission delay timer" UBYTE COMP_0202_S 1 100 0 255 ECU_ADDRESS 0xFFFF446E /begin FUNCTION_LIST KF7-500.6D[9] KF7-500.47B[15] /end FUNCTION_LIST /end MEASUREMENT
/begin MEASUREMENT tIERRTIM "A delay timer (for the idle) for the C-VTC diagnosis" UBYTE COMP_0202_S 1 100 0 255 ECU_ADDRESS 0xFFFF4486 /begin FUNCTION_LIST KF7-500.6D[9] KF7-500.47B[15] /end FUNCTION_LIST /end MEASUREMENT
/begin MEASUREMENT tIGCKTM "After ignition the first diagnosis START SW ON-> off, delay timer" UBYTE COMP_0202_S 1 100 0 255 ECU_ADDRESS 0xFFFF448D /begin FUNCTION_LIST KF7-500.10[3] /end FUNCTION_LIST /end MEASUREMENT
/begin MEASUREMENT tVTCADCT "A timer for the VTC alignment check diagnosis complete number of times count" UBYTE COMP_0202_S 1 100 0 255 ECU_ADDRESS 0xFFFF4571 /begin FUNCTION_LIST KF7-500.6D[9] KF7-500.47B[15] /end FUNCTION_LIST /end MEASUREMENT
/begin MEASUREMENT tVTCMLDLY "A NG judgement delay timer for MIL lighting" UBYTE COMP_0202_S 1 100 0 255 ECU_ADDRESS 0xFFFF4576 /begin FUNCTION_LIST KF7-500.6D[9] KF7-500.47B[15] /end FUNCTION_LIST /end MEASUREMENT
/begin MEASUREMENT tVTCNGDLY "A delay timer for the alignment check diagnosis failsafe judgement" UBYTE COMP_0202_S 1 100 0 255 ECU_ADDRESS 0xFFFF457E /begin FUNCTION_LIST KF7-500.6D[9] KF7-500.47B[15] /end FUNCTION_LIST /end MEASUREMENT
/begin MEASUREMENT tVTCSDLY "After the start, diagnosis start delay timer" UBYTE COMP_0202_S 1 100 0 255 ECU_ADDRESS 0xFFFF4584 /begin FUNCTION_LIST KF7-500.6D[9] KF7-500.47B[15] /end FUNCTION_LIST /end MEASUREMENT
/begin MEASUREMENT tAFDGNT "AFM middle delay trouble judgement timer" UBYTE COMP_0203_S 1 100 0 255 ECU_ADDRESS 0xFFFF45B5 /begin FUNCTION_LIST KF7-500.7[12] KF7-505.26[2] /end FUNCTION_LIST /end MEASUREMENT
/begin MEASUREMENT tCSNGDC "CAM breakage diagnosis NG judgement timer" UBYTE COMP_0203_S 1 100 0 255 ECU_ADDRESS 0xFFFF45D1 /begin FUNCTION_LIST KF7-500.6D[9] /end FUNCTION_LIST /end MEASUREMENT
/begin MEASUREMENT tCSNGDP "POS10 breakage judgement timer" UBYTE COMP_0203_S 1 100 0 255 ECU_ADDRESS 0xFFFF45D3 /begin FUNCTION_LIST KF7-500.6D[9] /end FUNCTION_LIST /end MEASUREMENT
/begin MEASUREMENT tCSNGSTC "At the time of the start, CAM breakage judgement timer" UBYTE COMP_0203_S 1 100 0 255 ECU_ADDRESS 0xFFFF45D4 /begin FUNCTION_LIST KF7-500.6D[9] /end FUNCTION_LIST /end MEASUREMENT
/begin MEASUREMENT tCSNGSTP "At the time of the start, POS10 breakage judgement delay" UBYTE COMP_0203_S 1 100 0 255 ECU_ADDRESS 0xFFFF45D6 /begin FUNCTION_LIST KF7-500.6D[9] /end FUNCTION_LIST /end MEASUREMENT
/begin MEASUREMENT tTPSFSDL1 "TPS At the time of the single trouble, failsafe delay (for the TP treatment)" UWORD COMP_0203_S 1 100 0 65535 ECU_ADDRESS 0xFFFF4724 /begin FUNCTION_LIST KF7-450.50[10] /end FUNCTION_LIST /end MEASUREMENT
/begin MEASUREMENT tNGDCAM "CAM signal breakage judgement timer" UBYTE COMP_0203_S 1 100 0 255 ECU_ADDRESS 0xFFFF2615 /begin FUNCTION_LIST KF7-500.6D[9] /end FUNCTION_LIST /end MEASUREMENT
/begin MEASUREMENT tNGDCAM2 "POS10 diagnosis permission CAM signal input period" UBYTE COMP_0203_S 1 100 0 255 ECU_ADDRESS 0xFFFF2616 /begin FUNCTION_LIST KF7-500.6D[9] /end FUNCTION_LIST /end MEASUREMENT
/begin MEASUREMENT tNGDPOS "POS10 signal breakage judgement time" UBYTE COMP_0203_S 1 100 0 255 ECU_ADDRESS 0xFFFF2619 /begin FUNCTION_LIST KF7-500.6D[9] /end FUNCTION_LIST /end MEASUREMENT
/begin MEASUREMENT tTMLOF "After the start, compulsion MIL lights out measuring timer" UBYTE COMP_0203_S 1 100 0 255 ECU_ADDRESS 0xFFFF2660 /begin FUNCTION_LIST KF7-500.1[54] /end FUNCTION_LIST /end MEASUREMENT
/begin MEASUREMENT avCLRTIME "Running time after the trouble code clear" UWORD COMP_0533_S 1 100 0 65535 ECU_ADDRESS 0xFFFFB68E /begin FUNCTION_LIST KF7-500.1[54] /end FUNCTION_LIST /end MEASUREMENT
/begin MEASUREMENT avFFALP "F.F. data buffer short periodic fuel compensation value" UBYTE COMP_0117 1 100 -100 99.21875 ECU_ADDRESS 0xFFFFB6AE /begin FUNCTION_LIST KF7-500.1[54] /end FUNCTION_LIST /end MEASUREMENT
/begin MEASUREMENT avFFALP_R#1 "F.F. data buffer short periodic fuel compensation value" UBYTE COMP_0117 1 100 -100 99.21875 ECU_ADDRESS 0xFFFFB6AE /begin FUNCTION_LIST KF7-500.1[54] /end FUNCTION_LIST /end MEASUREMENT
/begin MEASUREMENT avFFALP_R#2 "F.F. data buffer short periodic fuel compensation value" UBYTE COMP_0117 1 100 -100 99.21875 ECU_ADDRESS 0xFFFFB6AF /begin FUNCTION_LIST KF7-500.1[54] /end FUNCTION_LIST /end MEASUREMENT
/begin MEASUREMENT avFFAPS1OF "F.F. data buffer accelerator pedal position (D)" UBYTE COMP_0378 1 100 0 100.000000065 ECU_ADDRESS 0xFFFFB6B0 /begin FUNCTION_LIST KF7-500.1[54] /end FUNCTION_LIST /end MEASUREMENT
/begin MEASUREMENT avFFAPS2OF "F.F. data buffer accelerator pedal position (E)" UBYTE COMP_0378 1 100 0 100.000000065 ECU_ADDRESS 0xFFFFB6B1 /begin FUNCTION_LIST KF7-500.1[54] /end FUNCTION_LIST /end MEASUREMENT
/begin MEASUREMENT avFFBST "F.F. data buffer intake manifold absolute pressure" UBYTE COMP_0535_S 1 100 0 255 ECU_ADDRESS 0xFFFFB6B2 /begin FUNCTION_LIST KF7-500.1[54] KF7-580.1[8] /end FUNCTION_LIST /end MEASUREMENT
/begin MEASUREMENT avFFCLRDST "Mileage after the F.F. data buffer trouble code clear" UWORD COMP_0470 1 100 0 65535 ECU_ADDRESS 0xFFFFB6B4 /begin FUNCTION_LIST KF7-500.1[54] /end FUNCTION_LIST /end MEASUREMENT
/begin MEASUREMENT avFFCLTIME "Running time after the F.F. data buffer trouble code clear" UWORD COMP_0533_S 1 100 0 65535 ECU_ADDRESS 0xFFFFB6B6 /begin FUNCTION_LIST KF7-500.1[54] /end FUNCTION_LIST /end MEASUREMENT
/begin MEASUREMENT avFFCLV "F.F. data buffer logic operation load value" UBYTE COMP_0425 1 100 0 99.99999981 ECU_ADDRESS 0xFFFFB6B8 /begin FUNCTION_LIST KF7-500.1[54] KF7-580.1[8] /end FUNCTION_LIST /end MEASUREMENT
/begin MEASUREMENT avFFCODE "F.F. data buffer self-diagnosis details distinction code" UWORD COMP_0426 1 100 0 65535 ECU_ADDRESS 0xFFFFB6BA /begin FUNCTION_LIST KF7-500.1[54] KF7-580.1[8] /end FUNCTION_LIST /end MEASUREMENT
/begin MEASUREMENT avFFFSS "F.F. data buffer fuel control condition distinction flag" UBYTE COMP_0091 1 100 0 255 ECU_ADDRESS 0xFFFFB6BC /begin FUNCTION_LIST KF7-500.1[54] /end FUNCTION_LIST /end MEASUREMENT
/begin MEASUREMENT avFFFSS_R#1 "F.F. data buffer fuel control condition distinction flag" UBYTE COMP_0091 1 100 0 255 ECU_ADDRESS 0xFFFFB6BC /begin FUNCTION_LIST KF7-500.1[54] /end FUNCTION_LIST /end MEASUREMENT
/begin MEASUREMENT avFFFSS_R#2 "F.F. data buffer fuel control condition distinction flag" UBYTE COMP_0091 1 100 0 255 ECU_ADDRESS 0xFFFFB6BD /begin FUNCTION_LIST KF7-500.1[54] /end FUNCTION_LIST /end MEASUREMENT
/begin MEASUREMENT avFFITAC "F.F. data buffer, absolutely, load value" UWORD COMP_0378 1 100 0 25700.000016705 ECU_ADDRESS 0xFFFFB6BE /begin FUNCTION_LIST KF7-500.1[54] /end FUNCTION_LIST /end MEASUREMENT
/begin MEASUREMENT avFFKBL "F.F. data buffer head periodic fuel compensation value" UBYTE COMP_0117 1 100 -100 99.21875 ECU_ADDRESS 0xFFFFB6C0 /begin FUNCTION_LIST KF7-500.1[54] /end FUNCTION_LIST /end MEASUREMENT
/begin MEASUREMENT avFFKBL_R#1 "F.F. data buffer head periodic fuel compensation value" UBYTE COMP_0117 1 100 -100 99.21875 ECU_ADDRESS 0xFFFFB6C0 /begin FUNCTION_LIST KF7-500.1[54] /end FUNCTION_LIST /end MEASUREMENT
/begin MEASUREMENT avFFKBL_R#2 "F.F. data buffer head periodic fuel compensation value" UBYTE COMP_0117 1 100 -100 99.21875 ECU_ADDRESS 0xFFFFB6C1 /begin FUNCTION_LIST KF7-500.1[54] /end FUNCTION_LIST /end MEASUREMENT
/begin MEASUREMENT avFFMLTIME "Mileage from the F.F. data buffer MILON" UWORD COMP_0533_S 1 100 0 65535 ECU_ADDRESS 0xFFFFB6C2 /begin FUNCTION_LIST KF7-500.1[54] /end FUNCTION_LIST /end MEASUREMENT
/begin MEASUREMENT avFFNGC "F.F. data buffer NG code" UWORD COMP_0426 1 100 0 65535 ECU_ADDRESS 0xFFFFB6C4 /begin FUNCTION_LIST KF7-500.1[54] KF7-580.1[8] /end FUNCTION_LIST /end MEASUREMENT
/begin MEASUREMENT avFFPPAMB "F.F. data buffer atomospheric pressure value" UBYTE COMP_0535_S 1 100 0 255 ECU_ADDRESS 0xFFFFB6C6 /begin FUNCTION_LIST KF7-500.1[54] /end FUNCTION_LIST /end MEASUREMENT
/begin MEASUREMENT avFFQM "The amount of F.F. data buffer inhalation air" UWORD COMP_0536_S 1 100 0 655.35 ECU_ADDRESS 0xFFFFB6C8 /begin FUNCTION_LIST KF7-500.1[54] /end FUNCTION_LIST /end MEASUREMENT
/begin MEASUREMENT avFFRPM "F.F. data buffer engine speed" UWORD COMP_0427 1 100 0 16383.75 ECU_ADDRESS 0xFFFFB6CA /begin FUNCTION_LIST KF7-500.1[54] KF7-580.1[8] /end FUNCTION_LIST /end MEASUREMENT
/begin MEASUREMENT avFFRUNTM "After the F.F. data buffer engine drive, progress time" UWORD COMP_0049 1 100 0 65535 ECU_ADDRESS 0xFFFFB6CC /begin FUNCTION_LIST KF7-500.1[54] /end FUNCTION_LIST /end MEASUREMENT
/begin MEASUREMENT avFFTAG "An intake air temperature for the F.F. data buffer GST" UBYTE COMP_0428 1 100 -40 215 ECU_ADDRESS 0xFFFFB6CE /begin FUNCTION_LIST KF7-500.1[54] /end FUNCTION_LIST /end MEASUREMENT
/begin MEASUREMENT avFFTGABFE "In such cases as the F.F. data buffer target, quantity ratio" UWORD COMP_0327 1 100 0 1.9988175 ECU_ADDRESS 0xFFFFB6D0 /begin FUNCTION_LIST KF7-500.1[54] /end FUNCTION_LIST /end MEASUREMENT
/begin MEASUREMENT avFFTGTVO "F.F. data buffer target throttle open-degree" UBYTE COMP_0378 1 100 0 100.000000065 ECU_ADDRESS 0xFFFFB6D2 /begin FUNCTION_LIST KF7-500.1[54] /end FUNCTION_LIST /end MEASUREMENT
/begin MEASUREMENT avFFTPH "F.F. buffer cylinder air quantity equivalent pulse width (high rank)" UBYTE COMP_0001 1 100 0 31.875 ECU_ADDRESS 0xFFFFB6D3 /begin FUNCTION_LIST KF7-500.1[54] KF7-580.1[8] /end FUNCTION_LIST /end MEASUREMENT
/begin MEASUREMENT avFFTPS1OF "F.F. data buffer, absolutely, throttle open-degree 1" UBYTE COMP_0378 1 100 0 100.000000065 ECU_ADDRESS 0xFFFFB6D4 /begin FUNCTION_LIST KF7-500.1[54] /end FUNCTION_LIST /end MEASUREMENT
/begin MEASUREMENT avFFTVO "F.F. buffer throttle open-degree" UBYTE COMP_0002 1 100 0 89.25 ECU_ADDRESS 0xFFFFB6D5 /begin FUNCTION_LIST KF7-500.1[54] KF7-580.1[8] /end FUNCTION_LIST /end MEASUREMENT
/begin MEASUREMENT avFFTWN "F.F. data buffer engine cooling coolant temperature" UBYTE COMP_0428 1 100 -40 215 ECU_ADDRESS 0xFFFFB6D6 /begin FUNCTION_LIST KF7-500.1[54] KF7-580.1[8] /end FUNCTION_LIST /end MEASUREMENT
/begin MEASUREMENT avFFVB "F.F. data buffer battery voltage" UWORD COMP_0537_S 1 100 0 65.535 ECU_ADDRESS 0xFFFFB6D8 /begin FUNCTION_LIST KF7-500.1[54] /end FUNCTION_LIST /end MEASUREMENT
/begin MEASUREMENT avFFVO2 "F.F. data buffer O2 sensor voltage" UBYTE COMP_0538_S 1 100 0 1.275 ECU_ADDRESS 0xFFFFB6DA /begin FUNCTION_LIST KF7-500.1[54] /end FUNCTION_LIST /end MEASUREMENT
/begin MEASUREMENT avFFVO2_R#1 "F.F. data buffer O2 sensor voltage" UBYTE COMP_0538_S 1 100 0 1.275 ECU_ADDRESS 0xFFFFB6DA /begin FUNCTION_LIST KF7-500.1[54] /end FUNCTION_LIST /end MEASUREMENT
/begin MEASUREMENT avFFVO2_R#2 "F.F. data buffer O2 sensor voltage" UBYTE COMP_0538_S 1 100 0 1.275 ECU_ADDRESS 0xFFFFB6DB /begin FUNCTION_LIST KF7-500.1[54] /end FUNCTION_LIST /end MEASUREMENT
/begin MEASUREMENT avFFVRO2 "F.F. data buffer rear O2 voltage" UBYTE COMP_0538_S 1 100 0 1.275 ECU_ADDRESS 0xFFFFB6DC /begin FUNCTION_LIST KF7-500.1[54] /end FUNCTION_LIST /end MEASUREMENT
/begin MEASUREMENT avFFVRO2_R#1 "F.F. data buffer rear O2 voltage" UBYTE COMP_0538_S 1 100 0 1.275 ECU_ADDRESS 0xFFFFB6DC /begin FUNCTION_LIST KF7-500.1[54] /end FUNCTION_LIST /end MEASUREMENT
/begin MEASUREMENT avFFVRO2_R#2 "F.F. data buffer rear O2 voltage" UBYTE COMP_0538_S 1 100 0 1.275 ECU_ADDRESS 0xFFFFB6DD /begin FUNCTION_LIST KF7-500.1[54] /end FUNCTION_LIST /end MEASUREMENT
/begin MEASUREMENT avFFVSP "A degree of a F.F. data buffer vehicle speed" UBYTE COMP_0429 1 100 0 255 ECU_ADDRESS 0xFFFFB6DE /begin FUNCTION_LIST KF7-500.1[54] KF7-580.1[8] /end FUNCTION_LIST /end MEASUREMENT
/begin MEASUREMENT avGSTIMR "Diagnosis completion monitor flag" UBYTE COMP_0068 1 100 0 255 ECU_ADDRESS 0xFFFFB6F2 /begin FUNCTION_LIST KF7-500.1[54] KF7-580.1[8] /end FUNCTION_LIST /end MEASUREMENT
/begin MEASUREMENT avGSTIMR_R#1 "Diagnosis completion monitor flag" UBYTE COMP_0068 1 100 0 255 ECU_ADDRESS 0xFFFFB6F2 /begin FUNCTION_LIST KF7-500.1[54] KF7-580.1[8] /end FUNCTION_LIST /end MEASUREMENT
/begin MEASUREMENT avGSTIMR_R#2 "Diagnosis completion monitor flag" UBYTE COMP_0068 1 100 0 255 ECU_ADDRESS 0xFFFFB6F3 /begin FUNCTION_LIST KF7-500.1[54] KF7-580.1[8] /end FUNCTION_LIST /end MEASUREMENT
/begin MEASUREMENT avMILTIME "MIL Running time from on" UWORD COMP_0533_S 1 100 0 65535 ECU_ADDRESS 0xFFFFB702 /begin FUNCTION_LIST KF7-500.1[54] /end FUNCTION_LIST /end MEASUREMENT
/begin MEASUREMENT avRTCLV "Logic operation load value" UBYTE COMP_0425 1 100 0 99.99999981 ECU_ADDRESS 0xFFFF415E /begin FUNCTION_LIST KF7-500.1[54] KF7-500.20B[4] KF7-500.26[17] KF7-580.1[8] /end FUNCTION_LIST /end MEASUREMENT
/begin MEASUREMENT avRTFSS "A fuel control condition distinction flag for GST" UBYTE COMP_0091 1 100 0 255 ECU_ADDRESS 0xFFFF4164 /begin FUNCTION_LIST KF7-500.1[54] /end FUNCTION_LIST /end MEASUREMENT
/begin MEASUREMENT avRTFSS_R#1 "A fuel control condition distinction flag for GST" UBYTE COMP_0091 1 100 0 255 ECU_ADDRESS 0xFFFF4164 /begin FUNCTION_LIST KF7-500.1[54] /end FUNCTION_LIST /end MEASUREMENT
/begin MEASUREMENT avRTFSS_R#2 "A fuel control condition distinction flag for GST" UBYTE COMP_0091 1 100 0 255 ECU_ADDRESS 0xFFFF4165 /begin FUNCTION_LIST KF7-500.1[54] /end FUNCTION_LIST /end MEASUREMENT
/begin MEASUREMENT avRUNTM "After the engine drive, progress time" UWORD COMP_0013 1 100 0 65535 ECU_ADDRESS 0xFFFF416C /begin FUNCTION_LIST KF7-500.1[54] /end FUNCTION_LIST /end MEASUREMENT
/begin MEASUREMENT avTWG "An engine cooling coolant temperature for GST" UBYTE COMP_0428 1 100 -40 215 ECU_ADDRESS 0xFFFF419A /begin FUNCTION_LIST KF7-500.1[54] KF7-500.20B[4] KF7-500.26[17] /end FUNCTION_LIST /end MEASUREMENT
/begin MEASUREMENT avWARMUPS "The number of warm-ups after the trouble code clear" UBYTE COMP_0016 1 100 0 255 ECU_ADDRESS 0xFFFFB724 /begin FUNCTION_LIST KF7-500.1[54] /end FUNCTION_LIST /end MEASUREMENT
/begin MEASUREMENT bvEGSTPM "Motor position monitor value" UWORD COMP_0140 1 100 0 32767.5 ECU_ADDRESS 0xFFFFB672 /begin FUNCTION_LIST KF7-500.1[54] /end FUNCTION_LIST /end MEASUREMENT
/begin MEASUREMENT bvEVPDTY "Canister purge control duty" UBYTE COMP_0047 1 100 0 127.5 ECU_ADDRESS 0xFFFF22C2 /begin FUNCTION_LIST KF7-450.50[10] KF7-580.1[8] R901.1.Diag_on_can_app_1_6_2 /end FUNCTION_LIST /end MEASUREMENT
/begin MEASUREMENT vAADNV2TO "AA/N/V value for TPO1" UWORD COMP_0539_S 1 100 0 0.000005950578 ECU_ADDRESS 0xFFFF10BC /begin FUNCTION_LIST KF7-500.7[12] /end FUNCTION_LIST /end MEASUREMENT
/begin MEASUREMENT vAADNV2WO "At the time of WOT, AA/N/V value" UWORD COMP_0540_S 1 100 0 0.000005950578 ECU_ADDRESS 0xFFFF10BE /begin FUNCTION_LIST KF7-500.7[12] /end FUNCTION_LIST /end MEASUREMENT
/begin MEASUREMENT vAADNVTPO "AA/N/V value for TPO1" UWORD COMP_0541_S 1 100 0 0.000002975289 ECU_ADDRESS 0xFFFF10C0 /begin FUNCTION_LIST KF7-500.7[12] /end FUNCTION_LIST /end MEASUREMENT
/begin MEASUREMENT vAAWOT "At the time of WOT, a total duct area" UWORD COMP_0042 1 100 0 52.428 ECU_ADDRESS 0xFFFF10C6 /begin FUNCTION_LIST KF7-500.7[12] /end FUNCTION_LIST /end MEASUREMENT
/begin MEASUREMENT vADAFSFL "A/F (Front) sensor" UWORD COMP_0023 1 100 0 327675 ECU_ADDRESS 0xFFFF1CCC /begin FUNCTION_LIST KF7-500.1[54] /end FUNCTION_LIST /end MEASUREMENT
/begin MEASUREMENT vADPDPRES "Pd pressure sensor voltage" UWORD COMP_0023 1 100 0 327675 ECU_ADDRESS 0xFFFF8842 /begin FUNCTION_LIST KF7-460.1[6] /end FUNCTION_LIST /end MEASUREMENT
/begin MEASUREMENT vADPSPRES "Power steering pressure" UWORD COMP_0023 1 100 0 327675 ECU_ADDRESS 0xFFFF8844 /begin FUNCTION_LIST KF7-460.1[6] /end FUNCTION_LIST /end MEASUREMENT
/begin MEASUREMENT vAFMIDLNE "AFM function upper limit diagnosis diagnosis lower limit speed (target IDEL speed -100)" UBYTE COMP_0006 1 100 0 3187.5 ECU_ADDRESS 0xFFFF1118 /begin FUNCTION_LIST KF7-500.7[12] /end FUNCTION_LIST /end MEASUREMENT
/begin MEASUREMENT vAFMRCGH "AFM function upper limit diagnosis diagnosis criteria gain" UBYTE COMP_0435 1 100 0 7.96875 ECU_ADDRESS 0xFFFF1119 /begin FUNCTION_LIST KF7-500.7[12] /end FUNCTION_LIST /end MEASUREMENT
/begin MEASUREMENT vAFMRCHFG "At the time of the upper limit diagnosis timer minimum value, flag condition (AFM function diagnosis bu parameter)" UBYTE COMP_0068 1 100 0 255 ECU_ADDRESS 0xFFFFA097 /begin FUNCTION_LIST KF7-500.7[12] /end FUNCTION_LIST /end MEASUREMENT
/begin MEASUREMENT vAFMRCHIT "At the time of the upper limit diagnosis timer minimum value, ITAC (AFM function diagnosis bu parameter)" UBYTE COMP_0009 1 100 0 199.21875 ECU_ADDRESS 0xFFFFA098 /begin FUNCTION_LIST KF7-500.7[12] /end FUNCTION_LIST /end MEASUREMENT
/begin MEASUREMENT vAFMRCHNE "At the time of the upper limit diagnosis timer minimum value, MNRPM (AFM function diagnosis bu parameter)" UBYTE COMP_0000 1 100 0 6375 ECU_ADDRESS 0xFFFFA099 /begin FUNCTION_LIST KF7-500.7[12] /end FUNCTION_LIST /end MEASUREMENT
/begin MEASUREMENT vAFMRCHPA "At the time of the upper limit diagnosis timer minimum value, PPAMB (AFM function diagnosis bu parameter)" UBYTE COMP_0546_S 1 100 0 127.5 ECU_ADDRESS 0xFFFFA09A /begin FUNCTION_LIST KF7-500.7[12] /end FUNCTION_LIST /end MEASUREMENT
/begin MEASUREMENT vAFMRCHPG "At the time of the upper limit diagnosis timer minimum value, EVPS (AFM function diagnosis bu parameter)" UBYTE COMP_0047 1 100 0 127.5 ECU_ADDRESS 0xFFFFA09B /begin FUNCTION_LIST KF7-500.7[12] /end FUNCTION_LIST /end MEASUREMENT
/begin MEASUREMENT vAFMRCHS "At the time of the upper limit diagnosis timer minimum value, AFMRITAH (AFM function diagnosis bu parameter)" UBYTE COMP_0009 1 100 0 199.21875 ECU_ADDRESS 0xFFFFA09C /begin FUNCTION_LIST KF7-500.7[12] /end FUNCTION_LIST /end MEASUREMENT
/begin MEASUREMENT vAFMRCHTA "At the time of the upper limit diagnosis timer minimum value, TAN (AFM function diagnosis bu parameter)" UBYTE COMP_0035 1 100 -50 205 ECU_ADDRESS 0xFFFFA09D /begin FUNCTION_LIST KF7-500.7[12] /end FUNCTION_LIST /end MEASUREMENT
/begin MEASUREMENT vAFMRCHTM "Upper limit diagnosis trouble judgement timer minimum value (AFM function diagnosis bu parameter)" UBYTE COMP_0024 1 100 0 12750 ECU_ADDRESS 0xFFFFA09E /begin FUNCTION_LIST KF7-500.7[12] /end FUNCTION_LIST /end MEASUREMENT
/begin MEASUREMENT vAFMRCHTV "At the time of the upper limit diagnosis timer minimum value, TPO1 (AFM function diagnosis bu parameter)" UWORD COMP_0005 1 100 0 7208.85 ECU_ADDRESS 0xFFFFA0A0 /begin FUNCTION_LIST KF7-500.7[12] /end FUNCTION_LIST /end MEASUREMENT
/begin MEASUREMENT vAFMRCHVT "At the time of the upper limit diagnosis timer minimum value, VTCNOW (AFM function diagnosis bu parameter)" UBYTE COMP_0256 1 100 -64 63.5 ECU_ADDRESS 0xFFFFA0A2 /begin FUNCTION_LIST KF7-500.7[12] /end FUNCTION_LIST /end MEASUREMENT
/begin MEASUREMENT vAFMRCHVT_R#1 "At the time of the upper limit diagnosis timer minimum value, VTCNOW (AFM function diagnosis bu parameter)" UBYTE COMP_0256 1 100 -64 63.5 ECU_ADDRESS 0xFFFFA0A2 /begin FUNCTION_LIST KF7-500.7[12] /end FUNCTION_LIST /end MEASUREMENT
/begin MEASUREMENT vAFMRCHVT_R#2 "At the time of the upper limit diagnosis timer minimum value, VTCNOW (AFM function diagnosis bu parameter)" UBYTE COMP_0256 1 100 -64 63.5 ECU_ADDRESS 0xFFFFA0A3 /begin FUNCTION_LIST KF7-500.7[12] /end FUNCTION_LIST /end MEASUREMENT
/begin MEASUREMENT vAFMRCHWT "At the time of the upper limit diagnosis timer minimum value, TWN (AFM function diagnosis bu parameter)" UBYTE COMP_0035 1 100 -50 205 ECU_ADDRESS 0xFFFFA0A4 /begin FUNCTION_LIST KF7-500.7[12] /end FUNCTION_LIST /end MEASUREMENT
/begin MEASUREMENT vAFMRCLFG "At the time of the lower limit diagnosis timer minimum value, flag condition (AFM function diagnosis bu parameter)" UBYTE COMP_0068 1 100 0 255 ECU_ADDRESS 0xFFFFA0A5 /begin FUNCTION_LIST KF7-500.7[12] /end FUNCTION_LIST /end MEASUREMENT
/begin MEASUREMENT vAFMRCLIT "At the time of the lower limit diagnosis timer minimum value, ITAC (AFM function diagnosis bu parameter)" UBYTE COMP_0009 1 100 0 199.21875 ECU_ADDRESS 0xFFFFA0A6 /begin FUNCTION_LIST KF7-500.7[12] /end FUNCTION_LIST /end MEASUREMENT
/begin MEASUREMENT vAFMRCLNE "At the time of the lower limit diagnosis timer minimum value, MNRPM (AFM function diagnosis bu parameter)" UBYTE COMP_0000 1 100 0 6375 ECU_ADDRESS 0xFFFFA0A7 /begin FUNCTION_LIST KF7-500.7[12] /end FUNCTION_LIST /end MEASUREMENT
/begin MEASUREMENT vAFMRCLPA "At the time of the lower limit diagnosis timer minimum value, PPAMB (AFM function diagnosis bu parameter)" UBYTE COMP_0546_S 1 100 0 127.5 ECU_ADDRESS 0xFFFFA0A8 /begin FUNCTION_LIST KF7-500.7[12] /end FUNCTION_LIST /end MEASUREMENT
/begin MEASUREMENT vAFMRCLPG "At the time of the lower limit diagnosis timer minimum value, EVPS (AFM function diagnosis bu parameter)" UBYTE COMP_0047 1 100 0 127.5 ECU_ADDRESS 0xFFFFA0A9 /begin FUNCTION_LIST KF7-500.7[12] /end FUNCTION_LIST /end MEASUREMENT
/begin MEASUREMENT vAFMRCLS "At the time of the lower limit diagnosis timer minimum value, AFMRITAL (AFM function diagnosis bu parameter)" UBYTE COMP_0009 1 100 0 199.21875 ECU_ADDRESS 0xFFFFA0AA /begin FUNCTION_LIST KF7-500.7[12] /end FUNCTION_LIST /end MEASUREMENT
/begin MEASUREMENT vAFMRCLTA "At the time of the lower limit diagnosis timer minimum value, TAN (AFM function diagnosis bu parameter)" UBYTE COMP_0035 1 100 -50 205 ECU_ADDRESS 0xFFFFA0AB /begin FUNCTION_LIST KF7-500.7[12] /end FUNCTION_LIST /end MEASUREMENT
/begin MEASUREMENT vAFMRCLTM "Lower limit diagnosis trouble judgement timer minimum value (AFM function diagnosis bu parameter)" UBYTE COMP_0024 1 100 0 12750 ECU_ADDRESS 0xFFFFA0AC /begin FUNCTION_LIST KF7-500.7[12] /end FUNCTION_LIST /end MEASUREMENT
/begin MEASUREMENT vAFMRCLTV "At the time of the lower limit diagnosis timer minimum value, TPO1 (AFM function diagnosis bu parameter)" UWORD COMP_0005 1 100 0 7208.85 ECU_ADDRESS 0xFFFFA0AE /begin FUNCTION_LIST KF7-500.7[12] /end FUNCTION_LIST /end MEASUREMENT
/begin MEASUREMENT vAFMRCLVT "At the time of the lower limit diagnosis timer minimum value, VTCNOW (AFM function diagnosis bu parameter)" UBYTE COMP_0256 1 100 -64 63.5 ECU_ADDRESS 0xFFFFA0B0 /begin FUNCTION_LIST KF7-500.7[12] /end FUNCTION_LIST /end MEASUREMENT
/begin MEASUREMENT vAFMRCLVT_R#1 "At the time of the lower limit diagnosis timer minimum value, VTCNOW (AFM function diagnosis bu parameter)" UBYTE COMP_0256 1 100 -64 63.5 ECU_ADDRESS 0xFFFFA0B0 /begin FUNCTION_LIST KF7-500.7[12] /end FUNCTION_LIST /end MEASUREMENT
/begin MEASUREMENT vAFMRCLVT_R#2 "At the time of the lower limit diagnosis timer minimum value, VTCNOW (AFM function diagnosis bu parameter)" UBYTE COMP_0256 1 100 -64 63.5 ECU_ADDRESS 0xFFFFA0B1 /begin FUNCTION_LIST KF7-500.7[12] /end FUNCTION_LIST /end MEASUREMENT
/begin MEASUREMENT vAFMRCLWT "At the time of the lower limit diagnosis timer minimum value, TWN (AFM function diagnosis bu parameter)" UBYTE COMP_0035 1 100 -50 205 ECU_ADDRESS 0xFFFFA0B2 /begin FUNCTION_LIST KF7-500.7[12] /end FUNCTION_LIST /end MEASUREMENT
/begin MEASUREMENT vAFMRITAH "AFM function upper limit diagnosis diagnosis criteria filling up efficiency" UBYTE COMP_0009 1 100 0 199.21875 ECU_ADDRESS 0xFFFF111A /begin FUNCTION_LIST KF7-500.7[12] /end FUNCTION_LIST /end MEASUREMENT
/begin MEASUREMENT vAFMRITAL "AFM function lower limit diagnosis diagnosis criteria filling up efficiency" UBYTE COMP_0009 1 100 0 199.21875 ECU_ADDRESS 0xFFFF111B /begin FUNCTION_LIST KF7-500.7[12] /end FUNCTION_LIST /end MEASUREMENT
/begin MEASUREMENT vCLRDIST "Mileage after the trouble code clear" ULONG COMP_0389 1 100 0 1685624.33943218 ECU_ADDRESS 0xFFFFB5C8 /begin FUNCTION_LIST KF7-500.1[54] R904.1.Gst_on_can_1_0_1 /end FUNCTION_LIST /end MEASUREMENT
/begin MEASUREMENT vCLRTIME "Running time after the trouble code clear" UWORD COMP_0533_S 1 100 0 65535 ECU_ADDRESS 0xFFFFB736 /begin FUNCTION_LIST KF7-500.1[54] R904.1.Gst_on_can_1_0_1 /end FUNCTION_LIST /end MEASUREMENT
/begin MEASUREMENT vCMOIM1 "Monitor clamp timer 1" UBYTE COMP_0030 1 100 0 255 ECU_ADDRESS 0xFFFF3AAF /begin FUNCTION_LIST KF7-500.20B[4] /end FUNCTION_LIST /end MEASUREMENT
/begin MEASUREMENT vCMOIM2 "Monitor clamp timer 2" UBYTE COMP_0030 1 100 0 255 ECU_ADDRESS 0xFFFF299F /begin FUNCTION_LIST KF7-500.20B[4] /end FUNCTION_LIST /end MEASUREMENT
/begin MEASUREMENT vCNTTW "Diagnosis timing counter" ULONG COMP_0355 1 100 0 16777215.9960938 ECU_ADDRESS 0xFFFF29B8 /begin FUNCTION_LIST KF7-500.8[5] /end FUNCTION_LIST /end MEASUREMENT
/begin MEASUREMENT vCSNGRC "CAM diagnosis NG judgement number of times" UBYTE COMP_0016 1 100 0 255 ECU_ADDRESS 0xFFFF29D8 /begin FUNCTION_LIST KF7-500.6D[9] KF7-500.47B[15] /end FUNCTION_LIST /end MEASUREMENT
/begin MEASUREMENT vCSNGRP "POS10 diagnosis NG judgement delay" UBYTE COMP_0016 1 100 0 255 ECU_ADDRESS 0xFFFF29DA /begin FUNCTION_LIST KF7-500.6D[9] /end FUNCTION_LIST /end MEASUREMENT
/begin MEASUREMENT vDETCODE "Self-diagnosis details distinction code" UWORD COMP_0426 1 100 0 65535 ECU_ADDRESS 0xFFFF2A2C /begin FUNCTION_LIST KF7-500.1[54] /end FUNCTION_LIST /end MEASUREMENT
/begin MEASUREMENT vEGRRCC "EGR readiness-code set counter" UBYTE COMP_0030 1 100 0 255 ECU_ADDRESS 0xFFFFA304 /begin FUNCTION_LIST KF7-500.1[54] R000.4.EepAlloc_1_2_2 /end FUNCTION_LIST /end MEASUREMENT
/begin MEASUREMENT vEGSTPD "Motor target position" UWORD COMP_0140 1 100 0 32767.5 ECU_ADDRESS 0xFFFF2B40 /begin FUNCTION_LIST KF7-450.50[10] KF7-500.1[54] KF7-580.1[8] /end FUNCTION_LIST /end MEASUREMENT
/begin MEASUREMENT vEVPRES "PEVAP weighted average value" UWORD COMP_0050 1 100 0 5119.921875 ECU_ADDRESS 0xFFFF8996 /begin FUNCTION_LIST KF7-500.1[54] KF7-500.30[8] KF7-580.1[8] /end FUNCTION_LIST /end MEASUREMENT
/begin MEASUREMENT vEVPSj5 "Basis DUTY value (for the DDL monitor)" UBYTE COMP_0047 1 100 0 127.5 ECU_ADDRESS 0xFFFF134A /begin FUNCTION_LIST KF7-500.7[12] /end FUNCTION_LIST /end MEASUREMENT
/begin MEASUREMENT vEVPTR "Target purge magnification" UBYTE COMP_0158 1 100 0 15.9375 ECU_ADDRESS 0xFFFF101E /begin FUNCTION_LIST KF7-500.1[54] /end FUNCTION_LIST /end MEASUREMENT
/begin MEASUREMENT vFADV1CYL "1 cylinder final ignition timing" UBYTE COMP_0017 1 100 0 255 ECU_ADDRESS 0xFFFF1FCE /begin FUNCTION_LIST KF7-500.1[54] /end FUNCTION_LIST /end MEASUREMENT
/begin MEASUREMENT vFDV80A "A counter (for the catalyst criteria) for the misfire judgement region data elimination" UBYTE COMP_0016 1 100 0 255 ECU_ADDRESS 0xFFFFA3C1 /begin FUNCTION_LIST KF7-500.1[54] KF7-500.26[17] R000.4.EepAlloc_1_2_2 /end FUNCTION_LIST /end MEASUREMENT
/begin MEASUREMENT vFDV80B "A counter (after the start, for the emission criteria) for the misfire judgement region data elimination" UBYTE COMP_0016 1 100 0 255 ECU_ADDRESS 0xFFFFA3C2 /begin FUNCTION_LIST KF7-500.1[54] KF7-500.26[17] R000.4.EepAlloc_1_2_2 /end FUNCTION_LIST /end MEASUREMENT
/begin MEASUREMENT vFDV80C "A counter (usually, for the emission criteria) for the misfire judgement region data elimination" UBYTE COMP_0016 1 100 0 255 ECU_ADDRESS 0xFFFFA3C3 /begin FUNCTION_LIST KF7-500.1[54] KF7-500.26[17] R000.4.EepAlloc_1_2_2 /end FUNCTION_LIST /end MEASUREMENT
/begin MEASUREMENT vFFADV "F.F. data buffer ignition timing" UBYTE COMP_0594_S 1 100 -64 63.5 ECU_ADDRESS 0xFFFFA3C6 /begin FUNCTION_LIST KF7-500.1[54] /end FUNCTION_LIST /end MEASUREMENT
/begin MEASUREMENT vFFALP "F.F. data buffer short periodic fuel compensation value" UBYTE COMP_0072_S 1 100 -1 0.9921875 ECU_ADDRESS 0xFFFFB756
 /begin FUNCTION_LIST KF7-500.1[54] R901.1.Diag_on_can_app_1_6_2 R904.1.Gst_on_can_1_0_1 /end FUNCTION_LIST
/end MEASUREMENT
/begin MEASUREMENT vFFALP_R#1 "F.F. data buffer short periodic fuel compensation value" UBYTE COMP_0072_S 1 100 -1 0.9921875 ECU_ADDRESS 0xFFFFB756
 /begin FUNCTION_LIST KF7-500.1[54] R901.1.Diag_on_can_app_1_6_2 R904.1.Gst_on_can_1_0_1 /end FUNCTION_LIST
/end MEASUREMENT
/begin MEASUREMENT vFFALP_R#2 "F.F. data buffer short periodic fuel compensation value" UBYTE COMP_0072_S 1 100 -1 0.9921875 ECU_ADDRESS 0xFFFFB757
 /begin FUNCTION_LIST KF7-500.1[54] R901.1.Diag_on_can_app_1_6_2 R904.1.Gst_on_can_1_0_1 /end FUNCTION_LIST
/end MEASUREMENT
/begin MEASUREMENT vFFAPS1OF "F.F. data buffer accelerator pedal position (D)" UBYTE COMP_0378 1 100 0 100.000000065 ECU_ADDRESS 0xFFFFB758 /begin FUNCTION_LIST KF7-500.1[54] R904.1.Gst_on_can_1_0_1 /end FUNCTION_LIST /end MEASUREMENT
/begin MEASUREMENT vFFAPS2OF "F.F. data buffer accelerator pedal position (E)" UBYTE COMP_0378 1 100 0 100.000000065 ECU_ADDRESS 0xFFFFB759 /begin FUNCTION_LIST KF7-500.1[54] R904.1.Gst_on_can_1_0_1 /end FUNCTION_LIST /end MEASUREMENT
/begin MEASUREMENT vFFBST "F.F. data buffer intake manifold absolute pressure" UBYTE COMP_0424 1 100 0 255 ECU_ADDRESS 0xFFFFB75A
 /begin FUNCTION_LIST KF7-500.1[54] KF7-580.1[8] R901.1.Diag_on_can_app_1_6_2 R904.1.Gst_on_can_1_0_1 /end FUNCTION_LIST
/end MEASUREMENT
/begin MEASUREMENT vFFCLRDST "Mileage after the F.F. data buffer trouble code clear" UWORD COMP_0470 1 100 0 65535 ECU_ADDRESS 0xFFFFB75C /begin FUNCTION_LIST KF7-500.1[54] R904.1.Gst_on_can_1_0_1 /end FUNCTION_LIST /end MEASUREMENT
/begin MEASUREMENT vFFCLTIME "Running time after the F.F. data buffer trouble code clear" UWORD COMP_0533_S 1 100 0 65535 ECU_ADDRESS 0xFFFFB75E /begin FUNCTION_LIST KF7-500.1[54] R904.1.Gst_on_can_1_0_1 /end FUNCTION_LIST /end MEASUREMENT
/begin MEASUREMENT vFFCLV "F.F. data buffer logic operation load value" UBYTE COMP_0425 1 100 0 99.99999981 ECU_ADDRESS 0xFFFFB760
 /begin FUNCTION_LIST KF7-500.1[54] KF7-580.1[8] R901.1.Diag_on_can_app_1_6_2 R904.1.Gst_on_can_1_0_1 /end FUNCTION_LIST
/end MEASUREMENT
/begin MEASUREMENT vFFCODE "F.F. data buffer self-diagnosis details distinction code" UWORD COMP_0426 1 100 0 65535 ECU_ADDRESS 0xFFFFB762 /begin FUNCTION_LIST KF7-500.1[54] KF7-580.1[8] R901.1.Diag_on_can_app_1_6_2 /end FUNCTION_LIST /end MEASUREMENT
/begin MEASUREMENT vFFDTRGW "The existence of the diagnosis of FFDTRG (reverse side trigger flag) =1" UBYTE COMP_0004 1 100 0 255 ECU_ADDRESS 0xFFFFA3E0 /begin FUNCTION_LIST KF7-500.1[54] KF7-525.1[4] /end FUNCTION_LIST /end MEASUREMENT
/begin MEASUREMENT vFFFSS "F.F. data buffer fuel control condition distinction flag" UBYTE COMP_0091 1 100 0 255 ECU_ADDRESS 0xFFFFB764
 /begin FUNCTION_LIST KF7-500.1[54] R901.1.Diag_on_can_app_1_6_2 R904.1.Gst_on_can_1_0_1 /end FUNCTION_LIST
/end MEASUREMENT
/begin MEASUREMENT vFFFSS_R#1 "F.F. data buffer fuel control condition distinction flag" UBYTE COMP_0091 1 100 0 255 ECU_ADDRESS 0xFFFFB764
 /begin FUNCTION_LIST KF7-500.1[54] R901.1.Diag_on_can_app_1_6_2 R904.1.Gst_on_can_1_0_1 /end FUNCTION_LIST
/end MEASUREMENT
/begin MEASUREMENT vFFFSS_R#2 "F.F. data buffer fuel control condition distinction flag" UBYTE COMP_0091 1 100 0 255 ECU_ADDRESS 0xFFFFB765
 /begin FUNCTION_LIST KF7-500.1[54] R901.1.Diag_on_can_app_1_6_2 R904.1.Gst_on_can_1_0_1 /end FUNCTION_LIST
/end MEASUREMENT
/begin MEASUREMENT vFFITAC "F.F. data buffer, absolutely, load value" UWORD COMP_0378 1 100 0 25700.000016705 ECU_ADDRESS 0xFFFFB766 /begin FUNCTION_LIST KF7-500.1[54] R904.1.Gst_on_can_1_0_1 /end FUNCTION_LIST /end MEASUREMENT
/begin MEASUREMENT vFFKBL "F.F. data buffer head periodic fuel compensation value" UBYTE COMP_0072_S 1 100 -1 0.9921875 ECU_ADDRESS 0xFFFFB768
 /begin FUNCTION_LIST KF7-500.1[54] R901.1.Diag_on_can_app_1_6_2 R904.1.Gst_on_can_1_0_1 /end FUNCTION_LIST
/end MEASUREMENT
/begin MEASUREMENT vFFKBL_R#1 "F.F. data buffer head periodic fuel compensation value" UBYTE COMP_0072_S 1 100 -1 0.9921875 ECU_ADDRESS 0xFFFFB768
 /begin FUNCTION_LIST KF7-500.1[54] R901.1.Diag_on_can_app_1_6_2 R904.1.Gst_on_can_1_0_1 /end FUNCTION_LIST
/end MEASUREMENT
/begin MEASUREMENT vFFKBL_R#2 "F.F. data buffer head periodic fuel compensation value" UBYTE COMP_0072_S 1 100 -1 0.9921875 ECU_ADDRESS 0xFFFFB769
 /begin FUNCTION_LIST KF7-500.1[54] R901.1.Diag_on_can_app_1_6_2 R904.1.Gst_on_can_1_0_1 /end FUNCTION_LIST
/end MEASUREMENT
/begin MEASUREMENT vFFMLTIME "Mileage from the F.F. data buffer MILON" UWORD COMP_0533_S 1 100 0 65535 ECU_ADDRESS 0xFFFFB76A /begin FUNCTION_LIST KF7-500.1[54] R904.1.Gst_on_can_1_0_1 /end FUNCTION_LIST /end MEASUREMENT
/begin MEASUREMENT vFFNGC "F.F. data buffer NG code" UWORD COMP_0426 1 100 0 65535 ECU_ADDRESS 0xFFFFB76C
 /begin FUNCTION_LIST KF7-500.1[54] KF7-580.1[8] R901.1.Diag_on_can_app_1_6_2 R904.1.Gst_on_can_1_0_1 /end FUNCTION_LIST
/end MEASUREMENT
/begin MEASUREMENT vFFPPAMB "F.F. data buffer atomospheric pressure value" UBYTE COMP_0535_S 1 100 0 255 ECU_ADDRESS 0xFFFFB76E /begin FUNCTION_LIST KF7-500.1[54] R904.1.Gst_on_can_1_0_1 /end FUNCTION_LIST /end MEASUREMENT
/begin MEASUREMENT vFFQM "The amount of F.F. data buffer inhalation air" UWORD COMP_0536_S 1 100 0 655.35 ECU_ADDRESS 0xFFFFB770 /begin FUNCTION_LIST KF7-500.1[54] R904.1.Gst_on_can_1_0_1 /end FUNCTION_LIST /end MEASUREMENT
/begin MEASUREMENT vFFRPM "F.F. data buffer engine speed" UWORD COMP_0427 1 100 0 16383.75 ECU_ADDRESS 0xFFFFB772
 /begin FUNCTION_LIST KF7-500.1[54] KF7-580.1[8] R901.1.Diag_on_can_app_1_6_2 R904.1.Gst_on_can_1_0_1 /end FUNCTION_LIST
/end MEASUREMENT
/begin MEASUREMENT vFFRUNTM "After the F.F. data buffer engine drive, progress time" UWORD COMP_0049 1 100 0 65535 ECU_ADDRESS 0xFFFFB774 /begin FUNCTION_LIST KF7-500.1[54] R904.1.Gst_on_can_1_0_1 /end FUNCTION_LIST /end MEASUREMENT
/begin MEASUREMENT vFFTAG "An intake air temperature for the F.F. data buffer GST" UBYTE COMP_0428 1 100 -40 215 ECU_ADDRESS 0xFFFFB776 /begin FUNCTION_LIST KF7-500.1[54] R904.1.Gst_on_can_1_0_1 /end FUNCTION_LIST /end MEASUREMENT
/begin MEASUREMENT vFFTAN "F.F. data buffer intake air temperature" UBYTE COMP_0035 1 100 -50 205 ECU_ADDRESS 0xFFFFA3FA /begin FUNCTION_LIST KF7-500.1[54] KF7-580.1[8] R901.1.Diag_on_can_app_1_6_2 /end FUNCTION_LIST /end MEASUREMENT
/begin MEASUREMENT vFFTFM "F.F. data air-fuel ratio map switching flag" UBYTE COMP_0068 1 100 0 255 ECU_ADDRESS 0xFFFFA3FE /begin FUNCTION_LIST KF7-500.1[54] /end FUNCTION_LIST /end MEASUREMENT
/begin MEASUREMENT vFFTGABFE "F.F. data buffer target air-fuel ratio" UWORD COMP_0327 1 100 0 1.9988175 ECU_ADDRESS 0xFFFFB778 /begin FUNCTION_LIST KF7-500.1[54] R904.1.Gst_on_can_1_0_1 /end FUNCTION_LIST /end MEASUREMENT
/begin MEASUREMENT vFFTGTVO "F.F. data buffer target throttle open-degree" UBYTE COMP_0378 1 100 0 100.000000065 ECU_ADDRESS 0xFFFFB77A /begin FUNCTION_LIST KF7-500.1[54] R904.1.Gst_on_can_1_0_1 /end FUNCTION_LIST /end MEASUREMENT
/begin MEASUREMENT vFFTPH "F.F. buffer cylinder air quantity equivalent pulse width (high rank)" UBYTE COMP_0001 1 100 0 31.875 ECU_ADDRESS 0xFFFFB77B /begin FUNCTION_LIST KF7-500.1[54] KF7-580.1[8] R901.1.Diag_on_can_app_1_6_2 /end FUNCTION_LIST /end MEASUREMENT
/begin MEASUREMENT vFFTPS1OF "F.F. data buffer, absolutely, throttle open-degree 1" UBYTE COMP_0378 1 100 0 100.000000065 ECU_ADDRESS 0xFFFFB77C /begin FUNCTION_LIST KF7-500.1[54] R904.1.Gst_on_can_1_0_1 /end FUNCTION_LIST /end MEASUREMENT
/begin MEASUREMENT vFFTPS2OF "F.F. data buffer, absolutely, throttle open-degree 2" UBYTE COMP_0378 1 100 0 100.000000065 ECU_ADDRESS 0xFFFFA406 /begin FUNCTION_LIST KF7-500.1[54] /end FUNCTION_LIST /end MEASUREMENT
/begin MEASUREMENT vFFTVO "F.F. buffer throttle open-degree" UBYTE COMP_0002 1 100 0 89.25 ECU_ADDRESS 0xFFFFB77D
 /begin FUNCTION_LIST KF7-500.1[54] KF7-580.1[8] R901.1.Diag_on_can_app_1_6_2 R904.1.Gst_on_can_1_0_1 /end FUNCTION_LIST
/end MEASUREMENT
/begin MEASUREMENT vFFTWN "F.F. data buffer engine cooling coolant temperature" UBYTE COMP_0428 1 100 -40 215 ECU_ADDRESS 0xFFFFB77E
 /begin FUNCTION_LIST KF7-500.1[54] KF7-580.1[8] R901.1.Diag_on_can_app_1_6_2 R904.1.Gst_on_can_1_0_1 /end FUNCTION_LIST
/end MEASUREMENT
/begin MEASUREMENT vFFVB "F.F. data buffer battery voltage" UWORD COMP_0537_S 1 100 0 65.535 ECU_ADDRESS 0xFFFFB780
 /begin FUNCTION_LIST KF7-500.1[54] R301.13.FFDforDiagOnCAN_1_1_3 R901.1.Diag_on_can_app_1_6_2 R904.1.Gst_on_can_1_0_1 /end FUNCTION_LIST
/end MEASUREMENT
/begin MEASUREMENT vFFVO2 "F.F. data buffer O2 sensor voltage" UBYTE COMP_0538_S 1 100 0 1.275 ECU_ADDRESS 0xFFFFB782 /begin FUNCTION_LIST KF7-500.1[54] R904.1.Gst_on_can_1_0_1 /end FUNCTION_LIST /end MEASUREMENT
/begin MEASUREMENT vFFVO2_R#1 "F.F. data buffer O2 sensor voltage" UBYTE COMP_0538_S 1 100 0 1.275 ECU_ADDRESS 0xFFFFB782 /begin FUNCTION_LIST KF7-500.1[54] R904.1.Gst_on_can_1_0_1 /end FUNCTION_LIST /end MEASUREMENT
/begin MEASUREMENT vFFVO2_R#2 "F.F. data buffer O2 sensor voltage" UBYTE COMP_0538_S 1 100 0 1.275 ECU_ADDRESS 0xFFFFB783 /begin FUNCTION_LIST KF7-500.1[54] R904.1.Gst_on_can_1_0_1 /end FUNCTION_LIST /end MEASUREMENT
/begin MEASUREMENT vFFVRO2 "F.F. data buffer rear O2 voltage" UBYTE COMP_0538_S 1 100 0 1.275 ECU_ADDRESS 0xFFFFB784 /begin FUNCTION_LIST KF7-500.1[54] R904.1.Gst_on_can_1_0_1 /end FUNCTION_LIST /end MEASUREMENT
/begin MEASUREMENT vFFVRO2_R#1 "F.F. data buffer rear O2 voltage" UBYTE COMP_0538_S 1 100 0 1.275 ECU_ADDRESS 0xFFFFB784 /begin FUNCTION_LIST KF7-500.1[54] R904.1.Gst_on_can_1_0_1 /end FUNCTION_LIST /end MEASUREMENT
/begin MEASUREMENT vFFVRO2_R#2 "F.F. data buffer rear O2 voltage" UBYTE COMP_0538_S 1 100 0 1.275 ECU_ADDRESS 0xFFFFB785 /begin FUNCTION_LIST KF7-500.1[54] R904.1.Gst_on_can_1_0_1 /end FUNCTION_LIST /end MEASUREMENT
/begin MEASUREMENT vFFVSP "A degree of a F.F. data buffer vehicle speed" UBYTE COMP_0429 1 100 0 255 ECU_ADDRESS 0xFFFFB786
 /begin FUNCTION_LIST KF7-500.1[54] KF7-580.1[8] R901.1.Diag_on_can_app_1_6_2 R904.1.Gst_on_can_1_0_1 /end FUNCTION_LIST
/end MEASUREMENT
/begin MEASUREMENT vFGAGE3 "Fuel level gauge weighted average value 3" UWORD COMP_0050 1 100 0 5119.921875 ECU_ADDRESS 0xFFFF493C /begin FUNCTION_LIST KF7-500.1[54] KF7-580.1[8] /end FUNCTION_LIST /end MEASUREMENT
/begin MEASUREMENT vFGEND "IGN At the time of off, fuel level gauge voltage" UWORD COMP_0050 1 100 0 5119.921875 ECU_ADDRESS 0xFFFFA010 /begin FUNCTION_LIST KF7-500.1[54] KF7-580.1[8] /end FUNCTION_LIST /end MEASUREMENT
/begin MEASUREMENT vFGN "Fuel level gauge voltage normalize value" UWORD COMP_0050 1 100 0 5119.921875 ECU_ADDRESS 0xFFFF493E /begin FUNCTION_LIST KF7-500.1[54] KF7-580.1[8] /end FUNCTION_LIST /end MEASUREMENT
/begin MEASUREMENT vFLGFSW "The existence of the diagnosis of FLGFS (failsafe executive flag) =1" UBYTE COMP_0004 1 100 0 255 ECU_ADDRESS 0xFFFFA423 /begin FUNCTION_LIST KF7-500.1[54] /end FUNCTION_LIST /end MEASUREMENT
/begin MEASUREMENT vFMILONW "The existence of the diagnosis of FMILON (trouble alarm indication flag) =1" UBYTE COMP_0004 1 100 0 255 ECU_ADDRESS 0xFFFFA424 /begin FUNCTION_LIST KF7-500.1[54] R902.2.DiagMiscell_1_3_5 /end FUNCTION_LIST /end MEASUREMENT
/begin MEASUREMENT vFSENST_0 "The existence of the diagnosis of FSENST (engine stall prevention failsafe control) =1" UBYTE COMP_0004 1 100 0 255 ECU_ADDRESS 0xFFFFA433 /begin FUNCTION_LIST KF7-500.1[54] /end FUNCTION_LIST /end MEASUREMENT
/begin MEASUREMENT vFSMIL_0 "The existence of the diagnosis of FSMIL (MIL lighting) =1" UBYTE COMP_0004 1 100 0 255 ECU_ADDRESS 0xFFFFA435 /begin FUNCTION_LIST KF7-500.1[54] /end FUNCTION_LIST /end MEASUREMENT
/begin MEASUREMENT vGSTIMR "Diagnosis completion monitor flag" UBYTE COMP_0004 1 100 0 255 ECU_ADDRESS 0xFFFFB79A
 /begin FUNCTION_LIST KF7-500.1[54] KF7-580.1[8] R000.4.EepAlloc_1_2_2 R904.1.Gst_on_can_1_0_1 /end FUNCTION_LIST
/end MEASUREMENT
/begin MEASUREMENT vGSTIMR_R#1 "Diagnosis completion monitor flag" UBYTE COMP_0004 1 100 0 255 ECU_ADDRESS 0xFFFFB79A
 /begin FUNCTION_LIST KF7-500.1[54] KF7-580.1[8] R000.4.EepAlloc_1_2_2 R904.1.Gst_on_can_1_0_1 /end FUNCTION_LIST
/end MEASUREMENT
/begin MEASUREMENT vGSTIMR_R#2 "Diagnosis completion monitor flag" UBYTE COMP_0004 1 100 0 255 ECU_ADDRESS 0xFFFFB79B
 /begin FUNCTION_LIST KF7-500.1[54] KF7-580.1[8] R000.4.EepAlloc_1_2_2 R904.1.Gst_on_can_1_0_1 /end FUNCTION_LIST
/end MEASUREMENT
/begin MEASUREMENT vGST_CODE "The minimum value of the diagnosis NG GST_CODE" UWORD COMP_0068 1 100 0 65535 ECU_ADDRESS 0xFFFF2E12 /begin FUNCTION_LIST KF7-500.1[54] /end FUNCTION_LIST /end MEASUREMENT
/begin MEASUREMENT vIGMEM "Check signal LOW counter" UBYTE COMP_0016 1 100 0 255 ECU_ADDRESS 0xFFFF1440 /begin FUNCTION_LIST KF7-500.10[3] /end FUNCTION_LIST /end MEASUREMENT
/begin MEASUREMENT vISSTPD "STEP/MOTOR position target value" UWORD COMP_0025 1 100 0 32767.5 ECU_ADDRESS 0xFFFF2E64 /begin FUNCTION_LIST KF7-500.7[12] KF7-580.1[8] /end FUNCTION_LIST /end MEASUREMENT
/begin MEASUREMENT vITAC0WOT "At the time of WOT, standard condition filling up efficiency" UBYTE COMP_0009 1 100 0 199.21875 ECU_ADDRESS 0xFFFF14B4 /begin FUNCTION_LIST KF7-500.7[12] /end FUNCTION_LIST /end MEASUREMENT
/begin MEASUREMENT vITACEST "Estimated filling up efficiency" UBYTE COMP_0009 1 100 0 199.21875 ECU_ADDRESS 0xFFFF14B5 /begin FUNCTION_LIST KF7-500.7[12] /end FUNCTION_LIST /end MEASUREMENT
/begin MEASUREMENT vITACWOT "At the time of WOT, estimated filling up efficiency" UBYTE COMP_0009 1 100 0 199.21875 ECU_ADDRESS 0xFFFF14B8 /begin FUNCTION_LIST KF7-500.7[12] /end FUNCTION_LIST /end MEASUREMENT
/begin MEASUREMENT vKDUTY "DUTY compensation coefficient" UBYTE COMP_0044 1 100 0 1.9921875 ECU_ADDRESS 0xFFFF14C5 /begin FUNCTION_LIST KF7-500.1[54] KF7-500.21[19] KF7-500.24[10] /end FUNCTION_LIST /end MEASUREMENT
/begin MEASUREMENT vKQEGR "EGR fresh air conversion coefficient" UWORD COMP_0057 1 100 0 3.999941832 ECU_ADDRESS 0xFFFF14F2 /begin FUNCTION_LIST KF7-460.1[6] /end FUNCTION_LIST /end MEASUREMENT
/begin MEASUREMENT vMFDVC "A driving-cycle counter for the misfire diagnosis" UBYTE COMP_0030 1 100 0 255 ECU_ADDRESS 0xFFFFA56C /begin FUNCTION_LIST KF7-500.1[54] KF7-500.26[17] R000.4.EepAlloc_1_2_2 /end FUNCTION_LIST /end MEASUREMENT
/begin MEASUREMENT vMILEG1 "Mileage counter 1" ULONG COMP_0469 1 100 0 1685602.8645957 ECU_ADDRESS 0xFFFFB630 /begin FUNCTION_LIST KF7-500.1[54] /end FUNCTION_LIST /end MEASUREMENT
/begin MEASUREMENT vMILEG2 "Mileage counter 2" ULONG COMP_0389 1 100 0 1685624.33943218 ECU_ADDRESS 0xFFFFB634 /begin FUNCTION_LIST KF7-500.1[54] KF7-500.26[17] KF7-500.75[4] /end FUNCTION_LIST /end MEASUREMENT
/begin MEASUREMENT vMILTIME "MIL Running time from on" UWORD COMP_0533_S 1 100 0 65535 ECU_ADDRESS 0xFFFFB7AA /begin FUNCTION_LIST KF7-500.1[54] R904.1.Gst_on_can_1_0_1 /end FUNCTION_LIST /end MEASUREMENT
/begin MEASUREMENT vMIONKM "At the time of the trouble, vehicle speed integration value" UWORD COMP_0470 1 100 0 65535 ECU_ADDRESS 0xFFFFB638 /begin FUNCTION_LIST KF7-500.1[54] KF7-580.1[8] /end FUNCTION_LIST /end MEASUREMENT
/begin MEASUREMENT vMLTRPS1 "An independent setup trip counter 1" UBYTE COMP_0030 1 100 0 255 ECU_ADDRESS 0xFFFFA73D /begin FUNCTION_LIST KF7-500.1[54] R000.4.EepAlloc_1_2_2 /end FUNCTION_LIST /end MEASUREMENT
/begin MEASUREMENT vMLTRPS2 "An independent setup trip counter 2" UBYTE COMP_0030 1 100 0 255 ECU_ADDRESS 0xFFFFA73E /begin FUNCTION_LIST KF7-500.1[54] R000.4.EepAlloc_1_2_2 /end FUNCTION_LIST /end MEASUREMENT
/begin MEASUREMENT vMLTRPS3 "An independent setup trip counter 3" UBYTE COMP_0030 1 100 0 255 ECU_ADDRESS 0xFFFFA73F /begin FUNCTION_LIST KF7-500.1[54] R000.4.EepAlloc_1_2_2 /end FUNCTION_LIST /end MEASUREMENT
/begin MEASUREMENT vMLTRPS4 "An independent setup trip counter 4" UBYTE COMP_0030 1 100 0 255 ECU_ADDRESS 0xFFFFA740 /begin FUNCTION_LIST KF7-500.1[54] R000.4.EepAlloc_1_2_2 /end FUNCTION_LIST /end MEASUREMENT
/begin MEASUREMENT vMLTRPS5 "An independent setup trip counter 5" UBYTE COMP_0030 1 100 0 255 ECU_ADDRESS 0xFFFFA741 /begin FUNCTION_LIST KF7-500.1[54] R000.4.EepAlloc_1_2_2 /end FUNCTION_LIST /end MEASUREMENT
/begin MEASUREMENT vMLTRTFG "Fuel level gauge function diagnosis TRIP counter" UBYTE COMP_0030 1 100 0 255 ECU_ADDRESS 0xFFFFA742 /begin FUNCTION_LIST KF7-500.1[54] /end FUNCTION_LIST /end MEASUREMENT
/begin MEASUREMENT vMRDEL "A driving-cycle counter for the fuel system LEAN diagnosis" UBYTE COMP_0030 1 100 0 255 ECU_ADDRESS 0xFFFFAAAC /begin FUNCTION_LIST KF7-500.1[54] KF7-500.20B[4] R000.4.EepAlloc_1_2_2 /end FUNCTION_LIST /end MEASUREMENT
/begin MEASUREMENT vMRDER "A driving-cycle counter for the fuel system RICH diagnosis" UBYTE COMP_0030 1 100 0 255 ECU_ADDRESS 0xFFFFAAAD /begin FUNCTION_LIST KF7-500.1[54] KF7-500.20B[4] R000.4.EepAlloc_1_2_2 /end FUNCTION_LIST /end MEASUREMENT
/begin MEASUREMENT vMRDVCL "A driving-cycle counter for the fuel system LEAN diagnosis" UBYTE COMP_0030 1 100 0 255 ECU_ADDRESS 0xFFFFAAAE /begin FUNCTION_LIST KF7-500.1[54] KF7-500.20B[4] R000.4.EepAlloc_1_2_2 /end FUNCTION_LIST /end MEASUREMENT
/begin MEASUREMENT vMRDVCR "A driving-cycle counter for the fuel system RICH diagnosis" UBYTE COMP_0030 1 100 0 255 ECU_ADDRESS 0xFFFFAAAF /begin FUNCTION_LIST KF7-500.1[54] KF7-500.20B[4] R000.4.EepAlloc_1_2_2 /end FUNCTION_LIST /end MEASUREMENT
/begin MEASUREMENT vMRLCLV "F.F. data buffer logic operation load value for the fuel system LEAN diagnosis" UBYTE COMP_0425 1 100 0 99.99999981 ECU_ADDRESS 0xFFFFAAB0 /begin FUNCTION_LIST KF7-500.20B[4] R000.4.EepAlloc_1_2_2 /end FUNCTION_LIST /end MEASUREMENT
/begin MEASUREMENT vMRLRPM "F.F. data buffer engine speed for the fuel system LEAN diagnosis" UWORD COMP_0427 1 100 0 16383.75 ECU_ADDRESS 0xFFFFAAB2 /begin FUNCTION_LIST KF7-500.20B[4] R000.4.EepAlloc_1_2_2 /end FUNCTION_LIST /end MEASUREMENT
/begin MEASUREMENT vMRLTW "A F.F. data buffer engine cooling coolant temperature for the fuel system LEAN diagnosis" UBYTE COMP_0428 1 100 -40 215 ECU_ADDRESS 0xFFFFAAB4 /begin FUNCTION_LIST KF7-500.20B[4] R000.4.EepAlloc_1_2_2 /end FUNCTION_LIST /end MEASUREMENT
/begin MEASUREMENT vMRRCLV "F.F. data buffer logic operation load value for the fuel system RICH diagnosis" UBYTE COMP_0425 1 100 0 99.99999981 ECU_ADDRESS 0xFFFFAAB5 /begin FUNCTION_LIST KF7-500.20B[4] R000.4.EepAlloc_1_2_2 /end FUNCTION_LIST /end MEASUREMENT
/begin MEASUREMENT vMRRRPM "F.F. data buffer engine speed for the fuel system RICH diagnosis" UWORD COMP_0427 1 100 0 16383.75 ECU_ADDRESS 0xFFFFAAB6 /begin FUNCTION_LIST KF7-500.20B[4] R000.4.EepAlloc_1_2_2 /end FUNCTION_LIST /end MEASUREMENT
/begin MEASUREMENT vMRRTW "A F.F. data buffer engine cooling coolant temperature for the fuel system RICH diagnosis" UBYTE COMP_0428 1 100 -40 215 ECU_ADDRESS 0xFFFFAAB8 /begin FUNCTION_LIST KF7-500.20B[4] R000.4.EepAlloc_1_2_2 /end FUNCTION_LIST /end MEASUREMENT
/begin MEASUREMENT vMRTRPL "A trip counter for the fuel system LEAN diagnosis" UBYTE COMP_0030 1 100 0 255 ECU_ADDRESS 0xFFFFAAB9 /begin FUNCTION_LIST KF7-500.20B[4] R000.4.EepAlloc_1_2_2 /end FUNCTION_LIST /end MEASUREMENT
/begin MEASUREMENT vMRTRPR "A trip counter for the fuel system RICH diagnosis" UBYTE COMP_0030 1 100 0 255 ECU_ADDRESS 0xFFFFAABA /begin FUNCTION_LIST KF7-500.20B[4] R000.4.EepAlloc_1_2_2 /end FUNCTION_LIST /end MEASUREMENT
/begin MEASUREMENT vNGBUW "The existence of the diagnosis of NGBU (pending trouble condition memory flag) =1" UBYTE COMP_0004 1 100 0 255 ECU_ADDRESS 0xFFFFAD7A /begin FUNCTION_LIST KF7-500.1[54] /end FUNCTION_LIST /end MEASUREMENT
/begin MEASUREMENT vNGMEMW "The existence of the diagnosis of NGMEM (trouble memory one's personal history flag) =1" UBYTE COMP_0004 1 100 0 255 ECU_ADDRESS 0xFFFFADD8 /begin FUNCTION_LIST KF7-500.1[54] /end FUNCTION_LIST /end MEASUREMENT
/begin MEASUREMENT vOERROR "The amount of operation corner deviation" UBYTE COMP_0256 1 100 -64 63.5 ECU_ADDRESS 0xFFFF1614 /begin FUNCTION_LIST KF7-500.6D[9] KF7-500.47B[15] /end FUNCTION_LIST /end MEASUREMENT
/begin MEASUREMENT vOERROR_R#1 "The amount of operation corner deviation" UBYTE COMP_0256 1 100 -64 63.5 ECU_ADDRESS 0xFFFF1614 /begin FUNCTION_LIST KF7-500.6D[9] KF7-500.47B[15] /end FUNCTION_LIST /end MEASUREMENT
/begin MEASUREMENT vOERROR_R#2 "The amount of operation corner deviation" UBYTE COMP_0256 1 100 -64 63.5 ECU_ADDRESS 0xFFFF1615 /begin FUNCTION_LIST KF7-500.6D[9] KF7-500.47B[15] /end FUNCTION_LIST /end MEASUREMENT
/begin MEASUREMENT vOFMILE "After unit conversion, mileage counter" ULONG COMP_0385 1 100 0 6906307410.36 ECU_ADDRESS 0xFFFFA07C /begin FUNCTION_LIST KF7-500.1[54] KF7-500.24[10] /end FUNCTION_LIST /end MEASUREMENT
/begin MEASUREMENT vPAMBHK "At the time of WOT, a standard condition filling up efficiency atomospheric pressure compensation coefficient" UBYTE COMP_0045 1 100 0 1.9921875 ECU_ADDRESS 0xFFFF1638 /begin FUNCTION_LIST KF7-500.7[12] /end FUNCTION_LIST /end MEASUREMENT
/begin MEASUREMENT vPBOOST "In the intake manifold, pressure output" UWORD COMP_0050 1 100 0 5119.921875 ECU_ADDRESS 0xFFFF1642
 /begin FUNCTION_LIST KF7-500.1[54] KF7-500.51[3] KF7-580.1[8] R904.1.Gst_on_can_1_0_1 /end FUNCTION_LIST
/end MEASUREMENT
/begin MEASUREMENT vPEVAP "Canister charge line pressure sensor voltage" UWORD COMP_0050 1 100 0 5119.921875 ECU_ADDRESS 0xFFFF1EF6 /begin FUNCTION_LIST KF7-500.1[54] KF7-500.30[8] KF7-580.1[8] /end FUNCTION_LIST /end MEASUREMENT
/begin MEASUREMENT vPMCAFNG1 "Parameter monitor RAM" UBYTE COMP_0016 1 100 0 255 ECU_ADDRESS 0xFFFFAEBA /begin FUNCTION_LIST KF7-500.7[12] /end FUNCTION_LIST /end MEASUREMENT
/begin MEASUREMENT vPMCAFNG2 "Parameter monitor RAM" UBYTE COMP_0016 1 100 0 255 ECU_ADDRESS 0xFFFFAEBB /begin FUNCTION_LIST KF7-500.7[12] /end FUNCTION_LIST /end MEASUREMENT
/begin MEASUREMENT vPMTAFNG4 "Parameter monitor RAM" UBYTE COMP_0024 1 100 0 12750 ECU_ADDRESS 0xFFFFAEBE /begin FUNCTION_LIST KF7-500.7[12] /end FUNCTION_LIST /end MEASUREMENT
/begin MEASUREMENT vQH00 "QH0 normalized value" UBYTE COMP_0063 1 100 0 0.99609375 ECU_ADDRESS 0xFFFF16DC /begin FUNCTION_LIST KF7-500.7[12] /end FUNCTION_LIST /end MEASUREMENT
/begin MEASUREMENT vQH0TPO1 "TPO1 reference QH0 value" UBYTE COMP_0063 1 100 0 0.99609375 ECU_ADDRESS 0xFFFF16E0 /begin FUNCTION_LIST KF7-500.7[12] /end FUNCTION_LIST /end MEASUREMENT
/begin MEASUREMENT vQH0WOT "At the time of the full-open, QH0 value" UBYTE COMP_0063 1 100 0 0.99609375 ECU_ADDRESS 0xFFFF16E1 /begin FUNCTION_LIST KF7-500.7[12] /end FUNCTION_LIST /end MEASUREMENT
/begin MEASUREMENT vQSE "vQM0 weighted average value" UWORD COMP_0004 1 100 0 65535 ECU_ADDRESS 0xFFFF495C /begin FUNCTION_LIST KF7-500.8[5] /end FUNCTION_LIST /end MEASUREMENT
/begin MEASUREMENT vQZIKKI "Diagnosis timing counter switching Qa" UWORD COMP_0004 1 100 0 65535 ECU_ADDRESS 0xFFFF30E2 /begin FUNCTION_LIST KF7-500.8[5] /end FUNCTION_LIST /end MEASUREMENT
/begin MEASUREMENT vREGRAR "An actual EGR opening area" UBYTE COMP_0345 1 100 0 0.816 ECU_ADDRESS 0xFFFF172F /begin FUNCTION_LIST KF7-500.7[12] /end FUNCTION_LIST /end MEASUREMENT
/begin MEASUREMENT vRPAMB "TP compensation coefficient" UBYTE COMP_0045 1 100 0 1.9921875 ECU_ADDRESS 0xFFFF3183 /begin FUNCTION_LIST KF7-500.1[54] KF7-500.30[8] KF7-580.1[8] /end FUNCTION_LIST /end MEASUREMENT
/begin MEASUREMENT vRTCLV "Logic operation load value" UBYTE COMP_0425 1 100 0 99.99999981 ECU_ADDRESS 0xFFFF421E
 /begin FUNCTION_LIST KF7-500.1[54] KF7-500.20B[4] KF7-500.26[17] KF7-580.1[8] R901.1.Diag_on_can_app_1_6_2 R904.1.Gst_on_can_1_0_1 /end FUNCTION_LIST
/end MEASUREMENT
/begin MEASUREMENT vRTFSS "A fuel control condition distinction flag for GST" UBYTE COMP_0091 1 100 0 255 ECU_ADDRESS 0xFFFF4224
 /begin FUNCTION_LIST KF7-500.1[54] R901.1.Diag_on_can_app_1_6_2 R904.1.Gst_on_can_1_0_1 /end FUNCTION_LIST
/end MEASUREMENT
/begin MEASUREMENT vRTFSS_R#1 "A fuel control condition distinction flag for GST" UBYTE COMP_0091 1 100 0 255 ECU_ADDRESS 0xFFFF4224
 /begin FUNCTION_LIST KF7-500.1[54] R901.1.Diag_on_can_app_1_6_2 R904.1.Gst_on_can_1_0_1 /end FUNCTION_LIST
/end MEASUREMENT
/begin MEASUREMENT vRTFSS_R#2 "A fuel control condition distinction flag for GST" UBYTE COMP_0091 1 100 0 255 ECU_ADDRESS 0xFFFF4225
 /begin FUNCTION_LIST KF7-500.1[54] R901.1.Diag_on_can_app_1_6_2 R904.1.Gst_on_can_1_0_1 /end FUNCTION_LIST
/end MEASUREMENT
/begin MEASUREMENT vRUNTM "After the engine drive, progress time" UWORD COMP_0013 1 100 0 65535 ECU_ADDRESS 0xFFFF422C /begin FUNCTION_LIST KF7-500.1[54] R904.1.Gst_on_can_1_0_1 /end FUNCTION_LIST /end MEASUREMENT
/begin MEASUREMENT vSENNRPM "Engine speed limiter" UWORD COMP_0006 1 100 0 819187.5 ECU_ADDRESS 0xFFFF177E /begin FUNCTION_LIST KF7-450.50[10] /end FUNCTION_LIST /end MEASUREMENT
/begin MEASUREMENT vSPCV "Space capacity" UWORD COMP_0312 1 100 0 127.998046875 ECU_ADDRESS 0xFFFF496E /begin FUNCTION_LIST KF7-500.1[54] /end FUNCTION_LIST /end MEASUREMENT
/begin MEASUREMENT vSPDGCNT "A counter for vehicle speed sensor diagnosis frequency measuring" UWORD COMP_0016 1 100 0 65535 ECU_ADDRESS 0xFFFFB22C /begin FUNCTION_LIST KF7-500.16[4] KF7-580.1[8] /end FUNCTION_LIST /end MEASUREMENT
/begin MEASUREMENT vTAMBHK "At the time of WOT, a standard condition filling up efficiency intake air temperature compensation coefficient" UBYTE COMP_0045 1 100 0 1.9921875 ECU_ADDRESS 0xFFFF1804 /begin FUNCTION_LIST KF7-500.7[12] /end FUNCTION_LIST /end MEASUREMENT
/begin MEASUREMENT vTE "Effective pulse width" UWORD COMP_0125 1 100 0 255.99609375 ECU_ADDRESS 0xFFFF1844 /begin FUNCTION_LIST KF7-450.50[10] /end FUNCTION_LIST /end MEASUREMENT
/begin MEASUREMENT vTMCMON "MONT CPCNG judgement delay timer" UBYTE COMP_0096 1 100 0 2550 ECU_ADDRESS 0xFFFF3F54 /begin FUNCTION_LIST KF7-500.20B[4] /end FUNCTION_LIST /end MEASUREMENT
/begin MEASUREMENT vTMSRVNG1 "Servo error diagnosis timer 1" UWORD COMP_0014 1 100 0 655350 ECU_ADDRESS 0xFFFF3378 /begin FUNCTION_LIST KF7-450.50[10] KF7-505.26[2] KF7-505.32[6] /end FUNCTION_LIST /end MEASUREMENT
/begin MEASUREMENT vTPLOW "Cylinder air quantity equivalent pulse width select low" UWORD COMP_0514 1 100 0 32.0007405 ECU_ADDRESS 0xFFFF1986 /begin FUNCTION_LIST KF7-450.50[10] /end FUNCTION_LIST /end MEASUREMENT
/begin MEASUREMENT vTTMTRP "A timer for engine operating time measuring" UBYTE COMP_0234 1 100 0 2550 ECU_ADDRESS 0xFFFF1F45 /begin FUNCTION_LIST KF7-500.1[54] /end FUNCTION_LIST /end MEASUREMENT
/begin MEASUREMENT vTWCLCNT "Coolant temperature sensor function diagnosis Rate counter" UWORD COMP_0016 1 100 0 65535 ECU_ADDRESS 0xFFFFB2BA /begin FUNCTION_LIST KF7-500.8[5] KF7-580.1[8] /end FUNCTION_LIST /end MEASUREMENT
/begin MEASUREMENT vTWG "An engine cooling coolant temperature for GST" UBYTE COMP_0428 1 100 -40 215 ECU_ADDRESS 0xFFFF425A
 /begin FUNCTION_LIST KF7-500.1[54] KF7-500.20B[4] KF7-500.26[17] R301.13.FFDforDiagOnCAN_1_1_3 R901.1.Diag_on_can_app_1_6_2 R904.1.Gst_on_can_1_0_1 /end FUNCTION_LIST
/end MEASUREMENT
/begin MEASUREMENT vTWKMIN "The initial rest, at least, coolant temperature" UBYTE COMP_0356 1 100 -40 119.375 ECU_ADDRESS 0xFFFF342E /begin FUNCTION_LIST KF7-500.1[54] KF7-500.8[5] /end FUNCTION_LIST /end MEASUREMENT
/begin MEASUREMENT vTWTMR "Judgement delay time" UBYTE COMP_0096 1 100 0 2550 ECU_ADDRESS 0xFFFF3438 /begin FUNCTION_LIST KF7-500.8[5] /end FUNCTION_LIST /end MEASUREMENT
/begin MEASUREMENT vVBNIGN "IGN SW At the time of on, battery voltage" UBYTE COMP_0033 1 100 0 20400 ECU_ADDRESS 0xFFFF344E /begin FUNCTION_LIST KF7-500.6D[9] /end FUNCTION_LIST /end MEASUREMENT
/begin MEASUREMENT vVEGR "EGR temperature sensor voltage" UBYTE COMP_0054 1 100 0 5100 ECU_ADDRESS 0xFFFF4999 /begin FUNCTION_LIST KF7-460.1[6] KF7-580.1[8] /end FUNCTION_LIST /end MEASUREMENT
/begin MEASUREMENT vVSNGD1 "NG judgement timer count rise delay count" UBYTE COMP_0013 1 100 0 255 ECU_ADDRESS 0xFFFF345C /begin FUNCTION_LIST KF7-500.16[4] /end FUNCTION_LIST /end MEASUREMENT
/begin MEASUREMENT vVSNGD2 "NG judgement timer clear delay count" UBYTE COMP_0013 1 100 0 255 ECU_ADDRESS 0xFFFF345D /begin FUNCTION_LIST KF7-500.16[4] /end FUNCTION_LIST /end MEASUREMENT
/begin MEASUREMENT vWARMUPS "The number of warm-ups after the trouble code clear" UBYTE COMP_0016 1 100 0 255 ECU_ADDRESS 0xFFFFB7CC
 /begin FUNCTION_LIST KF7-500.1[54] R000.4.EepAlloc_1_2_2 R904.1.Gst_on_can_1_0_1 /end FUNCTION_LIST
/end MEASUREMENT
/begin MEASUREMENT vXDVADV "An ignition timing for the digital variable" SBYTE COMP_0018 1 100 -128 127 ECU_ADDRESS 0xFFFFB670 /begin FUNCTION_LIST KF7-460.1[6] /end FUNCTION_LIST /end MEASUREMENT
/begin MEASUREMENT vXDVFBYA "Target air-fuel ratio basic value for the digital variable" UWORD COMP_0217 1 100 0 3.999941832 ECU_ADDRESS 0xFFFFB518 /begin FUNCTION_LIST KF7-460.1[6] /end FUNCTION_LIST /end MEASUREMENT
/begin MEASUREMENT vXDVKADV "The amount of ignition timing compensation by the cylinder for digital variable" SBYTE COMP_0018 1 100 -128 127 ECU_ADDRESS 0xFFFFB671 /begin FUNCTION_LIST KF7-460.1[6] /end FUNCTION_LIST /end MEASUREMENT
/begin MEASUREMENT vXDVKQEGR "Digital variable EGR fresh air conversion coefficient" UWORD COMP_0217 1 100 0 3.999941832 ECU_ADDRESS 0xFFFFB51A /begin FUNCTION_LIST KF7-460.1[6] /end FUNCTION_LIST /end MEASUREMENT
/begin MEASUREMENT vXDVKTRM "At the time of the digital variable, KTRM value" UBYTE COMP_0045 1 100 0 1.9921875 ECU_ADDRESS 0xFFFFB66B /begin FUNCTION_LIST KF7-460.1[6] /end FUNCTION_LIST /end MEASUREMENT
/begin MEASUREMENT vXDVTIM "A homogeneous injection timing for the digital variable" UWORD COMP_0190 1 100 0 131070 ECU_ADDRESS 0xFFFFB51C /begin FUNCTION_LIST KF7-460.1[6] /end FUNCTION_LIST /end MEASUREMENT
/begin MEASUREMENT vXDVVTC "A VTC target operation angle for the digital variable" UBYTE COMP_0256 1 100 -64 63.5 ECU_ADDRESS 0xFFFFB51E /begin FUNCTION_LIST KF7-460.1[6] /end FUNCTION_LIST /end MEASUREMENT
/begin MEASUREMENT wvADPDPRES "Pd pressure sensor voltage" UWORD COMP_0023 1 100 0 327675 ECU_ADDRESS 0xFFFF883C /begin FUNCTION_LIST KF7-460.1[6] /end FUNCTION_LIST /end MEASUREMENT
/begin MEASUREMENT wvADPSPRES "Power steering pressure" UWORD COMP_0023 1 100 0 327675 ECU_ADDRESS 0xFFFF883E /begin FUNCTION_LIST KF7-460.1[6] /end FUNCTION_LIST /end MEASUREMENT
/begin MEASUREMENT wvEVPRES "PEVAP weighted average value" UWORD COMP_0050 1 100 0 5119.921875 ECU_ADDRESS 0xFFFF890A /begin FUNCTION_LIST KF7-500.1[54] KF7-500.30[8] KF7-580.1[8] /end FUNCTION_LIST /end MEASUREMENT
/begin MEASUREMENT wvFGAGE3 "Fuel level gauge weighted average value 3" UWORD COMP_0050 1 100 0 5119.921875 ECU_ADDRESS 0xFFFF483A /begin FUNCTION_LIST KF7-500.1[54] KF7-580.1[8] /end FUNCTION_LIST /end MEASUREMENT
/begin MEASUREMENT wvFGEND "IGN At the time of off, fuel level gauge voltage" UWORD COMP_0050 1 100 0 5119.921875 ECU_ADDRESS 0xFFFF9F6C /begin FUNCTION_LIST KF7-500.1[54] KF7-580.1[8] /end FUNCTION_LIST /end MEASUREMENT
/begin MEASUREMENT wvOFMILE "After unit conversion, mileage counter" ULONG COMP_0385 1 100 0 6906307410.36 ECU_ADDRESS 0xFFFF9FD8 /begin FUNCTION_LIST KF7-500.1[54] KF7-500.24[10] /end FUNCTION_LIST /end MEASUREMENT
/begin MEASUREMENT wvQSE "vQM0 weighted average value" UWORD COMP_0004 1 100 0 65535 ECU_ADDRESS 0xFFFF485A /begin FUNCTION_LIST KF7-500.8[5] /end FUNCTION_LIST /end MEASUREMENT
/begin MEASUREMENT wvSPCV "Space capacity" UWORD COMP_0312 1 100 0 127.998046875 ECU_ADDRESS 0xFFFF486C /begin FUNCTION_LIST KF7-500.1[54] /end FUNCTION_LIST /end MEASUREMENT
/begin MEASUREMENT wvVEGR "EGR temperature sensor voltage" UBYTE COMP_0054 1 100 0 5100 ECU_ADDRESS 0xFFFF4897 /begin FUNCTION_LIST KF7-460.1[6] KF7-580.1[8] /end FUNCTION_LIST /end MEASUREMENT
/begin MEASUREMENT CUNG "RAM value CUNG" UBYTE COMP_0068 1 100 0 255 ECU_ADDRESS 0xFFFF9C72 /begin FUNCTION_LIST KF7-500.2A[29] /end FUNCTION_LIST /end MEASUREMENT
/begin MEASUREMENT O2CLB1 "RAM value O2CLB1" UBYTE COMP_0068 1 100 0 255 ECU_ADDRESS 0xFFFF9C75 /begin FUNCTION_LIST KF7-500.2A[29] KF7-500.39[5] /end FUNCTION_LIST /end MEASUREMENT
/begin MEASUREMENT O2CLB2 "RAM value O2CLB2" UBYTE COMP_0068 1 100 0 255 ECU_ADDRESS 0xFFFF9C78 /begin FUNCTION_LIST KF7-500.2A[29] KF7-500.39[5] /end FUNCTION_LIST /end MEASUREMENT
/begin MEASUREMENT MF6NG "RAM value MF6NG" UBYTE COMP_0068 1 100 0 255 ECU_ADDRESS 0xFFFF9C7B /begin FUNCTION_LIST KF7-500.2A[29] /end FUNCTION_LIST /end MEASUREMENT
/begin MEASUREMENT MF5NG "RAM value MF5NG" UBYTE COMP_0068 1 100 0 255 ECU_ADDRESS 0xFFFF9C7E /begin FUNCTION_LIST KF7-500.2A[29] /end FUNCTION_LIST /end MEASUREMENT
/begin MEASUREMENT MF4NG "RAM value MF4NG" UBYTE COMP_0068 1 100 0 255 ECU_ADDRESS 0xFFFF9C81 /begin FUNCTION_LIST KF7-500.2A[29] /end FUNCTION_LIST /end MEASUREMENT
/begin MEASUREMENT MF3NG "RAM value MF3NG" UBYTE COMP_0068 1 100 0 255 ECU_ADDRESS 0xFFFF9C84 /begin FUNCTION_LIST KF7-500.2A[29] /end FUNCTION_LIST /end MEASUREMENT
/begin MEASUREMENT MF2NG "RAM value MF2NG" UBYTE COMP_0068 1 100 0 255 ECU_ADDRESS 0xFFFF9C87 /begin FUNCTION_LIST KF7-500.2A[29] /end FUNCTION_LIST /end MEASUREMENT
/begin MEASUREMENT MF1NG "RAM value MF1NG" UBYTE COMP_0068 1 100 0 255 ECU_ADDRESS 0xFFFF9C8A /begin FUNCTION_LIST KF7-500.2A[29] /end FUNCTION_LIST /end MEASUREMENT
/begin MEASUREMENT MFMCNG "RAM value MFMCNG" UBYTE COMP_0068 1 100 0 255 ECU_ADDRESS 0xFFFF9C8D /begin FUNCTION_LIST KF7-500.2A[29] KF7-500.26[17] /end FUNCTION_LIST /end MEASUREMENT
/begin MEASUREMENT MRNG "RAM value MRNG" UBYTE COMP_0068 1 100 0 255 ECU_ADDRESS 0xFFFF9C96 /begin FUNCTION_LIST KF7-500.2A[29] /end FUNCTION_LIST /end MEASUREMENT
/begin MEASUREMENT MRNG2 "RAM value MRNG2" UBYTE COMP_0068 1 100 0 255 ECU_ADDRESS 0xFFFF9C99 /begin FUNCTION_LIST KF7-500.2A[29] /end FUNCTION_LIST /end MEASUREMENT
/begin MEASUREMENT TWCLNG "RAM value TWCLNG" UBYTE COMP_0068 1 100 0 255 ECU_ADDRESS 0xFFFF9C9C /begin FUNCTION_LIST KF7-500.2A[29] KF7-500.8[5] /end FUNCTION_LIST /end MEASUREMENT
/begin MEASUREMENT NSNG "RAM value NSNG" UBYTE COMP_0068 1 100 0 255 ECU_ADDRESS 0xFFFF9C9F
 /begin FUNCTION_LIST KF7-500.2A[29] KF7-500.28[4] KF7-505.23[2] R000.3.RS_SelfDiagflags_1_1_2 /end FUNCTION_LIST
/end MEASUREMENT
/begin MEASUREMENT VTCSV1 "RAM value VTCSV1" UBYTE COMP_0068 1 100 0 255 ECU_ADDRESS 0xFFFF9CA2
 /begin FUNCTION_LIST KF7-500.2A[29] KF7-500.47B[15] R000.3.RS_SelfDiagflags_1_1_2 /end FUNCTION_LIST
/end MEASUREMENT
/begin MEASUREMENT VTCSV2 "RAM value VTCSV2" UBYTE COMP_0068 1 100 0 255 ECU_ADDRESS 0xFFFF9CA5
 /begin FUNCTION_LIST KF7-500.2A[29] KF7-500.47B[15] R000.3.RS_SelfDiagflags_1_1_2 /end FUNCTION_LIST
/end MEASUREMENT
/begin MEASUREMENT VIASDN "RAM value VIASDN" UBYTE COMP_0068 1 100 0 255 ECU_ADDRESS 0xFFFF9CA8 /begin FUNCTION_LIST KF7-500.2A[29] KF7-500.56[2] /end FUNCTION_LIST /end MEASUREMENT
/begin MEASUREMENT DCS1NG "RAM value DCS1NG" UBYTE COMP_0068 1 100 0 255 ECU_ADDRESS 0xFFFF9CAB /begin FUNCTION_LIST KF7-500.2A[29] KF7-500.6D[9] /end FUNCTION_LIST /end MEASUREMENT
/begin MEASUREMENT DCS2NG "RAM value DCS2NG" UBYTE COMP_0068 1 100 0 255 ECU_ADDRESS 0xFFFF9CAE /begin FUNCTION_LIST KF7-500.2A[29] KF7-500.6D[9] /end FUNCTION_LIST /end MEASUREMENT
/begin MEASUREMENT DCS3NG "RAM value DCS3NG" UBYTE COMP_0068 1 100 0 255 ECU_ADDRESS 0xFFFF9CB1 /begin FUNCTION_LIST KF7-500.2A[29] KF7-500.6D[9] /end FUNCTION_LIST /end MEASUREMENT
/begin MEASUREMENT DPS1NG "RAM value DPS1NG" UBYTE COMP_0068 1 100 0 255 ECU_ADDRESS 0xFFFF9CB4 /begin FUNCTION_LIST KF7-500.2A[29] KF7-500.6D[9] /end FUNCTION_LIST /end MEASUREMENT
/begin MEASUREMENT DPS2NG "RAM value DPS2NG" UBYTE COMP_0068 1 100 0 255 ECU_ADDRESS 0xFFFF9CB7 /begin FUNCTION_LIST KF7-500.2A[29] KF7-500.6D[9] /end FUNCTION_LIST /end MEASUREMENT
/begin MEASUREMENT DPS3NG "RAM value DPS3NG" UBYTE COMP_0068 1 100 0 255 ECU_ADDRESS 0xFFFF9CBA /begin FUNCTION_LIST KF7-500.2A[29] KF7-500.6D[9] /end FUNCTION_LIST /end MEASUREMENT
/begin MEASUREMENT PPSNG "RAM value PPSNG" UBYTE COMP_0068 1 100 0 255 ECU_ADDRESS 0xFFFF9CBD /begin FUNCTION_LIST KF7-500.2A[29] KF7-500.73[1] /end FUNCTION_LIST /end MEASUREMENT
/begin MEASUREMENT ALUNG "RAM value ALUNG" UBYTE COMP_0068 1 100 0 255 ECU_ADDRESS 0xFFFF9CC3
 /begin FUNCTION_LIST KF7-500.2A[29] KF7-505.39[2] KF7-505.41[2] KF7-525.2[6] KF7-525.2S[10] R000.3.RS_SelfDiagflags_1_1_2 /end FUNCTION_LIST
/end MEASUREMENT
/begin MEASUREMENT QCKNG "RAM value QCKNG" UBYTE COMP_0068 1 100 0 255 ECU_ADDRESS 0xFFFF9CC6
 /begin FUNCTION_LIST KF7-500.2A[29] KF7-505.40[1] KF7-525.2[6] KF7-525.2S[10] R000.3.RS_SelfDiagflags_1_1_2 /end FUNCTION_LIST
/end MEASUREMENT
/begin MEASUREMENT ADNG "RAM value ADNG" UBYTE COMP_0068 1 100 0 255 ECU_ADDRESS 0xFFFF9CCC /begin FUNCTION_LIST KF7-500.2A[29] KF7-505.38[4] R000.3.RS_SelfDiagflags_1_1_2 /end FUNCTION_LIST /end MEASUREMENT
/begin MEASUREMENT IC3NG "RAM value IC3NG" UBYTE COMP_0068 1 100 0 255 ECU_ADDRESS 0xFFFF9CCF /begin FUNCTION_LIST KF7-500.2A[29] R000.3.RS_SelfDiagflags_1_1_2 /end FUNCTION_LIST /end MEASUREMENT
/begin MEASUREMENT THFBNG "RAM value THFBNG" UBYTE COMP_0068 1 100 0 255 ECU_ADDRESS 0xFFFF9CD5 /begin FUNCTION_LIST KF7-500.2A[29] KF7-505.15[4] KF7-525.2[6] KF7-525.2S[10] /end FUNCTION_LIST /end MEASUREMENT
/begin MEASUREMENT VAPXNG "RAM value VAPXNG" UBYTE COMP_0068 1 100 0 255 ECU_ADDRESS 0xFFFF9CD8
 /begin FUNCTION_LIST KF7-500.2A[29] KF7-505.17[3] KF7-525.2[6] KF7-525.2S[10] R000.3.RS_SelfDiagflags_1_1_2 R301.21.SafetyLevel2_1_0_2 /end FUNCTION_LIST
/end MEASUREMENT
/begin MEASUREMENT APOXNG "RAM value APOXNG" UBYTE COMP_0068 1 100 0 255 ECU_ADDRESS 0xFFFF9CDB
 /begin FUNCTION_LIST KF7-500.2A[29] KF7-505.9[3] KF7-525.2[6] KF7-525.2S[10] R000.3.RS_SelfDiagflags_1_1_2 R301.21.SafetyLevel2_1_0_2 /end FUNCTION_LIST
/end MEASUREMENT
/begin MEASUREMENT TGTXNG "RAM value TGTXNG" UBYTE COMP_0068 1 100 0 255 ECU_ADDRESS 0xFFFF9CDE
 /begin FUNCTION_LIST KF7-500.2A[29] KF7-505.16[1] KF7-525.2[6] KF7-525.2S[10] R000.3.RS_SelfDiagflags_1_1_2 R301.21.SafetyLevel2_1_0_2 /end FUNCTION_LIST
/end MEASUREMENT
/begin MEASUREMENT SERVNG "RAM value SERVNG" UBYTE COMP_0068 1 100 0 255 ECU_ADDRESS 0xFFFF9CE1 /begin FUNCTION_LIST KF7-500.2A[29] KF7-505.32[6] KF7-525.2[6] KF7-525.2S[10] /end FUNCTION_LIST /end MEASUREMENT
/begin MEASUREMENT ASTRNG "RAM value ASTRNG" UBYTE COMP_0068 1 100 0 255 ECU_ADDRESS 0xFFFF9CE4
 /begin FUNCTION_LIST KF7-500.2A[29] KF7-505.17[3] R000.3.RS_SelfDiagflags_1_1_2 R301.21.SafetyLevel2_1_0_2 /end FUNCTION_LIST
/end MEASUREMENT
/begin MEASUREMENT QHAPNG "RAM value QHAPNG" UBYTE COMP_0068 1 100 0 255 ECU_ADDRESS 0xFFFF9CE7
 /begin FUNCTION_LIST KF7-500.2A[29] KF7-505.90[N] KF7-525.2[6] KF7-525.2S[10] R000.3.RS_SelfDiagflags_1_1_2 R301.21.SafetyLevel2_1_0_2 /end FUNCTION_LIST
/end MEASUREMENT
/begin MEASUREMENT TEPDNG "RAM value TEPDNG" UBYTE COMP_0068 1 100 0 255 ECU_ADDRESS 0xFFFF9CEA
 /begin FUNCTION_LIST KF7-500.2A[29] KF7-505.51[2] KF7-525.2[6] KF7-525.2S[10] R000.3.RS_SelfDiagflags_1_1_2 /end FUNCTION_LIST
/end MEASUREMENT
/begin MEASUREMENT TATENG "RAM value TATENG" UBYTE COMP_0068 1 100 0 255 ECU_ADDRESS 0xFFFF9CED
 /begin FUNCTION_LIST KF7-500.2A[29] KF7-505.52[1] KF7-525.2[6] KF7-525.2S[10] R000.3.RS_SelfDiagflags_1_1_2 R301.21.SafetyLevel2_1_0_2 /end FUNCTION_LIST
/end MEASUREMENT
/begin MEASUREMENT TTEPNG "RAM value TTEPNG" UBYTE COMP_0068 1 100 0 255 ECU_ADDRESS 0xFFFF9CF0
 /begin FUNCTION_LIST KF7-500.2A[29] KF7-505.53[1] KF7-525.2[6] KF7-525.2S[10] R000.3.RS_SelfDiagflags_1_1_2 R301.21.SafetyLevel2_1_0_2 /end FUNCTION_LIST
/end MEASUREMENT
/begin MEASUREMENT RLONNG "RAM value RLONNG" UBYTE COMP_0068 1 100 0 255 ECU_ADDRESS 0xFFFF9CF3
 /begin FUNCTION_LIST KF7-500.2A[29] KF7-505.31[5] KF7-525.2[6] KF7-525.2S[10] R000.3.RS_SelfDiagflags_1_1_2 /end FUNCTION_LIST
/end MEASUREMENT
/begin MEASUREMENT RLOFNG "RAM value RLOFNG" UBYTE COMP_0068 1 100 0 255 ECU_ADDRESS 0xFFFF9CF6
 /begin FUNCTION_LIST KF7-500.2A[29] KF7-505.31[5] KF7-525.2[6] KF7-525.2S[10] R000.3.RS_SelfDiagflags_1_1_2 /end FUNCTION_LIST
/end MEASUREMENT
/begin MEASUREMENT DTSPNG "RAM value DTSPNG" UBYTE COMP_0068 1 100 0 255 ECU_ADDRESS 0xFFFF9CF9
 /begin FUNCTION_LIST KF7-500.2A[29] KF7-505.54[2] R000.3.RS_SelfDiagflags_1_1_2 R301.21.SafetyLevel2_1_0_2 /end FUNCTION_LIST
/end MEASUREMENT
/begin MEASUREMENT BSOFNG "RAM value BSOFNG" UBYTE COMP_0068 1 100 0 255 ECU_ADDRESS 0xFFFF9CFF
 /begin FUNCTION_LIST KF7-450.50[10] KF7-500.2A[29] KF7-505.27[4] KF7-525.2[6] KF7-525.2S[10] R000.1.RS_Integ_1_10_2 /end FUNCTION_LIST
/end MEASUREMENT
/begin MEASUREMENT TSKNGM "RAM value TSKNGM" UBYTE COMP_0068 1 100 0 255 ECU_ADDRESS 0xFFFF9D11
 /begin FUNCTION_LIST KF7-500.2A[29] KF7-505.19[1] KF7-525.2[6] KF7-525.2S[10] R000.3.RS_SelfDiagflags_1_1_2 /end FUNCTION_LIST
/end MEASUREMENT
/begin MEASUREMENT ROMNGM "RAM value ROMNGM" UBYTE COMP_0068 1 100 0 255 ECU_ADDRESS 0xFFFF9D14
 /begin FUNCTION_LIST KF7-500.2A[29] KF7-505.35[2] KF7-525.2[6] KF7-525.2S[10] R000.3.RS_SelfDiagflags_1_1_2 R301.24.RomDiagnosis_1_0_1 /end FUNCTION_LIST
/end MEASUREMENT
/begin MEASUREMENT RAMNGM "RAM value RAMNGM" UBYTE COMP_0068 1 100 0 255 ECU_ADDRESS 0xFFFF9D17
 /begin FUNCTION_LIST KF7-500.2A[29] KF7-505.12[6] KF7-505.36[2] KF7-525.2[6] KF7-525.2S[10] R000.3.RS_SelfDiagflags_1_1_2 /end FUNCTION_LIST
/end MEASUREMENT
/begin MEASUREMENT TIMNGM "RAM value TIMNGM" UBYTE COMP_0068 1 100 0 255 ECU_ADDRESS 0xFFFF9D1D /begin FUNCTION_LIST KF7-500.2A[29] KF7-505.37[1] R000.3.RS_SelfDiagflags_1_1_2 /end FUNCTION_LIST /end MEASUREMENT
/begin MEASUREMENT RANGM2 "RAM value RANGM2" UBYTE COMP_0068 1 100 0 255 ECU_ADDRESS 0xFFFF9D26 /begin FUNCTION_LIST KF7-500.2A[29] /end FUNCTION_LIST /end MEASUREMENT
/begin MEASUREMENT DC21NG "RAM value DC21NG" UBYTE COMP_0068 1 100 0 255 ECU_ADDRESS 0xFFFF9D29 /begin FUNCTION_LIST KF7-500.2A[29] KF7-500.6D[9] /end FUNCTION_LIST /end MEASUREMENT
/begin MEASUREMENT DC22NG "RAM value DC22NG" UBYTE COMP_0068 1 100 0 255 ECU_ADDRESS 0xFFFF9D2C /begin FUNCTION_LIST KF7-500.2A[29] KF7-500.6D[9] /end FUNCTION_LIST /end MEASUREMENT
/begin MEASUREMENT DC23NG "RAM value DC23NG" UBYTE COMP_0068 1 100 0 255 ECU_ADDRESS 0xFFFF9D2F /begin FUNCTION_LIST KF7-500.2A[29] KF7-500.6D[9] /end FUNCTION_LIST /end MEASUREMENT
/begin MEASUREMENT AFLNG1 "RAM value AFLNG1" UBYTE COMP_0068 1 100 0 255 ECU_ADDRESS 0xFFFF9D32 /begin FUNCTION_LIST KF7-500.2A[29] KF7-500.76[8] /end FUNCTION_LIST /end MEASUREMENT
/begin MEASUREMENT AFLNG2 "RAM value AFLNG2" UBYTE COMP_0068 1 100 0 255 ECU_ADDRESS 0xFFFF9D35 /begin FUNCTION_LIST KF7-500.2A[29] /end FUNCTION_LIST /end MEASUREMENT
/begin MEASUREMENT AFLLS "RAM value AFLLS" UBYTE COMP_0068 1 100 0 255 ECU_ADDRESS 0xFFFF9D38 /begin FUNCTION_LIST KF7-500.2A[29] KF7-500.75[4] /end FUNCTION_LIST /end MEASUREMENT
/begin MEASUREMENT AFLRS "RAM value AFLRS" UBYTE COMP_0068 1 100 0 255 ECU_ADDRESS 0xFFFF9D3B /begin FUNCTION_LIST KF7-500.2A[29] /end FUNCTION_LIST /end MEASUREMENT
/begin MEASUREMENT AFLAV "RAM value AFLAV" UBYTE COMP_0068 1 100 0 255 ECU_ADDRESS 0xFFFF9D3E /begin FUNCTION_LIST KF7-500.2A[29] KF7-500.74[11] /end FUNCTION_LIST /end MEASUREMENT
/begin MEASUREMENT AFRNG1 "RAM value AFRNG1" UBYTE COMP_0068 1 100 0 255 ECU_ADDRESS 0xFFFF9D41 /begin FUNCTION_LIST KF7-500.2A[29] KF7-500.76[8] /end FUNCTION_LIST /end MEASUREMENT
/begin MEASUREMENT AFRNG2 "RAM value AFRNG2" UBYTE COMP_0068 1 100 0 255 ECU_ADDRESS 0xFFFF9D44 /begin FUNCTION_LIST KF7-500.2A[29] /end FUNCTION_LIST /end MEASUREMENT
/begin MEASUREMENT AFRLS "RAM value AFRLS" UBYTE COMP_0068 1 100 0 255 ECU_ADDRESS 0xFFFF9D47 /begin FUNCTION_LIST KF7-500.2A[29] KF7-500.75[4] /end FUNCTION_LIST /end MEASUREMENT
/begin MEASUREMENT AFRRS "RAM value AFRRS" UBYTE COMP_0068 1 100 0 255 ECU_ADDRESS 0xFFFF9D4A /begin FUNCTION_LIST KF7-500.2A[29] /end FUNCTION_LIST /end MEASUREMENT
/begin MEASUREMENT AFRAV "RAM value AFRAV" UBYTE COMP_0068 1 100 0 255 ECU_ADDRESS 0xFFFF9D4D /begin FUNCTION_LIST KF7-500.2A[29] KF7-500.74[11] /end FUNCTION_LIST /end MEASUREMENT
/begin MEASUREMENT ISCNGL "RAM value ISCNGL" UBYTE COMP_0068 1 100 0 255 ECU_ADDRESS 0xFFFF9D50 /begin FUNCTION_LIST KF7-500.2A[29] KF7-500.38A[4] /end FUNCTION_LIST /end MEASUREMENT
/begin MEASUREMENT ISCNGH "RAM value ISCNGH" UBYTE COMP_0068 1 100 0 255 ECU_ADDRESS 0xFFFF9D53 /begin FUNCTION_LIST KF7-500.2A[29] KF7-500.38A[4] /end FUNCTION_LIST /end MEASUREMENT
/begin MEASUREMENT O2R1O "RAM value O2R1O" UBYTE COMP_0068 1 100 0 255 ECU_ADDRESS 0xFFFF9D56 /begin FUNCTION_LIST KF7-500.2A[29] /end FUNCTION_LIST /end MEASUREMENT
/begin MEASUREMENT O2R2O "RAM value O2R2O" UBYTE COMP_0068 1 100 0 255 ECU_ADDRESS 0xFFFF9D59 /begin FUNCTION_LIST KF7-500.2A[29] /end FUNCTION_LIST /end MEASUREMENT
/begin MEASUREMENT O2R1L "RAM value O2R1L" UBYTE COMP_0068 1 100 0 255 ECU_ADDRESS 0xFFFF9D5C /begin FUNCTION_LIST KF7-500.2A[29] /end FUNCTION_LIST /end MEASUREMENT
/begin MEASUREMENT O2R2L "RAM value O2R2L" UBYTE COMP_0068 1 100 0 255 ECU_ADDRESS 0xFFFF9D5F /begin FUNCTION_LIST KF7-500.2A[29] /end FUNCTION_LIST /end MEASUREMENT
/begin MEASUREMENT O2R1R "RAM value O2R1R" UBYTE COMP_0068 1 100 0 255 ECU_ADDRESS 0xFFFF9D62 /begin FUNCTION_LIST KF7-500.2A[29] /end FUNCTION_LIST /end MEASUREMENT
/begin MEASUREMENT O2R2R "RAM value O2R2R" UBYTE COMP_0068 1 100 0 255 ECU_ADDRESS 0xFFFF9D65 /begin FUNCTION_LIST KF7-500.2A[29] /end FUNCTION_LIST /end MEASUREMENT
/begin MEASUREMENT O2R1H "RAM value O2R1H" UBYTE COMP_0068 1 100 0 255 ECU_ADDRESS 0xFFFF9D68 /begin FUNCTION_LIST KF7-500.2A[29] /end FUNCTION_LIST /end MEASUREMENT
/begin MEASUREMENT O2R2H "RAM value O2R2H" UBYTE COMP_0068 1 100 0 255 ECU_ADDRESS 0xFFFF9D6B /begin FUNCTION_LIST KF7-500.2A[29] /end FUNCTION_LIST /end MEASUREMENT
/begin MEASUREMENT RO2HH1 "RAM value RO2HH1" UBYTE COMP_0068 1 100 0 255 ECU_ADDRESS 0xFFFF9D6E
 /begin FUNCTION_LIST KF7-500.2A[29] KF7-500.25A[7] R301.18.VB_short_Protection_1_0_2 /end FUNCTION_LIST
/end MEASUREMENT
/begin MEASUREMENT RO2HH2 "RAM value RO2HH2" UBYTE COMP_0068 1 100 0 255 ECU_ADDRESS 0xFFFF9D71
 /begin FUNCTION_LIST KF7-500.2A[29] KF7-500.25A[7] R301.18.VB_short_Protection_1_0_2 /end FUNCTION_LIST
/end MEASUREMENT
/begin MEASUREMENT RO2HL1 "RAM value RO2HL1" UBYTE COMP_0068 1 100 0 255 ECU_ADDRESS 0xFFFF9D74 /begin FUNCTION_LIST KF7-500.2A[29] KF7-500.25A[7] /end FUNCTION_LIST /end MEASUREMENT
/begin MEASUREMENT RO2HL2 "RAM value RO2HL2" UBYTE COMP_0068 1 100 0 255 ECU_ADDRESS 0xFFFF9D77 /begin FUNCTION_LIST KF7-500.2A[29] KF7-500.25A[7] /end FUNCTION_LIST /end MEASUREMENT
/begin MEASUREMENT KN1NGL "RAM value KN1NGL" UBYTE COMP_0068 1 100 0 255 ECU_ADDRESS 0xFFFF9D7A /begin FUNCTION_LIST KF7-500.2A[29] KF7-500.12[3] /end FUNCTION_LIST /end MEASUREMENT
/begin MEASUREMENT KN1NGH "RAM value KN1NGH" UBYTE COMP_0068 1 100 0 255 ECU_ADDRESS 0xFFFF9D7D /begin FUNCTION_LIST KF7-500.2A[29] KF7-500.12[3] /end FUNCTION_LIST /end MEASUREMENT
/begin MEASUREMENT KN2NGL "RAM value KN2NGL" UBYTE COMP_0068 1 100 0 255 ECU_ADDRESS 0xFFFF9D80 /begin FUNCTION_LIST KF7-500.2A[29] KF7-500.12[3] /end FUNCTION_LIST /end MEASUREMENT
/begin MEASUREMENT KN2NGH "RAM value KN2NGH" UBYTE COMP_0068 1 100 0 255 ECU_ADDRESS 0xFFFF9D83 /begin FUNCTION_LIST KF7-500.2A[29] KF7-500.12[3] /end FUNCTION_LIST /end MEASUREMENT
/begin MEASUREMENT AFMNGR "RAM value AFMNGR" UBYTE COMP_0068 1 100 0 255 ECU_ADDRESS 0xFFFF9D86 /begin FUNCTION_LIST KF7-500.2A[29] KF7-500.7[12] /end FUNCTION_LIST /end MEASUREMENT
/begin MEASUREMENT AFMNGL "RAM value AFMNGL" UBYTE COMP_0068 1 100 0 255 ECU_ADDRESS 0xFFFF9D89 /begin FUNCTION_LIST KF7-500.2A[29] KF7-500.7[12] /end FUNCTION_LIST /end MEASUREMENT
/begin MEASUREMENT AFMNGH "RAM value AFMNGH" UBYTE COMP_0068 1 100 0 255 ECU_ADDRESS 0xFFFF9D8C /begin FUNCTION_LIST KF7-500.2A[29] KF7-500.7[12] /end FUNCTION_LIST /end MEASUREMENT
/begin MEASUREMENT IGNGR "RAM value IGNGR" UBYTE COMP_0068 1 100 0 255 ECU_ADDRESS 0xFFFF9D8F /begin FUNCTION_LIST KF7-500.2A[29] KF7-500.10[3] R301.11.INJDiag_1_1_2 /end FUNCTION_LIST /end MEASUREMENT
/begin MEASUREMENT TWNGL "RAM value TWNGL" UBYTE COMP_0068 1 100 0 255 ECU_ADDRESS 0xFFFF9D92 /begin FUNCTION_LIST KF7-500.2A[29] KF7-500.8[5] /end FUNCTION_LIST /end MEASUREMENT
/begin MEASUREMENT TWNGH "RAM value TWNGH" UBYTE COMP_0068 1 100 0 255 ECU_ADDRESS 0xFFFF9D95 /begin FUNCTION_LIST KF7-500.2A[29] KF7-500.8[5] /end FUNCTION_LIST /end MEASUREMENT
/begin MEASUREMENT EVCNGO "RAM value EVCNGO" UBYTE COMP_0068 1 100 0 255 ECU_ADDRESS 0xFFFF9DA1 /begin FUNCTION_LIST KF7-500.2A[29] KF7-500.30[8] /end FUNCTION_LIST /end MEASUREMENT
/begin MEASUREMENT EVCNGS "RAM value EVCNGS" UBYTE COMP_0068 1 100 0 255 ECU_ADDRESS 0xFFFF9DA4 /begin FUNCTION_LIST KF7-500.2A[29] KF7-500.30[8] /end FUNCTION_LIST /end MEASUREMENT
/begin MEASUREMENT THMNGR "RAM value THMNGR" UBYTE COMP_0068 1 100 0 255 ECU_ADDRESS 0xFFFF9DA7 /begin FUNCTION_LIST KF7-500.2A[29] KF7-500.60[5] /end FUNCTION_LIST /end MEASUREMENT
/begin MEASUREMENT MRNR "RAM value MRNR" UBYTE COMP_0068 1 100 0 255 ECU_ADDRESS 0xFFFF9DAA /begin FUNCTION_LIST KF7-500.2A[29] KF7-500.20B[4] /end FUNCTION_LIST /end MEASUREMENT
/begin MEASUREMENT MRNL "RAM value MRNL" UBYTE COMP_0068 1 100 0 255 ECU_ADDRESS 0xFFFF9DAD /begin FUNCTION_LIST KF7-500.2A[29] KF7-500.20B[4] /end FUNCTION_LIST /end MEASUREMENT
/begin MEASUREMENT MRNR2 "RAM value MRNR2" UBYTE COMP_0068 1 100 0 255 ECU_ADDRESS 0xFFFF9DB0 /begin FUNCTION_LIST KF7-500.2A[29] KF7-500.20B[4] /end FUNCTION_LIST /end MEASUREMENT
/begin MEASUREMENT MRNL2 "RAM value MRNL2" UBYTE COMP_0068 1 100 0 255 ECU_ADDRESS 0xFFFF9DB3 /begin FUNCTION_LIST KF7-500.2A[29] KF7-500.20B[4] /end FUNCTION_LIST /end MEASUREMENT
/begin MEASUREMENT VTCI1R "RAM value VTCI1R" UBYTE COMP_0068 1 100 0 255 ECU_ADDRESS 0xFFFF9DB6 /begin FUNCTION_LIST KF7-500.2A[29] KF7-500.6D[9] KF7-500.47B[15] /end FUNCTION_LIST /end MEASUREMENT
/begin MEASUREMENT VTCI2R "RAM value VTCI2R" UBYTE COMP_0068 1 100 0 255 ECU_ADDRESS 0xFFFF9DB9 /begin FUNCTION_LIST KF7-500.2A[29] KF7-500.6D[9] KF7-500.47B[15] /end FUNCTION_LIST /end MEASUREMENT
/begin MEASUREMENT PRSNGL "RAM value PRSNGL" UBYTE COMP_0068 1 100 0 255 ECU_ADDRESS 0xFFFF9DBC /begin FUNCTION_LIST KF7-500.2A[29] KF7-500.51[3] /end FUNCTION_LIST /end MEASUREMENT
/begin MEASUREMENT PRSNGH "RAM value PRSNGH" UBYTE COMP_0068 1 100 0 255 ECU_ADDRESS 0xFFFF9DBF /begin FUNCTION_LIST KF7-500.2A[29] KF7-500.51[3] /end FUNCTION_LIST /end MEASUREMENT
/begin MEASUREMENT AVCCSH "RAM value AVCCSH" UBYTE COMP_0068 1 100 0 255 ECU_ADDRESS 0xFFFF9DC2
 /begin FUNCTION_LIST KF7-500.2A[29] KF7-505.32[6] KF7-505.34[3] R000.5.DataCompSpec_1_0_2 /end FUNCTION_LIST
/end MEASUREMENT
/begin MEASUREMENT TPLRLO "RAM value TPLRLO" UBYTE COMP_0068 1 100 0 255 ECU_ADDRESS 0xFFFF9DD4 /begin FUNCTION_LIST KF7-500.2A[29] KF7-505.29[4] R000.3.RS_SelfDiagflags_1_1_2 /end FUNCTION_LIST /end MEASUREMENT
/begin MEASUREMENT TPLRNO "RAM value TPLRNO" UBYTE COMP_0068 1 100 0 255 ECU_ADDRESS 0xFFFF9DD7 /begin FUNCTION_LIST KF7-500.2A[29] KF7-505.30[6] R000.3.RS_SelfDiagflags_1_1_2 /end FUNCTION_LIST /end MEASUREMENT
/begin MEASUREMENT VMOOPN "RAM value VMOOPN" UBYTE COMP_0068 1 100 0 255 ECU_ADDRESS 0xFFFF9DDA /begin FUNCTION_LIST KF7-500.2A[29] KF7-505.32[6] /end FUNCTION_LIST /end MEASUREMENT
/begin MEASUREMENT VMOSHT "RAM value VMOSHT" UBYTE COMP_0068 1 100 0 255 ECU_ADDRESS 0xFFFF9DDD /begin FUNCTION_LIST KF7-500.2A[29] KF7-505.31[5] /end FUNCTION_LIST /end MEASUREMENT
/begin MEASUREMENT MOTSHT "RAM value MOTSHT" UBYTE COMP_0068 1 100 0 255 ECU_ADDRESS 0xFFFF9DE0 /begin FUNCTION_LIST KF7-500.2A[29] KF7-505.32[6] /end FUNCTION_LIST /end MEASUREMENT
/begin MEASUREMENT AFLHZR "RAM value AFLHZR" UBYTE COMP_0068 1 100 0 255 ECU_ADDRESS 0xFFFF9DE3 /begin FUNCTION_LIST KF7-500.2A[29] KF7-500.74[11] /end FUNCTION_LIST /end MEASUREMENT
/begin MEASUREMENT AFLHZL "RAM value AFLHZL" UBYTE COMP_0068 1 100 0 255 ECU_ADDRESS 0xFFFF9DE6 /begin FUNCTION_LIST KF7-500.2A[29] KF7-500.74[11] /end FUNCTION_LIST /end MEASUREMENT
/begin MEASUREMENT AFRHZR "RAM value AFRHZR" UBYTE COMP_0068 1 100 0 255 ECU_ADDRESS 0xFFFF9DE9 /begin FUNCTION_LIST KF7-500.2A[29] KF7-500.74[11] /end FUNCTION_LIST /end MEASUREMENT
/begin MEASUREMENT AFRHZL "RAM value AFRHZL" UBYTE COMP_0068 1 100 0 255 ECU_ADDRESS 0xFFFF9DEC /begin FUNCTION_LIST KF7-500.2A[29] KF7-500.74[11] /end FUNCTION_LIST /end MEASUREMENT
/begin MEASUREMENT AFHF1L "RAM value AFHF1L" UBYTE COMP_0068 1 100 0 255 ECU_ADDRESS 0xFFFF9DEF /begin FUNCTION_LIST KF7-500.2A[29] KF7-500.59[6] /end FUNCTION_LIST /end MEASUREMENT
/begin MEASUREMENT AFHF1H "RAM value AFHF1H" UBYTE COMP_0068 1 100 0 255 ECU_ADDRESS 0xFFFF9DF2
 /begin FUNCTION_LIST KF7-500.2A[29] KF7-500.59[6] R301.18.VB_short_Protection_1_0_2 /end FUNCTION_LIST
/end MEASUREMENT
/begin MEASUREMENT AFHF2L "RAM value AFHF2L" UBYTE COMP_0068 1 100 0 255 ECU_ADDRESS 0xFFFF9DF5 /begin FUNCTION_LIST KF7-500.2A[29] KF7-500.59[6] /end FUNCTION_LIST /end MEASUREMENT
/begin MEASUREMENT AFHF2H "RAM value AFHF2H" UBYTE COMP_0068 1 100 0 255 ECU_ADDRESS 0xFFFF9DF8
 /begin FUNCTION_LIST KF7-500.2A[29] KF7-500.59[6] R301.18.VB_short_Protection_1_0_2 /end FUNCTION_LIST
/end MEASUREMENT
/begin MEASUREMENT AFRLD1 "RAM value AFRLD1" UBYTE COMP_0068 1 100 0 255 ECU_ADDRESS 0xFFFF9DFB /begin FUNCTION_LIST KF7-500.2A[29] KF7-500.74B[5] /end FUNCTION_LIST /end MEASUREMENT
/begin MEASUREMENT AFLRD1 "RAM value AFLRD1" UBYTE COMP_0068 1 100 0 255 ECU_ADDRESS 0xFFFF9DFE /begin FUNCTION_LIST KF7-500.2A[29] KF7-500.74B[5] /end FUNCTION_LIST /end MEASUREMENT
/begin MEASUREMENT AFRLD2 "RAM value AFRLD2" UBYTE COMP_0068 1 100 0 255 ECU_ADDRESS 0xFFFF9E01 /begin FUNCTION_LIST KF7-500.2A[29] KF7-500.74B[5] /end FUNCTION_LIST /end MEASUREMENT
/begin MEASUREMENT AFLRD2 "RAM value AFLRD2" UBYTE COMP_0068 1 100 0 255 ECU_ADDRESS 0xFFFF9E04 /begin FUNCTION_LIST KF7-500.2A[29] KF7-500.74B[5] /end FUNCTION_LIST /end MEASUREMENT
/begin MEASUREMENT vO2CLB1 "RAM value vO2CLB1" UWORD COMP_0068 1 100 0 65535 ECU_ADDRESS 0xFFFF9C76 /begin FUNCTION_LIST KF7-500.2A[29] KF7-500.39[5] /end FUNCTION_LIST /end MEASUREMENT
/begin MEASUREMENT vMF6NG "RAM value vMF6NG" UWORD COMP_0068 1 100 0 65535 ECU_ADDRESS 0xFFFF9C7C /begin FUNCTION_LIST KF7-500.2A[29] /end FUNCTION_LIST /end MEASUREMENT
/begin MEASUREMENT vMF4NG "RAM value vMF4NG" UWORD COMP_0068 1 100 0 65535 ECU_ADDRESS 0xFFFF9C82 /begin FUNCTION_LIST KF7-500.2A[29] /end FUNCTION_LIST /end MEASUREMENT
/begin MEASUREMENT vMF2NG "RAM value vMF2NG" UWORD COMP_0068 1 100 0 65535 ECU_ADDRESS 0xFFFF9C88 /begin FUNCTION_LIST KF7-500.2A[29] /end FUNCTION_LIST /end MEASUREMENT
/begin MEASUREMENT vMFMCNG "RAM value vMFMCNG" UWORD COMP_0068 1 100 0 65535 ECU_ADDRESS 0xFFFF9C8E /begin FUNCTION_LIST KF7-500.2A[29] KF7-500.26[17] /end FUNCTION_LIST /end MEASUREMENT
/begin MEASUREMENT vMRNG2 "RAM value vMRNG2" UBYTE COMP_0068 1 100 0 255 ECU_ADDRESS 0xFFFF9C98 /begin FUNCTION_LIST KF7-500.2A[29] /end FUNCTION_LIST /end MEASUREMENT
/begin MEASUREMENT vNSNG "RAM value vNSNG" UWORD COMP_0068 1 100 0 65535 ECU_ADDRESS 0xFFFF9CA0 /begin FUNCTION_LIST KF7-500.2A[29] KF7-500.28[4] KF7-505.23[2] /end FUNCTION_LIST /end MEASUREMENT
/begin MEASUREMENT vVTCSV2 "RAM value vVTCSV2" UWORD COMP_0068 1 100 0 65535 ECU_ADDRESS 0xFFFF9CA6 /begin FUNCTION_LIST KF7-500.2A[29] KF7-500.47B[15] /end FUNCTION_LIST /end MEASUREMENT
/begin MEASUREMENT vDCS1NG "RAM value vDCS1NG" UWORD COMP_0068 1 100 0 65535 ECU_ADDRESS 0xFFFF9CAC /begin FUNCTION_LIST KF7-500.2A[29] KF7-500.6D[9] /end FUNCTION_LIST /end MEASUREMENT
/begin MEASUREMENT vDCS3NG "RAM value vDCS3NG" UWORD COMP_0068 1 100 0 65535 ECU_ADDRESS 0xFFFF9CB2 /begin FUNCTION_LIST KF7-500.2A[29] KF7-500.6D[9] /end FUNCTION_LIST /end MEASUREMENT
/begin MEASUREMENT vDPS2NG "RAM value vDPS2NG" UWORD COMP_0068 1 100 0 65535 ECU_ADDRESS 0xFFFF9CB8 /begin FUNCTION_LIST KF7-500.2A[29] KF7-500.6D[9] /end FUNCTION_LIST /end MEASUREMENT
/begin MEASUREMENT vPPSNG "RAM value vPPSNG" UWORD COMP_0068 1 100 0 65535 ECU_ADDRESS 0xFFFF9CBE /begin FUNCTION_LIST KF7-500.2A[29] KF7-500.73[1] R000.1.RS_Integ_1_10_2 /end FUNCTION_LIST /end MEASUREMENT
/begin MEASUREMENT vALUNG "RAM value vALUNG" UWORD COMP_0068 1 100 0 65535 ECU_ADDRESS 0xFFFF9CC4
 /begin FUNCTION_LIST KF7-500.2A[29] KF7-505.39[2] KF7-505.41[2] KF7-525.2[6] KF7-525.2S[10] /end FUNCTION_LIST
/end MEASUREMENT
/begin MEASUREMENT vIC3NG "RAM value vIC3NG" UWORD COMP_0068 1 100 0 65535 ECU_ADDRESS 0xFFFF9CD0 /begin FUNCTION_LIST KF7-500.2A[29] /end FUNCTION_LIST /end MEASUREMENT
/begin MEASUREMENT vTHFBNG "RAM value vTHFBNG" UWORD COMP_0068 1 100 0 65535 ECU_ADDRESS 0xFFFF9CD6 /begin FUNCTION_LIST KF7-500.2A[29] KF7-505.15[4] KF7-525.2[6] KF7-525.2S[10] /end FUNCTION_LIST /end MEASUREMENT
/begin MEASUREMENT vAPOXNG "RAM value vAPOXNG" UWORD COMP_0068 1 100 0 65535 ECU_ADDRESS 0xFFFF9CDC /begin FUNCTION_LIST KF7-500.2A[29] KF7-505.9[3] KF7-525.2[6] KF7-525.2S[10] /end FUNCTION_LIST /end MEASUREMENT
/begin MEASUREMENT vSERVNG "RAM value vSERVNG" UWORD COMP_0068 1 100 0 65535 ECU_ADDRESS 0xFFFF9CE2 /begin FUNCTION_LIST KF7-500.2A[29] KF7-505.32[6] KF7-525.2[6] KF7-525.2S[10] /end FUNCTION_LIST /end MEASUREMENT
/begin MEASUREMENT vQHAPNG "RAM value vQHAPNG" UWORD COMP_0068 1 100 0 65535 ECU_ADDRESS 0xFFFF9CE8 /begin FUNCTION_LIST KF7-500.2A[29] KF7-505.90[N] KF7-525.2[6] KF7-525.2S[10] /end FUNCTION_LIST /end MEASUREMENT
/begin MEASUREMENT vTATENG "RAM value vTATENG" UWORD COMP_0068 1 100 0 65535 ECU_ADDRESS 0xFFFF9CEE /begin FUNCTION_LIST KF7-500.2A[29] KF7-505.52[1] KF7-525.2[6] KF7-525.2S[10] /end FUNCTION_LIST /end MEASUREMENT
/begin MEASUREMENT vRLONNG "RAM value vRLONNG" UWORD COMP_0068 1 100 0 65535 ECU_ADDRESS 0xFFFF9CF4 /begin FUNCTION_LIST KF7-500.2A[29] KF7-505.31[5] KF7-525.2[6] KF7-525.2S[10] /end FUNCTION_LIST /end MEASUREMENT
/begin MEASUREMENT vDTSPNG "RAM value vDTSPNG" UWORD COMP_0068 1 100 0 65535 ECU_ADDRESS 0xFFFF9CFA /begin FUNCTION_LIST KF7-500.2A[29] KF7-505.54[2] /end FUNCTION_LIST /end MEASUREMENT
/begin MEASUREMENT vBSOFNG "RAM value vBSOFNG" UWORD COMP_0068 1 100 0 65535 ECU_ADDRESS 0xFFFF9D00
 /begin FUNCTION_LIST KF7-450.50[10] KF7-500.2A[29] KF7-505.27[4] KF7-525.2[6] KF7-525.2S[10] /end FUNCTION_LIST
/end MEASUREMENT
/begin MEASUREMENT vTSKNGM "RAM value vTSKNGM" UWORD COMP_0068 1 100 0 65535 ECU_ADDRESS 0xFFFF9D12 /begin FUNCTION_LIST KF7-500.2A[29] KF7-505.19[1] KF7-525.2[6] KF7-525.2S[10] /end FUNCTION_LIST /end MEASUREMENT
/begin MEASUREMENT vRAMNGM "RAM value vRAMNGM" UWORD COMP_0068 1 100 0 65535 ECU_ADDRESS 0xFFFF9D18
 /begin FUNCTION_LIST KF7-500.2A[29] KF7-505.12[6] KF7-505.36[2] KF7-525.2[6] KF7-525.2S[10] /end FUNCTION_LIST
/end MEASUREMENT
/begin MEASUREMENT vTIMNGM "RAM value vTIMNGM" UWORD COMP_0068 1 100 0 65535 ECU_ADDRESS 0xFFFF9D1E /begin FUNCTION_LIST KF7-500.2A[29] KF7-505.37[1] /end FUNCTION_LIST /end MEASUREMENT
/begin MEASUREMENT vDC21NG "RAM value vDC21NG" UWORD COMP_0068 1 100 0 65535 ECU_ADDRESS 0xFFFF9D2A /begin FUNCTION_LIST KF7-500.2A[29] KF7-500.6D[9] /end FUNCTION_LIST /end MEASUREMENT
/begin MEASUREMENT vDC23NG "RAM value vDC23NG" UWORD COMP_0068 1 100 0 65535 ECU_ADDRESS 0xFFFF9D30 /begin FUNCTION_LIST KF7-500.2A[29] KF7-500.6D[9] /end FUNCTION_LIST /end MEASUREMENT
/begin MEASUREMENT vAFLNG2 "RAM value vAFLNG2" UWORD COMP_0068 1 100 0 65535 ECU_ADDRESS 0xFFFF9D36 /begin FUNCTION_LIST KF7-500.2A[29] /end FUNCTION_LIST /end MEASUREMENT
/begin MEASUREMENT vAFLRS "RAM value vAFLRS" UWORD COMP_0068 1 100 0 65535 ECU_ADDRESS 0xFFFF9D3C /begin FUNCTION_LIST KF7-500.2A[29] /end FUNCTION_LIST /end MEASUREMENT
/begin MEASUREMENT vAFRNG1 "RAM value vAFRNG1" UWORD COMP_0068 1 100 0 65535 ECU_ADDRESS 0xFFFF9D42 /begin FUNCTION_LIST KF7-500.2A[29] KF7-500.76[8] /end FUNCTION_LIST /end MEASUREMENT
/begin MEASUREMENT vAFRLS "RAM value vAFRLS" UWORD COMP_0068 1 100 0 65535 ECU_ADDRESS 0xFFFF9D48 /begin FUNCTION_LIST KF7-500.2A[29] KF7-500.75[4] /end FUNCTION_LIST /end MEASUREMENT
/begin MEASUREMENT vAFRAV "RAM value vAFRAV" UWORD COMP_0068 1 100 0 65535 ECU_ADDRESS 0xFFFF9D4E /begin FUNCTION_LIST KF7-500.2A[29] KF7-500.74[11] /end FUNCTION_LIST /end MEASUREMENT
/begin MEASUREMENT vISCNGH "RAM value vISCNGH" UWORD COMP_0068 1 100 0 65535 ECU_ADDRESS 0xFFFF9D54 /begin FUNCTION_LIST KF7-500.2A[29] KF7-500.38A[4] /end FUNCTION_LIST /end MEASUREMENT
/begin MEASUREMENT vO2R2O "RAM value vO2R2O" UWORD COMP_0068 1 100 0 65535 ECU_ADDRESS 0xFFFF9D5A /begin FUNCTION_LIST KF7-500.2A[29] /end FUNCTION_LIST /end MEASUREMENT
/begin MEASUREMENT vO2R2L "RAM value vO2R2L" UWORD COMP_0068 1 100 0 65535 ECU_ADDRESS 0xFFFF9D60 /begin FUNCTION_LIST KF7-500.2A[29] /end FUNCTION_LIST /end MEASUREMENT
/begin MEASUREMENT vO2R2R "RAM value vO2R2R" UWORD COMP_0068 1 100 0 65535 ECU_ADDRESS 0xFFFF9D66 /begin FUNCTION_LIST KF7-500.2A[29] /end FUNCTION_LIST /end MEASUREMENT
/begin MEASUREMENT vO2R2H "RAM value vO2R2H" UWORD COMP_0068 1 100 0 65535 ECU_ADDRESS 0xFFFF9D6C /begin FUNCTION_LIST KF7-500.2A[29] /end FUNCTION_LIST /end MEASUREMENT
/begin MEASUREMENT vRO2HH2 "RAM value vRO2HH2" UWORD COMP_0068 1 100 0 65535 ECU_ADDRESS 0xFFFF9D72 /begin FUNCTION_LIST KF7-500.2A[29] KF7-500.25A[7] /end FUNCTION_LIST /end MEASUREMENT
/begin MEASUREMENT vRO2HL2 "RAM value vRO2HL2" UWORD COMP_0068 1 100 0 65535 ECU_ADDRESS 0xFFFF9D78 /begin FUNCTION_LIST KF7-500.2A[29] KF7-500.25A[7] /end FUNCTION_LIST /end MEASUREMENT
/begin MEASUREMENT vKN1NGH "RAM value vKN1NGH" UWORD COMP_0068 1 100 0 65535 ECU_ADDRESS 0xFFFF9D7E /begin FUNCTION_LIST KF7-500.2A[29] KF7-500.12[3] /end FUNCTION_LIST /end MEASUREMENT
/begin MEASUREMENT vKN2NGH "RAM value vKN2NGH" UWORD COMP_0068 1 100 0 65535 ECU_ADDRESS 0xFFFF9D84 /begin FUNCTION_LIST KF7-500.2A[29] KF7-500.12[3] /end FUNCTION_LIST /end MEASUREMENT
/begin MEASUREMENT vAFMNGL "RAM value vAFMNGL" UWORD COMP_0068 1 100 0 65535 ECU_ADDRESS 0xFFFF9D8A /begin FUNCTION_LIST KF7-500.2A[29] KF7-500.7[12] /end FUNCTION_LIST /end MEASUREMENT
/begin MEASUREMENT vIGNGR "RAM value vIGNGR" UWORD COMP_0068 1 100 0 65535 ECU_ADDRESS 0xFFFF9D90 /begin FUNCTION_LIST KF7-500.2A[29] KF7-500.10[3] /end FUNCTION_LIST /end MEASUREMENT
/begin MEASUREMENT vTWNGH "RAM value vTWNGH" UWORD COMP_0068 1 100 0 65535 ECU_ADDRESS 0xFFFF9D96 /begin FUNCTION_LIST KF7-500.2A[29] KF7-500.8[5] /end FUNCTION_LIST /end MEASUREMENT
/begin MEASUREMENT vEVCNGO "RAM value vEVCNGO" UWORD COMP_0068 1 100 0 65535 ECU_ADDRESS 0xFFFF9DA2 /begin FUNCTION_LIST KF7-500.2A[29] KF7-500.30[8] /end FUNCTION_LIST /end MEASUREMENT
/begin MEASUREMENT vTHMNGR "RAM value vTHMNGR" UWORD COMP_0068 1 100 0 65535 ECU_ADDRESS 0xFFFF9DA8 /begin FUNCTION_LIST KF7-500.2A[29] KF7-500.60[5] /end FUNCTION_LIST /end MEASUREMENT
/begin MEASUREMENT vMRNR2 "RAM value vMRNR2" UBYTE COMP_0068 1 100 0 255 ECU_ADDRESS 0xFFFF9DAC /begin FUNCTION_LIST KF7-500.2A[29] KF7-500.20B[4] /end FUNCTION_LIST /end MEASUREMENT
/begin MEASUREMENT vMRNL "RAM value vMRNL" UWORD COMP_0068 1 100 0 65535 ECU_ADDRESS 0xFFFF9DAE /begin FUNCTION_LIST KF7-500.2A[29] KF7-500.20B[4] /end FUNCTION_LIST /end MEASUREMENT
/begin MEASUREMENT vMRNL2 "RAM value vMRNL2" UWORD COMP_0068 1 100 0 65535 ECU_ADDRESS 0xFFFF9DB4 /begin FUNCTION_LIST KF7-500.2A[29] KF7-500.20B[4] /end FUNCTION_LIST /end MEASUREMENT
/begin MEASUREMENT vVTCI2R "RAM value vVTCI2R" UWORD COMP_0068 1 100 0 65535 ECU_ADDRESS 0xFFFF9DBA /begin FUNCTION_LIST KF7-500.2A[29] KF7-500.6D[9] KF7-500.47B[15] /end FUNCTION_LIST /end MEASUREMENT
/begin MEASUREMENT vPRSNGH "RAM value vPRSNGH" UWORD COMP_0068 1 100 0 65535 ECU_ADDRESS 0xFFFF9DC0 /begin FUNCTION_LIST KF7-500.2A[29] KF7-500.51[3] /end FUNCTION_LIST /end MEASUREMENT
/begin MEASUREMENT vTPLRNO "RAM value vTPLRNO" UWORD COMP_0068 1 100 0 65535 ECU_ADDRESS 0xFFFF9DD8 /begin FUNCTION_LIST KF7-500.2A[29] KF7-505.30[6] /end FUNCTION_LIST /end MEASUREMENT
/begin MEASUREMENT vVMOSHT "RAM value vVMOSHT" UWORD COMP_0068 1 100 0 65535 ECU_ADDRESS 0xFFFF9DDE /begin FUNCTION_LIST KF7-500.2A[29] KF7-505.31[5] /end FUNCTION_LIST /end MEASUREMENT
/begin MEASUREMENT vAFLHZR "RAM value vAFLHZR" UWORD COMP_0068 1 100 0 65535 ECU_ADDRESS 0xFFFF9DE4 /begin FUNCTION_LIST KF7-500.2A[29] KF7-500.74[11] /end FUNCTION_LIST /end MEASUREMENT
/begin MEASUREMENT vAFRHZR "RAM value vAFRHZR" UWORD COMP_0068 1 100 0 65535 ECU_ADDRESS 0xFFFF9DEA /begin FUNCTION_LIST KF7-500.2A[29] KF7-500.74[11] /end FUNCTION_LIST /end MEASUREMENT
/begin MEASUREMENT vAFHF1L "RAM value vAFHF1L" UWORD COMP_0068 1 100 0 65535 ECU_ADDRESS 0xFFFF9DF0 /begin FUNCTION_LIST KF7-500.2A[29] KF7-500.59[6] /end FUNCTION_LIST /end MEASUREMENT
/begin MEASUREMENT vAFHF2L "RAM value vAFHF2L" UWORD COMP_0068 1 100 0 65535 ECU_ADDRESS 0xFFFF9DF6 /begin FUNCTION_LIST KF7-500.2A[29] KF7-500.59[6] /end FUNCTION_LIST /end MEASUREMENT
/begin MEASUREMENT vAFRLD1 "RAM value vAFRLD1" UWORD COMP_0068 1 100 0 65535 ECU_ADDRESS 0xFFFF9DFC /begin FUNCTION_LIST KF7-500.2A[29] KF7-500.74B[5] /end FUNCTION_LIST /end MEASUREMENT
/begin MEASUREMENT vAFRLD2 "RAM value vAFRLD2" UWORD COMP_0068 1 100 0 65535 ECU_ADDRESS 0xFFFF9E02 /begin FUNCTION_LIST KF7-500.2A[29] KF7-500.74B[5] /end FUNCTION_LIST /end MEASUREMENT
/* COMPU_METHOD --------------------------------------------------------- */
/begin COMPU_METHOD COMP_0017 "1deg" RAT_FUNC "%8.2" "deg" COEFFS 0 1 0 0 0 1 /end COMPU_METHOD
/begin COMPU_METHOD COMP_0068 "1-" RAT_FUNC "%8.2" "-" COEFFS 0 1 0 0 0 1 /end COMPU_METHOD
/begin COMPU_METHOD COMP_0004 "1Å|" RAT_FUNC "%8.2" "Å|" COEFFS 0 1 0 0 0 1 /end COMPU_METHOD
/begin COMPU_METHOD COMP_0023 "5mV" RAT_FUNC "%8.2" "mV" COEFFS 0 1 0 0 0 5 /end COMPU_METHOD
/begin COMPU_METHOD COMP_0429 "1km/h" RAT_FUNC "%8.2" "km/h" COEFFS 0 1 0 0 0 1 /end COMPU_METHOD
/begin COMPU_METHOD COMP_0045 "1/128-" RAT_FUNC "%8.4" "-" COEFFS 0 1 0 0 0 0.0078125 /end COMPU_METHOD
/begin COMPU_METHOD COMP_0001 "1/8ms" RAT_FUNC "%8.2" "ms" COEFFS 0 1 0 0 0 0.125 /end COMPU_METHOD
/begin COMPU_METHOD COMP_0020 "50rpm" RAT_FUNC "%8.2" "rpm" COEFFS 0 1 0 0 0 50 /end COMPU_METHOD
/begin COMPU_METHOD COMP_0002 "0.35deg" RAT_FUNC "%8.2" "deg" COEFFS 0 1 0 0 0 0.35 /end COMPU_METHOD
/begin COMPU_METHOD COMP_0014 "10ms" RAT_FUNC "%8.2" "ms" COEFFS 0 1 0 0 0 10 /end COMPU_METHOD
/begin COMPU_METHOD COMP_0006 "12.5rpm" RAT_FUNC "%8.2" "rpm" COEFFS 0 1 0 0 0 12.5 /end COMPU_METHOD
/begin COMPU_METHOD COMP_0008 "100ms" RAT_FUNC "%8.2" "ms" COEFFS 0 1 0 0 0 100 /end COMPU_METHOD
/begin COMPU_METHOD COMP_0009 "100/128%" RAT_FUNC "%8.2" "%" COEFFS 0 1 0 0 0 0.78125 /end COMPU_METHOD
/begin COMPU_METHOD COMP_0013 "1s" RAT_FUNC "%8.2" "s" COEFFS 0 1 0 0 0 1 /end COMPU_METHOD
/begin COMPU_METHOD COMP_0000 "25rpm" RAT_FUNC "%8.2" "rpm" COEFFS 0 1 0 0 0 25 /end COMPU_METHOD
/begin COMPU_METHOD COMP_0047 "0.5%" RAT_FUNC "%8.2" "%" COEFFS 0 1 0 0 0 0.5 /end COMPU_METHOD
/begin COMPU_METHOD COMP_0018 "1deg" RAT_FUNC "%8.2" "deg" COEFFS 0 1 0 0 0 1 /end COMPU_METHOD
/begin COMPU_METHOD COMP_0007 "2km/h" RAT_FUNC "%8.2" "km/h" COEFFS 0 1 0 0 0 2 /end COMPU_METHOD
/begin COMPU_METHOD COMP_0217 "1/16384-" RAT_FUNC "%8.6" "-" COEFFS 0 1 0 0 0 0.0000610352 /end COMPU_METHOD
/begin COMPU_METHOD COMP_0033 "80mV" RAT_FUNC "%8.2" "mV" COEFFS 0 1 0 0 0 80 /end COMPU_METHOD
/begin COMPU_METHOD COMP_0027 "1%" RAT_FUNC "%8.2" "%" COEFFS 0 1 0 0 0 1 /end COMPU_METHOD
/begin COMPU_METHOD COMP_0049 "1sec" RAT_FUNC "%8.2" "sec" COEFFS 0 1 0 0 0 1 /end COMPU_METHOD
/begin COMPU_METHOD COMP_0063 "1/256-" RAT_FUNC "%8.4" "-" COEFFS 0 1 0 0 0 0.00390625 /end COMPU_METHOD
/begin COMPU_METHOD COMP_0130 "0.0275deg" RAT_FUNC "%8.3" "deg" COEFFS 0 1 0 0 0 0.0275 /end COMPU_METHOD
/begin COMPU_METHOD COMP_0024 "50ms" RAT_FUNC "%8.2" "ms" COEFFS 0 1 0 0 0 50 /end COMPU_METHOD
/begin COMPU_METHOD COMP_0030 "1âÒ" RAT_FUNC "%8.2" "âÒ" COEFFS 0 1 0 0 0 1 /end COMPU_METHOD
/begin COMPU_METHOD COMP_0005 "0.11deg" RAT_FUNC "%8.2" "deg" COEFFS 0 1 0 0 0 0.11 /end COMPU_METHOD
/begin COMPU_METHOD COMP_0044 "1/128Å|" RAT_FUNC "%8.4" "Å|" COEFFS 0 1 0 0 0 0.0078125 /end COMPU_METHOD
/begin COMPU_METHOD COMP_0048 "64/128degCA" RAT_FUNC "%8.2" "degCA" COEFFS 0 1 0 0 0 0.5 /end COMPU_METHOD
/begin COMPU_METHOD COMP_0016 "1count" RAT_FUNC "%8.2" "count" COEFFS 0 1 0 0 0 1 /end COMPU_METHOD
/begin COMPU_METHOD COMP_0054 "20mV" RAT_FUNC "%8.2" "mV" COEFFS 0 1 0 0 0 20 /end COMPU_METHOD
/begin COMPU_METHOD COMP_0050 "5/64mV" RAT_FUNC "%8.3" "mV" COEFFS 0 1 0 0 0 0.078125 /end COMPU_METHOD
/begin COMPU_METHOD COMP_0035 "X-50Åé" RAT_FUNC "%8.2" "Åé" COEFFS 0 1 50 0 0 1 /end COMPU_METHOD
/begin COMPU_METHOD COMP_0096 "10s" RAT_FUNC "%8.2" "s" COEFFS 0 1 0 0 0 10 /end COMPU_METHOD
/begin COMPU_METHOD COMP_0327 "1/32768-" RAT_FUNC "%8.6" "-" COEFFS 0 1 0 0 0 0.0000305 /end COMPU_METHOD
/begin COMPU_METHOD COMP_0425 "100/255%" RAT_FUNC "%8.2" "%" COEFFS 0 1 0 0 0 0.392156862 /end COMPU_METHOD
/begin COMPU_METHOD COMP_0125 "1/256ms" RAT_FUNC "%8.4" "ms" COEFFS 0 1 0 0 0 0.00390625 /end COMPU_METHOD
/begin COMPU_METHOD COMP_0004_S "Å|Å|" RAT_FUNC "%8.6" "Å|" COEFFS 0 1 0 0 0 0.000061 /end COMPU_METHOD
/begin COMPU_METHOD COMP_0190 "2deg" RAT_FUNC "%8.2" "deg" COEFFS 0 1 0 0 0 2 /end COMPU_METHOD
/begin COMPU_METHOD COMP_0256 "64/128degCA" RAT_FUNC "%8.2" "degCA" COEFFS 0 1 64 0 0 0.5 /end COMPU_METHOD
/begin COMPU_METHOD COMP_0025 "0.5step" RAT_FUNC "%8.2" "step" COEFFS 0 1 0 0 0 0.5 /end COMPU_METHOD
/begin COMPU_METHOD COMP_0435 "1/32-" RAT_FUNC "%8.3" "-" COEFFS 0 1 0 0 0 0.03125 /end COMPU_METHOD
/begin COMPU_METHOD COMP_0234 "10sec" RAT_FUNC "%8.2" "sec" COEFFS 0 1 0 0 0 10 /end COMPU_METHOD
/begin COMPU_METHOD COMP_0052 "1/2048ms" RAT_FUNC "%8.5" "ms" COEFFS 0 1 0 0 0 0.000488282 /end COMPU_METHOD
/begin COMPU_METHOD COMP_0356 "0.625X-40Åé" RAT_FUNC "%8.2" "Åé" COEFFS 0 1 40 0 0 0.625 /end COMPU_METHOD
/begin COMPU_METHOD COMP_0312 "0.5/256L" RAT_FUNC "%8.4" "L" COEFFS 0 1 0 0 0 0.001953125 /end COMPU_METHOD
/begin COMPU_METHOD COMP_0057 "1/16384Å|" RAT_FUNC "%8.6" "Å|" COEFFS 0 1 0 0 0 0.0000610352 /end COMPU_METHOD
/begin COMPU_METHOD COMP_0144 "1/2048ms" RAT_FUNC "%8.5" "ms" COEFFS 0 1 0 0 0 0.000488281 /end COMPU_METHOD
/begin COMPU_METHOD COMP_0263_S "12.5/2048rpm/ms" RAT_FUNC "%8.4" "rpm/ms" COEFFS 0 1 0 0 0 0.00610352 /end COMPU_METHOD
/begin COMPU_METHOD COMP_0295 "100msec" RAT_FUNC "%8.2" "msec" COEFFS 0 1 0 0 0 100 /end COMPU_METHOD
/begin COMPU_METHOD COMP_0355 "1/256s" RAT_FUNC "%8.4" "s" COEFFS 0 1 0 0 0 0.00390625 /end COMPU_METHOD
/begin COMPU_METHOD COMP_0210_S "1Åé" RAT_FUNC "%8.2" "Åé" COEFFS 0 1 50 0 0 1 /end COMPU_METHOD
/begin COMPU_METHOD COMP_0273_S "fixed axis rpm" RAT_FUNC "%8.2" "rpm" COEFFS 0 1 -400 0 0 400 /end COMPU_METHOD
/begin COMPU_METHOD COMP_0278_S "fixed axis Åé" RAT_FUNC "%8.2" "Åé" COEFFS 0 1 40 0 0 20 /end COMPU_METHOD
/begin COMPU_METHOD COMP_0271_S "fixed axis rpm" RAT_FUNC "%8.2" "rpm" COEFFS 0 1 0 0 0 400 /end COMPU_METHOD
/begin COMPU_METHOD COMP_0280_S "fixed axis Åé" RAT_FUNC "%8.2" "Åé" COEFFS 0 1 40 0 0 10 /end COMPU_METHOD
/begin COMPU_METHOD COMP_0042 "0.0008cm**2" RAT_FUNC "%8.5" "cm**2" COEFFS 0 1 0 0 0 0.0008 /end COMPU_METHOD
/begin COMPU_METHOD COMP_0504_S "fixed axis deg" RAT_FUNC "%8.2" "deg" COEFFS 0 1 -0.55 0 0 1.43 /end COMPU_METHOD
/begin COMPU_METHOD COMP_0329_S "fixed axis km/h" RAT_FUNC "%8.2" "km/h" COEFFS 0 1 0 0 0 16 /end COMPU_METHOD
/begin COMPU_METHOD COMP_0522_S "fixed axis kPa" RAT_FUNC "%8.2" "kPa" COEFFS 0 1 0 0 0 16 /end COMPU_METHOD
/begin COMPU_METHOD COMP_0283 "1flag" RAT_FUNC "%8.2" "flag" COEFFS 0 1 0 0 0 1 /end COMPU_METHOD
/begin COMPU_METHOD COMP_0091 "Ã◊∏ﬁÃ◊∏ﬁ" RAT_FUNC "%8.2" "Ã◊∏ﬁ" COEFFS 0 1 0 0 0 1 /end COMPU_METHOD
/begin COMPU_METHOD COMP_0201_S "1s1s" RAT_FUNC "%8.2" "1s" COEFFS 0 1 0 0 0 1 /end COMPU_METHOD
/begin COMPU_METHOD COMP_0202_S "100ms100ms" RAT_FUNC "%8.2" "100ms" COEFFS 0 1 0 0 0 1 /end COMPU_METHOD
/begin COMPU_METHOD COMP_0203_S "10ms10ms" RAT_FUNC "%8.2" "10ms" COEFFS 0 1 0 0 0 1 /end COMPU_METHOD
/begin COMPU_METHOD COMP_0378 "100/255%" RAT_FUNC "%8.2" "%" COEFFS 0 1 0 0 0 0.392156863 /end COMPU_METHOD
/begin COMPU_METHOD COMP_0533_S "minmin" RAT_FUNC "%8.2" "min" COEFFS 0 1 0 0 0 1 /end COMPU_METHOD
/begin COMPU_METHOD COMP_0117 "100/128%" RAT_FUNC "%8.2" "%" COEFFS 0 1 100 0 0 0.78125 /end COMPU_METHOD
/begin COMPU_METHOD COMP_0535_S "kPakPa" RAT_FUNC "%8.2" "kPa" COEFFS 0 1 0 0 0 1 /end COMPU_METHOD
/begin COMPU_METHOD COMP_0470 "1km" RAT_FUNC "%8.2" "km" COEFFS 0 1 0 0 0 1 /end COMPU_METHOD
/begin COMPU_METHOD COMP_0426 "Å|code" RAT_FUNC "%8.2" "code" COEFFS 0 1 0 0 0 1 /end COMPU_METHOD
/begin COMPU_METHOD COMP_0536_S "g/sg/s" RAT_FUNC "%8.3" "g/s" COEFFS 0 1 0 0 0 0.01 /end COMPU_METHOD
/begin COMPU_METHOD COMP_0427 "0.25rpm" RAT_FUNC "%8.2" "rpm" COEFFS 0 1 0 0 0 0.25 /end COMPU_METHOD
/begin COMPU_METHOD COMP_0428 "X-40Åé" RAT_FUNC "%8.2" "Åé" COEFFS 0 1 40 0 0 1 /end COMPU_METHOD
/begin COMPU_METHOD COMP_0537_S "VV" RAT_FUNC "%8.4" "V" COEFFS 0 1 0 0 0 0.001 /end COMPU_METHOD
/begin COMPU_METHOD COMP_0538_S "VV" RAT_FUNC "%8.4" "V" COEFFS 0 1 0 0 0 0.005 /end COMPU_METHOD
/begin COMPU_METHOD COMP_0140 "0.5STEP" RAT_FUNC "%8.2" "STEP" COEFFS 0 1 0 0 0 0.5 /end COMPU_METHOD
/begin COMPU_METHOD COMP_0539_S "cm^2/(rpm*cc)cm^2/(rp" RAT_FUNC "%8.6" "cm^2/(rp" COEFFS 0 1 0 0 0 0.0000000000908 /end COMPU_METHOD
/begin COMPU_METHOD COMP_0540_S "cm^2/rpm/cccm^2/rpm" RAT_FUNC "%8.6" "cm^2/rpm" COEFFS 0 1 0 0 0 0.0000000000908 /end COMPU_METHOD
/begin COMPU_METHOD COMP_0541_S "cm^2/(rpm*cc)cm^2/(rp" RAT_FUNC "%8.6" "cm^2/(rp" COEFFS 0 1 0 0 0 0.0000000000454 /end COMPU_METHOD
/begin COMPU_METHOD COMP_0546_S "kPakPa" RAT_FUNC "%8.2" "kPa" COEFFS 0 1 0 0 0 0.5 /end COMPU_METHOD
/begin COMPU_METHOD COMP_0385 "1.608km" RAT_FUNC "%8.2" "km" COEFFS 0 1 0 0 0 1.608 /end COMPU_METHOD
/begin COMPU_METHOD COMP_0389 "1/2548km" RAT_FUNC "%8.5" "km" COEFFS 0 1 0 0 0 0.000392465 /end COMPU_METHOD
/begin COMPU_METHOD COMP_0345 "0.0032cm**2" RAT_FUNC "%8.4" "cm**2" COEFFS 0 1 0 0 0 0.0032 /end COMPU_METHOD
/begin COMPU_METHOD COMP_0158 "1/16Å|" RAT_FUNC "%8.3" "Å|" COEFFS 0 1 0 0 0 0.0625 /end COMPU_METHOD
/begin COMPU_METHOD COMP_0594_S "ÅãÅã" RAT_FUNC "%8.2" "Åã" COEFFS 0 1 64 0 0 0.5 /end COMPU_METHOD
/begin COMPU_METHOD COMP_0072_S "%%" RAT_FUNC "%8.4" "%" COEFFS 0 1 1 0 0 0.0078125 /end COMPU_METHOD
/begin COMPU_METHOD COMP_0424 "1kpa" RAT_FUNC "%8.2" "kpa" COEFFS 0 1 0 0 0 1 /end COMPU_METHOD
/begin COMPU_METHOD COMP_0469 "1/2548km" RAT_FUNC "%8.5" "km" COEFFS 0 1 0 0 0 0.00039246 /end COMPU_METHOD
/begin COMPU_METHOD COMP_0514 "1/2048ms" RAT_FUNC "%8.5" "ms" COEFFS 0 1 0 0 0 0.0004883 /end COMPU_METHOD
/* RECORD_LAYOUT ------------------------------------------------------ */
/begin RECORD_LAYOUT REC_UBYTE_C FNC_VALUES 1 UBYTE COLUMN_DIR DIRECT /end RECORD_LAYOUT
/begin RECORD_LAYOUT REC_UWORD_C FNC_VALUES 1 UWORD COLUMN_DIR DIRECT /end RECORD_LAYOUT
/begin RECORD_LAYOUT REC_SBYTE_C FNC_VALUES 1 SBYTE COLUMN_DIR DIRECT /end RECORD_LAYOUT
/begin RECORD_LAYOUT REC_ULONG_C FNC_VALUES 1 ULONG COLUMN_DIR DIRECT /end RECORD_LAYOUT
/begin RECORD_LAYOUT REC_AXIS_UBYTE AXIS_PTS_X 1 UBYTE INDEX_INCR DIRECT /end RECORD_LAYOUT
/end MODULE
/end PROJECT
