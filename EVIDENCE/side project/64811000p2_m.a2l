ASAP2_VERSION 1 3_BETA
/begin PROJECT TK_X91_EUR_VC ""
/begin HEADER "" /* key HEADER ++ "comment" Ç… Par.scomment */ PROJECT_NO TK_X91_EUR_VC /* key PROJECT_NO ++ project number Ç… car_eng_desti_lot */ VERSION "7V4YHZEB2" /* key VERSION ++ version number Ç… mProgver */ /end HEADER
/begin MODULE DIM ""
/begin MOD_COMMON "" DEPOSIT ABSOLUTE BYTE_ORDER MSB_FIRST /* ﬁ≤ƒµ∞¿ﬁ∞Ç™ÿÃﬂ⁄∞ΩÇ≥ÇÍÇÈ */ /end MOD_COMMON
/begin FUNCTION KF7-313C.1[36] "Interface" /end FUNCTION
/begin FUNCTION KF7-313C.2[4] "A/F sensor activation judgement" /end FUNCTION
/begin FUNCTION KF7-313C.3[1] "Lambda point compensation" /end FUNCTION
/begin FUNCTION KF7-313C.4[3] "A/F sensor shift learning" /end FUNCTION
/begin FUNCTION KF7-313C.5[3] "HOSCMAX learning" /end FUNCTION
/begin FUNCTION KF7-313C.6[5] "Target A/F fixing control" /end FUNCTION
/begin FUNCTION KF7-313C.7[1] "Initial value switching control for hot-restart" /end FUNCTION
/begin FUNCTION KF7-313C.9[3] "RrO2 sensor feedback control" /end FUNCTION
/begin FUNCTION KF7-313C.11B[1] "SMC type ALPHA calculation" /end FUNCTION
/begin FUNCTION KF7-313D.1[7] "OSC control C source (SMC)" /end FUNCTION
/begin FUNCTION KF7-314.1F[1] "A/F sensor air fuel ratio control learning control (SULEV 6/8cyl)" /end FUNCTION
/begin FUNCTION KF7-314B.1[N] "A/F sensor air fuel ratio control C source" /end FUNCTION
/begin FUNCTION KF7-320A.1[6] "Calculation of torque correction volume at ignition timing" /end FUNCTION
/begin FUNCTION KF7-320A.2[3] "Retard control against shock at reacceleation" /end FUNCTION
/begin FUNCTION KF7-320A.3[N] "Adjusted ADV value" /end FUNCTION
/begin FUNCTION KF7-320A.4[6] "Calculation of the amount of change and absolute value limiter" /end FUNCTION
/begin FUNCTION KF7-320A.5[N] "Calculation of final ignition timing" /end FUNCTION
/begin FUNCTION KF7-320A.6[3] "Calculation of non-dwell angle" /end FUNCTION
/begin FUNCTION KF7-320A.8[2] "Calculation of MBT angle" /end FUNCTION
/begin FUNCTION KF7-320A.9[9] "Correction of trimming Map" /end FUNCTION
/begin FUNCTION KF7-320A.10[14] "Calculation of GOV idle" /end FUNCTION
/begin FUNCTION KF7-320A.11[1] "Calculation of warming catalyst correction" /end FUNCTION
/begin FUNCTION KF7-320A.12[N] "Calculation of fast idle retard volume " /end FUNCTION
/begin FUNCTION KF7-320A.13[N] "Calculation of mid-range coolant temperature retard volume" /end FUNCTION
/begin FUNCTION KF7-320A.14[1] "Calculation of corrected advance angle for negative KTW" /end FUNCTION
/begin CHARACTERISTIC mTLBLRC "Learning map TP shaft lattice point table" CURVE 0x0000D4EA REC_UBYTE_C 0 COMP_0001 0 31.875
 /begin AXIS_DESCR FIX_AXIS NO_INPUT_QUANTITY COMP_0205_S 8 0 7 FIX_AXIS_PAR_DIST 0 1 8 /end AXIS_DESCR
 /begin FUNCTION_LIST KF7-314.1F[1] /end FUNCTION_LIST
/end CHARACTERISTIC
/begin CHARACTERISTIC mTNBLRC "Learning map N shaft lattice point table" CURVE 0x0000D5CC REC_UBYTE_C 0 COMP_0020 0 12750
 /begin AXIS_DESCR FIX_AXIS NO_INPUT_QUANTITY COMP_0205_S 8 0 7 FIX_AXIS_PAR_DIST 0 1 8 /end AXIS_DESCR
 /begin FUNCTION_LIST KF7-314.1F[1] /end FUNCTION_LIST
/end CHARACTERISTIC
/begin CHARACTERISTIC mA5TP1 "Intermadiate coolant temperature retard addition judgement TP" VALUE 0x000081BC REC_UBYTE_C 0 COMP_0001 0 31.875 /begin FUNCTION_LIST KF7-320A.13[N] /end FUNCTION_LIST /end CHARACTERISTIC
/begin CHARACTERISTIC mA5TVO "Intermadiate coolant temperature retard addition judgement TVO" VALUE 0x000081BD REC_UBYTE_C 0 COMP_0002 0 89.25 /begin FUNCTION_LIST KF7-320A.13[N] /end FUNCTION_LIST /end CHARACTERISTIC
/begin CHARACTERISTIC mA5TWD "Intermadiate coolant temperature retard addition judgement upper limit coolant temperature (at the time of the start, for the rise)" VALUE 0x000081BE REC_UBYTE_C 0 COMP_0003 0 255 /begin FUNCTION_LIST KF7-320A.13[N] /end FUNCTION_LIST /end CHARACTERISTIC
/begin CHARACTERISTIC mABFHT "At the time of the high exhaust temperature, rich-ization control target A/F" VALUE 0x00008F94 REC_UWORD_C 0 COMP_0453 0 131.07 /begin FUNCTION_LIST KF7-313C.6[5] /end FUNCTION_LIST /end CHARACTERISTIC
/begin CHARACTERISTIC mADJINI "Lambda point compensation value initial value" VALUE 0x00008EBE REC_SWORD_C 0 COMP_0353 -163840 163835 /begin FUNCTION_LIST KF7-313C.3[1] /end FUNCTION_LIST /end CHARACTERISTIC
/begin CHARACTERISTIC mADVADH "ADV adjustment value upper limit" VALUE 0x00008184 REC_SBYTE_C 0 COMP_0018 -128 127 /begin FUNCTION_LIST KF7-320A.3[N] KF7-580.1[8] /end FUNCTION_LIST /end CHARACTERISTIC
/begin CHARACTERISTIC mADVADL "ADV adjustment value lower limit" VALUE 0x00008185 REC_SBYTE_C 0 COMP_0018 -128 127 /begin FUNCTION_LIST KF7-320A.3[N] KF7-580.1[8] /end FUNCTION_LIST /end CHARACTERISTIC
/begin CHARACTERISTIC mADVAMX "Advance side limiter" VALUE 0x00008186 REC_SBYTE_C 0 COMP_0018 -128 127 /begin FUNCTION_LIST KF7-320A.4[6] R301.23.ADV_calculation_1_1_2 /end FUNCTION_LIST /end CHARACTERISTIC
/begin CHARACTERISTIC mADVLMT "Retard side maximum change width" VALUE 0x000081F9 REC_UBYTE_C 0 COMP_0017 0 255
 /begin FUNCTION_LIST KF7-320A.4[6] KF7-320A.6[3] KF7-320A.21[N] R301.23.ADV_calculation_1_1_2 /end FUNCTION_LIST
/end CHARACTERISTIC
/begin CHARACTERISTIC mADVLMTPI "Ignition timing change rate limiter" VALUE 0x000081FA REC_UBYTE_C 0 COMP_0340_S 0 255 /begin FUNCTION_LIST KF7-320A.1[6] R301.23.ADV_calculation_1_1_2 /end FUNCTION_LIST /end CHARACTERISTIC
/begin CHARACTERISTIC mADVLMTS "Retard side maximum change width (When it starts.)" VALUE 0x000081FB REC_UBYTE_C 0 COMP_0017 0 255 /begin FUNCTION_LIST KF7-320A.4[6] KF7-320A.6[3] R301.23.ADV_calculation_1_1_2 /end FUNCTION_LIST /end CHARACTERISTIC
/begin CHARACTERISTIC mADVRMX "Retard side limiter" VALUE 0x00008188 REC_SBYTE_C 0 COMP_0018 -128 127 /begin FUNCTION_LIST KF7-320A.4[6] R301.23.ADV_calculation_1_1_2 /end FUNCTION_LIST /end CHARACTERISTIC
/begin CHARACTERISTIC mAFACTH "A/F sensor activated judgement permission TFBYA upper limit" VALUE 0x00008FAA REC_UWORD_C 0 COMP_0217 0 3.999941832 /begin FUNCTION_LIST KF7-313C.2[4] /end FUNCTION_LIST /end CHARACTERISTIC
/begin CHARACTERISTIC mAFACTL "A/F sensor activated judgement permission TFBYA lower limit" VALUE 0x00008FAC REC_UWORD_C 0 COMP_0217 0 3.999941832 /begin FUNCTION_LIST KF7-313C.2[4] /end FUNCTION_LIST /end CHARACTERISTIC
/begin CHARACTERISTIC mAFHCUR "A/F sensor activated judgement permission heater electric current value" VALUE 0x00008FC0 REC_UWORD_C 0 COMP_0061 0 327675 /begin FUNCTION_LIST KF7-313C.2[4] /end FUNCTION_LIST /end CHARACTERISTIC
/begin CHARACTERISTIC mAFHKJYU "A/F sensor heater electric current weighted average index number" VALUE 0x00008219 REC_UBYTE_C 0 COMP_0032 0 0.99609375 /begin FUNCTION_LIST KF7-313C.2[4] /end FUNCTION_LIST /end CHARACTERISTIC
/begin CHARACTERISTIC mAFOHONT "A/F sensor shift compensation learning : the rest O2 heater on delay" VALUE 0x00008229 REC_UBYTE_C 0 COMP_0008 0 25500 /begin FUNCTION_LIST KF7-313C.4[3] /end FUNCTION_LIST /end CHARACTERISTIC
/begin CHARACTERISTIC mAFSHCT "AFSHOS renewal count value" VALUE 0x0000822D REC_UBYTE_C 0 COMP_0030 0 255 /begin FUNCTION_LIST KF7-314.1F[1] /end FUNCTION_LIST /end CHARACTERISTIC
/begin CHARACTERISTIC mAFSHSL "AFSHDM change quantity S/L" VALUE 0x00008FDE REC_UWORD_C 0 COMP_0453 0 131.07 /begin FUNCTION_LIST KF7-314.1F[1] /end FUNCTION_LIST /end CHARACTERISTIC
/begin CHARACTERISTIC mAFSLRBL "At the time of the monitor clamp, learning lean side hysteresis" VALUE 0x00008FE0 REC_UWORD_C 0 COMP_0453 0 131.07 /begin FUNCTION_LIST KF7-314.1F[1] /end FUNCTION_LIST /end CHARACTERISTIC
/begin CHARACTERISTIC mAFSLRBR "At the time of the monitor clamp, learning rich side hysteresis" VALUE 0x00008FE2 REC_UWORD_C 0 COMP_0453 0 131.07 /begin FUNCTION_LIST KF7-314.1F[1] /end FUNCTION_LIST /end CHARACTERISTIC
/begin CHARACTERISTIC mALCTMN "ALPCAT lower limit value" VALUE 0x00008250 REC_UBYTE_C 0 COMP_0027 0 255 /begin FUNCTION_LIST KF7-313C.9[3] /end FUNCTION_LIST /end CHARACTERISTIC
/begin CHARACTERISTIC mALCTMX "ALPCAT upper limit value" VALUE 0x00008251 REC_UBYTE_C 0 COMP_0027 0 255 /begin FUNCTION_LIST KF7-313C.9[3] /end FUNCTION_LIST /end CHARACTERISTIC
/begin CHARACTERISTIC mALP21 "É¢ALP upper limit" VALUE 0x00008267 REC_UBYTE_C 0 COMP_0027 0 255 /begin FUNCTION_LIST KF7-314.1F[1] /end FUNCTION_LIST /end CHARACTERISTIC
/begin CHARACTERISTIC mASHLTM "A/F sensor shift compensation learning : learning permission condition judgement delay" VALUE 0x0000828E REC_UBYTE_C 0 COMP_0008 0 25500 /begin FUNCTION_LIST KF7-313C.4[3] /end FUNCTION_LIST /end CHARACTERISTIC
/begin CHARACTERISTIC mBLBDEC "Gasoline mixing quantity decrease rate" VALUE 0x000082BB REC_UBYTE_C 0 COMP_0044 0 1.9921875 /begin FUNCTION_LIST KF7-314.1F[1] /end FUNCTION_LIST /end CHARACTERISTIC
/begin CHARACTERISTIC mBLBHOT "At the time of the start, gasoline mixing quantity index number" VALUE 0x000082BC REC_UBYTE_C 0 COMP_0016 0 255 /begin FUNCTION_LIST KF7-314.1F[1] /end FUNCTION_LIST /end CHARACTERISTIC
/begin CHARACTERISTIC mBLBKMR "At the time of the KMR increase, gasoline mixing speed" VALUE 0x000082BD REC_UBYTE_C 0 COMP_0016 0 255 /begin FUNCTION_LIST KF7-314.1F[1] /end FUNCTION_LIST /end CHARACTERISTIC
/begin CHARACTERISTIC mBLBSTC "At the time of the start, gasoline mixing quantity initial value" VALUE 0x000082BE REC_UBYTE_C 0 COMP_0016 0 255 /begin FUNCTION_LIST KF7-314.1F[1] /end FUNCTION_LIST /end CHARACTERISTIC
/begin CHARACTERISTIC mCATJD2 "Stage 2 diagnosis region condition disconnection delay" VALUE 0x000082E6 REC_UBYTE_C 0 COMP_0013 0 255 /begin FUNCTION_LIST KF7-313C.9[3] KF7-500.21[19] /end FUNCTION_LIST /end CHARACTERISTIC
/begin CHARACTERISTIC mCLCHGOVT "At the time of the clutch cutting, GOV permission coolant temperature" VALUE 0x00008323 REC_UBYTE_C 0 COMP_0035 -50 205 /begin FUNCTION_LIST KF7-320A.1[6] R301.23.ADV_calculation_1_1_2 /end FUNCTION_LIST /end CHARACTERISTIC
/begin CHARACTERISTIC mCLRMAX "Learning counter monitor maximum value" VALUE 0x0000832E REC_UBYTE_C 0 COMP_0027 0 255 /begin FUNCTION_LIST KF7-314.1F[1] /end FUNCTION_LIST /end CHARACTERISTIC
/begin CHARACTERISTIC mCLRMIN "Learning counter monitor minimum value" VALUE 0x0000832F REC_UBYTE_C 0 COMP_0027 0 255 /begin FUNCTION_LIST KF7-314.1F[1] /end FUNCTION_LIST /end CHARACTERISTIC
/begin CHARACTERISTIC mCLSDLY "Lambda control formation delay" VALUE 0x00008330 REC_UBYTE_C 0 COMP_0049 0 255 /begin FUNCTION_LIST KF7-313C.6[5] /end FUNCTION_LIST /end CHARACTERISTIC
/begin CHARACTERISTIC mCNTIDLN "At the time of the idle, learning renewal number of times target value" VALUE 0x0000834A REC_UBYTE_C 0 COMP_0016 0 255 /begin FUNCTION_LIST KF7-314.1F[1] /end FUNCTION_LIST /end CHARACTERISTIC
/begin CHARACTERISTIC mDBBNMH "Gasoline mixing quantity decrease upper limit speed" VALUE 0x000083B4 REC_UBYTE_C 0 COMP_0020 0 12750 /begin FUNCTION_LIST KF7-314.1F[1] /end FUNCTION_LIST /end CHARACTERISTIC
/begin CHARACTERISTIC mDBBNML "Gasoline mixing quantity decrease lower limit speed" VALUE 0x000083B5 REC_UBYTE_C 0 COMP_0020 0 12750 /begin FUNCTION_LIST KF7-314.1F[1] /end FUNCTION_LIST /end CHARACTERISTIC
/begin CHARACTERISTIC mDBBTPH "Gasoline mixing quantity decrease upper limit TP" VALUE 0x000083B6 REC_UBYTE_C 0 COMP_0001 0 31.875 /begin FUNCTION_LIST KF7-314.1F[1] /end FUNCTION_LIST /end CHARACTERISTIC
/begin CHARACTERISTIC mDBBTPL "Gasoline mixing quantity decrease lower limit TP" VALUE 0x000083B7 REC_UBYTE_C 0 COMP_0001 0 31.875 /begin FUNCTION_LIST KF7-314.1F[1] /end FUNCTION_LIST /end CHARACTERISTIC
/begin CHARACTERISTIC mDBBTW "Gasoline mixing quantity decrease lower limit coolant temperature" VALUE 0x000083B8 REC_UBYTE_C 0 COMP_0035 -50 205 /begin FUNCTION_LIST KF7-314.1F[1] /end FUNCTION_LIST /end CHARACTERISTIC
/begin CHARACTERISTIC mDBLBST "At the time of the start, BLBST decrease speed" VALUE 0x000083B9 REC_UBYTE_C 0 COMP_0016 0 255 /begin FUNCTION_LIST KF7-314.1F[1] /end FUNCTION_LIST /end CHARACTERISTIC
/begin CHARACTERISTIC mDGINGOV "At the time of switching, damper coefficient" VALUE 0x0000842F REC_UBYTE_C 0 COMP_0340_S 0 255 /begin FUNCTION_LIST KF7-320A.10[14] /end FUNCTION_LIST /end CHARACTERISTIC
/begin CHARACTERISTIC mDILU "Dilution modification coefficient" VALUE 0x00008433 REC_UBYTE_C 0 COMP_0095 0 398.4375 /begin FUNCTION_LIST KF7-320A.8[2] /end FUNCTION_LIST /end CHARACTERISTIC
/begin CHARACTERISTIC mDKTARTDR "For the high intake air temperature retard change width limiter ref" VALUE 0x0000844F REC_UBYTE_C 0 COMP_0215_S 0 255 /begin FUNCTION_LIST KF7-320A.9[9] /end FUNCTION_LIST /end CHARACTERISTIC
/begin CHARACTERISTIC mDLMD1 "TRLRC lattice" VALUE 0x00008463 REC_UBYTE_C 0 COMP_0027 0 255 /begin FUNCTION_LIST KF7-314.1F[1] /end FUNCTION_LIST /end CHARACTERISTIC
/begin CHARACTERISTIC mDLMD2 "TRLRC lattice" VALUE 0x00008464 REC_UBYTE_C 0 COMP_0027 0 255 /begin FUNCTION_LIST KF7-314.1F[1] /end FUNCTION_LIST /end CHARACTERISTIC
/begin CHARACTERISTIC mDLMD3 "TRLRC lattice" VALUE 0x00008465 REC_UBYTE_C 0 COMP_0027 0 255 /begin FUNCTION_LIST KF7-314.1F[1] /end FUNCTION_LIST /end CHARACTERISTIC
/begin CHARACTERISTIC mDTFCTW "Torque going down control prohibition coolant temperature" VALUE 0x000084DD REC_UBYTE_C 0 COMP_0035 -50 205
 /begin FUNCTION_LIST KF7-320A.2[3] KF7-385.1[32] KF7-385.2[18] R301.23.ADV_calculation_1_1_2 /end FUNCTION_LIST
/end CHARACTERISTIC
/begin CHARACTERISTIC mDTVHOS "HOSCMAX learning : learning region delta-TVO upper limit" VALUE 0x000084ED REC_UBYTE_C 0 COMP_0002 0 89.25 /begin FUNCTION_LIST KF7-313C.5[3] /end FUNCTION_LIST /end CHARACTERISTIC
/begin CHARACTERISTIC mDTVHOST "HOSCMAX learning : learning region delta-TVO judgement delay" VALUE 0x000084EE REC_UBYTE_C 0 COMP_0008 0 25500 /begin FUNCTION_LIST KF7-313C.5[3] /end FUNCTION_LIST /end CHARACTERISTIC
/begin CHARACTERISTIC mDTVOSC "A/F sensor shift compensation learning : learning region delta-TVO upper limit" VALUE 0x000084F7 REC_UBYTE_C 0 COMP_0002 0 89.25 /begin FUNCTION_LIST KF7-313C.4[3] /end FUNCTION_LIST /end CHARACTERISTIC
/begin CHARACTERISTIC mDTVOSCT "A/F sensor shift compensation learning : learning region delta-TVO judgement delay" VALUE 0x000084F8 REC_UBYTE_C 0 COMP_0008 0 25500 /begin FUNCTION_LIST KF7-313C.4[3] /end FUNCTION_LIST /end CHARACTERISTIC
/begin CHARACTERISTIC mDWLDEGup "A fever limitation coefficient" VALUE 0x0000851A REC_UBYTE_C 0 COMP_0228_S 0 2.988294 /begin FUNCTION_LIST KF7-320A.6[3] KF7-320A.21[N] /end FUNCTION_LIST /end CHARACTERISTIC
/begin CHARACTERISTIC mDWLDEGus "A fever limitation coefficient (When it starts.)" VALUE 0x0000851B REC_UBYTE_C 0 COMP_0404_S 0 7.96875 /begin FUNCTION_LIST KF7-320A.6[3] /end FUNCTION_LIST /end CHARACTERISTIC
/begin CHARACTERISTIC mDWLHOS "At the time of the dwell start, rotation rise compensation coefficient" VALUE 0x0000851C REC_UBYTE_C 0 COMP_0405_S 0 9.9705 /begin FUNCTION_LIST KF7-320A.6[3] /end FUNCTION_LIST /end CHARACTERISTIC
/begin CHARACTERISTIC mDWLNEMAX "Speed upper limit for the dwell calculation" VALUE 0x0000851D REC_UBYTE_C 0 COMP_0020 0 12750 /begin FUNCTION_LIST KF7-320A.6[3] KF7-320A.21[N] /end FUNCTION_LIST /end CHARACTERISTIC
/begin CHARACTERISTIC mDWLNEMIN "Speed lower limit for the dwell calculation" VALUE 0x0000851E REC_UBYTE_C 0 COMP_0020 0 12750 /begin FUNCTION_LIST KF7-320A.6[3] KF7-320A.21[N] /end FUNCTION_LIST /end CHARACTERISTIC
/begin CHARACTERISTIC mDWLTIM "Dwell TIM coefficient" VALUE 0x0000851F REC_UBYTE_C 0 COMP_0136 0 5.1 /begin FUNCTION_LIST KF7-320A.6[3] KF7-320A.21[N] /end FUNCTION_LIST /end CHARACTERISTIC
/begin CHARACTERISTIC mDWLVBMIN "A battery voltage lower limit for the dwell calculation" VALUE 0x00008520 REC_UBYTE_C 0 COMP_0026 0 20400 /begin FUNCTION_LIST KF7-320A.6[3] KF7-320A.21[N] /end FUNCTION_LIST /end CHARACTERISTIC
/begin CHARACTERISTIC mDYHTMP "A high exhaust temperature lambda control switchover delay" VALUE 0x00008523 REC_UBYTE_C 0 COMP_0049 0 255 /begin FUNCTION_LIST KF7-313C.6[5] /end FUNCTION_LIST /end CHARACTERISTIC
/begin CHARACTERISTIC mEGRS "EGR modification coefficient" VALUE 0x00008536 REC_UBYTE_C 0 COMP_0095 0 398.4375 /begin FUNCTION_LIST KF7-320A.8[2] /end FUNCTION_LIST /end CHARACTERISTIC
/begin CHARACTERISTIC mFACNG1 "FIR, intermadiate coolant temperature retard section compensation rate change quantity 1 (at the time of the idle, the mild acceleration)" VALUE 0x000085D1 REC_UBYTE_C 0 COMP_0108 0 0.99609375 /begin FUNCTION_LIST KF7-320A.12[N] KF7-320A.13[N] /end FUNCTION_LIST /end CHARACTERISTIC
/begin CHARACTERISTIC mFACNG2 "FIR, intermadiate coolant temperature retard section compensation rate change quantity 2 (at the time of the urgent acceleration)" VALUE 0x000085D2 REC_UBYTE_C 0 COMP_0108 0 0.99609375 /begin FUNCTION_LIST KF7-320A.12[N] KF7-320A.13[N] /end FUNCTION_LIST /end CHARACTERISTIC
/begin CHARACTERISTIC mFATVO "FIR, intermadiate coolant temperature retard section compensation rate acceleration judgement delta-TVO" VALUE 0x000085D6 REC_UBYTE_C 0 COMP_0053_S 0 89.25 /begin FUNCTION_LIST KF7-320A.12[N] KF7-320A.13[N] /end FUNCTION_LIST /end CHARACTERISTIC
/begin CHARACTERISTIC mFRA5TW "At the time of FIR, the intermadiate coolant temperature retard addition judgement start, coolant temperature" VALUE 0x0000862C REC_UBYTE_C 0 COMP_0035 -50 205 /begin FUNCTION_LIST KF7-320A.12[N] KF7-320A.13[N] /end FUNCTION_LIST /end CHARACTERISTIC
/begin CHARACTERISTIC mFRBASE "First idle retard basic value" VALUE 0x0000862D REC_UBYTE_C 0 COMP_0017 0 255 /begin FUNCTION_LIST KF7-320A.12[N] /end FUNCTION_LIST /end CHARACTERISTIC
/begin CHARACTERISTIC mFRTM "After first idle retard addition judgement ST/SW off, progress time" VALUE 0x00008632 REC_UBYTE_C 0 COMP_0008 0 25500 /begin FUNCTION_LIST KF7-320A.12[N] /end FUNCTION_LIST /end CHARACTERISTIC
/begin CHARACTERISTIC mFRTWD "First idle retard addition judgement upper limit coolant temperature (at the time of the start, for the rise)" VALUE 0x00008633 REC_UBYTE_C 0 COMP_0003 0 255 /begin FUNCTION_LIST KF7-320A.12[N] /end FUNCTION_LIST /end CHARACTERISTIC
/begin CHARACTERISTIC mFRTWH "First idle retard addition judgement upper limit coolant temperature" VALUE 0x00008634 REC_UBYTE_C 0 COMP_0035 -50 205 /begin FUNCTION_LIST KF7-320A.12[N] /end FUNCTION_LIST /end CHARACTERISTIC
/begin CHARACTERISTIC mFSDWLL "At the time of the POS10 sensor trouble, control-in-progress non-energizing angle compensation value" VALUE 0x00008640 REC_UBYTE_C 0 COMP_0017 0 255 /begin FUNCTION_LIST KF7-320A.6[3] KF7-450.9A[5] /end FUNCTION_LIST /end CHARACTERISTIC
/begin CHARACTERISTIC mFSFADV "At the time of the POS10 sensor trouble, control-in-progress final ignition timing limiter" VALUE 0x00008641 REC_UBYTE_C 0 COMP_0017 0 255 /begin FUNCTION_LIST KF7-320A.5[N] KF7-450.9A[5] /end FUNCTION_LIST /end CHARACTERISTIC
/begin CHARACTERISTIC mGOV4 "At the time of 3rd L/UP slowdown, ADV" VALUE 0x00008678 REC_UBYTE_C 0 COMP_0314 -128 127 /begin FUNCTION_LIST KF7-320A.10[14] R301.25.GOV_idle_1_0_2 /end FUNCTION_LIST /end CHARACTERISTIC
/begin CHARACTERISTIC mGOVDLY "GOV3 setup time" VALUE 0x0000867A REC_UBYTE_C 0 COMP_0014 0 2550 /begin FUNCTION_LIST KF7-320A.10[14] R301.25.GOV_idle_1_0_2 /end FUNCTION_LIST /end CHARACTERISTIC
/begin CHARACTERISTIC mGOVTW "GOV switching coolant temperature" VALUE 0x0000867B REC_UBYTE_C 0 COMP_0035 -50 205 /begin FUNCTION_LIST KF7-320A.10[14] R301.25.GOV_idle_1_0_2 /end FUNCTION_LIST /end CHARACTERISTIC
/begin CHARACTERISTIC mHLRMAX "KBLRCB upper limit value" VALUE 0x00008694 REC_UBYTE_C 0 COMP_0027 0 255 /begin FUNCTION_LIST KF7-314.1F[1] KF7-500.20B[4] /end FUNCTION_LIST /end CHARACTERISTIC
/begin CHARACTERISTIC mHLRMIN "KBLRCB lower limit value" VALUE 0x00008695 REC_UBYTE_C 0 COMP_0027 0 255 /begin FUNCTION_LIST KF7-314.1F[1] KF7-500.20B[4] /end FUNCTION_LIST /end CHARACTERISTIC
/begin CHARACTERISTIC mHNKBH "Learning speed condition upper limit" VALUE 0x00008696 REC_UBYTE_C 0 COMP_0020 0 12750 /begin FUNCTION_LIST KF7-314.1F[1] KF7-500.20B[4] /end FUNCTION_LIST /end CHARACTERISTIC
/begin CHARACTERISTIC mHNKBL "Learning speed condition lower limit" VALUE 0x00008697 REC_UBYTE_C 0 COMP_0020 0 12750 /begin FUNCTION_LIST KF7-314.1F[1] KF7-500.20B[4] /end FUNCTION_LIST /end CHARACTERISTIC
/begin CHARACTERISTIC mHOSAFSH "HOSCMAX learning : learning region AFSHOS upper limit" VALUE 0x00008F08 REC_SWORD_C 0 COMP_0341_S -65.536 65.534 /begin FUNCTION_LIST KF7-313C.5[3] /end FUNCTION_LIST /end CHARACTERISTIC
/begin CHARACTERISTIC mHOSAFSL "HOSCMAX learning : learning region AFSHOS lower limit" VALUE 0x00008F0A REC_SWORD_C 0 COMP_0341_S -65.536 65.534 /begin FUNCTION_LIST KF7-313C.5[3] /end FUNCTION_LIST /end CHARACTERISTIC
/begin CHARACTERISTIC mHOSHONT "HOSCMAX learning : the rest O2 heater on delay" VALUE 0x00008699 REC_UBYTE_C 0 COMP_0008 0 25500 /begin FUNCTION_LIST KF7-313C.5[3] /end FUNCTION_LIST /end CHARACTERISTIC
/begin CHARACTERISTIC mHOSLTM "HOSCMAX learning : learning permission condition judgement delay" VALUE 0x0000869A REC_UBYTE_C 0 COMP_0008 0 25500 /begin FUNCTION_LIST KF7-313C.5[3] /end FUNCTION_LIST /end CHARACTERISTIC
/begin CHARACTERISTIC mHOSNH "HOSCMAX learning : learning region speed upper limit" VALUE 0x0000869B REC_UBYTE_C 0 COMP_0000 0 6375 /begin FUNCTION_LIST KF7-313C.5[3] /end FUNCTION_LIST /end CHARACTERISTIC
/begin CHARACTERISTIC mHOSNL "HOSCMAX learning : learning region speed lower limit" VALUE 0x0000869C REC_UBYTE_C 0 COMP_0000 0 6375 /begin FUNCTION_LIST KF7-313C.5[3] /end FUNCTION_LIST /end CHARACTERISTIC
/begin CHARACTERISTIC mHOSTPH "Learning region TP upper limit" VALUE 0x0000869D REC_UBYTE_C 0 COMP_0001 0 31.875 /begin FUNCTION_LIST KF7-313C.5[3] /end FUNCTION_LIST /end CHARACTERISTIC
/begin CHARACTERISTIC mHOSTPL "Learning region TP lower limit" VALUE 0x0000869E REC_UBYTE_C 0 COMP_0001 0 31.875 /begin FUNCTION_LIST KF7-313C.5[3] /end FUNCTION_LIST /end CHARACTERISTIC
/begin CHARACTERISTIC mHOSWLRC "HOSCMAX learning : learning region coolant temperature lower limit" VALUE 0x0000869F REC_UBYTE_C 0 COMP_0035 -50 205 /begin FUNCTION_LIST KF7-313C.5[3] /end FUNCTION_LIST /end CHARACTERISTIC
/begin CHARACTERISTIC mHOSWLRH "HOSCMAX learning : learning region coolant temperature upper limit" VALUE 0x000086A0 REC_UBYTE_C 0 COMP_0035 -50 205 /begin FUNCTION_LIST KF7-313C.5[3] /end FUNCTION_LIST /end CHARACTERISTIC
/begin CHARACTERISTIC mHSOSQH "At the time of the hot restart, HSOSQ initial value" VALUE 0x000096BC REC_SLONG_C 0 COMP_0094_S -21474836.48 21474836.47 /begin FUNCTION_LIST KF7-313C.7[1] /end FUNCTION_LIST /end CHARACTERISTIC
/begin CHARACTERISTIC mHSOSQL "At the time of the cold start, HSOSQ initial value" VALUE 0x000096C0 REC_SLONG_C 0 COMP_0094_S -21474836.48 21474836.47 /begin FUNCTION_LIST KF7-313C.7[1] /end FUNCTION_LIST /end CHARACTERISTIC
/begin CHARACTERISTIC mHTRPMH "At the time of the high exhaust temperature, rich-ization control condition upper limit engine speed" VALUE 0x000086A5 REC_UBYTE_C 0 COMP_0000 0 6375 /begin FUNCTION_LIST KF7-313C.6[5] /end FUNCTION_LIST /end CHARACTERISTIC
/begin CHARACTERISTIC mHTTWNH "At the time of the high exhaust temperature, rich-ization control condition upper limit coolant temperature" VALUE 0x000086A6 REC_UBYTE_C 0 COMP_0035 -50 205 /begin FUNCTION_LIST KF7-313C.6[5] /end FUNCTION_LIST /end CHARACTERISTIC
/begin CHARACTERISTIC mHTVSPH "At the time of the high exhaust temperature, rich-ization control condition upper limit vehicle speed" VALUE 0x000086A7 REC_UBYTE_C 0 COMP_0007 0 510 /begin FUNCTION_LIST KF7-313C.6[5] /end FUNCTION_LIST /end CHARACTERISTIC
/begin CHARACTERISTIC mICAT "ALPCAT I-gain" VALUE 0x000086D1 REC_UBYTE_C 0 COMP_0031 0 0.99609375 /begin FUNCTION_LIST KF7-313C.9[3] /end FUNCTION_LIST /end CHARACTERISTIC
/begin CHARACTERISTIC mICATL "ALPCAT LEAN I-gain" VALUE 0x000086D2 REC_UBYTE_C 0 COMP_0031 0 0.99609375 /begin FUNCTION_LIST KF7-313C.9[3] /end FUNCTION_LIST /end CHARACTERISTIC
/begin CHARACTERISTIC mICATR "ALPCAT RICH I-gain" VALUE 0x000086D3 REC_UBYTE_C 0 COMP_0031 0 0.99609375 /begin FUNCTION_LIST KF7-313C.9[3] /end FUNCTION_LIST /end CHARACTERISTIC
/begin CHARACTERISTIC mIDLLDY "At the time of the idle, a purge cut delay for learning" VALUE 0x000086F2 REC_UBYTE_C 0 COMP_0267_S 0 25.5 /begin FUNCTION_LIST KF7-314.1F[1] /end FUNCTION_LIST /end CHARACTERISTIC
/begin CHARACTERISTIC mIDLLPR "At the time of idle learning, purge rate" VALUE 0x000086F3 REC_UBYTE_C 0 COMP_0027 0 255 /begin FUNCTION_LIST KF7-314.1F[1] /end FUNCTION_LIST /end CHARACTERISTIC
/begin CHARACTERISTIC mIDLLVSP "Idle learning permission vehicle speed upper limit" VALUE 0x000086F4 REC_UBYTE_C 0 COMP_0007 0 510 /begin FUNCTION_LIST KF7-314.1F[1] /end FUNCTION_LIST /end CHARACTERISTIC
/begin CHARACTERISTIC mJUGRAC "Activated judgement inside ÉCÉìÉsÅ[É_ÉìÉX" VALUE 0x00009316 REC_UWORD_C 0 COMP_0415_S 0 4095.9375 /begin FUNCTION_LIST KF7-313C.2[4] /end FUNCTION_LIST /end CHARACTERISTIC
/begin CHARACTERISTIC mKBLB "KBLRCB renewal value" VALUE 0x00008784 REC_UBYTE_C 0 COMP_0031 0 0.99609375 /begin FUNCTION_LIST KF7-314.1F[1] /end FUNCTION_LIST /end CHARACTERISTIC
/begin CHARACTERISTIC mKBLBH "KBLRCB renewal value 2" VALUE 0x00008785 REC_UBYTE_C 0 COMP_0163 0 15.9375 /begin FUNCTION_LIST KF7-314.1F[1] /end FUNCTION_LIST /end CHARACTERISTIC
/begin CHARACTERISTIC mKBLGH "KBLRCB learning start MR deviation LEAN side" VALUE 0x00008788 REC_UBYTE_C 0 COMP_0027 0 255 /begin FUNCTION_LIST KF7-314.1F[1] /end FUNCTION_LIST /end CHARACTERISTIC
/begin CHARACTERISTIC mKBLGL "KBLRCB learning start MR deviation RICH side" VALUE 0x00008789 REC_UBYTE_C 0 COMP_0027 0 255 /begin FUNCTION_LIST KF7-314.1F[1] /end FUNCTION_LIST /end CHARACTERISTIC
/begin CHARACTERISTIC mKBLHMN "A/F sensor shift compensation lower limit value" VALUE 0x00008F16 REC_SWORD_C 0 COMP_0341_S -65.536 65.534 /begin FUNCTION_LIST KF7-314.1F[1] /end FUNCTION_LIST /end CHARACTERISTIC
/begin CHARACTERISTIC mKBLHMX "A/F sensor shift compensation upper limit value" VALUE 0x00008F18 REC_SWORD_C 0 COMP_0341_S -65.536 65.534 /begin FUNCTION_LIST KF7-314.1F[1] /end FUNCTION_LIST /end CHARACTERISTIC
/begin CHARACTERISTIC mKTRTD1 "A high intake air temperature retard low rotation side gain" VALUE 0x000087ED REC_UBYTE_C 0 COMP_0119_S 0 3.984375 /begin FUNCTION_LIST KF7-320A.9[9] /end FUNCTION_LIST /end CHARACTERISTIC
/begin CHARACTERISTIC mKTRTD2 "A high intake air temperature retard high rotation side gain" VALUE 0x000087EE REC_UBYTE_C 0 COMP_0119_S 0 3.984375 /begin FUNCTION_LIST KF7-320A.9[9] /end FUNCTION_LIST /end CHARACTERISTIC
/begin CHARACTERISTIC mKVADJMN "Lambda point compensation value lower limit" VALUE 0x00008F1A REC_SWORD_C 0 COMP_0353 -163840 163835 /begin FUNCTION_LIST KF7-313C.3[1] /end FUNCTION_LIST /end CHARACTERISTIC
/begin CHARACTERISTIC mKVADJMX "Lambda point compensation value upper limit" VALUE 0x00008F1C REC_SWORD_C 0 COMP_0353 -163840 163835 /begin FUNCTION_LIST KF7-313C.3[1] /end FUNCTION_LIST /end CHARACTERISTIC
/begin CHARACTERISTIC mLHNES "NE lattice hysteresis" VALUE 0x00008812 REC_UBYTE_C 0 COMP_0006 0 3187.5 /begin FUNCTION_LIST KF7-314.1F[1] /end FUNCTION_LIST /end CHARACTERISTIC
/begin CHARACTERISTIC mLHTP "TP lattice hysteresis" VALUE 0x00008813 REC_UBYTE_C 0 COMP_0001 0 31.875 /begin FUNCTION_LIST KF7-314.1F[1] /end FUNCTION_LIST /end CHARACTERISTIC
/begin CHARACTERISTIC mLKBRA "Lean side KBLRCA whole area reflection lower limit" VALUE 0x00008815 REC_UBYTE_C 0 COMP_0027 0 255 /begin FUNCTION_LIST KF7-314.1F[1] /end FUNCTION_LIST /end CHARACTERISTIC
/begin CHARACTERISTIC mLKBRBA "Lean side KBLRCA whole area reflection KBLRCB lower limit" VALUE 0x00008816 REC_UBYTE_C 0 COMP_0027 0 255 /begin FUNCTION_LIST KF7-314.1F[1] /end FUNCTION_LIST /end CHARACTERISTIC
/begin CHARACTERISTIC mLSOSQH "At the time of the hot restart, LSOSQ initial value" VALUE 0x000096E0 REC_SLONG_C 0 COMP_0094_S -21474836.48 21474836.47 /begin FUNCTION_LIST KF7-313C.7[1] /end FUNCTION_LIST /end CHARACTERISTIC
/begin CHARACTERISTIC mLSOSQL "At the time of the cold start, LSOSQ initial value" VALUE 0x000096E4 REC_SLONG_C 0 COMP_0094_S -21474836.48 21474836.47 /begin FUNCTION_LIST KF7-313C.7[1] /end FUNCTION_LIST /end CHARACTERISTIC
/begin CHARACTERISTIC mMBTM "Ignition timing main constant" VALUE 0x0000883B REC_UBYTE_C 0 COMP_0248 0 0.99609375 /begin FUNCTION_LIST KF7-320A.8[2] /end FUNCTION_LIST /end CHARACTERISTIC
/begin CHARACTERISTIC mMBTT "War way speed weight constant" VALUE 0x0000883C REC_UBYTE_C 0 COMP_0244_S 0 0.000031875 /begin FUNCTION_LIST KF7-320A.8[2] /end FUNCTION_LIST /end CHARACTERISTIC
/begin CHARACTERISTIC mMKADV "Minus KTW compensation advance rate" VALUE 0x00008858 REC_UBYTE_C 0 COMP_0254 0 15.9375 /begin FUNCTION_LIST KF7-320A.14[1] /end FUNCTION_LIST /end CHARACTERISTIC
/begin CHARACTERISTIC mMKCNG3 "Minus KTW section compensation rate 3 (advance compensation)" VALUE 0x0000885A REC_UBYTE_C 0 COMP_0255 0 31.875 /begin FUNCTION_LIST KF7-320A.14[1] /end FUNCTION_LIST /end CHARACTERISTIC
/begin CHARACTERISTIC mMNRRO2 "RROFMT condition lower limit" VALUE 0x00008862 REC_UBYTE_C 0 COMP_0049 0 255 /begin FUNCTION_LIST KF7-313C.9[3] /end FUNCTION_LIST /end CHARACTERISTIC
/begin CHARACTERISTIC mNADVAJH "Ignition adjustment value upper limit speed" VALUE 0x0000887F REC_UBYTE_C 0 COMP_0000 0 6375 /begin FUNCTION_LIST KF7-320A.4[6] R301.23.ADV_calculation_1_1_2 /end FUNCTION_LIST /end CHARACTERISTIC
/begin CHARACTERISTIC mNADVAJL "Ignition adjustment value lower limit speed" VALUE 0x00008880 REC_UBYTE_C 0 COMP_0000 0 6375 /begin FUNCTION_LIST KF7-320A.4[6] R301.23.ADV_calculation_1_1_2 /end FUNCTION_LIST /end CHARACTERISTIC
/begin CHARACTERISTIC mNCHKC "Estimated learning region judgement speed" VALUE 0x0000888A REC_UBYTE_C 0 COMP_0020 0 12750 /begin FUNCTION_LIST KF7-320A.9[9] KF7-379.2[1] /end FUNCTION_LIST /end CHARACTERISTIC
/begin CHARACTERISTIC mNPSMP "Estimated learning permission counter" VALUE 0x000088DA REC_UBYTE_C 0 COMP_0004 0 255 /begin FUNCTION_LIST KF7-314.1F[1] /end FUNCTION_LIST /end CHARACTERISTIC
/begin CHARACTERISTIC mNPSMP0 "The first estimated learning permission counter" VALUE 0x000088DB REC_UBYTE_C 0 COMP_0004 0 255 /begin FUNCTION_LIST KF7-314.1F[1] /end FUNCTION_LIST /end CHARACTERISTIC
/begin CHARACTERISTIC mNTARTD "A high intake air temperature retard rotation threshold" VALUE 0x000088FC REC_UBYTE_C 0 COMP_0020 0 12750 /begin FUNCTION_LIST KF7-320A.9[9] /end FUNCTION_LIST /end CHARACTERISTIC
/begin CHARACTERISTIC mOSCDL1 "A/F sensor shift compensation learning : OSC control start judgement delay" VALUE 0x00008952 REC_UBYTE_C 0 COMP_0008 0 25500 /begin FUNCTION_LIST KF7-313C.4[3] /end FUNCTION_LIST /end CHARACTERISTIC
/begin CHARACTERISTIC mOSCDL2 "A/F sensor shift compensation learning : F/C completion judgement delay" VALUE 0x00008953 REC_UBYTE_C 0 COMP_0008 0 25500 /begin FUNCTION_LIST KF7-313C.4[3] /end FUNCTION_LIST /end CHARACTERISTIC
/begin CHARACTERISTIC mOSCDL3 "HOSCMAX learning : OSC control start judgement delay" VALUE 0x00008954 REC_UBYTE_C 0 COMP_0008 0 25500 /begin FUNCTION_LIST KF7-313C.5[3] /end FUNCTION_LIST /end CHARACTERISTIC
/begin CHARACTERISTIC mOSCDL4 "HOSCMAX learning : F/C completion judgement delay" VALUE 0x00008955 REC_UBYTE_C 0 COMP_0008 0 25500 /begin FUNCTION_LIST KF7-313C.5[3] /end FUNCTION_LIST /end CHARACTERISTIC
/begin CHARACTERISTIC mOSCIDLTH "Idle continuation time" VALUE 0x00008956 REC_UBYTE_C 0 COMP_0049 0 255 /begin FUNCTION_LIST KF7-313C.4[3] /end FUNCTION_LIST /end CHARACTERISTIC
/begin CHARACTERISTIC mOSCNH "A/F sensor shift compensation learning : learning region speed upper limit" VALUE 0x00008959 REC_UBYTE_C 0 COMP_0000 0 6375 /begin FUNCTION_LIST KF7-313C.4[3] /end FUNCTION_LIST /end CHARACTERISTIC
/begin CHARACTERISTIC mOSCNH2 "Idle judgement speed upper limit" VALUE 0x0000895A REC_UBYTE_C 0 COMP_0000 0 6375 /begin FUNCTION_LIST KF7-313C.4[3] /end FUNCTION_LIST /end CHARACTERISTIC
/begin CHARACTERISTIC mOSCNL "A/F sensor shift compensation learning : learning region speed lower limit" VALUE 0x0000895B REC_UBYTE_C 0 COMP_0000 0 6375 /begin FUNCTION_LIST KF7-313C.4[3] /end FUNCTION_LIST /end CHARACTERISTIC
/begin CHARACTERISTIC mOSCNL2 "Idle judgement speed lower limit" VALUE 0x0000895C REC_UBYTE_C 0 COMP_0000 0 6375 /begin FUNCTION_LIST KF7-313C.4[3] /end FUNCTION_LIST /end CHARACTERISTIC
/begin CHARACTERISTIC mOSCTPH "A/F sensor shift compensation learning : learning region TP upper limit" VALUE 0x00008961 REC_UBYTE_C 0 COMP_0001 0 31.875 /begin FUNCTION_LIST KF7-313C.4[3] /end FUNCTION_LIST /end CHARACTERISTIC
/begin CHARACTERISTIC mOSCTPL "A/F sensor shift compensation learning : learning region TP lower limit" VALUE 0x00008962 REC_UBYTE_C 0 COMP_0001 0 31.875 /begin FUNCTION_LIST KF7-313C.4[3] /end FUNCTION_LIST /end CHARACTERISTIC
/begin CHARACTERISTIC mOSCWLRC "A/F sensor shift compensation learning : learning region coolant temperature lower limit" VALUE 0x00008963 REC_UBYTE_C 0 COMP_0035 -50 205 /begin FUNCTION_LIST KF7-313C.4[3] /end FUNCTION_LIST /end CHARACTERISTIC
/begin CHARACTERISTIC mOSCWLRH "A/F sensor shift compensation learning : learning region coolant temperature upper limit" VALUE 0x00008964 REC_UBYTE_C 0 COMP_0035 -50 205 /begin FUNCTION_LIST KF7-313C.4[3] /end FUNCTION_LIST /end CHARACTERISTIC
/begin CHARACTERISTIC mPCATLR "ALPCAT LEAN P-gain" VALUE 0x00008980 REC_UBYTE_C 0 COMP_0163 0 15.9375 /begin FUNCTION_LIST KF7-313C.9[3] /end FUNCTION_LIST /end CHARACTERISTIC
/begin CHARACTERISTIC mPCATRL "ALPCAT RICH P-gain" VALUE 0x00008981 REC_UBYTE_C 0 COMP_0163 0 15.9375 /begin FUNCTION_LIST KF7-313C.9[3] /end FUNCTION_LIST /end CHARACTERISTIC
/begin CHARACTERISTIC mQHTMP "A high exhaust temperature lambda control judgement QM" VALUE 0x00008A06 REC_UBYTE_C 0 COMP_0159 0 65280 /begin FUNCTION_LIST KF7-313C.6[5] /end FUNCTION_LIST /end CHARACTERISTIC
/begin CHARACTERISTIC mRESTOS "HSOSQ, LSOSQ initial ílêÿÇË are changed, judgement time" VALUE 0x00008A44 REC_UBYTE_C 0 COMP_0014 0 2550 /begin FUNCTION_LIST KF7-313C.7[1] /end FUNCTION_LIST /end CHARACTERISTIC
/begin CHARACTERISTIC mRFBKRO "Rest O2 sensor smoothing constant" VALUE 0x00008A5F REC_UBYTE_C 0 COMP_0044 0 1.9921875 /begin FUNCTION_LIST KF7-313C.9[3] /end FUNCTION_LIST /end CHARACTERISTIC
/begin CHARACTERISTIC mRFBSLH "The rest O2 slice level LR" VALUE 0x00008A62 REC_UBYTE_C 0 COMP_0104 0 2550 /begin FUNCTION_LIST KF7-313C.9[3] /end FUNCTION_LIST /end CHARACTERISTIC
/begin CHARACTERISTIC mRFBSLL "The rest O2 slice level RL" VALUE 0x00008A63 REC_UBYTE_C 0 COMP_0104 0 2550 /begin FUNCTION_LIST KF7-313C.9[3] /end FUNCTION_LIST /end CHARACTERISTIC
/begin CHARACTERISTIC mRFO2GO "RrO2/S F/B permission delay" VALUE 0x00008A6D REC_UBYTE_C 0 COMP_0013 0 255 /begin FUNCTION_LIST KF7-313C.9[3] KF7-500.24[10] /end FUNCTION_LIST /end CHARACTERISTIC
/begin CHARACTERISTIC mRFO2SH "The rest O2 slice level LR" VALUE 0x00008A6E REC_UBYTE_C 0 COMP_0104 0 2550 /begin FUNCTION_LIST KF7-313C.9[3] /end FUNCTION_LIST /end CHARACTERISTIC
/begin CHARACTERISTIC mRFO2SL "The rest O2 slice level RL" VALUE 0x00008A6F REC_UBYTE_C 0 COMP_0104 0 2550 /begin FUNCTION_LIST KF7-313C.9[3] /end FUNCTION_LIST /end CHARACTERISTIC
/begin CHARACTERISTIC mRKBRA "Rich side KBLRCA whole area reflection lower limit" VALUE 0x00008A9F REC_UBYTE_C 0 COMP_0027 0 255 /begin FUNCTION_LIST KF7-314.1F[1] /end FUNCTION_LIST /end CHARACTERISTIC
/begin CHARACTERISTIC mRKBRBA "Rich side KBLRCA whole area reflection KBLRCB lower limit" VALUE 0x00008AA0 REC_UBYTE_C 0 COMP_0027 0 255 /begin FUNCTION_LIST KF7-314.1F[1] /end FUNCTION_LIST /end CHARACTERISTIC
/begin CHARACTERISTIC mRLRC0 "At the time of the first learning, gain" VALUE 0x00008AA6 REC_UBYTE_C 0 COMP_0021 0 99.609375 /begin FUNCTION_LIST KF7-314.1F[1] /end FUNCTION_LIST /end CHARACTERISTIC
/begin CHARACTERISTIC mRLRMNS "Learning value lower limit value" VALUE 0x00008AA7 REC_UBYTE_C 0 COMP_0027 0 255 /begin FUNCTION_LIST KF7-314.1F[1] /end FUNCTION_LIST /end CHARACTERISTIC
/begin CHARACTERISTIC mRLRMXS "Learning value upper limit value" VALUE 0x00008AA8 REC_UBYTE_C 0 COMP_0027 0 255 /begin FUNCTION_LIST KF7-314.1F[1] /end FUNCTION_LIST /end CHARACTERISTIC
/begin CHARACTERISTIC mSCKDLY "Control start delay time" VALUE 0x00008AE8 REC_UBYTE_C 0 COMP_0014 0 2550 /begin FUNCTION_LIST KF7-320A.2[3] R301.23.ADV_calculation_1_1_2 /end FUNCTION_LIST /end CHARACTERISTIC
/begin CHARACTERISTIC mSCKLUDLY "LU judgement delay" VALUE 0x00008AF2 REC_UBYTE_C 0 COMP_0014 0 2550 /begin FUNCTION_LIST KF7-320A.2[3] R301.23.ADV_calculation_1_1_2 /end FUNCTION_LIST /end CHARACTERISTIC
/begin CHARACTERISTIC mSCKOWCNE "ONC non-conclusion judgement speed" VALUE 0x000094F4 REC_UWORD_C 0 COMP_0065 0 204796.875 /begin FUNCTION_LIST KF7-320A.2[3] R301.23.ADV_calculation_1_1_2 /end FUNCTION_LIST /end CHARACTERISTIC
/begin CHARACTERISTIC mSCKRETTM "Re-acceleration shock retard time" VALUE 0x00008AF3 REC_UBYTE_C 0 COMP_0014 0 2550 /begin FUNCTION_LIST KF7-320A.2[3] R301.23.ADV_calculation_1_1_2 /end FUNCTION_LIST /end CHARACTERISTIC
/begin CHARACTERISTIC mSCKVAPO "Control permission VAPO condition" VALUE 0x000094F6 REC_UWORD_C 0 COMP_0005 0 7208.85 /begin FUNCTION_LIST KF7-320A.2[3] R301.23.ADV_calculation_1_1_2 /end FUNCTION_LIST /end CHARACTERISTIC
/begin CHARACTERISTIC mSCKVSP "Control permission vehicle speed condition" VALUE 0x00008AF4 REC_UBYTE_C 0 COMP_0007 0 510 /begin FUNCTION_LIST KF7-320A.2[3] R301.23.ADV_calculation_1_1_2 /end FUNCTION_LIST /end CHARACTERISTIC
/begin CHARACTERISTIC mSESSTL "A/F sensor activated judgement S/L (lean side)" VALUE 0x000094FC REC_UWORD_C 0 COMP_0061 0 327675 /begin FUNCTION_LIST KF7-313C.2[4] /end FUNCTION_LIST /end CHARACTERISTIC
/begin CHARACTERISTIC mSESSTR "A/F sensor activated judgement S/L (rich side)" VALUE 0x000094FE REC_UWORD_C 0 COMP_0061 0 327675 /begin FUNCTION_LIST KF7-313C.2[4] /end FUNCTION_LIST /end CHARACTERISTIC
/begin CHARACTERISTIC mSTUG "STRAG unit coefficient" VALUE 0x00008B4A REC_UBYTE_C 0 COMP_0092 0 255 /begin FUNCTION_LIST KF7-313C.9[3] KF7-500.21[19] R904.1.Gst_on_can_1_0_1 /end FUNCTION_LIST /end CHARACTERISTIC
/begin CHARACTERISTIC mTAOFST "A high intake air temperature retard reference intake air temperature" VALUE 0x00008B81 REC_UBYTE_C 0 COMP_0035 -50 205 /begin FUNCTION_LIST KF7-320A.9[9] /end FUNCTION_LIST /end CHARACTERISTIC
/begin CHARACTERISTIC mTARTDMX "High intake air temperature retard maximum value" VALUE 0x00008B84 REC_UBYTE_C 0 COMP_0017 0 255 /begin FUNCTION_LIST KF7-320A.9[9] /end FUNCTION_LIST /end CHARACTERISTIC
/begin CHARACTERISTIC mTARTTAL "A high intake air temperature retard permission intake air temperature" VALUE 0x00008B85 REC_UBYTE_C 0 COMP_0035 -50 205 /begin FUNCTION_LIST KF7-320A.9[9] /end FUNCTION_LIST /end CHARACTERISTIC
/begin CHARACTERISTIC mTAU0 "Ignition delay time" VALUE 0x00008B8B REC_UBYTE_C 0 COMP_0262_S 0 4.9804815 /begin FUNCTION_LIST KF7-320A.8[2] /end FUNCTION_LIST /end CHARACTERISTIC
/begin CHARACTERISTIC mTCATK1H "IGN SW At the time of off, catalyst estimated temperature lower limit" VALUE 0x00008B92 REC_UBYTE_C 0 COMP_0062 0 1020 /begin FUNCTION_LIST KF7-313C.7[1] /end FUNCTION_LIST /end CHARACTERISTIC
/begin CHARACTERISTIC mTDSTAF1 "A/F sensor activated judgement delay time 1" VALUE 0x00008BA3 REC_UBYTE_C 0 COMP_0014 0 2550 /begin FUNCTION_LIST KF7-313C.2[4] /end FUNCTION_LIST /end CHARACTERISTIC
/begin CHARACTERISTIC mTDSTAF2 "A/F sensor activated judgement delay time 2" VALUE 0x00008BA4 REC_UBYTE_C 0 COMP_0013 0 255 /begin FUNCTION_LIST KF7-313C.2[4] /end FUNCTION_LIST /end CHARACTERISTIC
/begin CHARACTERISTIC mTDWLMAX "Dwell upper limit value" VALUE 0x00008BA7 REC_UBYTE_C 0 COMP_0017 0 255 /begin FUNCTION_LIST KF7-320A.6[3] KF7-320A.21[N] /end FUNCTION_LIST /end CHARACTERISTIC
/begin CHARACTERISTIC mTDWLMIN "Dwell lower limit value" VALUE 0x00008BA8 REC_UBYTE_C 0 COMP_0017 0 255 /begin FUNCTION_LIST KF7-320A.6[3] KF7-320A.21[N] /end FUNCTION_LIST /end CHARACTERISTIC
/begin CHARACTERISTIC mTHBLBY "BLBYC judgement reference" VALUE 0x00008BDC REC_UBYTE_C 0 COMP_0016 0 255 /begin FUNCTION_LIST KF7-314.1F[1] /end FUNCTION_LIST /end CHARACTERISTIC
/begin CHARACTERISTIC mTHBLTW "At the time of the start, BLBYC judgement coolant temperature condition" VALUE 0x00008BDD REC_UBYTE_C 0 COMP_0035 -50 205 /begin FUNCTION_LIST KF7-314.1F[1] /end FUNCTION_LIST /end CHARACTERISTIC
/begin CHARACTERISTIC mTLKBRA "Lean side KBLRCA whole area reflection condition judgement time" VALUE 0x00008C08 REC_UBYTE_C 0 COMP_0049 0 255 /begin FUNCTION_LIST KF7-314.1F[1] /end FUNCTION_LIST /end CHARACTERISTIC
/begin CHARACTERISTIC mTMADJM1 "Lambda point compensation delay time 1" VALUE 0x00008C0D REC_UBYTE_C 0 COMP_0014 0 2550 /begin FUNCTION_LIST KF7-313C.3[1] /end FUNCTION_LIST /end CHARACTERISTIC
/begin CHARACTERISTIC mTMNOACT "Activated judgement release judgement delay time" VALUE 0x00008C60 REC_UBYTE_C 0 COMP_0013 0 255 /begin FUNCTION_LIST KF7-313C.2[4] /end FUNCTION_LIST /end CHARACTERISTIC
/begin CHARACTERISTIC mTMPIST "Ignition timing F/B PI control time" VALUE 0x00008C6B REC_UBYTE_C 0 COMP_0013 0 255 /begin FUNCTION_LIST KF7-320A.10[14] KF7-390.3A[15] /end FUNCTION_LIST /end CHARACTERISTIC
/begin CHARACTERISTIC mTPCHK "Estimated learning region judgement TP" VALUE 0x00008CC5 REC_UBYTE_C 0 COMP_0001 0 31.875 /begin FUNCTION_LIST KF7-320A.9[9] KF7-379.2[1] /end FUNCTION_LIST /end CHARACTERISTIC
/begin CHARACTERISTIC mTPKBH "Learning TP condition upper limit" VALUE 0x00008CD3 REC_UBYTE_C 0 COMP_0001 0 31.875 /begin FUNCTION_LIST KF7-314.1F[1] KF7-500.20B[4] /end FUNCTION_LIST /end CHARACTERISTIC
/begin CHARACTERISTIC mTPKBL "Learning TP condition lower limit" VALUE 0x00008CD4 REC_UBYTE_C 0 COMP_0001 0 31.875 /begin FUNCTION_LIST KF7-314.1F[1] KF7-500.20B[4] /end FUNCTION_LIST /end CHARACTERISTIC
/begin CHARACTERISTIC mTRKBRA "Rich side KBLRCA whole area reflection condition judgement time" VALUE 0x00008CEA REC_UBYTE_C 0 COMP_0049 0 255 /begin FUNCTION_LIST KF7-314.1F[1] /end FUNCTION_LIST /end CHARACTERISTIC
/begin CHARACTERISTIC mTWIKB "When learning starts, coolant temperature condition lower limit" VALUE 0x00008D32 REC_UBYTE_C 0 COMP_0035 -50 205 /begin FUNCTION_LIST KF7-314.1F[1] KF7-500.20B[4] /end FUNCTION_LIST /end CHARACTERISTIC
/begin CHARACTERISTIC mTWKBH "Learning coolant temperature condition upper limit" VALUE 0x00008D3E REC_UBYTE_C 0 COMP_0035 -50 205 /begin FUNCTION_LIST KF7-314.1F[1] KF7-500.20B[4] /end FUNCTION_LIST /end CHARACTERISTIC
/begin CHARACTERISTIC mTWKBL "Learning coolant temperature condition lower limit" VALUE 0x00008D3F REC_UBYTE_C 0 COMP_0035 -50 205 /begin FUNCTION_LIST KF7-314.1F[1] KF7-500.20B[4] /end FUNCTION_LIST /end CHARACTERISTIC
/begin CHARACTERISTIC mTWLRC "Learning start coolant temperature" VALUE 0x00008D46 REC_UBYTE_C 0 COMP_0035 -50 205 /begin FUNCTION_LIST KF7-314.1F[1] /end FUNCTION_LIST /end CHARACTERISTIC
/begin CHARACTERISTIC mTWNDKOH "At the time of IGN SW ON, off, coolant temperature difference upper limit" VALUE 0x00008D4D REC_UBYTE_C 0 COMP_0003 0 255 /begin FUNCTION_LIST KF7-313C.7[1] /end FUNCTION_LIST /end CHARACTERISTIC
/begin CHARACTERISTIC mTWNK1H "IGN SW At the time of off, coolant temperature lower limit" VALUE 0x00008D53 REC_UBYTE_C 0 COMP_0035 -50 205 /begin FUNCTION_LIST KF7-313C.7[1] /end FUNCTION_LIST /end CHARACTERISTIC
/begin CHARACTERISTIC mTWVTSLH "VTC target angle computed map switching coolant temperature HIGH side" VALUE 0x00008D76 REC_UBYTE_C 0 COMP_0035 -50 205 /begin FUNCTION_LIST KF7-320A.9[9] KF7-393.1C[8] /end FUNCTION_LIST /end CHARACTERISTIC
/begin CHARACTERISTIC mTWVTSLL "VTC target angle computed map switching coolant temperature LOW side" VALUE 0x00008D77 REC_UBYTE_C 0 COMP_0035 -50 205 /begin FUNCTION_LIST KF7-320A.9[9] KF7-320A.22[5] KF7-393.1C[8] /end FUNCTION_LIST /end CHARACTERISTIC
/begin CHARACTERISTIC mVADJOK "Lambda point compensation practice VB lower limit" VALUE 0x0000964C REC_UWORD_C 0 COMP_0033 0 5242800 /begin FUNCTION_LIST KF7-313C.3[1] /end FUNCTION_LIST /end CHARACTERISTIC
/begin CHARACTERISTIC mVBDWL "Dwell VB coefficient" VALUE 0x00009650 REC_UWORD_C 0 COMP_0265_S 0 8388480 /begin FUNCTION_LIST KF7-320A.6[3] KF7-320A.21[N] /end FUNCTION_LIST /end CHARACTERISTIC
/begin CHARACTERISTIC mVSKBLB "Learning vehicle speed condition lower limit" VALUE 0x00008DFB REC_UBYTE_C 0 COMP_0007 0 510 /begin FUNCTION_LIST KF7-314.1F[1] KF7-500.20B[4] /end FUNCTION_LIST /end CHARACTERISTIC
/begin CHARACTERISTIC mVSKBLH "Learning vehicle speed condition upper limit" VALUE 0x00008DFC REC_UBYTE_C 0 COMP_0007 0 510 /begin FUNCTION_LIST KF7-314.1F[1] KF7-500.20B[4] /end FUNCTION_LIST /end CHARACTERISTIC
/begin CHARACTERISTIC mMADVTRMC "Trimming-map low coolant temperature" MAP 0x0000993E REC_UBYTE_C 0 COMP_0245 -64 191
 /begin AXIS_DESCR COM_AXIS NO_INPUT_QUANTITY COMP_0020 16 0 12750 AXIS_PTS_REF mTADVTRSN /end AXIS_DESCR
 /begin AXIS_DESCR COM_AXIS NO_INPUT_QUANTITY COMP_0009 16 0 199.21875 AXIS_PTS_REF mTADVTRSI /end AXIS_DESCR
 /begin FUNCTION_LIST KF7-320A.9[9] R301.2.MapBreakpoint_1_1_2 /end FUNCTION_LIST
/end CHARACTERISTIC
/begin CHARACTERISTIC mMADVTRMH "Trimming-map high-octane" MAP 0x00009A3E REC_UBYTE_C 0 COMP_0245 -64 191
 /begin AXIS_DESCR COM_AXIS NO_INPUT_QUANTITY COMP_0020 16 0 12750 AXIS_PTS_REF mTADVTRSN /end AXIS_DESCR
 /begin AXIS_DESCR COM_AXIS NO_INPUT_QUANTITY COMP_0009 16 0 199.21875 AXIS_PTS_REF mTADVTRSI /end AXIS_DESCR
 /begin FUNCTION_LIST KF7-320A.9[9] KF7-379.2[1] KF7-379.5[3] R301.2.MapBreakpoint_1_1_2 /end FUNCTION_LIST
/end CHARACTERISTIC
/begin CHARACTERISTIC mMADVTRMR "Trimming-map regular" MAP 0x00009B3E REC_UBYTE_C 0 COMP_0245 -64 191
 /begin AXIS_DESCR COM_AXIS NO_INPUT_QUANTITY COMP_0020 16 0 12750 AXIS_PTS_REF mTADVTRSN /end AXIS_DESCR
 /begin AXIS_DESCR COM_AXIS NO_INPUT_QUANTITY COMP_0009 16 0 199.21875 AXIS_PTS_REF mTADVTRSI /end AXIS_DESCR
 /begin FUNCTION_LIST KF7-320A.9[9] KF7-379.2[1] KF7-379.5[3] R301.2.MapBreakpoint_1_1_2 /end FUNCTION_LIST
/end CHARACTERISTIC
/begin CHARACTERISTIC mMFLML "Layer way flame speed basic map" MAP 0x00009D4E REC_UBYTE_C 0 COMP_0253 0 0.0159375
 /begin AXIS_DESCR COM_AXIS NO_INPUT_QUANTITY COMP_0020 4 0 12750 AXIS_PTS_REF mITANN /end AXIS_DESCR
 /begin AXIS_DESCR COM_AXIS NO_INPUT_QUANTITY COMP_0009 4 0 199.21875 AXIS_PTS_REF mITANI /end AXIS_DESCR
 /begin FUNCTION_LIST KF7-320A.8[2] /end FUNCTION_LIST
/end CHARACTERISTIC
/begin CHARACTERISTIC mTA5N "Intermadiate coolant temperature retard rotation compensation table" CURVE 0x0000CD86 REC_UBYTE_C 0 COMP_0032 0 0.99609375
 /begin AXIS_DESCR FIX_AXIS NO_INPUT_QUANTITY COMP_0271_S 16 0 6000 FIX_AXIS_PAR_DIST 0 1 16 /end AXIS_DESCR
 /begin FUNCTION_LIST KF7-320A.13[N] /end FUNCTION_LIST
/end CHARACTERISTIC
/begin CHARACTERISTIC mTA5TW "Intermadiate coolant temperature retard coolant temperature compensation table" CURVE 0x0000CD9E REC_UBYTE_C 0 COMP_0032 0 0.99609375
 /begin AXIS_DESCR FIX_AXIS NO_INPUT_QUANTITY COMP_0280_S 16 -40 110 FIX_AXIS_PAR_DIST 0 1 16 /end AXIS_DESCR
 /begin FUNCTION_LIST KF7-320A.13[N] /end FUNCTION_LIST
/end CHARACTERISTIC
/begin CHARACTERISTIC mTA5TP "Intermadiate coolant temperature retard basic value table" CURVE 0x0000CD96 REC_UBYTE_C 0 COMP_0017 0 255
 /begin AXIS_DESCR FIX_AXIS NO_INPUT_QUANTITY COMP_0122_S 8 0 14 FIX_AXIS_PAR_DIST 0 1 8 /end AXIS_DESCR
 /begin FUNCTION_LIST KF7-320A.13[N] /end FUNCTION_LIST
/end CHARACTERISTIC
/begin CHARACTERISTIC mTAVCD1 "ADVCD1 table (D range)" CURVE 0x0000CE2A REC_UBYTE_C 0 COMP_0017 0 255
 /begin AXIS_DESCR FIX_AXIS NO_INPUT_QUANTITY COMP_0278_S 8 -40 100 FIX_AXIS_PAR_DIST 0 1 8 /end AXIS_DESCR
 /begin FUNCTION_LIST KF7-320A.10[14] R301.25.GOV_idle_1_0_2 /end FUNCTION_LIST
/end CHARACTERISTIC
/begin CHARACTERISTIC mTAVCN1 "ADVCD1 table (N range)" CURVE 0x0000CE32 REC_UBYTE_C 0 COMP_0017 0 255
 /begin AXIS_DESCR FIX_AXIS NO_INPUT_QUANTITY COMP_0278_S 8 -40 100 FIX_AXIS_PAR_DIST 0 1 8 /end AXIS_DESCR
 /begin FUNCTION_LIST KF7-320A.10[14] R301.25.GOV_idle_1_0_2 /end FUNCTION_LIST
/end CHARACTERISTIC
/begin CHARACTERISTIC mTAVCNL "At the time of the lambda control, compensation value table" CURVE 0x0000CE3A REC_UBYTE_C 0 COMP_0017 0 255
 /begin AXIS_DESCR FIX_AXIS NO_INPUT_QUANTITY COMP_0278_S 8 -40 100 FIX_AXIS_PAR_DIST 0 1 8 /end AXIS_DESCR
 /begin FUNCTION_LIST KF7-320A.10[14] /end FUNCTION_LIST
/end CHARACTERISTIC
/begin CHARACTERISTIC mTAVCNS "At the time of the PI control, compensation value table" CURVE 0x0000CE42 REC_UBYTE_C 0 COMP_0017 0 255
 /begin AXIS_DESCR FIX_AXIS NO_INPUT_QUANTITY COMP_0278_S 8 -40 100 FIX_AXIS_PAR_DIST 0 1 8 /end AXIS_DESCR
 /begin FUNCTION_LIST KF7-320A.10[14] /end FUNCTION_LIST
/end CHARACTERISTIC
/begin CHARACTERISTIC mTDENS "An unburned gas density table" CURVE 0x0000CF6E REC_UBYTE_C 0 COMP_0303 0 31875
 /begin AXIS_DESCR FIX_AXIS NO_INPUT_QUANTITY COMP_0316_S 8 0 175 FIX_AXIS_PAR_DIST 0 1 8 /end AXIS_DESCR
 /begin FUNCTION_LIST KF7-320A.8[2] /end FUNCTION_LIST
/end CHARACTERISTIC
/begin CHARACTERISTIC mTDWLNE "Dwell speed 2/ three power table" CURVE 0x0000D02E REC_UBYTE_C 0 COMP_0057_S 0 510
 /begin AXIS_DESCR FIX_AXIS NO_INPUT_QUANTITY COMP_0318_S 8 0 11200 FIX_AXIS_PAR_DIST 0 1 8 /end AXIS_DESCR
 /begin FUNCTION_LIST KF7-320A.6[3] KF7-320A.21[N] /end FUNCTION_LIST
/end CHARACTERISTIC
/begin CHARACTERISTIC mTDWLVB "Dwell battery (-2/3) power table" CURVE 0x0000D036 REC_UBYTE_C 0 COMP_0319_S 0 0.3984375
 /begin AXIS_DESCR FIX_AXIS NO_INPUT_QUANTITY COMP_0320_S 8 0 17920 FIX_AXIS_PAR_DIST 0 1 8 /end AXIS_DESCR
 /begin FUNCTION_LIST KF7-320A.6[3] KF7-320A.21[N] /end FUNCTION_LIST
/end CHARACTERISTIC
/begin CHARACTERISTIC mTFLFA "Air-fuel ratio compensation table" CURVE 0x0000D0BE REC_UBYTE_C 0 COMP_0009 0 199.21875
 /begin AXIS_DESCR FIX_AXIS NO_INPUT_QUANTITY COMP_0323_S 8 0.5 1.375 FIX_AXIS_PAR_DIST 0 1 8 /end AXIS_DESCR
 /begin FUNCTION_LIST KF7-320A.8[2] /end FUNCTION_LIST
/end CHARACTERISTIC
/begin CHARACTERISTIC mTFLTW "Coolant temperature compensation table" CURVE 0x0000D0CE REC_UBYTE_C 0 COMP_0009 0 199.21875
 /begin AXIS_DESCR FIX_AXIS NO_INPUT_QUANTITY COMP_0278_S 8 -40 100 FIX_AXIS_PAR_DIST 0 1 8 /end AXIS_DESCR
 /begin FUNCTION_LIST KF7-320A.8[2] /end FUNCTION_LIST
/end CHARACTERISTIC
/begin CHARACTERISTIC mTGOV "GOV table" CURVE 0x0000D11E REC_UBYTE_C 0 COMP_0314 -128 127
 /begin AXIS_DESCR FIX_AXIS NO_INPUT_QUANTITY COMP_0271_S 8 0 2800 FIX_AXIS_PAR_DIST 0 1 8 /end AXIS_DESCR
 /begin FUNCTION_LIST KF7-320A.10[14] R301.25.GOV_idle_1_0_2 /end FUNCTION_LIST
/end CHARACTERISTIC
/begin CHARACTERISTIC mTGOV3 "GOV3 table" CURVE 0x0000D126 REC_UBYTE_C 0 COMP_0314 -128 127
 /begin AXIS_DESCR FIX_AXIS NO_INPUT_QUANTITY COMP_0271_S 8 0 2800 FIX_AXIS_PAR_DIST 0 1 8 /end AXIS_DESCR
 /begin FUNCTION_LIST KF7-320A.10[14] R301.25.GOV_idle_1_0_2 /end FUNCTION_LIST
/end CHARACTERISTIC
/begin CHARACTERISTIC mTGOVCLCH "At the time of the MT car clutch cutting, GOV table" CURVE 0x0000D12E REC_UBYTE_C 0 COMP_0517_S -128 127
 /begin AXIS_DESCR FIX_AXIS NO_INPUT_QUANTITY COMP_0312_S 8 0 5600 FIX_AXIS_PAR_DIST 0 1 8 /end AXIS_DESCR
 /begin FUNCTION_LIST KF7-320A.1[6] R301.23.ADV_calculation_1_1_2 /end FUNCTION_LIST
/end CHARACTERISTIC
/begin CHARACTERISTIC mTGOVL "GOV table (at the time of the lean)" CURVE 0x0000D136 REC_UBYTE_C 0 COMP_0314 -128 127
 /begin AXIS_DESCR FIX_AXIS NO_INPUT_QUANTITY COMP_0271_S 8 0 2800 FIX_AXIS_PAR_DIST 0 1 8 /end AXIS_DESCR
 /begin FUNCTION_LIST KF7-320A.10[14] R301.25.GOV_idle_1_0_2 /end FUNCTION_LIST
/end CHARACTERISTIC
/begin CHARACTERISTIC mTMKAVN "Minus KTW compensation advance rate table (rotation)" CURVE 0x0000D570 REC_UBYTE_C 0 COMP_0044 0 1.9921875
 /begin AXIS_DESCR FIX_AXIS NO_INPUT_QUANTITY COMP_0273_S 8 400 3200 FIX_AXIS_PAR_DIST 0 1 8 /end AXIS_DESCR
 /begin FUNCTION_LIST KF7-320A.14[1] /end FUNCTION_LIST
/end CHARACTERISTIC
/begin CHARACTERISTIC mTMKAVP "Minus KTW compensation advance rate table (TP)" CURVE 0x0000D578 REC_UBYTE_C 0 COMP_0254 0 15.9375
 /begin AXIS_DESCR FIX_AXIS NO_INPUT_QUANTITY COMP_0122_S 8 0 14 FIX_AXIS_PAR_DIST 0 1 8 /end AXIS_DESCR
 /begin FUNCTION_LIST KF7-320A.14[1] /end FUNCTION_LIST
/end CHARACTERISTIC
/begin CHARACTERISTIC mTRMDHOS "Air-fuel ratio compensation table" CURVE 0x0000D85A REC_UBYTE_C 0 COMP_0009 0 199.21875
 /begin AXIS_DESCR FIX_AXIS NO_INPUT_QUANTITY COMP_0323_S 8 0.5 1.375 FIX_AXIS_PAR_DIST 0 1 8 /end AXIS_DESCR
 /begin FUNCTION_LIST KF7-320A.8[2] /end FUNCTION_LIST
/end CHARACTERISTIC
/begin CHARACTERISTIC mTSCKRET "Re-acceleration shock retard table" CURVE 0x0000F13E REC_UWORD_C 0 COMP_0017 0 65535
 /begin AXIS_DESCR FIX_AXIS NO_INPUT_QUANTITY COMP_0314_S 8 0 49.28 FIX_AXIS_PAR_DIST 0 1 8 /end AXIS_DESCR
 /begin FUNCTION_LIST KF7-320A.2[3] R301.23.ADV_calculation_1_1_2 /end FUNCTION_LIST
/end CHARACTERISTIC
/begin CHARACTERISTIC mTTWHOS "Coolant temperature table 2" CURVE 0x0000DC5A REC_UBYTE_C 0 COMP_0009 0 199.21875
 /begin AXIS_DESCR FIX_AXIS NO_INPUT_QUANTITY COMP_0278_S 8 -40 100 FIX_AXIS_PAR_DIST 0 1 8 /end AXIS_DESCR
 /begin FUNCTION_LIST KF7-320A.8[2] /end FUNCTION_LIST
/end CHARACTERISTIC
/begin CHARACTERISTIC mTRLRC "Learning gain table" CURVE 0x0000D856 REC_UBYTE_C 0 COMP_0021 0 99.609375
 /begin AXIS_DESCR FIX_AXIS NO_INPUT_QUANTITY COMP_0205_S 4 0 3 FIX_AXIS_PAR_DIST 0 1 4 /end AXIS_DESCR
 /begin FUNCTION_LIST KF7-314.1F[1] /end FUNCTION_LIST
/end CHARACTERISTIC
/begin CHARACTERISTIC mfFSCKATIH "ignition retard inhibition coding flag" VALUE 0x00008AD1 REC_UBYTE_C 0 COMP_0283 0 1 BIT_MASK 0x0020
 /begin FUNCTION_LIST KF7-320A.2[3] R000.2.RS_ROMflags_1_10_3 R301.23.ADV_calculation_1_1_2 /end FUNCTION_LIST
/end CHARACTERISTIC
/begin CHARACTERISTIC mfMRNGR "0:Not DGN  1:DGN" VALUE 0x0001021A REC_UBYTE_C 0 COMP_0283 0 1 BIT_MASK 0x0004 /begin FUNCTION_LIST KF7-314.1F[1] KF7-500.2A[29] /end FUNCTION_LIST /end CHARACTERISTIC
/begin CHARACTERISTIC mfMRNGL "0:Not DGN  1:DGN" VALUE 0x0001021A REC_UBYTE_C 0 COMP_0283 0 1 BIT_MASK 0x0002 /begin FUNCTION_LIST KF7-314.1F[1] KF7-500.2A[29] /end FUNCTION_LIST /end CHARACTERISTIC
/begin CHARACTERISTIC mfMRNGR2 "0:Not DGN  1:DGN" VALUE 0x0001021B REC_UBYTE_C 0 COMP_0283 0 1 BIT_MASK 0x0080 /begin FUNCTION_LIST KF7-314.1F[1] KF7-500.2A[29] /end FUNCTION_LIST /end CHARACTERISTIC
/begin CHARACTERISTIC mfMRNGL2 "0:Not DGN  1:DGN" VALUE 0x0001021B REC_UBYTE_C 0 COMP_0283 0 1 BIT_MASK 0x0040 /begin FUNCTION_LIST KF7-314.1F[1] KF7-500.2A[29] /end FUNCTION_LIST /end CHARACTERISTIC
/* AXIS -------------------------------------------------------------------- */
/begin AXIS_PTS mTADVTRSN "50rpm" 0x0000CDFE NO_INPUT_QUANTITY REC_AXIS_UBYTE 0 COMP_0020 16 0 12750 /end AXIS_PTS
/begin AXIS_PTS mTADVTRSI "200/256%" 0x0000CDEE NO_INPUT_QUANTITY REC_AXIS_UBYTE 0 COMP_0009 16 0 199.21875 /end AXIS_PTS
/begin AXIS_PTS mITANN "50rpm" 0x0000CA3F NO_INPUT_QUANTITY REC_AXIS_UBYTE 0 COMP_0020 4 0 12750 /end AXIS_PTS
/begin AXIS_PTS mITANI "100/128%" 0x0000CA3B NO_INPUT_QUANTITY REC_AXIS_UBYTE 0 COMP_0009 4 0 199.21875 /end AXIS_PTS
/begin MEASUREMENT fAHOSINBL "0:AFSHOSçXêVïsãñâ¬  1:AFSHOSçXêVãñâ¬" UBYTE COMP_0283 1 100 0 1 BIT_MASK 0x0002 ECU_ADDRESS 0xFFFF27FB /begin FUNCTION_LIST KF7-313C.4[3] /end FUNCTION_LIST /end MEASUREMENT
/begin MEASUREMENT fALPJDGE "0:ñ¢åoâﬂ  1:åoâﬂ" UBYTE COMP_0283 1 100 0 1 BIT_MASK 0x0002 ECU_ADDRESS 0xFFFF1148 /begin FUNCTION_LIST KF7-314.1F[1] /end FUNCTION_LIST /end MEASUREMENT
/begin MEASUREMENT fASHLRCV "0:A/Fæ›ªºÃƒäwèKèåèïsê¨óß  1:A/Fæ›ªºÃƒäwèKèåèê¨óß" UBYTE COMP_0283 1 100 0 1 BIT_MASK 0x0002 ECU_ADDRESS 0xFFFF288C /begin FUNCTION_LIST KF7-313C.4[3] /end FUNCTION_LIST /end MEASUREMENT
/begin MEASUREMENT fCST1OK "0:ÉXÉeÅ[ÉWÇPOKñ¢îªíË  1:ÉXÉeÅ[ÉWÇPOKîªíË" UBYTE COMP_0283 1 100 0 1 BIT_MASK 0x0002 ECU_ADDRESS 0xFFFF29DD /begin FUNCTION_LIST KF7-313C.6[5] KF7-500.21[19] /end FUNCTION_LIST /end MEASUREMENT
/begin MEASUREMENT fCST2NG "0:ÉXÉeÅ[ÉW2NGñ¢îªíË  1:ÉXÉeÅ[ÉW2NGîªíË" UBYTE COMP_0283 1 100 0 1 BIT_MASK 0x0002 ECU_ADDRESS 0xFFFF29DE /begin FUNCTION_LIST KF7-313C.6[5] KF7-500.21[19] /end FUNCTION_LIST /end MEASUREMENT
/begin MEASUREMENT fCST2OK "0:ÉXÉeÅ[ÉW2OKñ¢îªíË  1:ÉXÉeÅ[ÉW2OKîªíË" UBYTE COMP_0283 1 100 0 1 BIT_MASK 0x0002 ECU_ADDRESS 0xFFFF29DF /begin FUNCTION_LIST KF7-313C.6[5] KF7-500.21[19] /end FUNCTION_LIST /end MEASUREMENT
/begin MEASUREMENT fDYHTMP "0:√ﬁ®⁄≤íÜ  1:√ﬁ®⁄≤å„" UBYTE COMP_0283 1 100 0 1 BIT_MASK 0x0002 ECU_ADDRESS 0xFFFF12C6 /begin FUNCTION_LIST KF7-313C.6[5] /end FUNCTION_LIST /end MEASUREMENT
/begin MEASUREMENT fELNREV "0:¥›ºﬁ›16âÒì]ÇµÇƒÇ¢Ç»Ç¢  1:¥›ºﬁ›16âÒì]ÇµÇƒÇ¢ÇÈ" UBYTE COMP_0283 1 100 0 1 BIT_MASK 0x0002 ECU_ADDRESS 0xFFFF12D0 /begin FUNCTION_LIST KF7-314.1F[1] /end FUNCTION_LIST /end MEASUREMENT
/begin MEASUREMENT fELRNOK "0:óÃàÊï äwèKèåèïsê¨óß  1:óÃàÊï äwèKèåèê¨óß" UBYTE COMP_0283 1 100 0 1 BIT_MASK 0x0002 ECU_ADDRESS 0xFFFF12D2 /begin FUNCTION_LIST KF7-314.1F[1] /end FUNCTION_LIST /end MEASUREMENT
/begin MEASUREMENT fFAFHFAL "0:âEãLà»äO  1:Ã™∞Ÿ”∞ƒﬁ" UBYTE COMP_0283 1 100 0 1 BIT_MASK 0x0002 ECU_ADDRESS 0xFFFF1EB0 /begin FUNCTION_LIST KF7-313C.2[4] /end FUNCTION_LIST /end MEASUREMENT
/begin MEASUREMENT fFAFSACT "0:éÊÇËè¡Çµ  1:A/Fæ›ªäàê´îªíËê¨óß" UBYTE COMP_0283 1 100 0 1 BIT_MASK 0x0002 ECU_ADDRESS 0xFFFF899A /begin FUNCTION_LIST KF7-313C.2[4] KF7-500.39[5] /end FUNCTION_LIST /end MEASUREMENT
/begin MEASUREMENT wfFAFSACT "0:éÊÇËè¡Çµ  1:A/Fæ›ªäàê´îªíËê¨óß" UBYTE COMP_0283 1 100 0 1 BIT_MASK 0x0002 ECU_ADDRESS 0xFFFF890E /begin FUNCTION_LIST KF7-313C.2[4] KF7-500.39[5] /end FUNCTION_LIST /end MEASUREMENT
/begin MEASUREMENT fHOSCINBL "0:HOSCMAXçXêVïsãñâ¬  1:HOSCMAXçXêVãñâ¬" UBYTE COMP_0283 1 100 0 1 BIT_MASK 0x0002 ECU_ADDRESS 0xFFFF2E21 /begin FUNCTION_LIST KF7-313C.5[3] /end FUNCTION_LIST /end MEASUREMENT
/begin MEASUREMENT fHOSLGO "0:HOSCMAXäwèKïsãñâ¬  1:HOSCMAXäwèKãñâ¬" UBYTE COMP_0283 1 100 0 1 BIT_MASK 0x0002 ECU_ADDRESS 0xFFFF2E23 /begin FUNCTION_LIST KF7-313C.5[3] /end FUNCTION_LIST /end MEASUREMENT
/begin MEASUREMENT fIDLNEND "0:-  1:-" UBYTE COMP_0283 1 100 0 1 BIT_MASK 0x0002 ECU_ADDRESS 0xFFFF143A /begin FUNCTION_LIST KF7-314.1F[1] /end FUNCTION_LIST /end MEASUREMENT
/begin MEASUREMENT fLAON "0:É…ì_ï‚ê≥ÉÇÅ[Éhâèú  1:É…ì_ï‚ê≥ÉÇÅ[ÉhíÜ" UBYTE COMP_0283 1 100 0 1 BIT_MASK 0x0002 ECU_ADDRESS 0xFFFF3DE6 /begin FUNCTION_LIST KF7-313C.3[1] /end FUNCTION_LIST /end MEASUREMENT
/begin MEASUREMENT fLNCNDOK "0:-  1:-" UBYTE COMP_0283 1 100 0 1 BIT_MASK 0x0002 ECU_ADDRESS 0xFFFF1534 /begin FUNCTION_LIST KF7-314.1F[1] /end FUNCTION_LIST /end MEASUREMENT
/begin MEASUREMENT fRLNOK "0:àŸèÌìdà≥êfíf(ç≈è¨íl)OKñ¢èIóπ  1:àŸèÌìdà≥êfíf(ç≈è¨íl)OKèIóπ" UBYTE COMP_0283 1 100 0 1 BIT_MASK 0x0002 ECU_ADDRESS 0xFFFF3154 /begin FUNCTION_LIST KF7-313C.6[5] KF7-500.24[10] /end FUNCTION_LIST /end MEASUREMENT
/begin MEASUREMENT fROMNCN "0:àŸèÌìdà≥(ç≈è¨íl)êfífTRIPñ¢èIóπ  1:àŸèÌìdà≥(ç≈è¨íl)êfífTRIPèIóπ" UBYTE COMP_0283 1 100 0 1 BIT_MASK 0x0002 ECU_ADDRESS 0xFFFF317C /begin FUNCTION_LIST KF7-313C.6[5] KF7-500.24[10] /end FUNCTION_LIST /end MEASUREMENT
/begin MEASUREMENT fROMXCN "0:àŸèÌìdà≥(ç≈ëÂíl)êfífTRIPñ¢èIóπ  1:àŸèÌìdà≥(ç≈ëÂíl)êfífTRIPèIóπ" UBYTE COMP_0283 1 100 0 1 BIT_MASK 0x0002 ECU_ADDRESS 0xFFFF317E /begin FUNCTION_LIST KF7-313C.6[5] KF7-500.24[10] /end FUNCTION_LIST /end MEASUREMENT
/begin MEASUREMENT fRORSCN "0:âûìöéûä‘êfífTRIPñ¢èIóπ  1:âûìöéûä‘êfífTRIPèIóπ" UBYTE COMP_0283 1 100 0 1 BIT_MASK 0x0002 ECU_ADDRESS 0xFFFF3181 /begin FUNCTION_LIST KF7-313C.6[5] KF7-500.24[10] /end FUNCTION_LIST /end MEASUREMENT
/begin MEASUREMENT fRRCOK "0:àŸèÌìdà≥êfíf(ç≈ëÂíl)OKñ¢èIóπ  1:àŸèÌìdà≥êfíf(ç≈ëÂíl)OKèIóπ" UBYTE COMP_0283 1 100 0 1 BIT_MASK 0x0002 ECU_ADDRESS 0xFFFF318B /begin FUNCTION_LIST KF7-313C.6[5] KF7-500.24[10] /end FUNCTION_LIST /end MEASUREMENT
/begin MEASUREMENT fRRPSOK "0:âûìöéûä‘êfífOKñ¢èIóπ  1:âûìöéûä‘êfífOKèIóπ" UBYTE COMP_0283 1 100 0 1 BIT_MASK 0x0002 ECU_ADDRESS 0xFFFF3194 /begin FUNCTION_LIST KF7-313C.6[5] KF7-500.24[10] /end FUNCTION_LIST /end MEASUREMENT
/begin MEASUREMENT fTDSTAF1 "0:âEãLà»äO  1:START SW ONÅ®OFFÇ∆Ç»Ç¡ÇΩéñÇ™óLÇÈ" UBYTE COMP_0283 1 100 0 1 BIT_MASK 0x0002 ECU_ADDRESS 0xFFFF1F1E /begin FUNCTION_LIST KF7-313C.2[4] /end FUNCTION_LIST /end MEASUREMENT
/begin MEASUREMENT fTMADJM1 "0:ïsê¨óß  1:ê¨óß" UBYTE COMP_0283 1 100 0 1 BIT_MASK 0x0002 ECU_ADDRESS 0xFFFF3F53 /begin FUNCTION_LIST KF7-313C.3[1] /end FUNCTION_LIST /end MEASUREMENT
/begin MEASUREMENT fAFHON "0:A/Fæ›ªÀ∞¿OFF  1:A/Fæ›ªÀ∞¿ON" UBYTE COMP_0283 1 100 0 1 BIT_MASK 0x0002 ECU_ADDRESS 0xFFFF48AA
 /begin FUNCTION_LIST KF7-313C.2[4] KF7-378.3B[5] KF7-500.39[5] KF7-500.74[11] KF7-500.76[8] /end FUNCTION_LIST
/end MEASUREMENT
/begin MEASUREMENT wfAFHON "0:A/Fæ›ªÀ∞¿OFF  1:A/Fæ›ªÀ∞¿ON" UBYTE COMP_0283 1 100 0 1 BIT_MASK 0x0002 ECU_ADDRESS 0xFFFF47A8
 /begin FUNCTION_LIST KF7-313C.2[4] KF7-378.3B[5] KF7-500.39[5] KF7-500.74[11] KF7-500.76[8] /end FUNCTION_LIST
/end MEASUREMENT
/begin MEASUREMENT wfCLCHSW "Clutch switch (for the daily output)" UBYTE COMP_0283 1 100 0 1 BIT_MASK 0x0004 ECU_ADDRESS 0xFFFF49C9 /begin FUNCTION_LIST KF7-320A.1[6] /end FUNCTION_LIST /end MEASUREMENT
/begin MEASUREMENT fCLCHSW "Clutch switch (for the daily output)" UBYTE COMP_0283 1 100 0 1 BIT_MASK 0x0004 ECU_ADDRESS 0xFFFF49D9 /begin FUNCTION_LIST KF7-320A.1[6] R301.23.ADV_calculation_1_1_2 /end FUNCTION_LIST /end MEASUREMENT
/begin MEASUREMENT fFOWCOFF "One-way clutch non-conclusion judgement" UBYTE COMP_0283 1 100 0 1 BIT_MASK 0x0040 ECU_ADDRESS 0xFFFF4278 /begin FUNCTION_LIST KF7-320A.2[3] R301.23.ADV_calculation_1_1_2 /end FUNCTION_LIST /end MEASUREMENT
/begin MEASUREMENT fFATIJOC "A communication condition flag with AT" UBYTE COMP_0283 1 100 0 1 BIT_MASK 0x0020 ECU_ADDRESS 0xFFFF42AA /begin FUNCTION_LIST KF7-320A.2[3] /end FUNCTION_LIST /end MEASUREMENT
/begin MEASUREMENT fFGPVTMP "Special gear shift pattern flag" UBYTE COMP_0283 1 100 0 1 BIT_MASK 0x0008 ECU_ADDRESS 0xFFFF42B6 /begin FUNCTION_LIST KF7-320A.2[3] R301.23.ADV_calculation_1_1_2 /end FUNCTION_LIST /end MEASUREMENT
/begin MEASUREMENT fFSCKON "Re-acceleration tense permission flag" UBYTE COMP_0283 1 100 0 1 BIT_MASK 0x0010 ECU_ADDRESS 0xFFFF42BF /begin FUNCTION_LIST KF7-320A.2[3] R301.23.ADV_calculation_1_1_2 /end FUNCTION_LIST /end MEASUREMENT
/begin MEASUREMENT fGOVTW "TWN : GOVTW hysteresis flag" UBYTE COMP_0283 1 100 0 1 BIT_MASK 0x0008 ECU_ADDRESS 0xFFFF42C5 /begin FUNCTION_LIST KF7-320A.10[14] /end FUNCTION_LIST /end MEASUREMENT
/begin MEASUREMENT fHOSWLRC "HOSCMAX learning region coolant temperature lower limit hysteresis flag" UBYTE COMP_0283 1 100 0 1 BIT_MASK 0x0008 ECU_ADDRESS 0xFFFF42C7 /begin FUNCTION_LIST KF7-313C.5[3] /end FUNCTION_LIST /end MEASUREMENT
/begin MEASUREMENT fHOSWLRH "HOSCMAX learning region coolant temperature upper limit hysteresis flag" UBYTE COMP_0283 1 100 0 1 BIT_MASK 0x0004 ECU_ADDRESS 0xFFFF42C7 /begin FUNCTION_LIST KF7-313C.5[3] /end FUNCTION_LIST /end MEASUREMENT
/begin MEASUREMENT fTARTTAL "Hysteresis flag" UBYTE COMP_0283 1 100 0 1 BIT_MASK 0x0040 ECU_ADDRESS 0xFFFF42F2 /begin FUNCTION_LIST KF7-320A.9[9] /end FUNCTION_LIST /end MEASUREMENT
/begin MEASUREMENT fVADJOK "Lambda point compensation practice VB condition hysteresis flag" UBYTE COMP_0283 1 100 0 1 BIT_MASK 0x0004 ECU_ADDRESS 0xFFFF4340 /begin FUNCTION_LIST KF7-313C.3[1] /end FUNCTION_LIST /end MEASUREMENT
/begin MEASUREMENT afFEVLKR "Prohibition of sky ëR ratio learning" UBYTE COMP_0283 1 100 0 1 BIT_MASK 0x0002 ECU_ADDRESS 0xFFFF4353 /begin FUNCTION_LIST KF7-314.1F[1] KF7-500.20B[4] /end FUNCTION_LIST /end MEASUREMENT
/begin MEASUREMENT fFEVLKR "Prohibition of sky ëR ratio learning" UBYTE COMP_0283 1 100 0 1 BIT_MASK 0x0002 ECU_ADDRESS 0xFFFF4364 /begin FUNCTION_LIST KF7-314.1F[1] KF7-500.20B[4] /end FUNCTION_LIST /end MEASUREMENT
/begin MEASUREMENT wfFSCKATIH "AT side control prohibition flag" UBYTE COMP_0283 1 100 0 1 BIT_MASK 0x0002 ECU_ADDRESS 0xFFFF8A8F /begin FUNCTION_LIST KF7-320A.2[3] /end FUNCTION_LIST /end MEASUREMENT
/begin MEASUREMENT wfONLUFLG "In LU, signal" UBYTE COMP_0283 1 100 0 1 BIT_MASK 0x0004 ECU_ADDRESS 0xFFFF8A90 /begin FUNCTION_LIST KF7-320A.2[3] KF7-385.1[32] /end FUNCTION_LIST /end MEASUREMENT
/begin MEASUREMENT fFSCKATIH "AT side control prohibition flag" UBYTE COMP_0283 1 100 0 1 BIT_MASK 0x0002 ECU_ADDRESS 0xFFFF8A92 /begin FUNCTION_LIST KF7-320A.2[3] /end FUNCTION_LIST /end MEASUREMENT
/begin MEASUREMENT fIDLSOFIS "At the time of IDLE, SOFIS control prohibition flag" UBYTE COMP_0283 1 100 0 1 BIT_MASK 0x0080 ECU_ADDRESS 0xFFFF8A93 /begin FUNCTION_LIST KF7-313C.11B[1] /end FUNCTION_LIST /end MEASUREMENT
/begin MEASUREMENT fONLUFLG "In LU, signal" UBYTE COMP_0283 1 100 0 1 BIT_MASK 0x0004 ECU_ADDRESS 0xFFFF8A93
 /begin FUNCTION_LIST KF7-320A.2[3] KF7-385.1[32] R204.1.CanComm_1_9_2 R301.23.ADV_calculation_1_1_2 /end FUNCTION_LIST
/end MEASUREMENT
/begin MEASUREMENT fA5TP1 "Hysteresis flag" UBYTE COMP_0283 1 100 0 1 BIT_MASK 0x0080 ECU_ADDRESS 0xFFFF2460 /begin FUNCTION_LIST KF7-320A.13[N] /end FUNCTION_LIST /end MEASUREMENT
/begin MEASUREMENT fA5TVO "Hysteresis flag" UBYTE COMP_0283 1 100 0 1 BIT_MASK 0x0040 ECU_ADDRESS 0xFFFF2460 /begin FUNCTION_LIST KF7-320A.13[N] /end FUNCTION_LIST /end MEASUREMENT
/begin MEASUREMENT fADD "Increase control" UBYTE COMP_0283 1 100 0 1 BIT_MASK 0x0020 ECU_ADDRESS 0xFFFF2464 /begin FUNCTION_LIST KF7-320A.10[14] KF7-379.5[3] KF7-505.41[2] /end FUNCTION_LIST /end MEASUREMENT
/begin MEASUREMENT fADVCD5 "Intermadiate coolant temperature retard" UBYTE COMP_0283 1 100 0 1 BIT_MASK 0x0010 ECU_ADDRESS 0xFFFF2464 /begin FUNCTION_LIST KF7-320A.11[1] KF7-320A.13[N] KF7-330.5[53] /end FUNCTION_LIST /end MEASUREMENT
/begin MEASUREMENT fAFMCANG "The flag which NBCAN is being set on by the AFM diagnosis" UBYTE COMP_0283 1 100 0 1 BIT_MASK 0x0008 ECU_ADDRESS 0xFFFF2464 /begin FUNCTION_LIST KF7-314.1F[1] /end FUNCTION_LIST /end MEASUREMENT
/begin MEASUREMENT fBBGJUG "Gasoline mixing judgement flag" UBYTE COMP_0283 1 100 0 1 BIT_MASK 0x0020 ECU_ADDRESS 0xFFFF2467 /begin FUNCTION_LIST KF7-314.1F[1] KF7-500.20B[4] /end FUNCTION_LIST /end MEASUREMENT
/begin MEASUREMENT fBLBDEC "At the time of the start, gasoline mixing decrease speed judgement flag" UBYTE COMP_0283 1 100 0 1 BIT_MASK 0x0010 ECU_ADDRESS 0xFFFF2467 /begin FUNCTION_LIST KF7-314.1F[1] /end FUNCTION_LIST /end MEASUREMENT
/begin MEASUREMENT fBLBST "At the time of the start, gasoline mixing increase speed judgement flag" UBYTE COMP_0283 1 100 0 1 BIT_MASK 0x0008 ECU_ADDRESS 0xFFFF2467 /begin FUNCTION_LIST KF7-314.1F[1] /end FUNCTION_LIST /end MEASUREMENT
/begin MEASUREMENT fDLTADV "Phase control start condition formation flag" UBYTE COMP_0283 1 100 0 1 BIT_MASK 0x0008 ECU_ADDRESS 0xFFFF246D /begin FUNCTION_LIST KF7-320A.1[6] KF7-320A.15[4] /end FUNCTION_LIST /end MEASUREMENT
/begin MEASUREMENT fDTFCTW "Hysteresis flag" UBYTE COMP_0283 1 100 0 1 BIT_MASK 0x0040 ECU_ADDRESS 0xFFFF246F /begin FUNCTION_LIST KF7-320A.2[3] KF7-385.1[32] KF7-385.2[18] /end FUNCTION_LIST /end MEASUREMENT
/begin MEASUREMENT fFA5 "Intermadiate coolant temperature retard addition judgement flag" UBYTE COMP_0283 1 100 0 1 BIT_MASK 0x0080 ECU_ADDRESS 0xFFFF2476 /begin FUNCTION_LIST KF7-320A.13[N] /end FUNCTION_LIST /end MEASUREMENT
/begin MEASUREMENT fFATVO "Hysteresis flag" UBYTE COMP_0283 1 100 0 1 BIT_MASK 0x0020 ECU_ADDRESS 0xFFFF2477 /begin FUNCTION_LIST KF7-320A.12[N] KF7-320A.13[N] /end FUNCTION_LIST /end MEASUREMENT
/begin MEASUREMENT fFFR "First idle retard addition judgement flag" UBYTE COMP_0283 1 100 0 1 BIT_MASK 0x0080 ECU_ADDRESS 0xFFFF247C /begin FUNCTION_LIST KF7-320A.12[N] /end FUNCTION_LIST /end MEASUREMENT
/begin MEASUREMENT fKNTBL "Knock control start condition formation" UBYTE COMP_0283 1 100 0 1 BIT_MASK 0x0002 ECU_ADDRESS 0xFFFF248B /begin FUNCTION_LIST KF7-320A.9[9] KF7-379.2[1] /end FUNCTION_LIST /end MEASUREMENT
/begin MEASUREMENT fNCHKC "A hysteresis flag for the KNFLAG computation" UBYTE COMP_0283 1 100 0 1 BIT_MASK 0x0004 ECU_ADDRESS 0xFFFF248F /begin FUNCTION_LIST KF7-320A.9[9] KF7-379.2[1] /end FUNCTION_LIST /end MEASUREMENT
/begin MEASUREMENT fOUTPUT "NSET00 value maintenance/setup flag" UBYTE COMP_0283 1 100 0 1 BIT_MASK 0x0020 ECU_ADDRESS 0xFFFF2492 /begin FUNCTION_LIST KF7-313C.11B[1] KF7-360.2[N] KF7-410.21[3] /end FUNCTION_LIST /end MEASUREMENT
/begin MEASUREMENT fREV16CHK "On every an engine 16 turns, set flag" UBYTE COMP_0283 1 100 0 1 BIT_MASK 0x0010 ECU_ADDRESS 0xFFFF2499 /begin FUNCTION_LIST KF7-314.1F[1] /end FUNCTION_LIST /end MEASUREMENT
/begin MEASUREMENT fTPCHK "A hysteresis flag for the estimated learning region computation" UBYTE COMP_0283 1 100 0 1 BIT_MASK 0x0008 ECU_ADDRESS 0xFFFF249F /begin FUNCTION_LIST KF7-320A.9[9] KF7-379.2[1] /end FUNCTION_LIST /end MEASUREMENT
/begin MEASUREMENT fADV1ST "Beginning ADV operation completion flag" UBYTE COMP_0283 1 100 0 1 BIT_MASK 0x0080 ECU_ADDRESS 0xFFFF24C1 /begin FUNCTION_LIST KF7-320A.1[6] /end FUNCTION_LIST /end MEASUREMENT
/begin MEASUREMENT fCLCHGOVT "At the time of the clutch cutting, ÉKÉoÉiÅ[ÉtÉâÉO" UBYTE COMP_0283 1 100 0 1 BIT_MASK 0x0004 ECU_ADDRESS 0xFFFF24C1 /begin FUNCTION_LIST KF7-320A.1[6] /end FUNCTION_LIST /end MEASUREMENT
/begin MEASUREMENT fRETTP "Compensation condition formation flag by the cylinder" UBYTE COMP_0283 1 100 0 1 BIT_MASK 0x0002 ECU_ADDRESS 0xFFFF24C4 /begin FUNCTION_LIST KF7-320A.4[6] /end FUNCTION_LIST /end MEASUREMENT
/begin MEASUREMENT afKNAREA "Knock control region formation" UBYTE COMP_0283 1 100 0 1 BIT_MASK 0x0020 ECU_ADDRESS 0xFFFF24C6 /begin FUNCTION_LIST KF7-320A.1[6] KF7-379.2[1] KF7-379.4[1] KF7-379.5[3] /end FUNCTION_LIST /end MEASUREMENT
/begin MEASUREMENT fKNAREA "Knock control region formation" UBYTE COMP_0283 1 100 0 1 BIT_MASK 0x0020 ECU_ADDRESS 0xFFFF24C7
 /begin FUNCTION_LIST KF7-320A.1[6] KF7-379.2[1] KF7-379.4[1] KF7-379.5[3] R301.23.ADV_calculation_1_1_2 /end FUNCTION_LIST
/end MEASUREMENT
/begin MEASUREMENT afBASERR "Base air-fuel ratio error judgement" UBYTE COMP_0283 1 100 0 1 BIT_MASK 0x0002 ECU_ADDRESS 0xFFFF24CD /begin FUNCTION_LIST KF7-314.1F[1] KF7-371.1E[15] KF7-500.20B[4] /end FUNCTION_LIST /end MEASUREMENT
/begin MEASUREMENT afFMRCPT "A purge cut flag for ëÊÉj learning" UBYTE COMP_0283 1 100 0 1 BIT_MASK 0x0004 ECU_ADDRESS 0xFFFF24CF /begin FUNCTION_LIST KF7-314.1F[1] KF7-371.1E[15] KF7-500.20B[4] /end FUNCTION_LIST /end MEASUREMENT
/begin MEASUREMENT afGKPGOK "Canister treatment completion judgement" UBYTE COMP_0283 1 100 0 1 BIT_MASK 0x0020 ECU_ADDRESS 0xFFFF24D0 /begin FUNCTION_LIST KF7-314.1F[1] KF7-371.1E[15] KF7-500.20B[4] /end FUNCTION_LIST /end MEASUREMENT
/begin MEASUREMENT afKNSTDY "Knock estimated learning region formation" UBYTE COMP_0283 1 100 0 1 BIT_MASK 0x0001 ECU_ADDRESS 0xFFFF24D0 /begin FUNCTION_LIST KF7-320A.1[6] KF7-379.2[1] KF7-379.5[3] /end FUNCTION_LIST /end MEASUREMENT
/begin MEASUREMENT afSTSW1 "STSW for the ignition timing computation" UBYTE COMP_0283 1 100 0 1 BIT_MASK 0x0002 ECU_ADDRESS 0xFFFF24D1 /begin FUNCTION_LIST KF7-320A.1[6] /end FUNCTION_LIST /end MEASUREMENT
/begin MEASUREMENT fBASERR "Base air-fuel ratio error judgement" UBYTE COMP_0283 1 100 0 1 BIT_MASK 0x0002 ECU_ADDRESS 0xFFFF24D4 /begin FUNCTION_LIST KF7-314.1F[1] KF7-371.1E[15] KF7-500.20B[4] /end FUNCTION_LIST /end MEASUREMENT
/begin MEASUREMENT fFMRCPT "A purge cut flag for ëÊÉj learning" UBYTE COMP_0283 1 100 0 1 BIT_MASK 0x0004 ECU_ADDRESS 0xFFFF24D6 /begin FUNCTION_LIST KF7-314.1F[1] KF7-371.1E[15] KF7-500.20B[4] /end FUNCTION_LIST /end MEASUREMENT
/begin MEASUREMENT fGKPGOK "Canister treatment completion judgement" UBYTE COMP_0283 1 100 0 1 BIT_MASK 0x0020 ECU_ADDRESS 0xFFFF24D7 /begin FUNCTION_LIST KF7-314.1F[1] KF7-371.1E[15] KF7-500.20B[4] /end FUNCTION_LIST /end MEASUREMENT
/begin MEASUREMENT fKNSTDY "Knock estimated learning region formation" UBYTE COMP_0283 1 100 0 1 BIT_MASK 0x0001 ECU_ADDRESS 0xFFFF24D7
 /begin FUNCTION_LIST KF7-320A.1[6] KF7-379.2[1] KF7-379.5[3] R301.23.ADV_calculation_1_1_2 /end FUNCTION_LIST
/end MEASUREMENT
/begin MEASUREMENT fSTSW1 "STSW for the ignition timing computation" UBYTE COMP_0283 1 100 0 1 BIT_MASK 0x0002 ECU_ADDRESS 0xFFFF24D8 /begin FUNCTION_LIST KF7-320A.1[6] R301.23.ADV_calculation_1_1_2 /end FUNCTION_LIST /end MEASUREMENT
/begin MEASUREMENT fNADVAJH "Hysteresis flag" UBYTE COMP_0283 1 100 0 1 BIT_MASK 0x0008 ECU_ADDRESS 0xFFFFB7E8 /begin FUNCTION_LIST KF7-320A.4[6] /end FUNCTION_LIST /end MEASUREMENT
/begin MEASUREMENT fNADVAJL "Hysteresis flag" UBYTE COMP_0283 1 100 0 1 BIT_MASK 0x0004 ECU_ADDRESS 0xFFFFB7E8 /begin FUNCTION_LIST KF7-320A.4[6] /end FUNCTION_LIST /end MEASUREMENT
/begin MEASUREMENT tTDSTAF2 "A heater DUTY condition delay for the A/F sensor activated judgement" UBYTE COMP_0201_S 1 100 0 255 ECU_ADDRESS 0xFFFF43FC /begin FUNCTION_LIST KF7-313C.2[4] /end FUNCTION_LIST /end MEASUREMENT
/begin MEASUREMENT tTMNOACT "Activated judgement release judgement delay" UBYTE COMP_0201_S 1 100 0 255 ECU_ADDRESS 0xFFFF4416 /begin FUNCTION_LIST KF7-313C.2[4] /end FUNCTION_LIST /end MEASUREMENT
/begin MEASUREMENT tTMPIST "Ignition timing F/B PI control time" UBYTE COMP_0201_S 1 100 0 255 ECU_ADDRESS 0xFFFF441C /begin FUNCTION_LIST KF7-320A.10[14] KF7-390.3A[15] /end FUNCTION_LIST /end MEASUREMENT
/begin MEASUREMENT tAFOHONT "A/F sensor shift compensation learning : the rest O2 heater on delay" UBYTE COMP_0202_S 1 100 0 255 ECU_ADDRESS 0xFFFF4449 /begin FUNCTION_LIST KF7-313C.4[3] /end FUNCTION_LIST /end MEASUREMENT
/begin MEASUREMENT tASHLTM "A/F sensor shift compensation learning : learning permission condition judgement delay" UBYTE COMP_0202_S 1 100 0 255 ECU_ADDRESS 0xFFFF444D /begin FUNCTION_LIST KF7-313C.4[3] /end FUNCTION_LIST /end MEASUREMENT
/begin MEASUREMENT tDTVHOST "Learning region delta-TVO judgement delay" UBYTE COMP_0202_S 1 100 0 255 ECU_ADDRESS 0xFFFF4466 /begin FUNCTION_LIST KF7-313C.5[3] /end FUNCTION_LIST /end MEASUREMENT
/begin MEASUREMENT tDTVOSCT "A/F sensor shift compensation learning : learning region delta-TVO judgement delay" UBYTE COMP_0202_S 1 100 0 255 ECU_ADDRESS 0xFFFF4468 /begin FUNCTION_LIST KF7-313C.4[3] /end FUNCTION_LIST /end MEASUREMENT
/begin MEASUREMENT tHOSHONT "The rest O2 heater on delay" UBYTE COMP_0202_S 1 100 0 255 ECU_ADDRESS 0xFFFF4480 /begin FUNCTION_LIST KF7-313C.5[3] /end FUNCTION_LIST /end MEASUREMENT
/begin MEASUREMENT tHOSLTM "Learning permission condition judgement delay" UBYTE COMP_0202_S 1 100 0 255 ECU_ADDRESS 0xFFFF4482 /begin FUNCTION_LIST KF7-313C.5[3] /end FUNCTION_LIST /end MEASUREMENT
/begin MEASUREMENT tOSCDL1 "A/F sensor shift compensation learning : OSC control start judgement delay" UBYTE COMP_0202_S 1 100 0 255 ECU_ADDRESS 0xFFFF44A4 /begin FUNCTION_LIST KF7-313C.4[3] /end FUNCTION_LIST /end MEASUREMENT
/begin MEASUREMENT tOSCDL2 "A/F sensor shift compensation learning : F/C completion judgement delay" UBYTE COMP_0202_S 1 100 0 255 ECU_ADDRESS 0xFFFF44A6 /begin FUNCTION_LIST KF7-313C.4[3] /end FUNCTION_LIST /end MEASUREMENT
/begin MEASUREMENT tOSCDL3 "OSC control start judgement delay" UBYTE COMP_0202_S 1 100 0 255 ECU_ADDRESS 0xFFFF44A8 /begin FUNCTION_LIST KF7-313C.5[3] /end FUNCTION_LIST /end MEASUREMENT
/begin MEASUREMENT tOSCDL4 "F/C completion judgement delay" UBYTE COMP_0202_S 1 100 0 255 ECU_ADDRESS 0xFFFF44AA /begin FUNCTION_LIST KF7-313C.5[3] /end FUNCTION_LIST /end MEASUREMENT
/begin MEASUREMENT tTMONT "A timer for monitor clamp periodic measuring" UBYTE COMP_0202_S 1 100 0 255 ECU_ADDRESS 0xFFFF4528 /begin FUNCTION_LIST KF7-313C.9[3] KF7-500.24[10] /end FUNCTION_LIST /end MEASUREMENT
/begin MEASUREMENT tRESTOS "HSOSQ, LSOSQ initial ílêÿÇË are changed, judgement timer" UBYTE COMP_0203_S 1 100 0 255 ECU_ADDRESS 0xFFFF4600 /begin FUNCTION_LIST KF7-313C.7[1] /end FUNCTION_LIST /end MEASUREMENT
/begin MEASUREMENT tSCKDLY "Control start delay time timer" UBYTE COMP_0203_S 1 100 0 255 ECU_ADDRESS 0xFFFF4602 /begin FUNCTION_LIST KF7-320A.2[3] /end FUNCTION_LIST /end MEASUREMENT
/begin MEASUREMENT tSCKRETTM "Re-acceleration shock retard time timer" UBYTE COMP_0203_S 1 100 0 255 ECU_ADDRESS 0xFFFF4603 /begin FUNCTION_LIST KF7-320A.2[3] /end FUNCTION_LIST /end MEASUREMENT
/begin MEASUREMENT tTMADJM1 "Lambda point compensation delay time 1" UBYTE COMP_0203_S 1 100 0 255 ECU_ADDRESS 0xFFFF4633 /begin FUNCTION_LIST KF7-313C.3[1] /end FUNCTION_LIST /end MEASUREMENT
/begin MEASUREMENT tCLSDLY "After the lambda control formation, delay timer" UBYTE COMP_0201_S 1 100 0 255 ECU_ADDRESS 0xFFFF24DF /begin FUNCTION_LIST KF7-313C.6[5] /end FUNCTION_LIST /end MEASUREMENT
/begin MEASUREMENT tDYHTMP "At the time of the high exhaust temperature, lambda control switchover delay timer" UBYTE COMP_0201_S 1 100 0 255 ECU_ADDRESS 0xFFFF24E7 /begin FUNCTION_LIST KF7-313C.6[5] /end FUNCTION_LIST /end MEASUREMENT
/begin MEASUREMENT tTLKBRA "Lean side KBLRCA whole area reflection condition judgement time" UBYTE COMP_0201_S 1 100 0 255 ECU_ADDRESS 0xFFFF2505 /begin FUNCTION_LIST KF7-314.1F[1] /end FUNCTION_LIST /end MEASUREMENT
/begin MEASUREMENT tTRKBRA "Rich side KBLRCA whole area reflection condition judgement time" UBYTE COMP_0201_S 1 100 0 255 ECU_ADDRESS 0xFFFF2519 /begin FUNCTION_LIST KF7-314.1F[1] /end FUNCTION_LIST /end MEASUREMENT
/begin MEASUREMENT tFRTM "After first idle retard addition judgement ST/SW off, progress time" UBYTE COMP_0202_S 1 100 0 255 ECU_ADDRESS 0xFFFF2551 /begin FUNCTION_LIST KF7-320A.12[N] /end FUNCTION_LIST /end MEASUREMENT
/begin MEASUREMENT tGOVDLY "IDLE SW After on, delay" UBYTE COMP_0203_S 1 100 0 255 ECU_ADDRESS 0xFFFF2602 /begin FUNCTION_LIST KF7-320A.10[14] /end FUNCTION_LIST /end MEASUREMENT
/begin MEASUREMENT tSCKLUDLY "LU judgement delay timer" UBYTE COMP_0203_S 1 100 0 255 ECU_ADDRESS 0xFFFF2632 /begin FUNCTION_LIST KF7-320A.2[3] /end FUNCTION_LIST /end MEASUREMENT
/begin MEASUREMENT tVVLDLY1 "Solenoid switching delay (low speed cam high-speed cam)" UBYTE COMP_0203_S 1 100 0 255 ECU_ADDRESS 0xFFFF268E /begin FUNCTION_LIST KF7-320A.9[9] /end FUNCTION_LIST /end MEASUREMENT
/begin MEASUREMENT tVVLDLY2 "Solenoid switching delay (a high-speed cam low speed cam)" UBYTE COMP_0203_S 1 100 0 255 ECU_ADDRESS 0xFFFF268F /begin FUNCTION_LIST KF7-320A.9[9] /end FUNCTION_LIST /end MEASUREMENT
/begin MEASUREMENT cREV16CHK "A rotation counter for the ALP computation" UBYTE COMP_0191 1 100 0 255 ECU_ADDRESS 0xFFFF26A5 /begin FUNCTION_LIST KF7-314.1F[1] /end FUNCTION_LIST /end MEASUREMENT
/begin MEASUREMENT cADVLMTPI "A counter because of a change in ADV" UBYTE COMP_0287 1 100 0 255 ECU_ADDRESS 0xFFFF26A7 /begin FUNCTION_LIST KF7-320A.1[6] /end FUNCTION_LIST /end MEASUREMENT
/begin MEASUREMENT cDGINGOV "The number of counts of mDGINGOV" UBYTE COMP_0287 1 100 0 255 ECU_ADDRESS 0xFFFF26AA /begin FUNCTION_LIST KF7-320A.10[14] /end FUNCTION_LIST /end MEASUREMENT
/begin MEASUREMENT avADCG "Additional charge condition" UBYTE COMP_0004 1 100 0 255 ECU_ADDRESS 0xFFFF22F8 /begin FUNCTION_LIST KF7-314.1F[1] KF7-371.1E[15] KF7-500.20B[4] /end FUNCTION_LIST /end MEASUREMENT
/begin MEASUREMENT avADVTRM "Trimming-map compensation value" UBYTE COMP_0245 1 100 -64 191 ECU_ADDRESS 0xFFFF22F9 /begin FUNCTION_LIST KF7-320A.9[9] KF7-320A.18[4] KF7-390.1A[3] /end FUNCTION_LIST /end MEASUREMENT
/begin MEASUREMENT avDLTADV "At the time of the acceleration, the amount of ADV phase control" SBYTE COMP_0018 1 100 -128 127 ECU_ADDRESS 0xFFFF2320 /begin FUNCTION_LIST KF7-320A.1[6] KF7-320A.15[4] /end FUNCTION_LIST /end MEASUREMENT
/begin MEASUREMENT avGOVIDL "GOV idle value" SBYTE COMP_0018 1 100 -128 127 ECU_ADDRESS 0xFFFF232A /begin FUNCTION_LIST KF7-320A.10[14] KF7-320A.18[4] KF7-390.1A[3] /end FUNCTION_LIST /end MEASUREMENT
/begin MEASUREMENT avHTARTD "High intake air temperature retard value" UBYTE COMP_0017 1 100 0 255 ECU_ADDRESS 0xFFFF232B /begin FUNCTION_LIST KF7-320A.9[9] /end FUNCTION_LIST /end MEASUREMENT
/begin MEASUREMENT avSCKRET "The amount of re-acceleration shock retard" UBYTE COMP_0017 1 100 0 255 ECU_ADDRESS 0xFFFF416E /begin FUNCTION_LIST KF7-320A.1[6] KF7-320A.2[3] /end FUNCTION_LIST /end MEASUREMENT
/begin MEASUREMENT avTADVM "A basic ignition timing" SBYTE COMP_0018 1 100 -128 127 ECU_ADDRESS 0xFFFF2359
 /begin FUNCTION_LIST KF7-320A.1[6] KF7-320A.10[14] KF7-320A.19[7] KF7-320A.20[2] KF7-385.2[18] KF7-386.1[4] KF7-386.2[4] KF7-390.1A[3] KF7-460.1[6] /end FUNCTION_LIST
/end MEASUREMENT
/begin MEASUREMENT bvADVCD5 "The amount of intermadiate coolant temperature retard" UBYTE COMP_0017 1 100 0 255 ECU_ADDRESS 0xFFFF22BC /begin FUNCTION_LIST KF7-320A.11[1] KF7-320A.13[N] KF7-330.5[53] /end FUNCTION_LIST /end MEASUREMENT
/begin MEASUREMENT bvBETA "Knock control value" SBYTE COMP_0018 1 100 -128 127 ECU_ADDRESS 0xFFFF22BE
 /begin FUNCTION_LIST KF7-320A.1[6] KF7-379.4[1] KF7-379.5[3] KF7-450.20[2] R901.1.Diag_on_can_app_1_6_2 /end FUNCTION_LIST
/end MEASUREMENT
/begin MEASUREMENT bvFCCYL "Fuel cut cylinder" UBYTE COMP_0421 1 100 0 255 ECU_ADDRESS 0xFFFF22A4
 /begin FUNCTION_LIST KF7-320A.1[6] KF7-330.5[53] KF7-360.8A[N] KF7-360.9M[43] R301.5.FuelCut_1_2_2 R301.13.FFDforDiagOnCAN_1_1_3 R901.1.Diag_on_can_app_1_6_2 /end FUNCTION_LIST
/end MEASUREMENT
/begin MEASUREMENT bvFIRTD "The amount of first idle retard" UBYTE COMP_0017 1 100 0 255 ECU_ADDRESS 0xFFFF22C5 /begin FUNCTION_LIST KF7-320A.11[1] KF7-320A.12[N] KF7-330.5[53] /end FUNCTION_LIST /end MEASUREMENT
/begin MEASUREMENT bvGEAR "Gear position" UBYTE COMP_0068 1 100 0 255 ECU_ADDRESS 0xFFFF22C6 /begin FUNCTION_LIST KF7-320A.10[14] /end FUNCTION_LIST /end MEASUREMENT
/begin MEASUREMENT bvKBLRCA "Region learning control value" UWORD COMP_0031 1 100 0 255.99609375 ECU_ADDRESS 0xFFFF22CE /begin FUNCTION_LIST KF7-314.1F[1] /end FUNCTION_LIST /end MEASUREMENT
/begin MEASUREMENT bvKBLRCA_R#1 "Region learning control value" UWORD COMP_0031 1 100 0 255.99609375 ECU_ADDRESS 0xFFFF22CE /begin FUNCTION_LIST KF7-314.1F[1] /end FUNCTION_LIST /end MEASUREMENT
/begin MEASUREMENT bvKBLRCA_R#2 "Region learning control value" UWORD COMP_0031 1 100 0 255.99609375 ECU_ADDRESS 0xFFFF22D0 /begin FUNCTION_LIST KF7-314.1F[1] /end FUNCTION_LIST /end MEASUREMENT
/begin MEASUREMENT bvRATEGR "Actual EGR rate estimated value" UBYTE COMP_0141 1 100 0 49.8046875 ECU_ADDRESS 0xFFFF22DE /begin FUNCTION_LIST KF7-320A.8[2] KF7-320A.10[14] /end FUNCTION_LIST /end MEASUREMENT
/begin MEASUREMENT bvSCADMP "A SCV coefficient for ignition timing compensation" UBYTE COMP_0021 1 100 0 99.609375 ECU_ADDRESS 0xFFFF22DF /begin FUNCTION_LIST KF7-320A.8[2] KF7-320A.9[9] /end FUNCTION_LIST /end MEASUREMENT
/begin MEASUREMENT vA5CNG "Intermadiate coolant temperature retard section compensation rate" UBYTE COMP_0108 1 100 0 0.99609375 ECU_ADDRESS 0xFFFF10B8 /begin FUNCTION_LIST KF7-320A.13[N] /end FUNCTION_LIST /end MEASUREMENT
/begin MEASUREMENT vA5N "Intermadiate coolant temperature retard rotation compensation rate" UBYTE COMP_0032 1 100 0 0.99609375 ECU_ADDRESS 0xFFFF10B9 /begin FUNCTION_LIST KF7-320A.13[N] /end FUNCTION_LIST /end MEASUREMENT
/begin MEASUREMENT vA5TP "Intermadiate coolant temperature retard basic value" UBYTE COMP_0017 1 100 0 255 ECU_ADDRESS 0xFFFF10BA /begin FUNCTION_LIST KF7-320A.13[N] /end FUNCTION_LIST /end MEASUREMENT
/begin MEASUREMENT vA5TW "Intermadiate coolant temperature retard coolant temperature compensation rate" UBYTE COMP_0032 1 100 0 0.99609375 ECU_ADDRESS 0xFFFF10BB /begin FUNCTION_LIST KF7-320A.13[N] /end FUNCTION_LIST /end MEASUREMENT
/begin MEASUREMENT vABFER "Air-fuel ratio deviation" SWORD COMP_0341_S 1 100 -65.536 65.534 ECU_ADDRESS 0xFFFF26FE /begin FUNCTION_LIST KF7-314.1F[1] /end FUNCTION_LIST /end MEASUREMENT
/begin MEASUREMENT vABFER_R#1 "Air-fuel ratio deviation" SWORD COMP_0341_S 1 100 -65.536 65.534 ECU_ADDRESS 0xFFFF26FE /begin FUNCTION_LIST KF7-314.1F[1] /end FUNCTION_LIST /end MEASUREMENT
/begin MEASUREMENT vABFER_R#2 "Air-fuel ratio deviation" SWORD COMP_0341_S 1 100 -65.536 65.534 ECU_ADDRESS 0xFFFF2700 /begin FUNCTION_LIST KF7-314.1F[1] /end FUNCTION_LIST /end MEASUREMENT
/begin MEASUREMENT vADAFSF "A/F (Front) sensor" UWORD COMP_0023 1 100 0 327675 ECU_ADDRESS 0xFFFF1CCA /begin FUNCTION_LIST KF7-313C.3[1] KF7-500.1[54] /end FUNCTION_LIST /end MEASUREMENT
/begin MEASUREMENT vADCG "Additional charge condition" UBYTE COMP_0004 1 100 0 255 ECU_ADDRESS 0xFFFF23A6 /begin FUNCTION_LIST KF7-314.1F[1] KF7-371.1E[15] KF7-500.20B[4] /end FUNCTION_LIST /end MEASUREMENT
/begin MEASUREMENT vADDOXY "The amount of O2 for the rest O2 sensor feedback" UWORD COMP_0068 1 100 0 65535 ECU_ADDRESS 0xFFFF2784 /begin FUNCTION_LIST KF7-313C.9[3] /end FUNCTION_LIST /end MEASUREMENT
/begin MEASUREMENT vADDOXY_R#1 "The amount of O2 for the rest O2 sensor feedback" UWORD COMP_0068 1 100 0 65535 ECU_ADDRESS 0xFFFF2784 /begin FUNCTION_LIST KF7-313C.9[3] /end FUNCTION_LIST /end MEASUREMENT
/begin MEASUREMENT vADDOXY_R#2 "The amount of O2 for the rest O2 sensor feedback" UWORD COMP_0068 1 100 0 65535 ECU_ADDRESS 0xFFFF2786 /begin FUNCTION_LIST KF7-313C.9[3] /end FUNCTION_LIST /end MEASUREMENT
/begin MEASUREMENT vADFHS1 "Heater electric current value A/D value" UWORD COMP_0023 1 100 0 327675 ECU_ADDRESS 0xFFFF3890 /begin FUNCTION_LIST KF7-313C.2[4] /end FUNCTION_LIST /end MEASUREMENT
/begin MEASUREMENT vADVBL "In front of the limiter, ignition timing" SBYTE COMP_0018 1 100 -128 127 ECU_ADDRESS 0xFFFF1100 /begin FUNCTION_LIST KF7-320A.1[6] KF7-320A.4[6] R301.23.ADV_calculation_1_1_2 /end FUNCTION_LIST /end MEASUREMENT
/begin MEASUREMENT vADVCD1 "At the time of the idle, ADVCD1" UBYTE COMP_0017 1 100 0 255 ECU_ADDRESS 0xFFFF1106 /begin FUNCTION_LIST KF7-320A.10[14] R301.25.GOV_idle_1_0_2 /end FUNCTION_LIST /end MEASUREMENT
/begin MEASUREMENT vADVEPN "Ignition timing adjustment EEPROM reading value" SBYTE COMP_0018 1 100 -128 127 ECU_ADDRESS 0xFFFF27AC /begin FUNCTION_LIST KF7-320A.3[N] /end FUNCTION_LIST /end MEASUREMENT
/begin MEASUREMENT vADVHOS "The amount of ADV compensation" SWORD COMP_0018 1 100 -32768 32767 ECU_ADDRESS 0xFFFF1F92 /begin FUNCTION_LIST KF7-320A.1[6] R301.23.ADV_calculation_1_1_2 /end FUNCTION_LIST /end MEASUREMENT
/begin MEASUREMENT vADVTRM "Trimming-map compensation value" UBYTE COMP_0245 1 100 -64 191 ECU_ADDRESS 0xFFFF23A7
 /begin FUNCTION_LIST KF7-320A.9[9] KF7-320A.18[4] KF7-390.1A[3] R301.22.TRHOSI_1_0_2 /end FUNCTION_LIST
/end MEASUREMENT
/begin MEASUREMENT vADVTRM0 "At the time of the SCV open, trimming-map compensation value" UBYTE COMP_0245 1 100 -64 191 ECU_ADDRESS 0xFFFF110A /begin FUNCTION_LIST KF7-320A.9[9] /end FUNCTION_LIST /end MEASUREMENT
/begin MEASUREMENT vADVTRM1 "At the time of the SCV close, trimming-map compensation value" UBYTE COMP_0245 1 100 -64 191 ECU_ADDRESS 0xFFFF110C /begin FUNCTION_LIST KF7-320A.9[9] /end FUNCTION_LIST /end MEASUREMENT
/begin MEASUREMENT vADVTRM2 "The trimming-map the first interpolation value" UBYTE COMP_0245 1 100 -64 191 ECU_ADDRESS 0xFFFF110E /begin FUNCTION_LIST KF7-320A.9[9] /end FUNCTION_LIST /end MEASUREMENT
/begin MEASUREMENT vADVTRMAP "Trimming-map reference value" UBYTE COMP_0245 1 100 -64 191 ECU_ADDRESS 0xFFFF110F /begin FUNCTION_LIST KF7-320A.9[9] /end FUNCTION_LIST /end MEASUREMENT
/begin MEASUREMENT vADVTRMHR "Trim MAP high-octane regular difference ignition timing" UBYTE COMP_0017 1 100 0 255 ECU_ADDRESS 0xFFFF1110 /begin FUNCTION_LIST KF7-320A.9[9] KF7-386.1[4] KF7-386.2[4] /end FUNCTION_LIST /end MEASUREMENT
/begin MEASUREMENT vAFSHDM "AFSHOS ÉfÉVÉÅÅ[ÉVÉáÉì value" SWORD COMP_0341_S 1 100 -65.536 65.534 ECU_ADDRESS 0xFFFF1000 /begin FUNCTION_LIST KF7-314.1F[1] /end FUNCTION_LIST /end MEASUREMENT
/begin MEASUREMENT vAFSHDM_R#1 "AFSHOS ÉfÉVÉÅÅ[ÉVÉáÉì value" SWORD COMP_0341_S 1 100 -65.536 65.534 ECU_ADDRESS 0xFFFF1000 /begin FUNCTION_LIST KF7-314.1F[1] /end FUNCTION_LIST /end MEASUREMENT
/begin MEASUREMENT vAFSHDM_R#2 "AFSHOS ÉfÉVÉÅÅ[ÉVÉáÉì value" SWORD COMP_0341_S 1 100 -65.536 65.534 ECU_ADDRESS 0xFFFF1002 /begin FUNCTION_LIST KF7-314.1F[1] /end FUNCTION_LIST /end MEASUREMENT
/begin MEASUREMENT vAHOSINBL "AFSHOS renewal permission flag" UBYTE COMP_0283 1 100 0 255 ECU_ADDRESS 0xFFFF27FA /begin FUNCTION_LIST KF7-313C.4[3] /end FUNCTION_LIST /end MEASUREMENT
/begin MEASUREMENT vALP1 "At the time of rich/lean switching, ALPHA" UWORD COMP_0031 1 100 0 255.99609375 ECU_ADDRESS 0xFFFF112E /begin FUNCTION_LIST KF7-314.1F[1] /end FUNCTION_LIST /end MEASUREMENT
/begin MEASUREMENT vALP1_R#1 "At the time of rich/lean switching, ALPHA" UWORD COMP_0031 1 100 0 255.99609375 ECU_ADDRESS 0xFFFF112E /begin FUNCTION_LIST KF7-314.1F[1] /end FUNCTION_LIST /end MEASUREMENT
/begin MEASUREMENT vALP1_R#2 "At the time of rich/lean switching, ALPHA" UWORD COMP_0031 1 100 0 255.99609375 ECU_ADDRESS 0xFFFF1130 /begin FUNCTION_LIST KF7-314.1F[1] /end FUNCTION_LIST /end MEASUREMENT
/begin MEASUREMENT vALP2 "Latest ALPHA" UWORD COMP_0031 1 100 0 255.99609375 ECU_ADDRESS 0xFFFF1132 /begin FUNCTION_LIST KF7-314.1F[1] /end FUNCTION_LIST /end MEASUREMENT
/begin MEASUREMENT vALP2_R#1 "Latest ALPHA" UWORD COMP_0031 1 100 0 255.99609375 ECU_ADDRESS 0xFFFF1132 /begin FUNCTION_LIST KF7-314.1F[1] /end FUNCTION_LIST /end MEASUREMENT
/begin MEASUREMENT vALP2_R#2 "Latest ALPHA" UWORD COMP_0031 1 100 0 255.99609375 ECU_ADDRESS 0xFFFF1134 /begin FUNCTION_LIST KF7-314.1F[1] /end FUNCTION_LIST /end MEASUREMENT
/begin MEASUREMENT vAVALP "ALPHA middle value" UWORD COMP_0031 1 100 0 255.99609375 ECU_ADDRESS 0xFFFF1186 /begin FUNCTION_LIST KF7-314.1F[1] /end FUNCTION_LIST /end MEASUREMENT
/begin MEASUREMENT vAVALP_R#1 "ALPHA middle value" UWORD COMP_0031 1 100 0 255.99609375 ECU_ADDRESS 0xFFFF1186 /begin FUNCTION_LIST KF7-314.1F[1] /end FUNCTION_LIST /end MEASUREMENT
/begin MEASUREMENT vAVALP_R#2 "ALPHA middle value" UWORD COMP_0031 1 100 0 255.99609375 ECU_ADDRESS 0xFFFF1188 /begin FUNCTION_LIST KF7-314.1F[1] /end FUNCTION_LIST /end MEASUREMENT
/begin MEASUREMENT vAVGAFH "Heater electric current value A/D value weighted average value" UWORD COMP_0023 1 100 0 327675 ECU_ADDRESS 0xFFFF48F0 /begin FUNCTION_LIST KF7-313C.2[4] KF7-378.3B[5] KF7-500.59[6] /end FUNCTION_LIST /end MEASUREMENT
/begin MEASUREMENT vBLBST "At the time of the start, gasoline mixing quantity increase acceleration speed" UBYTE COMP_0016 1 100 0 255 ECU_ADDRESS 0xFFFF11C6 /begin FUNCTION_LIST KF7-314.1F[1] /end FUNCTION_LIST /end MEASUREMENT
/begin MEASUREMENT vBLBYC "At the time of the start, gasoline mixing quantity index number" UBYTE COMP_0016 1 100 0 255 ECU_ADDRESS 0xFFFFA293 /begin FUNCTION_LIST KF7-314.1F[1] R901.1.Diag_on_can_app_1_6_2 /end FUNCTION_LIST /end MEASUREMENT
/begin MEASUREMENT vBSALP "Base learning value" UWORD COMP_0031 1 100 0 255.99609375 ECU_ADDRESS 0xFFFFA2A0 /begin FUNCTION_LIST KF7-314.1F[1] /end FUNCTION_LIST /end MEASUREMENT
/begin MEASUREMENT vBSALP_R#1 "Base learning value" UWORD COMP_0031 1 100 0 255.99609375 ECU_ADDRESS 0xFFFFA2A0 /begin FUNCTION_LIST KF7-314.1F[1] /end FUNCTION_LIST /end MEASUREMENT
/begin MEASUREMENT vBSALP_R#2 "Base learning value" UWORD COMP_0031 1 100 0 255.99609375 ECU_ADDRESS 0xFFFFA2A2 /begin FUNCTION_LIST KF7-314.1F[1] /end FUNCTION_LIST /end MEASUREMENT
/begin MEASUREMENT vCATDAN "Catalyst heating compensation value" UBYTE COMP_0017 1 100 0 255 ECU_ADDRESS 0xFFFF11D0 /begin FUNCTION_LIST KF7-320A.10[14] KF7-320A.11[1] KF7-320A.18[4] /end FUNCTION_LIST /end MEASUREMENT
/begin MEASUREMENT vCNTIDLN1 "At the time of the idle, learning renewal number of times (bank 1)" UBYTE COMP_0016 1 100 0 255 ECU_ADDRESS 0xFFFF11F7 /begin FUNCTION_LIST KF7-314.1F[1] /end FUNCTION_LIST /end MEASUREMENT
/begin MEASUREMENT vCNTIDLN2 "At the time of the idle, learning renewal number of times (bank 2)" UBYTE COMP_0016 1 100 0 255 ECU_ADDRESS 0xFFFF11F8 /begin FUNCTION_LIST KF7-314.1F[1] /end FUNCTION_LIST /end MEASUREMENT
/begin MEASUREMENT vCURGPV "Actual gear position estimated value" UBYTE COMP_0068 1 100 0 255 ECU_ADDRESS 0xFFFF88C3 /begin FUNCTION_LIST KF7-320A.2[3] KF7-360.12[6] /end FUNCTION_LIST /end MEASUREMENT
/begin MEASUREMENT vDELALP "MALPHA For the difference" SLONG COMP_0438 1 100 -8388608 8388607.99609375 ECU_ADDRESS 0xFFFF1258 /begin FUNCTION_LIST KF7-313C.9[3] /end FUNCTION_LIST /end MEASUREMENT
/begin MEASUREMENT vDELALP_R#1 "MALPHA For the difference" SLONG COMP_0438 1 100 -8388608 8388607.99609375 ECU_ADDRESS 0xFFFF1258 /begin FUNCTION_LIST KF7-313C.9[3] /end FUNCTION_LIST /end MEASUREMENT
/begin MEASUREMENT vDELALP_R#2 "MALPHA For the difference" SLONG COMP_0438 1 100 -8388608 8388607.99609375 ECU_ADDRESS 0xFFFF125C /begin FUNCTION_LIST KF7-313C.9[3] /end FUNCTION_LIST /end MEASUREMENT
/begin MEASUREMENT vDLTADV "At the time of the acceleration, the amount of ADV phase control" SBYTE COMP_0018 1 100 -128 127 ECU_ADDRESS 0xFFFF23CE /begin FUNCTION_LIST KF7-320A.1[6] KF7-320A.15[4] R301.23.ADV_calculation_1_1_2 /end FUNCTION_LIST /end MEASUREMENT
/begin MEASUREMENT vDSADV "The amount of ignition timing damper compensation for SCV" UBYTE COMP_0017 1 100 0 255 ECU_ADDRESS 0xFFFF1298 /begin FUNCTION_LIST KF7-320A.10[14] KF7-320A.18[4] /end FUNCTION_LIST /end MEASUREMENT
/begin MEASUREMENT vDWLNE "At the time of the dwell calculation, speed" UBYTE COMP_0020 1 100 0 12750 ECU_ADDRESS 0xFFFF12C0 /begin FUNCTION_LIST KF7-320A.6[3] KF7-320A.21[N] /end FUNCTION_LIST /end MEASUREMENT
/begin MEASUREMENT vDWLNET "Dwell speed 2/ three power value" UBYTE COMP_0057_S 1 100 0 510 ECU_ADDRESS 0xFFFF12C1 /begin FUNCTION_LIST KF7-320A.6[3] KF7-320A.21[N] /end FUNCTION_LIST /end MEASUREMENT
/begin MEASUREMENT vDWLVB "At the time of the dwell calculation, battery voltage" UBYTE COMP_0033 1 100 0 20400 ECU_ADDRESS 0xFFFF12C4 /begin FUNCTION_LIST KF7-320A.6[3] KF7-320A.21[N] /end FUNCTION_LIST /end MEASUREMENT
/begin MEASUREMENT vDWLVBT "Dwell battery (-2/3) power value" UBYTE COMP_0058_S 1 100 0 0.3984375 ECU_ADDRESS 0xFFFF12C5 /begin FUNCTION_LIST KF7-320A.6[3] KF7-320A.21[N] /end FUNCTION_LIST /end MEASUREMENT
/begin MEASUREMENT vEGRC "Modification EGR value" UWORD COMP_0271 1 100 0 199.99696053 ECU_ADDRESS 0xFFFF12CA /begin FUNCTION_LIST KF7-320A.8[2] /end FUNCTION_LIST /end MEASUREMENT
/begin MEASUREMENT vFADV "A final ignition timing" UBYTE COMP_0017 1 100 0 255 ECU_ADDRESS 0xFFFF8A3B
 /begin FUNCTION_LIST KF7-320A.5[N] KF7-450.9A[5] KF7-450.50[10] KF7-500.1[54] KF7-525.2[6] R904.1.Gst_on_can_1_0_1 /end FUNCTION_LIST
/end MEASUREMENT
/begin MEASUREMENT vFLFA "Air-fuel ratio compensation coefficient" UBYTE COMP_0009 1 100 0 199.21875 ECU_ADDRESS 0xFFFF1391 /begin FUNCTION_LIST KF7-320A.8[2] /end FUNCTION_LIST /end MEASUREMENT
/begin MEASUREMENT vFLML "Layer way flame speed modification value" UBYTE COMP_0253 1 100 0 0.0159375 ECU_ADDRESS 0xFFFF1394 /begin FUNCTION_LIST KF7-320A.8[2] /end FUNCTION_LIST /end MEASUREMENT
/begin MEASUREMENT vFLTW "Coolant temperature compensation coefficient" UBYTE COMP_0009 1 100 0 199.21875 ECU_ADDRESS 0xFFFF1396 /begin FUNCTION_LIST KF7-320A.8[2] /end FUNCTION_LIST /end MEASUREMENT
/begin MEASUREMENT vFLV "Flame speed" UWORD COMP_0430 1 100 0 0.999985458 ECU_ADDRESS 0xFFFF1398 /begin FUNCTION_LIST KF7-320A.8[2] /end FUNCTION_LIST /end MEASUREMENT
/begin MEASUREMENT vFODWN3 "At the time of Rich, HOSCMAX renewal permission flag (0: prohibition 1: permission)" UBYTE COMP_0283 1 100 0 255 ECU_ADDRESS 0xFFFF2D90 /begin FUNCTION_LIST KF7-313C.5[3] /end FUNCTION_LIST /end MEASUREMENT
/begin MEASUREMENT vFRCNG "First idle retard section compensation rate" UBYTE COMP_0108 1 100 0 0.99609375 ECU_ADDRESS 0xFFFF139E /begin FUNCTION_LIST KF7-320A.12[N] /end FUNCTION_LIST /end MEASUREMENT
/begin MEASUREMENT vFROUP3 "At the time of Lean, HOSCMAX renewal permission flag (0: prohibition 1: permission)" UBYTE COMP_0283 1 100 0 255 ECU_ADDRESS 0xFFFF2DB4 /begin FUNCTION_LIST KF7-313C.5[3] /end FUNCTION_LIST /end MEASUREMENT
/begin MEASUREMENT vFUELG "The number of fuel weight equivalent dimensions-less" UBYTE COMP_0021 1 100 0 99.609375 ECU_ADDRESS 0xFFFF13B0 /begin FUNCTION_LIST KF7-320A.8[2] /end FUNCTION_LIST /end MEASUREMENT
/begin MEASUREMENT vGOVDMP "Cranking ADV/GOV damper" SBYTE COMP_0018 1 100 -128 127 ECU_ADDRESS 0xFFFF13D8 /begin FUNCTION_LIST KF7-320A.10[14] /end FUNCTION_LIST /end MEASUREMENT
/begin MEASUREMENT vGOVIDL "GOV idle value" SBYTE COMP_0018 1 100 -128 127 ECU_ADDRESS 0xFFFF23D8
 /begin FUNCTION_LIST KF7-320A.10[14] KF7-320A.18[4] KF7-390.1A[3] R301.22.TRHOSI_1_0_2 R301.25.GOV_idle_1_0_2 /end FUNCTION_LIST
/end MEASUREMENT
/begin MEASUREMENT vHOSCINBL "HOSCMAX renewal permission flag" UBYTE COMP_0283 1 100 0 255 ECU_ADDRESS 0xFFFF2E20 /begin FUNCTION_LIST KF7-313C.5[3] /end FUNCTION_LIST /end MEASUREMENT
/begin MEASUREMENT vHTARTD "High intake air temperature retard value" UBYTE COMP_0017 1 100 0 255 ECU_ADDRESS 0xFFFF23D9 /begin FUNCTION_LIST KF7-320A.9[9] /end FUNCTION_LIST /end MEASUREMENT
/begin MEASUREMENT vHTARTDR "High intake air temperature retard value (after the change width limiter)" UBYTE COMP_0017 1 100 0 255 ECU_ADDRESS 0xFFFF8A3F /begin FUNCTION_LIST KF7-320A.9[9] /end FUNCTION_LIST /end MEASUREMENT
/begin MEASUREMENT vKTARTD "A high intake air temperature retard gain" UBYTE COMP_0119_S 1 100 0 3.984375 ECU_ADDRESS 0xFFFF14FE /begin FUNCTION_LIST KF7-320A.9[9] /end FUNCTION_LIST /end MEASUREMENT
/begin MEASUREMENT vKVAFADJ "Lambda point compensation value" SWORD COMP_0353 1 100 -163840 163835 ECU_ADDRESS 0xFFFFB60C /begin FUNCTION_LIST KF7-313C.3[1] /end FUNCTION_LIST /end MEASUREMENT
/begin MEASUREMENT vLRNTS "Learning value for TS" UWORD COMP_0458 1 100 -1280 1279.9609375 ECU_ADDRESS 0xFFFFA4D0 /begin FUNCTION_LIST KF7-314.1F[1] /end FUNCTION_LIST /end MEASUREMENT
/begin MEASUREMENT vLRNTS_R#1 "Learning value for TS" UWORD COMP_0458 1 100 -1280 1279.9609375 ECU_ADDRESS 0xFFFFA4D0 /begin FUNCTION_LIST KF7-314.1F[1] /end FUNCTION_LIST /end MEASUREMENT
/begin MEASUREMENT vLRNTS_R#2 "Learning value for TS" UWORD COMP_0458 1 100 -1280 1279.9609375 ECU_ADDRESS 0xFFFFA4D2 /begin FUNCTION_LIST KF7-314.1F[1] /end FUNCTION_LIST /end MEASUREMENT
/begin MEASUREMENT vMALPHA "ALPHA weighted average value (R/L)" UWORD COMP_0031 1 100 0 255.99609375 ECU_ADDRESS 0xFFFF1556
 /begin FUNCTION_LIST KF7-313C.9[3] KF7-330.5[53] KF7-371.1E[15] KF7-500.20B[4] KF7-500.21[19] KF7-500.24[10] /end FUNCTION_LIST
/end MEASUREMENT
/begin MEASUREMENT vMALPHA_R#1 "ALPHA weighted average value (R/L)" UWORD COMP_0031 1 100 0 255.99609375 ECU_ADDRESS 0xFFFF1556
 /begin FUNCTION_LIST KF7-313C.9[3] KF7-330.5[53] KF7-371.1E[15] KF7-500.20B[4] KF7-500.21[19] KF7-500.24[10] /end FUNCTION_LIST
/end MEASUREMENT
/begin MEASUREMENT vMALPHA_R#2 "ALPHA weighted average value (R/L)" UWORD COMP_0031 1 100 0 255.99609375 ECU_ADDRESS 0xFFFF1558
 /begin FUNCTION_LIST KF7-313C.9[3] KF7-330.5[53] KF7-371.1E[15] KF7-500.20B[4] KF7-500.21[19] KF7-500.24[10] /end FUNCTION_LIST
/end MEASUREMENT
/begin MEASUREMENT vMASSC "In the cylinder, mass" UWORD COMP_0460 1 100 0 49.999207365 ECU_ADDRESS 0xFFFF155E /begin FUNCTION_LIST KF7-320A.8[2] /end FUNCTION_LIST /end MEASUREMENT
/begin MEASUREMENT vMCLRL "A mixed ratio learning counter (the left bank)" UBYTE COMP_0068 1 100 0 255 ECU_ADDRESS 0xFFFFA4DA /begin FUNCTION_LIST KF7-314.1F[1] R901.1.Diag_on_can_app_1_6_2 /end FUNCTION_LIST /end MEASUREMENT
/begin MEASUREMENT vMCLRL_C#1_R#1 "A mixed ratio learning counter (the left bank)" UBYTE COMP_0068 1 100 0 255 ECU_ADDRESS 0xFFFFA4DA /begin FUNCTION_LIST KF7-314.1F[1] R901.1.Diag_on_can_app_1_6_2 /end FUNCTION_LIST /end MEASUREMENT
/begin MEASUREMENT vMCLRL_C#1_R#2 "A mixed ratio learning counter (the left bank)" UBYTE COMP_0068 1 100 0 255 ECU_ADDRESS 0xFFFFA4DB /begin FUNCTION_LIST KF7-314.1F[1] R901.1.Diag_on_can_app_1_6_2 /end FUNCTION_LIST /end MEASUREMENT
/begin MEASUREMENT vMCLRL_C#1_R#3 "A mixed ratio learning counter (the left bank)" UBYTE COMP_0068 1 100 0 255 ECU_ADDRESS 0xFFFFA4DC /begin FUNCTION_LIST KF7-314.1F[1] R901.1.Diag_on_can_app_1_6_2 /end FUNCTION_LIST /end MEASUREMENT
/begin MEASUREMENT vMCLRL_C#1_R#4 "A mixed ratio learning counter (the left bank)" UBYTE COMP_0068 1 100 0 255 ECU_ADDRESS 0xFFFFA4DD /begin FUNCTION_LIST KF7-314.1F[1] R901.1.Diag_on_can_app_1_6_2 /end FUNCTION_LIST /end MEASUREMENT
/begin MEASUREMENT vMCLRL_C#1_R#5 "A mixed ratio learning counter (the left bank)" UBYTE COMP_0068 1 100 0 255 ECU_ADDRESS 0xFFFFA4DE /begin FUNCTION_LIST KF7-314.1F[1] R901.1.Diag_on_can_app_1_6_2 /end FUNCTION_LIST /end MEASUREMENT
/begin MEASUREMENT vMCLRL_C#1_R#6 "A mixed ratio learning counter (the left bank)" UBYTE COMP_0068 1 100 0 255 ECU_ADDRESS 0xFFFFA4DF /begin FUNCTION_LIST KF7-314.1F[1] R901.1.Diag_on_can_app_1_6_2 /end FUNCTION_LIST /end MEASUREMENT
/begin MEASUREMENT vMCLRL_C#1_R#7 "A mixed ratio learning counter (the left bank)" UBYTE COMP_0068 1 100 0 255 ECU_ADDRESS 0xFFFFA4E0 /begin FUNCTION_LIST KF7-314.1F[1] R901.1.Diag_on_can_app_1_6_2 /end FUNCTION_LIST /end MEASUREMENT
/begin MEASUREMENT vMCLRL_C#1_R#8 "A mixed ratio learning counter (the left bank)" UBYTE COMP_0068 1 100 0 255 ECU_ADDRESS 0xFFFFA4E1 /begin FUNCTION_LIST KF7-314.1F[1] R901.1.Diag_on_can_app_1_6_2 /end FUNCTION_LIST /end MEASUREMENT
/begin MEASUREMENT vMCLRL_C#2_R#1 "A mixed ratio learning counter (the left bank)" UBYTE COMP_0068 1 100 0 255 ECU_ADDRESS 0xFFFFA4E2 /begin FUNCTION_LIST KF7-314.1F[1] R901.1.Diag_on_can_app_1_6_2 /end FUNCTION_LIST /end MEASUREMENT
/begin MEASUREMENT vMCLRL_C#2_R#2 "A mixed ratio learning counter (the left bank)" UBYTE COMP_0068 1 100 0 255 ECU_ADDRESS 0xFFFFA4E3 /begin FUNCTION_LIST KF7-314.1F[1] R901.1.Diag_on_can_app_1_6_2 /end FUNCTION_LIST /end MEASUREMENT
/begin MEASUREMENT vMCLRL_C#2_R#3 "A mixed ratio learning counter (the left bank)" UBYTE COMP_0068 1 100 0 255 ECU_ADDRESS 0xFFFFA4E4 /begin FUNCTION_LIST KF7-314.1F[1] R901.1.Diag_on_can_app_1_6_2 /end FUNCTION_LIST /end MEASUREMENT
/begin MEASUREMENT vMCLRL_C#2_R#4 "A mixed ratio learning counter (the left bank)" UBYTE COMP_0068 1 100 0 255 ECU_ADDRESS 0xFFFFA4E5 /begin FUNCTION_LIST KF7-314.1F[1] R901.1.Diag_on_can_app_1_6_2 /end FUNCTION_LIST /end MEASUREMENT
/begin MEASUREMENT vMCLRL_C#2_R#5 "A mixed ratio learning counter (the left bank)" UBYTE COMP_0068 1 100 0 255 ECU_ADDRESS 0xFFFFA4E6 /begin FUNCTION_LIST KF7-314.1F[1] R901.1.Diag_on_can_app_1_6_2 /end FUNCTION_LIST /end MEASUREMENT
/begin MEASUREMENT vMCLRL_C#2_R#6 "A mixed ratio learning counter (the left bank)" UBYTE COMP_0068 1 100 0 255 ECU_ADDRESS 0xFFFFA4E7 /begin FUNCTION_LIST KF7-314.1F[1] R901.1.Diag_on_can_app_1_6_2 /end FUNCTION_LIST /end MEASUREMENT
/begin MEASUREMENT vMCLRL_C#2_R#7 "A mixed ratio learning counter (the left bank)" UBYTE COMP_0068 1 100 0 255 ECU_ADDRESS 0xFFFFA4E8 /begin FUNCTION_LIST KF7-314.1F[1] R901.1.Diag_on_can_app_1_6_2 /end FUNCTION_LIST /end MEASUREMENT
/begin MEASUREMENT vMCLRL_C#2_R#8 "A mixed ratio learning counter (the left bank)" UBYTE COMP_0068 1 100 0 255 ECU_ADDRESS 0xFFFFA4E9 /begin FUNCTION_LIST KF7-314.1F[1] R901.1.Diag_on_can_app_1_6_2 /end FUNCTION_LIST /end MEASUREMENT
/begin MEASUREMENT vMCLRL_C#3_R#1 "A mixed ratio learning counter (the left bank)" UBYTE COMP_0068 1 100 0 255 ECU_ADDRESS 0xFFFFA4EA /begin FUNCTION_LIST KF7-314.1F[1] R901.1.Diag_on_can_app_1_6_2 /end FUNCTION_LIST /end MEASUREMENT
/begin MEASUREMENT vMCLRL_C#3_R#2 "A mixed ratio learning counter (the left bank)" UBYTE COMP_0068 1 100 0 255 ECU_ADDRESS 0xFFFFA4EB /begin FUNCTION_LIST KF7-314.1F[1] R901.1.Diag_on_can_app_1_6_2 /end FUNCTION_LIST /end MEASUREMENT
/begin MEASUREMENT vMCLRL_C#3_R#3 "A mixed ratio learning counter (the left bank)" UBYTE COMP_0068 1 100 0 255 ECU_ADDRESS 0xFFFFA4EC /begin FUNCTION_LIST KF7-314.1F[1] R901.1.Diag_on_can_app_1_6_2 /end FUNCTION_LIST /end MEASUREMENT
/begin MEASUREMENT vMCLRL_C#3_R#4 "A mixed ratio learning counter (the left bank)" UBYTE COMP_0068 1 100 0 255 ECU_ADDRESS 0xFFFFA4ED /begin FUNCTION_LIST KF7-314.1F[1] R901.1.Diag_on_can_app_1_6_2 /end FUNCTION_LIST /end MEASUREMENT
/begin MEASUREMENT vMCLRL_C#3_R#5 "A mixed ratio learning counter (the left bank)" UBYTE COMP_0068 1 100 0 255 ECU_ADDRESS 0xFFFFA4EE /begin FUNCTION_LIST KF7-314.1F[1] R901.1.Diag_on_can_app_1_6_2 /end FUNCTION_LIST /end MEASUREMENT
/begin MEASUREMENT vMCLRL_C#3_R#6 "A mixed ratio learning counter (the left bank)" UBYTE COMP_0068 1 100 0 255 ECU_ADDRESS 0xFFFFA4EF /begin FUNCTION_LIST KF7-314.1F[1] R901.1.Diag_on_can_app_1_6_2 /end FUNCTION_LIST /end MEASUREMENT
/begin MEASUREMENT vMCLRL_C#3_R#7 "A mixed ratio learning counter (the left bank)" UBYTE COMP_0068 1 100 0 255 ECU_ADDRESS 0xFFFFA4F0 /begin FUNCTION_LIST KF7-314.1F[1] R901.1.Diag_on_can_app_1_6_2 /end FUNCTION_LIST /end MEASUREMENT
/begin MEASUREMENT vMCLRL_C#3_R#8 "A mixed ratio learning counter (the left bank)" UBYTE COMP_0068 1 100 0 255 ECU_ADDRESS 0xFFFFA4F1 /begin FUNCTION_LIST KF7-314.1F[1] R901.1.Diag_on_can_app_1_6_2 /end FUNCTION_LIST /end MEASUREMENT
/begin MEASUREMENT vMCLRL_C#4_R#1 "A mixed ratio learning counter (the left bank)" UBYTE COMP_0068 1 100 0 255 ECU_ADDRESS 0xFFFFA4F2 /begin FUNCTION_LIST KF7-314.1F[1] R901.1.Diag_on_can_app_1_6_2 /end FUNCTION_LIST /end MEASUREMENT
/begin MEASUREMENT vMCLRL_C#4_R#2 "A mixed ratio learning counter (the left bank)" UBYTE COMP_0068 1 100 0 255 ECU_ADDRESS 0xFFFFA4F3 /begin FUNCTION_LIST KF7-314.1F[1] R901.1.Diag_on_can_app_1_6_2 /end FUNCTION_LIST /end MEASUREMENT
/begin MEASUREMENT vMCLRL_C#4_R#3 "A mixed ratio learning counter (the left bank)" UBYTE COMP_0068 1 100 0 255 ECU_ADDRESS 0xFFFFA4F4 /begin FUNCTION_LIST KF7-314.1F[1] R901.1.Diag_on_can_app_1_6_2 /end FUNCTION_LIST /end MEASUREMENT
/begin MEASUREMENT vMCLRL_C#4_R#4 "A mixed ratio learning counter (the left bank)" UBYTE COMP_0068 1 100 0 255 ECU_ADDRESS 0xFFFFA4F5 /begin FUNCTION_LIST KF7-314.1F[1] R901.1.Diag_on_can_app_1_6_2 /end FUNCTION_LIST /end MEASUREMENT
/begin MEASUREMENT vMCLRL_C#4_R#5 "A mixed ratio learning counter (the left bank)" UBYTE COMP_0068 1 100 0 255 ECU_ADDRESS 0xFFFFA4F6 /begin FUNCTION_LIST KF7-314.1F[1] R901.1.Diag_on_can_app_1_6_2 /end FUNCTION_LIST /end MEASUREMENT
/begin MEASUREMENT vMCLRL_C#4_R#6 "A mixed ratio learning counter (the left bank)" UBYTE COMP_0068 1 100 0 255 ECU_ADDRESS 0xFFFFA4F7 /begin FUNCTION_LIST KF7-314.1F[1] R901.1.Diag_on_can_app_1_6_2 /end FUNCTION_LIST /end MEASUREMENT
/begin MEASUREMENT vMCLRL_C#4_R#7 "A mixed ratio learning counter (the left bank)" UBYTE COMP_0068 1 100 0 255 ECU_ADDRESS 0xFFFFA4F8 /begin FUNCTION_LIST KF7-314.1F[1] R901.1.Diag_on_can_app_1_6_2 /end FUNCTION_LIST /end MEASUREMENT
/begin MEASUREMENT vMCLRL_C#4_R#8 "A mixed ratio learning counter (the left bank)" UBYTE COMP_0068 1 100 0 255 ECU_ADDRESS 0xFFFFA4F9 /begin FUNCTION_LIST KF7-314.1F[1] R901.1.Diag_on_can_app_1_6_2 /end FUNCTION_LIST /end MEASUREMENT
/begin MEASUREMENT vMCLRL_C#5_R#1 "A mixed ratio learning counter (the left bank)" UBYTE COMP_0068 1 100 0 255 ECU_ADDRESS 0xFFFFA4FA /begin FUNCTION_LIST KF7-314.1F[1] R901.1.Diag_on_can_app_1_6_2 /end FUNCTION_LIST /end MEASUREMENT
/begin MEASUREMENT vMCLRL_C#5_R#2 "A mixed ratio learning counter (the left bank)" UBYTE COMP_0068 1 100 0 255 ECU_ADDRESS 0xFFFFA4FB /begin FUNCTION_LIST KF7-314.1F[1] R901.1.Diag_on_can_app_1_6_2 /end FUNCTION_LIST /end MEASUREMENT
/begin MEASUREMENT vMCLRL_C#5_R#3 "A mixed ratio learning counter (the left bank)" UBYTE COMP_0068 1 100 0 255 ECU_ADDRESS 0xFFFFA4FC /begin FUNCTION_LIST KF7-314.1F[1] R901.1.Diag_on_can_app_1_6_2 /end FUNCTION_LIST /end MEASUREMENT
/begin MEASUREMENT vMCLRL_C#5_R#4 "A mixed ratio learning counter (the left bank)" UBYTE COMP_0068 1 100 0 255 ECU_ADDRESS 0xFFFFA4FD /begin FUNCTION_LIST KF7-314.1F[1] R901.1.Diag_on_can_app_1_6_2 /end FUNCTION_LIST /end MEASUREMENT
/begin MEASUREMENT vMCLRL_C#5_R#5 "A mixed ratio learning counter (the left bank)" UBYTE COMP_0068 1 100 0 255 ECU_ADDRESS 0xFFFFA4FE /begin FUNCTION_LIST KF7-314.1F[1] R901.1.Diag_on_can_app_1_6_2 /end FUNCTION_LIST /end MEASUREMENT
/begin MEASUREMENT vMCLRL_C#5_R#6 "A mixed ratio learning counter (the left bank)" UBYTE COMP_0068 1 100 0 255 ECU_ADDRESS 0xFFFFA4FF /begin FUNCTION_LIST KF7-314.1F[1] R901.1.Diag_on_can_app_1_6_2 /end FUNCTION_LIST /end MEASUREMENT
/begin MEASUREMENT vMCLRL_C#5_R#7 "A mixed ratio learning counter (the left bank)" UBYTE COMP_0068 1 100 0 255 ECU_ADDRESS 0xFFFFA500 /begin FUNCTION_LIST KF7-314.1F[1] R901.1.Diag_on_can_app_1_6_2 /end FUNCTION_LIST /end MEASUREMENT
/begin MEASUREMENT vMCLRL_C#5_R#8 "A mixed ratio learning counter (the left bank)" UBYTE COMP_0068 1 100 0 255 ECU_ADDRESS 0xFFFFA501 /begin FUNCTION_LIST KF7-314.1F[1] R901.1.Diag_on_can_app_1_6_2 /end FUNCTION_LIST /end MEASUREMENT
/begin MEASUREMENT vMCLRL_C#6_R#1 "A mixed ratio learning counter (the left bank)" UBYTE COMP_0068 1 100 0 255 ECU_ADDRESS 0xFFFFA502 /begin FUNCTION_LIST KF7-314.1F[1] R901.1.Diag_on_can_app_1_6_2 /end FUNCTION_LIST /end MEASUREMENT
/begin MEASUREMENT vMCLRL_C#6_R#2 "A mixed ratio learning counter (the left bank)" UBYTE COMP_0068 1 100 0 255 ECU_ADDRESS 0xFFFFA503 /begin FUNCTION_LIST KF7-314.1F[1] R901.1.Diag_on_can_app_1_6_2 /end FUNCTION_LIST /end MEASUREMENT
/begin MEASUREMENT vMCLRL_C#6_R#3 "A mixed ratio learning counter (the left bank)" UBYTE COMP_0068 1 100 0 255 ECU_ADDRESS 0xFFFFA504 /begin FUNCTION_LIST KF7-314.1F[1] R901.1.Diag_on_can_app_1_6_2 /end FUNCTION_LIST /end MEASUREMENT
/begin MEASUREMENT vMCLRL_C#6_R#4 "A mixed ratio learning counter (the left bank)" UBYTE COMP_0068 1 100 0 255 ECU_ADDRESS 0xFFFFA505 /begin FUNCTION_LIST KF7-314.1F[1] R901.1.Diag_on_can_app_1_6_2 /end FUNCTION_LIST /end MEASUREMENT
/begin MEASUREMENT vMCLRL_C#6_R#5 "A mixed ratio learning counter (the left bank)" UBYTE COMP_0068 1 100 0 255 ECU_ADDRESS 0xFFFFA506 /begin FUNCTION_LIST KF7-314.1F[1] R901.1.Diag_on_can_app_1_6_2 /end FUNCTION_LIST /end MEASUREMENT
/begin MEASUREMENT vMCLRL_C#6_R#6 "A mixed ratio learning counter (the left bank)" UBYTE COMP_0068 1 100 0 255 ECU_ADDRESS 0xFFFFA507 /begin FUNCTION_LIST KF7-314.1F[1] R901.1.Diag_on_can_app_1_6_2 /end FUNCTION_LIST /end MEASUREMENT
/begin MEASUREMENT vMCLRL_C#6_R#7 "A mixed ratio learning counter (the left bank)" UBYTE COMP_0068 1 100 0 255 ECU_ADDRESS 0xFFFFA508 /begin FUNCTION_LIST KF7-314.1F[1] R901.1.Diag_on_can_app_1_6_2 /end FUNCTION_LIST /end MEASUREMENT
/begin MEASUREMENT vMCLRL_C#6_R#8 "A mixed ratio learning counter (the left bank)" UBYTE COMP_0068 1 100 0 255 ECU_ADDRESS 0xFFFFA509 /begin FUNCTION_LIST KF7-314.1F[1] R901.1.Diag_on_can_app_1_6_2 /end FUNCTION_LIST /end MEASUREMENT
/begin MEASUREMENT vMCLRL_C#7_R#1 "A mixed ratio learning counter (the left bank)" UBYTE COMP_0068 1 100 0 255 ECU_ADDRESS 0xFFFFA50A /begin FUNCTION_LIST KF7-314.1F[1] R901.1.Diag_on_can_app_1_6_2 /end FUNCTION_LIST /end MEASUREMENT
/begin MEASUREMENT vMCLRL_C#7_R#2 "A mixed ratio learning counter (the left bank)" UBYTE COMP_0068 1 100 0 255 ECU_ADDRESS 0xFFFFA50B /begin FUNCTION_LIST KF7-314.1F[1] R901.1.Diag_on_can_app_1_6_2 /end FUNCTION_LIST /end MEASUREMENT
/begin MEASUREMENT vMCLRL_C#7_R#3 "A mixed ratio learning counter (the left bank)" UBYTE COMP_0068 1 100 0 255 ECU_ADDRESS 0xFFFFA50C /begin FUNCTION_LIST KF7-314.1F[1] R901.1.Diag_on_can_app_1_6_2 /end FUNCTION_LIST /end MEASUREMENT
/begin MEASUREMENT vMCLRL_C#7_R#4 "A mixed ratio learning counter (the left bank)" UBYTE COMP_0068 1 100 0 255 ECU_ADDRESS 0xFFFFA50D /begin FUNCTION_LIST KF7-314.1F[1] R901.1.Diag_on_can_app_1_6_2 /end FUNCTION_LIST /end MEASUREMENT
/begin MEASUREMENT vMCLRL_C#7_R#5 "A mixed ratio learning counter (the left bank)" UBYTE COMP_0068 1 100 0 255 ECU_ADDRESS 0xFFFFA50E /begin FUNCTION_LIST KF7-314.1F[1] R901.1.Diag_on_can_app_1_6_2 /end FUNCTION_LIST /end MEASUREMENT
/begin MEASUREMENT vMCLRL_C#7_R#6 "A mixed ratio learning counter (the left bank)" UBYTE COMP_0068 1 100 0 255 ECU_ADDRESS 0xFFFFA50F /begin FUNCTION_LIST KF7-314.1F[1] R901.1.Diag_on_can_app_1_6_2 /end FUNCTION_LIST /end MEASUREMENT
/begin MEASUREMENT vMCLRL_C#7_R#7 "A mixed ratio learning counter (the left bank)" UBYTE COMP_0068 1 100 0 255 ECU_ADDRESS 0xFFFFA510 /begin FUNCTION_LIST KF7-314.1F[1] R901.1.Diag_on_can_app_1_6_2 /end FUNCTION_LIST /end MEASUREMENT
/begin MEASUREMENT vMCLRL_C#7_R#8 "A mixed ratio learning counter (the left bank)" UBYTE COMP_0068 1 100 0 255 ECU_ADDRESS 0xFFFFA511 /begin FUNCTION_LIST KF7-314.1F[1] R901.1.Diag_on_can_app_1_6_2 /end FUNCTION_LIST /end MEASUREMENT
/begin MEASUREMENT vMCLRL_C#8_R#1 "A mixed ratio learning counter (the left bank)" UBYTE COMP_0068 1 100 0 255 ECU_ADDRESS 0xFFFFA512 /begin FUNCTION_LIST KF7-314.1F[1] R901.1.Diag_on_can_app_1_6_2 /end FUNCTION_LIST /end MEASUREMENT
/begin MEASUREMENT vMCLRL_C#8_R#2 "A mixed ratio learning counter (the left bank)" UBYTE COMP_0068 1 100 0 255 ECU_ADDRESS 0xFFFFA513 /begin FUNCTION_LIST KF7-314.1F[1] R901.1.Diag_on_can_app_1_6_2 /end FUNCTION_LIST /end MEASUREMENT
/begin MEASUREMENT vMCLRL_C#8_R#3 "A mixed ratio learning counter (the left bank)" UBYTE COMP_0068 1 100 0 255 ECU_ADDRESS 0xFFFFA514 /begin FUNCTION_LIST KF7-314.1F[1] R901.1.Diag_on_can_app_1_6_2 /end FUNCTION_LIST /end MEASUREMENT
/begin MEASUREMENT vMCLRL_C#8_R#4 "A mixed ratio learning counter (the left bank)" UBYTE COMP_0068 1 100 0 255 ECU_ADDRESS 0xFFFFA515 /begin FUNCTION_LIST KF7-314.1F[1] R901.1.Diag_on_can_app_1_6_2 /end FUNCTION_LIST /end MEASUREMENT
/begin MEASUREMENT vMCLRL_C#8_R#5 "A mixed ratio learning counter (the left bank)" UBYTE COMP_0068 1 100 0 255 ECU_ADDRESS 0xFFFFA516 /begin FUNCTION_LIST KF7-314.1F[1] R901.1.Diag_on_can_app_1_6_2 /end FUNCTION_LIST /end MEASUREMENT
/begin MEASUREMENT vMCLRL_C#8_R#6 "A mixed ratio learning counter (the left bank)" UBYTE COMP_0068 1 100 0 255 ECU_ADDRESS 0xFFFFA517 /begin FUNCTION_LIST KF7-314.1F[1] R901.1.Diag_on_can_app_1_6_2 /end FUNCTION_LIST /end MEASUREMENT
/begin MEASUREMENT vMCLRL_C#8_R#7 "A mixed ratio learning counter (the left bank)" UBYTE COMP_0068 1 100 0 255 ECU_ADDRESS 0xFFFFA518 /begin FUNCTION_LIST KF7-314.1F[1] R901.1.Diag_on_can_app_1_6_2 /end FUNCTION_LIST /end MEASUREMENT
/begin MEASUREMENT vMCLRL_C#8_R#8 "A mixed ratio learning counter (the left bank)" UBYTE COMP_0068 1 100 0 255 ECU_ADDRESS 0xFFFFA519 /begin FUNCTION_LIST KF7-314.1F[1] R901.1.Diag_on_can_app_1_6_2 /end FUNCTION_LIST /end MEASUREMENT
/begin MEASUREMENT vMCLRR "A mixed ratio learning counter (the right bank)" UBYTE COMP_0068 1 100 0 255 ECU_ADDRESS 0xFFFFA51A /begin FUNCTION_LIST KF7-314.1F[1] R901.1.Diag_on_can_app_1_6_2 /end FUNCTION_LIST /end MEASUREMENT
/begin MEASUREMENT vMCLRR_C#1_R#1 "A mixed ratio learning counter (the right bank)" UBYTE COMP_0068 1 100 0 255 ECU_ADDRESS 0xFFFFA51A /begin FUNCTION_LIST KF7-314.1F[1] R901.1.Diag_on_can_app_1_6_2 /end FUNCTION_LIST /end MEASUREMENT
/begin MEASUREMENT vMCLRR_C#1_R#2 "A mixed ratio learning counter (the right bank)" UBYTE COMP_0068 1 100 0 255 ECU_ADDRESS 0xFFFFA51B /begin FUNCTION_LIST KF7-314.1F[1] R901.1.Diag_on_can_app_1_6_2 /end FUNCTION_LIST /end MEASUREMENT
/begin MEASUREMENT vMCLRR_C#1_R#3 "A mixed ratio learning counter (the right bank)" UBYTE COMP_0068 1 100 0 255 ECU_ADDRESS 0xFFFFA51C /begin FUNCTION_LIST KF7-314.1F[1] R901.1.Diag_on_can_app_1_6_2 /end FUNCTION_LIST /end MEASUREMENT
/begin MEASUREMENT vMCLRR_C#1_R#4 "A mixed ratio learning counter (the right bank)" UBYTE COMP_0068 1 100 0 255 ECU_ADDRESS 0xFFFFA51D /begin FUNCTION_LIST KF7-314.1F[1] R901.1.Diag_on_can_app_1_6_2 /end FUNCTION_LIST /end MEASUREMENT
/begin MEASUREMENT vMCLRR_C#1_R#5 "A mixed ratio learning counter (the right bank)" UBYTE COMP_0068 1 100 0 255 ECU_ADDRESS 0xFFFFA51E /begin FUNCTION_LIST KF7-314.1F[1] R901.1.Diag_on_can_app_1_6_2 /end FUNCTION_LIST /end MEASUREMENT
/begin MEASUREMENT vMCLRR_C#1_R#6 "A mixed ratio learning counter (the right bank)" UBYTE COMP_0068 1 100 0 255 ECU_ADDRESS 0xFFFFA51F /begin FUNCTION_LIST KF7-314.1F[1] R901.1.Diag_on_can_app_1_6_2 /end FUNCTION_LIST /end MEASUREMENT
/begin MEASUREMENT vMCLRR_C#1_R#7 "A mixed ratio learning counter (the right bank)" UBYTE COMP_0068 1 100 0 255 ECU_ADDRESS 0xFFFFA520 /begin FUNCTION_LIST KF7-314.1F[1] R901.1.Diag_on_can_app_1_6_2 /end FUNCTION_LIST /end MEASUREMENT
/begin MEASUREMENT vMCLRR_C#1_R#8 "A mixed ratio learning counter (the right bank)" UBYTE COMP_0068 1 100 0 255 ECU_ADDRESS 0xFFFFA521 /begin FUNCTION_LIST KF7-314.1F[1] R901.1.Diag_on_can_app_1_6_2 /end FUNCTION_LIST /end MEASUREMENT
/begin MEASUREMENT vMCLRR_C#2_R#1 "A mixed ratio learning counter (the right bank)" UBYTE COMP_0068 1 100 0 255 ECU_ADDRESS 0xFFFFA522 /begin FUNCTION_LIST KF7-314.1F[1] R901.1.Diag_on_can_app_1_6_2 /end FUNCTION_LIST /end MEASUREMENT
/begin MEASUREMENT vMCLRR_C#2_R#2 "A mixed ratio learning counter (the right bank)" UBYTE COMP_0068 1 100 0 255 ECU_ADDRESS 0xFFFFA523 /begin FUNCTION_LIST KF7-314.1F[1] R901.1.Diag_on_can_app_1_6_2 /end FUNCTION_LIST /end MEASUREMENT
/begin MEASUREMENT vMCLRR_C#2_R#3 "A mixed ratio learning counter (the right bank)" UBYTE COMP_0068 1 100 0 255 ECU_ADDRESS 0xFFFFA524 /begin FUNCTION_LIST KF7-314.1F[1] R901.1.Diag_on_can_app_1_6_2 /end FUNCTION_LIST /end MEASUREMENT
/begin MEASUREMENT vMCLRR_C#2_R#4 "A mixed ratio learning counter (the right bank)" UBYTE COMP_0068 1 100 0 255 ECU_ADDRESS 0xFFFFA525 /begin FUNCTION_LIST KF7-314.1F[1] R901.1.Diag_on_can_app_1_6_2 /end FUNCTION_LIST /end MEASUREMENT
/begin MEASUREMENT vMCLRR_C#2_R#5 "A mixed ratio learning counter (the right bank)" UBYTE COMP_0068 1 100 0 255 ECU_ADDRESS 0xFFFFA526 /begin FUNCTION_LIST KF7-314.1F[1] R901.1.Diag_on_can_app_1_6_2 /end FUNCTION_LIST /end MEASUREMENT
/begin MEASUREMENT vMCLRR_C#2_R#6 "A mixed ratio learning counter (the right bank)" UBYTE COMP_0068 1 100 0 255 ECU_ADDRESS 0xFFFFA527 /begin FUNCTION_LIST KF7-314.1F[1] R901.1.Diag_on_can_app_1_6_2 /end FUNCTION_LIST /end MEASUREMENT
/begin MEASUREMENT vMCLRR_C#2_R#7 "A mixed ratio learning counter (the right bank)" UBYTE COMP_0068 1 100 0 255 ECU_ADDRESS 0xFFFFA528 /begin FUNCTION_LIST KF7-314.1F[1] R901.1.Diag_on_can_app_1_6_2 /end FUNCTION_LIST /end MEASUREMENT
/begin MEASUREMENT vMCLRR_C#2_R#8 "A mixed ratio learning counter (the right bank)" UBYTE COMP_0068 1 100 0 255 ECU_ADDRESS 0xFFFFA529 /begin FUNCTION_LIST KF7-314.1F[1] R901.1.Diag_on_can_app_1_6_2 /end FUNCTION_LIST /end MEASUREMENT
/begin MEASUREMENT vMCLRR_C#3_R#1 "A mixed ratio learning counter (the right bank)" UBYTE COMP_0068 1 100 0 255 ECU_ADDRESS 0xFFFFA52A /begin FUNCTION_LIST KF7-314.1F[1] R901.1.Diag_on_can_app_1_6_2 /end FUNCTION_LIST /end MEASUREMENT
/begin MEASUREMENT vMCLRR_C#3_R#2 "A mixed ratio learning counter (the right bank)" UBYTE COMP_0068 1 100 0 255 ECU_ADDRESS 0xFFFFA52B /begin FUNCTION_LIST KF7-314.1F[1] R901.1.Diag_on_can_app_1_6_2 /end FUNCTION_LIST /end MEASUREMENT
/begin MEASUREMENT vMCLRR_C#3_R#3 "A mixed ratio learning counter (the right bank)" UBYTE COMP_0068 1 100 0 255 ECU_ADDRESS 0xFFFFA52C /begin FUNCTION_LIST KF7-314.1F[1] R901.1.Diag_on_can_app_1_6_2 /end FUNCTION_LIST /end MEASUREMENT
/begin MEASUREMENT vMCLRR_C#3_R#4 "A mixed ratio learning counter (the right bank)" UBYTE COMP_0068 1 100 0 255 ECU_ADDRESS 0xFFFFA52D /begin FUNCTION_LIST KF7-314.1F[1] R901.1.Diag_on_can_app_1_6_2 /end FUNCTION_LIST /end MEASUREMENT
/begin MEASUREMENT vMCLRR_C#3_R#5 "A mixed ratio learning counter (the right bank)" UBYTE COMP_0068 1 100 0 255 ECU_ADDRESS 0xFFFFA52E /begin FUNCTION_LIST KF7-314.1F[1] R901.1.Diag_on_can_app_1_6_2 /end FUNCTION_LIST /end MEASUREMENT
/begin MEASUREMENT vMCLRR_C#3_R#6 "A mixed ratio learning counter (the right bank)" UBYTE COMP_0068 1 100 0 255 ECU_ADDRESS 0xFFFFA52F /begin FUNCTION_LIST KF7-314.1F[1] R901.1.Diag_on_can_app_1_6_2 /end FUNCTION_LIST /end MEASUREMENT
/begin MEASUREMENT vMCLRR_C#3_R#7 "A mixed ratio learning counter (the right bank)" UBYTE COMP_0068 1 100 0 255 ECU_ADDRESS 0xFFFFA530 /begin FUNCTION_LIST KF7-314.1F[1] R901.1.Diag_on_can_app_1_6_2 /end FUNCTION_LIST /end MEASUREMENT
/begin MEASUREMENT vMCLRR_C#3_R#8 "A mixed ratio learning counter (the right bank)" UBYTE COMP_0068 1 100 0 255 ECU_ADDRESS 0xFFFFA531 /begin FUNCTION_LIST KF7-314.1F[1] R901.1.Diag_on_can_app_1_6_2 /end FUNCTION_LIST /end MEASUREMENT
/begin MEASUREMENT vMCLRR_C#4_R#1 "A mixed ratio learning counter (the right bank)" UBYTE COMP_0068 1 100 0 255 ECU_ADDRESS 0xFFFFA532 /begin FUNCTION_LIST KF7-314.1F[1] R901.1.Diag_on_can_app_1_6_2 /end FUNCTION_LIST /end MEASUREMENT
/begin MEASUREMENT vMCLRR_C#4_R#2 "A mixed ratio learning counter (the right bank)" UBYTE COMP_0068 1 100 0 255 ECU_ADDRESS 0xFFFFA533 /begin FUNCTION_LIST KF7-314.1F[1] R901.1.Diag_on_can_app_1_6_2 /end FUNCTION_LIST /end MEASUREMENT
/begin MEASUREMENT vMCLRR_C#4_R#3 "A mixed ratio learning counter (the right bank)" UBYTE COMP_0068 1 100 0 255 ECU_ADDRESS 0xFFFFA534 /begin FUNCTION_LIST KF7-314.1F[1] R901.1.Diag_on_can_app_1_6_2 /end FUNCTION_LIST /end MEASUREMENT
/begin MEASUREMENT vMCLRR_C#4_R#4 "A mixed ratio learning counter (the right bank)" UBYTE COMP_0068 1 100 0 255 ECU_ADDRESS 0xFFFFA535 /begin FUNCTION_LIST KF7-314.1F[1] R901.1.Diag_on_can_app_1_6_2 /end FUNCTION_LIST /end MEASUREMENT
/begin MEASUREMENT vMCLRR_C#4_R#5 "A mixed ratio learning counter (the right bank)" UBYTE COMP_0068 1 100 0 255 ECU_ADDRESS 0xFFFFA536 /begin FUNCTION_LIST KF7-314.1F[1] R901.1.Diag_on_can_app_1_6_2 /end FUNCTION_LIST /end MEASUREMENT
/begin MEASUREMENT vMCLRR_C#4_R#6 "A mixed ratio learning counter (the right bank)" UBYTE COMP_0068 1 100 0 255 ECU_ADDRESS 0xFFFFA537 /begin FUNCTION_LIST KF7-314.1F[1] R901.1.Diag_on_can_app_1_6_2 /end FUNCTION_LIST /end MEASUREMENT
/begin MEASUREMENT vMCLRR_C#4_R#7 "A mixed ratio learning counter (the right bank)" UBYTE COMP_0068 1 100 0 255 ECU_ADDRESS 0xFFFFA538 /begin FUNCTION_LIST KF7-314.1F[1] R901.1.Diag_on_can_app_1_6_2 /end FUNCTION_LIST /end MEASUREMENT
/begin MEASUREMENT vMCLRR_C#4_R#8 "A mixed ratio learning counter (the right bank)" UBYTE COMP_0068 1 100 0 255 ECU_ADDRESS 0xFFFFA539 /begin FUNCTION_LIST KF7-314.1F[1] R901.1.Diag_on_can_app_1_6_2 /end FUNCTION_LIST /end MEASUREMENT
/begin MEASUREMENT vMCLRR_C#5_R#1 "A mixed ratio learning counter (the right bank)" UBYTE COMP_0068 1 100 0 255 ECU_ADDRESS 0xFFFFA53A /begin FUNCTION_LIST KF7-314.1F[1] R901.1.Diag_on_can_app_1_6_2 /end FUNCTION_LIST /end MEASUREMENT
/begin MEASUREMENT vMCLRR_C#5_R#2 "A mixed ratio learning counter (the right bank)" UBYTE COMP_0068 1 100 0 255 ECU_ADDRESS 0xFFFFA53B /begin FUNCTION_LIST KF7-314.1F[1] R901.1.Diag_on_can_app_1_6_2 /end FUNCTION_LIST /end MEASUREMENT
/begin MEASUREMENT vMCLRR_C#5_R#3 "A mixed ratio learning counter (the right bank)" UBYTE COMP_0068 1 100 0 255 ECU_ADDRESS 0xFFFFA53C /begin FUNCTION_LIST KF7-314.1F[1] R901.1.Diag_on_can_app_1_6_2 /end FUNCTION_LIST /end MEASUREMENT
/begin MEASUREMENT vMCLRR_C#5_R#4 "A mixed ratio learning counter (the right bank)" UBYTE COMP_0068 1 100 0 255 ECU_ADDRESS 0xFFFFA53D /begin FUNCTION_LIST KF7-314.1F[1] R901.1.Diag_on_can_app_1_6_2 /end FUNCTION_LIST /end MEASUREMENT
/begin MEASUREMENT vMCLRR_C#5_R#5 "A mixed ratio learning counter (the right bank)" UBYTE COMP_0068 1 100 0 255 ECU_ADDRESS 0xFFFFA53E /begin FUNCTION_LIST KF7-314.1F[1] R901.1.Diag_on_can_app_1_6_2 /end FUNCTION_LIST /end MEASUREMENT
/begin MEASUREMENT vMCLRR_C#5_R#6 "A mixed ratio learning counter (the right bank)" UBYTE COMP_0068 1 100 0 255 ECU_ADDRESS 0xFFFFA53F /begin FUNCTION_LIST KF7-314.1F[1] R901.1.Diag_on_can_app_1_6_2 /end FUNCTION_LIST /end MEASUREMENT
/begin MEASUREMENT vMCLRR_C#5_R#7 "A mixed ratio learning counter (the right bank)" UBYTE COMP_0068 1 100 0 255 ECU_ADDRESS 0xFFFFA540 /begin FUNCTION_LIST KF7-314.1F[1] R901.1.Diag_on_can_app_1_6_2 /end FUNCTION_LIST /end MEASUREMENT
/begin MEASUREMENT vMCLRR_C#5_R#8 "A mixed ratio learning counter (the right bank)" UBYTE COMP_0068 1 100 0 255 ECU_ADDRESS 0xFFFFA541 /begin FUNCTION_LIST KF7-314.1F[1] R901.1.Diag_on_can_app_1_6_2 /end FUNCTION_LIST /end MEASUREMENT
/begin MEASUREMENT vMCLRR_C#6_R#1 "A mixed ratio learning counter (the right bank)" UBYTE COMP_0068 1 100 0 255 ECU_ADDRESS 0xFFFFA542 /begin FUNCTION_LIST KF7-314.1F[1] R901.1.Diag_on_can_app_1_6_2 /end FUNCTION_LIST /end MEASUREMENT
/begin MEASUREMENT vMCLRR_C#6_R#2 "A mixed ratio learning counter (the right bank)" UBYTE COMP_0068 1 100 0 255 ECU_ADDRESS 0xFFFFA543 /begin FUNCTION_LIST KF7-314.1F[1] R901.1.Diag_on_can_app_1_6_2 /end FUNCTION_LIST /end MEASUREMENT
/begin MEASUREMENT vMCLRR_C#6_R#3 "A mixed ratio learning counter (the right bank)" UBYTE COMP_0068 1 100 0 255 ECU_ADDRESS 0xFFFFA544 /begin FUNCTION_LIST KF7-314.1F[1] R901.1.Diag_on_can_app_1_6_2 /end FUNCTION_LIST /end MEASUREMENT
/begin MEASUREMENT vMCLRR_C#6_R#4 "A mixed ratio learning counter (the right bank)" UBYTE COMP_0068 1 100 0 255 ECU_ADDRESS 0xFFFFA545 /begin FUNCTION_LIST KF7-314.1F[1] R901.1.Diag_on_can_app_1_6_2 /end FUNCTION_LIST /end MEASUREMENT
/begin MEASUREMENT vMCLRR_C#6_R#5 "A mixed ratio learning counter (the right bank)" UBYTE COMP_0068 1 100 0 255 ECU_ADDRESS 0xFFFFA546 /begin FUNCTION_LIST KF7-314.1F[1] R901.1.Diag_on_can_app_1_6_2 /end FUNCTION_LIST /end MEASUREMENT
/begin MEASUREMENT vMCLRR_C#6_R#6 "A mixed ratio learning counter (the right bank)" UBYTE COMP_0068 1 100 0 255 ECU_ADDRESS 0xFFFFA547 /begin FUNCTION_LIST KF7-314.1F[1] R901.1.Diag_on_can_app_1_6_2 /end FUNCTION_LIST /end MEASUREMENT
/begin MEASUREMENT vMCLRR_C#6_R#7 "A mixed ratio learning counter (the right bank)" UBYTE COMP_0068 1 100 0 255 ECU_ADDRESS 0xFFFFA548 /begin FUNCTION_LIST KF7-314.1F[1] R901.1.Diag_on_can_app_1_6_2 /end FUNCTION_LIST /end MEASUREMENT
/begin MEASUREMENT vMCLRR_C#6_R#8 "A mixed ratio learning counter (the right bank)" UBYTE COMP_0068 1 100 0 255 ECU_ADDRESS 0xFFFFA549 /begin FUNCTION_LIST KF7-314.1F[1] R901.1.Diag_on_can_app_1_6_2 /end FUNCTION_LIST /end MEASUREMENT
/begin MEASUREMENT vMCLRR_C#7_R#1 "A mixed ratio learning counter (the right bank)" UBYTE COMP_0068 1 100 0 255 ECU_ADDRESS 0xFFFFA54A /begin FUNCTION_LIST KF7-314.1F[1] R901.1.Diag_on_can_app_1_6_2 /end FUNCTION_LIST /end MEASUREMENT
/begin MEASUREMENT vMCLRR_C#7_R#2 "A mixed ratio learning counter (the right bank)" UBYTE COMP_0068 1 100 0 255 ECU_ADDRESS 0xFFFFA54B /begin FUNCTION_LIST KF7-314.1F[1] R901.1.Diag_on_can_app_1_6_2 /end FUNCTION_LIST /end MEASUREMENT
/begin MEASUREMENT vMCLRR_C#7_R#3 "A mixed ratio learning counter (the right bank)" UBYTE COMP_0068 1 100 0 255 ECU_ADDRESS 0xFFFFA54C /begin FUNCTION_LIST KF7-314.1F[1] R901.1.Diag_on_can_app_1_6_2 /end FUNCTION_LIST /end MEASUREMENT
/begin MEASUREMENT vMCLRR_C#7_R#4 "A mixed ratio learning counter (the right bank)" UBYTE COMP_0068 1 100 0 255 ECU_ADDRESS 0xFFFFA54D /begin FUNCTION_LIST KF7-314.1F[1] R901.1.Diag_on_can_app_1_6_2 /end FUNCTION_LIST /end MEASUREMENT
/begin MEASUREMENT vMCLRR_C#7_R#5 "A mixed ratio learning counter (the right bank)" UBYTE COMP_0068 1 100 0 255 ECU_ADDRESS 0xFFFFA54E /begin FUNCTION_LIST KF7-314.1F[1] R901.1.Diag_on_can_app_1_6_2 /end FUNCTION_LIST /end MEASUREMENT
/begin MEASUREMENT vMCLRR_C#7_R#6 "A mixed ratio learning counter (the right bank)" UBYTE COMP_0068 1 100 0 255 ECU_ADDRESS 0xFFFFA54F /begin FUNCTION_LIST KF7-314.1F[1] R901.1.Diag_on_can_app_1_6_2 /end FUNCTION_LIST /end MEASUREMENT
/begin MEASUREMENT vMCLRR_C#7_R#7 "A mixed ratio learning counter (the right bank)" UBYTE COMP_0068 1 100 0 255 ECU_ADDRESS 0xFFFFA550 /begin FUNCTION_LIST KF7-314.1F[1] R901.1.Diag_on_can_app_1_6_2 /end FUNCTION_LIST /end MEASUREMENT
/begin MEASUREMENT vMCLRR_C#7_R#8 "A mixed ratio learning counter (the right bank)" UBYTE COMP_0068 1 100 0 255 ECU_ADDRESS 0xFFFFA551 /begin FUNCTION_LIST KF7-314.1F[1] R901.1.Diag_on_can_app_1_6_2 /end FUNCTION_LIST /end MEASUREMENT
/begin MEASUREMENT vMCLRR_C#8_R#1 "A mixed ratio learning counter (the right bank)" UBYTE COMP_0068 1 100 0 255 ECU_ADDRESS 0xFFFFA552 /begin FUNCTION_LIST KF7-314.1F[1] R901.1.Diag_on_can_app_1_6_2 /end FUNCTION_LIST /end MEASUREMENT
/begin MEASUREMENT vMCLRR_C#8_R#2 "A mixed ratio learning counter (the right bank)" UBYTE COMP_0068 1 100 0 255 ECU_ADDRESS 0xFFFFA553 /begin FUNCTION_LIST KF7-314.1F[1] R901.1.Diag_on_can_app_1_6_2 /end FUNCTION_LIST /end MEASUREMENT
/begin MEASUREMENT vMCLRR_C#8_R#3 "A mixed ratio learning counter (the right bank)" UBYTE COMP_0068 1 100 0 255 ECU_ADDRESS 0xFFFFA554 /begin FUNCTION_LIST KF7-314.1F[1] R901.1.Diag_on_can_app_1_6_2 /end FUNCTION_LIST /end MEASUREMENT
/begin MEASUREMENT vMCLRR_C#8_R#4 "A mixed ratio learning counter (the right bank)" UBYTE COMP_0068 1 100 0 255 ECU_ADDRESS 0xFFFFA555 /begin FUNCTION_LIST KF7-314.1F[1] R901.1.Diag_on_can_app_1_6_2 /end FUNCTION_LIST /end MEASUREMENT
/begin MEASUREMENT vMCLRR_C#8_R#5 "A mixed ratio learning counter (the right bank)" UBYTE COMP_0068 1 100 0 255 ECU_ADDRESS 0xFFFFA556 /begin FUNCTION_LIST KF7-314.1F[1] R901.1.Diag_on_can_app_1_6_2 /end FUNCTION_LIST /end MEASUREMENT
/begin MEASUREMENT vMCLRR_C#8_R#6 "A mixed ratio learning counter (the right bank)" UBYTE COMP_0068 1 100 0 255 ECU_ADDRESS 0xFFFFA557 /begin FUNCTION_LIST KF7-314.1F[1] R901.1.Diag_on_can_app_1_6_2 /end FUNCTION_LIST /end MEASUREMENT
/begin MEASUREMENT vMCLRR_C#8_R#7 "A mixed ratio learning counter (the right bank)" UBYTE COMP_0068 1 100 0 255 ECU_ADDRESS 0xFFFFA558 /begin FUNCTION_LIST KF7-314.1F[1] R901.1.Diag_on_can_app_1_6_2 /end FUNCTION_LIST /end MEASUREMENT
/begin MEASUREMENT vMCLRR_C#8_R#8 "A mixed ratio learning counter (the right bank)" UBYTE COMP_0068 1 100 0 255 ECU_ADDRESS 0xFFFFA559 /begin FUNCTION_LIST KF7-314.1F[1] R901.1.Diag_on_can_app_1_6_2 /end FUNCTION_LIST /end MEASUREMENT
/begin MEASUREMENT vMKADV0 "The amount of compensation advance for the minus KTW" UBYTE COMP_0471 1 100 0 15.9375 ECU_ADDRESS 0xFFFF1592 /begin FUNCTION_LIST KF7-320A.11[1] KF7-320A.14[1] /end FUNCTION_LIST /end MEASUREMENT
/begin MEASUREMENT vMKAVN "Compensation advance quantity (rotation) for the minus KTW" UBYTE COMP_0044 1 100 0 1.9921875 ECU_ADDRESS 0xFFFF1593 /begin FUNCTION_LIST KF7-320A.14[1] /end FUNCTION_LIST /end MEASUREMENT
/begin MEASUREMENT vMKAVP "Compensation advance rate (TP) for the minus KTW" UBYTE COMP_0254 1 100 0 15.9375 ECU_ADDRESS 0xFFFF1594 /begin FUNCTION_LIST KF7-320A.14[1] /end FUNCTION_LIST /end MEASUREMENT
/begin MEASUREMENT vMLRCL "A mixed ratio learning map (the left bank)" UWORD COMP_0031 1 100 0 255.99609375 ECU_ADDRESS 0xFFFFA63C /begin FUNCTION_LIST KF7-314.1F[1] R901.1.Diag_on_can_app_1_6_2 /end FUNCTION_LIST /end MEASUREMENT
/begin MEASUREMENT vMLRCL_C#1_R#1 "A mixed ratio learning map (the left bank)" UWORD COMP_0031 1 100 0 255.99609375 ECU_ADDRESS 0xFFFFA63C /begin FUNCTION_LIST KF7-314.1F[1] R901.1.Diag_on_can_app_1_6_2 /end FUNCTION_LIST /end MEASUREMENT
/begin MEASUREMENT vMLRCL_C#1_R#2 "A mixed ratio learning map (the left bank)" UWORD COMP_0031 1 100 0 255.99609375 ECU_ADDRESS 0xFFFFA63E /begin FUNCTION_LIST KF7-314.1F[1] R901.1.Diag_on_can_app_1_6_2 /end FUNCTION_LIST /end MEASUREMENT
/begin MEASUREMENT vMLRCL_C#1_R#3 "A mixed ratio learning map (the left bank)" UWORD COMP_0031 1 100 0 255.99609375 ECU_ADDRESS 0xFFFFA640 /begin FUNCTION_LIST KF7-314.1F[1] R901.1.Diag_on_can_app_1_6_2 /end FUNCTION_LIST /end MEASUREMENT
/begin MEASUREMENT vMLRCL_C#1_R#4 "A mixed ratio learning map (the left bank)" UWORD COMP_0031 1 100 0 255.99609375 ECU_ADDRESS 0xFFFFA642 /begin FUNCTION_LIST KF7-314.1F[1] R901.1.Diag_on_can_app_1_6_2 /end FUNCTION_LIST /end MEASUREMENT
/begin MEASUREMENT vMLRCL_C#1_R#5 "A mixed ratio learning map (the left bank)" UWORD COMP_0031 1 100 0 255.99609375 ECU_ADDRESS 0xFFFFA644 /begin FUNCTION_LIST KF7-314.1F[1] R901.1.Diag_on_can_app_1_6_2 /end FUNCTION_LIST /end MEASUREMENT
/begin MEASUREMENT vMLRCL_C#1_R#6 "A mixed ratio learning map (the left bank)" UWORD COMP_0031 1 100 0 255.99609375 ECU_ADDRESS 0xFFFFA646 /begin FUNCTION_LIST KF7-314.1F[1] R901.1.Diag_on_can_app_1_6_2 /end FUNCTION_LIST /end MEASUREMENT
/begin MEASUREMENT vMLRCL_C#1_R#7 "A mixed ratio learning map (the left bank)" UWORD COMP_0031 1 100 0 255.99609375 ECU_ADDRESS 0xFFFFA648 /begin FUNCTION_LIST KF7-314.1F[1] R901.1.Diag_on_can_app_1_6_2 /end FUNCTION_LIST /end MEASUREMENT
/begin MEASUREMENT vMLRCL_C#1_R#8 "A mixed ratio learning map (the left bank)" UWORD COMP_0031 1 100 0 255.99609375 ECU_ADDRESS 0xFFFFA64A /begin FUNCTION_LIST KF7-314.1F[1] R901.1.Diag_on_can_app_1_6_2 /end FUNCTION_LIST /end MEASUREMENT
/begin MEASUREMENT vMLRCL_C#2_R#1 "A mixed ratio learning map (the left bank)" UWORD COMP_0031 1 100 0 255.99609375 ECU_ADDRESS 0xFFFFA64C /begin FUNCTION_LIST KF7-314.1F[1] R901.1.Diag_on_can_app_1_6_2 /end FUNCTION_LIST /end MEASUREMENT
/begin MEASUREMENT vMLRCL_C#2_R#2 "A mixed ratio learning map (the left bank)" UWORD COMP_0031 1 100 0 255.99609375 ECU_ADDRESS 0xFFFFA64E /begin FUNCTION_LIST KF7-314.1F[1] R901.1.Diag_on_can_app_1_6_2 /end FUNCTION_LIST /end MEASUREMENT
/begin MEASUREMENT vMLRCL_C#2_R#3 "A mixed ratio learning map (the left bank)" UWORD COMP_0031 1 100 0 255.99609375 ECU_ADDRESS 0xFFFFA650 /begin FUNCTION_LIST KF7-314.1F[1] R901.1.Diag_on_can_app_1_6_2 /end FUNCTION_LIST /end MEASUREMENT
/begin MEASUREMENT vMLRCL_C#2_R#4 "A mixed ratio learning map (the left bank)" UWORD COMP_0031 1 100 0 255.99609375 ECU_ADDRESS 0xFFFFA652 /begin FUNCTION_LIST KF7-314.1F[1] R901.1.Diag_on_can_app_1_6_2 /end FUNCTION_LIST /end MEASUREMENT
/begin MEASUREMENT vMLRCL_C#2_R#5 "A mixed ratio learning map (the left bank)" UWORD COMP_0031 1 100 0 255.99609375 ECU_ADDRESS 0xFFFFA654 /begin FUNCTION_LIST KF7-314.1F[1] R901.1.Diag_on_can_app_1_6_2 /end FUNCTION_LIST /end MEASUREMENT
/begin MEASUREMENT vMLRCL_C#2_R#6 "A mixed ratio learning map (the left bank)" UWORD COMP_0031 1 100 0 255.99609375 ECU_ADDRESS 0xFFFFA656 /begin FUNCTION_LIST KF7-314.1F[1] R901.1.Diag_on_can_app_1_6_2 /end FUNCTION_LIST /end MEASUREMENT
/begin MEASUREMENT vMLRCL_C#2_R#7 "A mixed ratio learning map (the left bank)" UWORD COMP_0031 1 100 0 255.99609375 ECU_ADDRESS 0xFFFFA658 /begin FUNCTION_LIST KF7-314.1F[1] R901.1.Diag_on_can_app_1_6_2 /end FUNCTION_LIST /end MEASUREMENT
/begin MEASUREMENT vMLRCL_C#2_R#8 "A mixed ratio learning map (the left bank)" UWORD COMP_0031 1 100 0 255.99609375 ECU_ADDRESS 0xFFFFA65A /begin FUNCTION_LIST KF7-314.1F[1] R901.1.Diag_on_can_app_1_6_2 /end FUNCTION_LIST /end MEASUREMENT
/begin MEASUREMENT vMLRCL_C#3_R#1 "A mixed ratio learning map (the left bank)" UWORD COMP_0031 1 100 0 255.99609375 ECU_ADDRESS 0xFFFFA65C /begin FUNCTION_LIST KF7-314.1F[1] R901.1.Diag_on_can_app_1_6_2 /end FUNCTION_LIST /end MEASUREMENT
/begin MEASUREMENT vMLRCL_C#3_R#2 "A mixed ratio learning map (the left bank)" UWORD COMP_0031 1 100 0 255.99609375 ECU_ADDRESS 0xFFFFA65E /begin FUNCTION_LIST KF7-314.1F[1] R901.1.Diag_on_can_app_1_6_2 /end FUNCTION_LIST /end MEASUREMENT
/begin MEASUREMENT vMLRCL_C#3_R#3 "A mixed ratio learning map (the left bank)" UWORD COMP_0031 1 100 0 255.99609375 ECU_ADDRESS 0xFFFFA660 /begin FUNCTION_LIST KF7-314.1F[1] R901.1.Diag_on_can_app_1_6_2 /end FUNCTION_LIST /end MEASUREMENT
/begin MEASUREMENT vMLRCL_C#3_R#4 "A mixed ratio learning map (the left bank)" UWORD COMP_0031 1 100 0 255.99609375 ECU_ADDRESS 0xFFFFA662 /begin FUNCTION_LIST KF7-314.1F[1] R901.1.Diag_on_can_app_1_6_2 /end FUNCTION_LIST /end MEASUREMENT
/begin MEASUREMENT vMLRCL_C#3_R#5 "A mixed ratio learning map (the left bank)" UWORD COMP_0031 1 100 0 255.99609375 ECU_ADDRESS 0xFFFFA664 /begin FUNCTION_LIST KF7-314.1F[1] R901.1.Diag_on_can_app_1_6_2 /end FUNCTION_LIST /end MEASUREMENT
/begin MEASUREMENT vMLRCL_C#3_R#6 "A mixed ratio learning map (the left bank)" UWORD COMP_0031 1 100 0 255.99609375 ECU_ADDRESS 0xFFFFA666 /begin FUNCTION_LIST KF7-314.1F[1] R901.1.Diag_on_can_app_1_6_2 /end FUNCTION_LIST /end MEASUREMENT
/begin MEASUREMENT vMLRCL_C#3_R#7 "A mixed ratio learning map (the left bank)" UWORD COMP_0031 1 100 0 255.99609375 ECU_ADDRESS 0xFFFFA668 /begin FUNCTION_LIST KF7-314.1F[1] R901.1.Diag_on_can_app_1_6_2 /end FUNCTION_LIST /end MEASUREMENT
/begin MEASUREMENT vMLRCL_C#3_R#8 "A mixed ratio learning map (the left bank)" UWORD COMP_0031 1 100 0 255.99609375 ECU_ADDRESS 0xFFFFA66A /begin FUNCTION_LIST KF7-314.1F[1] R901.1.Diag_on_can_app_1_6_2 /end FUNCTION_LIST /end MEASUREMENT
/begin MEASUREMENT vMLRCL_C#4_R#1 "A mixed ratio learning map (the left bank)" UWORD COMP_0031 1 100 0 255.99609375 ECU_ADDRESS 0xFFFFA66C /begin FUNCTION_LIST KF7-314.1F[1] R901.1.Diag_on_can_app_1_6_2 /end FUNCTION_LIST /end MEASUREMENT
/begin MEASUREMENT vMLRCL_C#4_R#2 "A mixed ratio learning map (the left bank)" UWORD COMP_0031 1 100 0 255.99609375 ECU_ADDRESS 0xFFFFA66E /begin FUNCTION_LIST KF7-314.1F[1] R901.1.Diag_on_can_app_1_6_2 /end FUNCTION_LIST /end MEASUREMENT
/begin MEASUREMENT vMLRCL_C#4_R#3 "A mixed ratio learning map (the left bank)" UWORD COMP_0031 1 100 0 255.99609375 ECU_ADDRESS 0xFFFFA670 /begin FUNCTION_LIST KF7-314.1F[1] R901.1.Diag_on_can_app_1_6_2 /end FUNCTION_LIST /end MEASUREMENT
/begin MEASUREMENT vMLRCL_C#4_R#4 "A mixed ratio learning map (the left bank)" UWORD COMP_0031 1 100 0 255.99609375 ECU_ADDRESS 0xFFFFA672 /begin FUNCTION_LIST KF7-314.1F[1] R901.1.Diag_on_can_app_1_6_2 /end FUNCTION_LIST /end MEASUREMENT
/begin MEASUREMENT vMLRCL_C#4_R#5 "A mixed ratio learning map (the left bank)" UWORD COMP_0031 1 100 0 255.99609375 ECU_ADDRESS 0xFFFFA674 /begin FUNCTION_LIST KF7-314.1F[1] R901.1.Diag_on_can_app_1_6_2 /end FUNCTION_LIST /end MEASUREMENT
/begin MEASUREMENT vMLRCL_C#4_R#6 "A mixed ratio learning map (the left bank)" UWORD COMP_0031 1 100 0 255.99609375 ECU_ADDRESS 0xFFFFA676 /begin FUNCTION_LIST KF7-314.1F[1] R901.1.Diag_on_can_app_1_6_2 /end FUNCTION_LIST /end MEASUREMENT
/begin MEASUREMENT vMLRCL_C#4_R#7 "A mixed ratio learning map (the left bank)" UWORD COMP_0031 1 100 0 255.99609375 ECU_ADDRESS 0xFFFFA678 /begin FUNCTION_LIST KF7-314.1F[1] R901.1.Diag_on_can_app_1_6_2 /end FUNCTION_LIST /end MEASUREMENT
/begin MEASUREMENT vMLRCL_C#4_R#8 "A mixed ratio learning map (the left bank)" UWORD COMP_0031 1 100 0 255.99609375 ECU_ADDRESS 0xFFFFA67A /begin FUNCTION_LIST KF7-314.1F[1] R901.1.Diag_on_can_app_1_6_2 /end FUNCTION_LIST /end MEASUREMENT
/begin MEASUREMENT vMLRCL_C#5_R#1 "A mixed ratio learning map (the left bank)" UWORD COMP_0031 1 100 0 255.99609375 ECU_ADDRESS 0xFFFFA67C /begin FUNCTION_LIST KF7-314.1F[1] R901.1.Diag_on_can_app_1_6_2 /end FUNCTION_LIST /end MEASUREMENT
/begin MEASUREMENT vMLRCL_C#5_R#2 "A mixed ratio learning map (the left bank)" UWORD COMP_0031 1 100 0 255.99609375 ECU_ADDRESS 0xFFFFA67E /begin FUNCTION_LIST KF7-314.1F[1] R901.1.Diag_on_can_app_1_6_2 /end FUNCTION_LIST /end MEASUREMENT
/begin MEASUREMENT vMLRCL_C#5_R#3 "A mixed ratio learning map (the left bank)" UWORD COMP_0031 1 100 0 255.99609375 ECU_ADDRESS 0xFFFFA680 /begin FUNCTION_LIST KF7-314.1F[1] R901.1.Diag_on_can_app_1_6_2 /end FUNCTION_LIST /end MEASUREMENT
/begin MEASUREMENT vMLRCL_C#5_R#4 "A mixed ratio learning map (the left bank)" UWORD COMP_0031 1 100 0 255.99609375 ECU_ADDRESS 0xFFFFA682 /begin FUNCTION_LIST KF7-314.1F[1] R901.1.Diag_on_can_app_1_6_2 /end FUNCTION_LIST /end MEASUREMENT
/begin MEASUREMENT vMLRCL_C#5_R#5 "A mixed ratio learning map (the left bank)" UWORD COMP_0031 1 100 0 255.99609375 ECU_ADDRESS 0xFFFFA684 /begin FUNCTION_LIST KF7-314.1F[1] R901.1.Diag_on_can_app_1_6_2 /end FUNCTION_LIST /end MEASUREMENT
/begin MEASUREMENT vMLRCL_C#5_R#6 "A mixed ratio learning map (the left bank)" UWORD COMP_0031 1 100 0 255.99609375 ECU_ADDRESS 0xFFFFA686 /begin FUNCTION_LIST KF7-314.1F[1] R901.1.Diag_on_can_app_1_6_2 /end FUNCTION_LIST /end MEASUREMENT
/begin MEASUREMENT vMLRCL_C#5_R#7 "A mixed ratio learning map (the left bank)" UWORD COMP_0031 1 100 0 255.99609375 ECU_ADDRESS 0xFFFFA688 /begin FUNCTION_LIST KF7-314.1F[1] R901.1.Diag_on_can_app_1_6_2 /end FUNCTION_LIST /end MEASUREMENT
/begin MEASUREMENT vMLRCL_C#5_R#8 "A mixed ratio learning map (the left bank)" UWORD COMP_0031 1 100 0 255.99609375 ECU_ADDRESS 0xFFFFA68A /begin FUNCTION_LIST KF7-314.1F[1] R901.1.Diag_on_can_app_1_6_2 /end FUNCTION_LIST /end MEASUREMENT
/begin MEASUREMENT vMLRCL_C#6_R#1 "A mixed ratio learning map (the left bank)" UWORD COMP_0031 1 100 0 255.99609375 ECU_ADDRESS 0xFFFFA68C /begin FUNCTION_LIST KF7-314.1F[1] R901.1.Diag_on_can_app_1_6_2 /end FUNCTION_LIST /end MEASUREMENT
/begin MEASUREMENT vMLRCL_C#6_R#2 "A mixed ratio learning map (the left bank)" UWORD COMP_0031 1 100 0 255.99609375 ECU_ADDRESS 0xFFFFA68E /begin FUNCTION_LIST KF7-314.1F[1] R901.1.Diag_on_can_app_1_6_2 /end FUNCTION_LIST /end MEASUREMENT
/begin MEASUREMENT vMLRCL_C#6_R#3 "A mixed ratio learning map (the left bank)" UWORD COMP_0031 1 100 0 255.99609375 ECU_ADDRESS 0xFFFFA690 /begin FUNCTION_LIST KF7-314.1F[1] R901.1.Diag_on_can_app_1_6_2 /end FUNCTION_LIST /end MEASUREMENT
/begin MEASUREMENT vMLRCL_C#6_R#4 "A mixed ratio learning map (the left bank)" UWORD COMP_0031 1 100 0 255.99609375 ECU_ADDRESS 0xFFFFA692 /begin FUNCTION_LIST KF7-314.1F[1] R901.1.Diag_on_can_app_1_6_2 /end FUNCTION_LIST /end MEASUREMENT
/begin MEASUREMENT vMLRCL_C#6_R#5 "A mixed ratio learning map (the left bank)" UWORD COMP_0031 1 100 0 255.99609375 ECU_ADDRESS 0xFFFFA694 /begin FUNCTION_LIST KF7-314.1F[1] R901.1.Diag_on_can_app_1_6_2 /end FUNCTION_LIST /end MEASUREMENT
/begin MEASUREMENT vMLRCL_C#6_R#6 "A mixed ratio learning map (the left bank)" UWORD COMP_0031 1 100 0 255.99609375 ECU_ADDRESS 0xFFFFA696 /begin FUNCTION_LIST KF7-314.1F[1] R901.1.Diag_on_can_app_1_6_2 /end FUNCTION_LIST /end MEASUREMENT
/begin MEASUREMENT vMLRCL_C#6_R#7 "A mixed ratio learning map (the left bank)" UWORD COMP_0031 1 100 0 255.99609375 ECU_ADDRESS 0xFFFFA698 /begin FUNCTION_LIST KF7-314.1F[1] R901.1.Diag_on_can_app_1_6_2 /end FUNCTION_LIST /end MEASUREMENT
/begin MEASUREMENT vMLRCL_C#6_R#8 "A mixed ratio learning map (the left bank)" UWORD COMP_0031 1 100 0 255.99609375 ECU_ADDRESS 0xFFFFA69A /begin FUNCTION_LIST KF7-314.1F[1] R901.1.Diag_on_can_app_1_6_2 /end FUNCTION_LIST /end MEASUREMENT
/begin MEASUREMENT vMLRCL_C#7_R#1 "A mixed ratio learning map (the left bank)" UWORD COMP_0031 1 100 0 255.99609375 ECU_ADDRESS 0xFFFFA69C /begin FUNCTION_LIST KF7-314.1F[1] R901.1.Diag_on_can_app_1_6_2 /end FUNCTION_LIST /end MEASUREMENT
/begin MEASUREMENT vMLRCL_C#7_R#2 "A mixed ratio learning map (the left bank)" UWORD COMP_0031 1 100 0 255.99609375 ECU_ADDRESS 0xFFFFA69E /begin FUNCTION_LIST KF7-314.1F[1] R901.1.Diag_on_can_app_1_6_2 /end FUNCTION_LIST /end MEASUREMENT
/begin MEASUREMENT vMLRCL_C#7_R#3 "A mixed ratio learning map (the left bank)" UWORD COMP_0031 1 100 0 255.99609375 ECU_ADDRESS 0xFFFFA6A0 /begin FUNCTION_LIST KF7-314.1F[1] R901.1.Diag_on_can_app_1_6_2 /end FUNCTION_LIST /end MEASUREMENT
/begin MEASUREMENT vMLRCL_C#7_R#4 "A mixed ratio learning map (the left bank)" UWORD COMP_0031 1 100 0 255.99609375 ECU_ADDRESS 0xFFFFA6A2 /begin FUNCTION_LIST KF7-314.1F[1] R901.1.Diag_on_can_app_1_6_2 /end FUNCTION_LIST /end MEASUREMENT
/begin MEASUREMENT vMLRCL_C#7_R#5 "A mixed ratio learning map (the left bank)" UWORD COMP_0031 1 100 0 255.99609375 ECU_ADDRESS 0xFFFFA6A4 /begin FUNCTION_LIST KF7-314.1F[1] R901.1.Diag_on_can_app_1_6_2 /end FUNCTION_LIST /end MEASUREMENT
/begin MEASUREMENT vMLRCL_C#7_R#6 "A mixed ratio learning map (the left bank)" UWORD COMP_0031 1 100 0 255.99609375 ECU_ADDRESS 0xFFFFA6A6 /begin FUNCTION_LIST KF7-314.1F[1] R901.1.Diag_on_can_app_1_6_2 /end FUNCTION_LIST /end MEASUREMENT
/begin MEASUREMENT vMLRCL_C#7_R#7 "A mixed ratio learning map (the left bank)" UWORD COMP_0031 1 100 0 255.99609375 ECU_ADDRESS 0xFFFFA6A8 /begin FUNCTION_LIST KF7-314.1F[1] R901.1.Diag_on_can_app_1_6_2 /end FUNCTION_LIST /end MEASUREMENT
/begin MEASUREMENT vMLRCL_C#7_R#8 "A mixed ratio learning map (the left bank)" UWORD COMP_0031 1 100 0 255.99609375 ECU_ADDRESS 0xFFFFA6AA /begin FUNCTION_LIST KF7-314.1F[1] R901.1.Diag_on_can_app_1_6_2 /end FUNCTION_LIST /end MEASUREMENT
/begin MEASUREMENT vMLRCL_C#8_R#1 "A mixed ratio learning map (the left bank)" UWORD COMP_0031 1 100 0 255.99609375 ECU_ADDRESS 0xFFFFA6AC /begin FUNCTION_LIST KF7-314.1F[1] R901.1.Diag_on_can_app_1_6_2 /end FUNCTION_LIST /end MEASUREMENT
/begin MEASUREMENT vMLRCL_C#8_R#2 "A mixed ratio learning map (the left bank)" UWORD COMP_0031 1 100 0 255.99609375 ECU_ADDRESS 0xFFFFA6AE /begin FUNCTION_LIST KF7-314.1F[1] R901.1.Diag_on_can_app_1_6_2 /end FUNCTION_LIST /end MEASUREMENT
/begin MEASUREMENT vMLRCL_C#8_R#3 "A mixed ratio learning map (the left bank)" UWORD COMP_0031 1 100 0 255.99609375 ECU_ADDRESS 0xFFFFA6B0 /begin FUNCTION_LIST KF7-314.1F[1] R901.1.Diag_on_can_app_1_6_2 /end FUNCTION_LIST /end MEASUREMENT
/begin MEASUREMENT vMLRCL_C#8_R#4 "A mixed ratio learning map (the left bank)" UWORD COMP_0031 1 100 0 255.99609375 ECU_ADDRESS 0xFFFFA6B2 /begin FUNCTION_LIST KF7-314.1F[1] R901.1.Diag_on_can_app_1_6_2 /end FUNCTION_LIST /end MEASUREMENT
/begin MEASUREMENT vMLRCL_C#8_R#5 "A mixed ratio learning map (the left bank)" UWORD COMP_0031 1 100 0 255.99609375 ECU_ADDRESS 0xFFFFA6B4 /begin FUNCTION_LIST KF7-314.1F[1] R901.1.Diag_on_can_app_1_6_2 /end FUNCTION_LIST /end MEASUREMENT
/begin MEASUREMENT vMLRCL_C#8_R#6 "A mixed ratio learning map (the left bank)" UWORD COMP_0031 1 100 0 255.99609375 ECU_ADDRESS 0xFFFFA6B6 /begin FUNCTION_LIST KF7-314.1F[1] R901.1.Diag_on_can_app_1_6_2 /end FUNCTION_LIST /end MEASUREMENT
/begin MEASUREMENT vMLRCL_C#8_R#7 "A mixed ratio learning map (the left bank)" UWORD COMP_0031 1 100 0 255.99609375 ECU_ADDRESS 0xFFFFA6B8 /begin FUNCTION_LIST KF7-314.1F[1] R901.1.Diag_on_can_app_1_6_2 /end FUNCTION_LIST /end MEASUREMENT
/begin MEASUREMENT vMLRCL_C#8_R#8 "A mixed ratio learning map (the left bank)" UWORD COMP_0031 1 100 0 255.99609375 ECU_ADDRESS 0xFFFFA6BA /begin FUNCTION_LIST KF7-314.1F[1] R901.1.Diag_on_can_app_1_6_2 /end FUNCTION_LIST /end MEASUREMENT
/begin MEASUREMENT vMLRCR "A mixed ratio learning map (the right bank)" UWORD COMP_0031 1 100 0 255.99609375 ECU_ADDRESS 0xFFFFA6BC /begin FUNCTION_LIST KF7-314.1F[1] R901.1.Diag_on_can_app_1_6_2 /end FUNCTION_LIST /end MEASUREMENT
/begin MEASUREMENT vMLRCR_C#1_R#1 "A mixed ratio learning map (the right bank)" UWORD COMP_0031 1 100 0 255.99609375 ECU_ADDRESS 0xFFFFA6BC /begin FUNCTION_LIST KF7-314.1F[1] R901.1.Diag_on_can_app_1_6_2 /end FUNCTION_LIST /end MEASUREMENT
/begin MEASUREMENT vMLRCR_C#1_R#2 "A mixed ratio learning map (the right bank)" UWORD COMP_0031 1 100 0 255.99609375 ECU_ADDRESS 0xFFFFA6BE /begin FUNCTION_LIST KF7-314.1F[1] R901.1.Diag_on_can_app_1_6_2 /end FUNCTION_LIST /end MEASUREMENT
/begin MEASUREMENT vMLRCR_C#1_R#3 "A mixed ratio learning map (the right bank)" UWORD COMP_0031 1 100 0 255.99609375 ECU_ADDRESS 0xFFFFA6C0 /begin FUNCTION_LIST KF7-314.1F[1] R901.1.Diag_on_can_app_1_6_2 /end FUNCTION_LIST /end MEASUREMENT
/begin MEASUREMENT vMLRCR_C#1_R#4 "A mixed ratio learning map (the right bank)" UWORD COMP_0031 1 100 0 255.99609375 ECU_ADDRESS 0xFFFFA6C2 /begin FUNCTION_LIST KF7-314.1F[1] R901.1.Diag_on_can_app_1_6_2 /end FUNCTION_LIST /end MEASUREMENT
/begin MEASUREMENT vMLRCR_C#1_R#5 "A mixed ratio learning map (the right bank)" UWORD COMP_0031 1 100 0 255.99609375 ECU_ADDRESS 0xFFFFA6C4 /begin FUNCTION_LIST KF7-314.1F[1] R901.1.Diag_on_can_app_1_6_2 /end FUNCTION_LIST /end MEASUREMENT
/begin MEASUREMENT vMLRCR_C#1_R#6 "A mixed ratio learning map (the right bank)" UWORD COMP_0031 1 100 0 255.99609375 ECU_ADDRESS 0xFFFFA6C6 /begin FUNCTION_LIST KF7-314.1F[1] R901.1.Diag_on_can_app_1_6_2 /end FUNCTION_LIST /end MEASUREMENT
/begin MEASUREMENT vMLRCR_C#1_R#7 "A mixed ratio learning map (the right bank)" UWORD COMP_0031 1 100 0 255.99609375 ECU_ADDRESS 0xFFFFA6C8 /begin FUNCTION_LIST KF7-314.1F[1] R901.1.Diag_on_can_app_1_6_2 /end FUNCTION_LIST /end MEASUREMENT
/begin MEASUREMENT vMLRCR_C#1_R#8 "A mixed ratio learning map (the right bank)" UWORD COMP_0031 1 100 0 255.99609375 ECU_ADDRESS 0xFFFFA6CA /begin FUNCTION_LIST KF7-314.1F[1] R901.1.Diag_on_can_app_1_6_2 /end FUNCTION_LIST /end MEASUREMENT
/begin MEASUREMENT vMLRCR_C#2_R#1 "A mixed ratio learning map (the right bank)" UWORD COMP_0031 1 100 0 255.99609375 ECU_ADDRESS 0xFFFFA6CC /begin FUNCTION_LIST KF7-314.1F[1] R901.1.Diag_on_can_app_1_6_2 /end FUNCTION_LIST /end MEASUREMENT
/begin MEASUREMENT vMLRCR_C#2_R#2 "A mixed ratio learning map (the right bank)" UWORD COMP_0031 1 100 0 255.99609375 ECU_ADDRESS 0xFFFFA6CE /begin FUNCTION_LIST KF7-314.1F[1] R901.1.Diag_on_can_app_1_6_2 /end FUNCTION_LIST /end MEASUREMENT
/begin MEASUREMENT vMLRCR_C#2_R#3 "A mixed ratio learning map (the right bank)" UWORD COMP_0031 1 100 0 255.99609375 ECU_ADDRESS 0xFFFFA6D0 /begin FUNCTION_LIST KF7-314.1F[1] R901.1.Diag_on_can_app_1_6_2 /end FUNCTION_LIST /end MEASUREMENT
/begin MEASUREMENT vMLRCR_C#2_R#4 "A mixed ratio learning map (the right bank)" UWORD COMP_0031 1 100 0 255.99609375 ECU_ADDRESS 0xFFFFA6D2 /begin FUNCTION_LIST KF7-314.1F[1] R901.1.Diag_on_can_app_1_6_2 /end FUNCTION_LIST /end MEASUREMENT
/begin MEASUREMENT vMLRCR_C#2_R#5 "A mixed ratio learning map (the right bank)" UWORD COMP_0031 1 100 0 255.99609375 ECU_ADDRESS 0xFFFFA6D4 /begin FUNCTION_LIST KF7-314.1F[1] R901.1.Diag_on_can_app_1_6_2 /end FUNCTION_LIST /end MEASUREMENT
/begin MEASUREMENT vMLRCR_C#2_R#6 "A mixed ratio learning map (the right bank)" UWORD COMP_0031 1 100 0 255.99609375 ECU_ADDRESS 0xFFFFA6D6 /begin FUNCTION_LIST KF7-314.1F[1] R901.1.Diag_on_can_app_1_6_2 /end FUNCTION_LIST /end MEASUREMENT
/begin MEASUREMENT vMLRCR_C#2_R#7 "A mixed ratio learning map (the right bank)" UWORD COMP_0031 1 100 0 255.99609375 ECU_ADDRESS 0xFFFFA6D8 /begin FUNCTION_LIST KF7-314.1F[1] R901.1.Diag_on_can_app_1_6_2 /end FUNCTION_LIST /end MEASUREMENT
/begin MEASUREMENT vMLRCR_C#2_R#8 "A mixed ratio learning map (the right bank)" UWORD COMP_0031 1 100 0 255.99609375 ECU_ADDRESS 0xFFFFA6DA /begin FUNCTION_LIST KF7-314.1F[1] R901.1.Diag_on_can_app_1_6_2 /end FUNCTION_LIST /end MEASUREMENT
/begin MEASUREMENT vMLRCR_C#3_R#1 "A mixed ratio learning map (the right bank)" UWORD COMP_0031 1 100 0 255.99609375 ECU_ADDRESS 0xFFFFA6DC /begin FUNCTION_LIST KF7-314.1F[1] R901.1.Diag_on_can_app_1_6_2 /end FUNCTION_LIST /end MEASUREMENT
/begin MEASUREMENT vMLRCR_C#3_R#2 "A mixed ratio learning map (the right bank)" UWORD COMP_0031 1 100 0 255.99609375 ECU_ADDRESS 0xFFFFA6DE /begin FUNCTION_LIST KF7-314.1F[1] R901.1.Diag_on_can_app_1_6_2 /end FUNCTION_LIST /end MEASUREMENT
/begin MEASUREMENT vMLRCR_C#3_R#3 "A mixed ratio learning map (the right bank)" UWORD COMP_0031 1 100 0 255.99609375 ECU_ADDRESS 0xFFFFA6E0 /begin FUNCTION_LIST KF7-314.1F[1] R901.1.Diag_on_can_app_1_6_2 /end FUNCTION_LIST /end MEASUREMENT
/begin MEASUREMENT vMLRCR_C#3_R#4 "A mixed ratio learning map (the right bank)" UWORD COMP_0031 1 100 0 255.99609375 ECU_ADDRESS 0xFFFFA6E2 /begin FUNCTION_LIST KF7-314.1F[1] R901.1.Diag_on_can_app_1_6_2 /end FUNCTION_LIST /end MEASUREMENT
/begin MEASUREMENT vMLRCR_C#3_R#5 "A mixed ratio learning map (the right bank)" UWORD COMP_0031 1 100 0 255.99609375 ECU_ADDRESS 0xFFFFA6E4 /begin FUNCTION_LIST KF7-314.1F[1] R901.1.Diag_on_can_app_1_6_2 /end FUNCTION_LIST /end MEASUREMENT
/begin MEASUREMENT vMLRCR_C#3_R#6 "A mixed ratio learning map (the right bank)" UWORD COMP_0031 1 100 0 255.99609375 ECU_ADDRESS 0xFFFFA6E6 /begin FUNCTION_LIST KF7-314.1F[1] R901.1.Diag_on_can_app_1_6_2 /end FUNCTION_LIST /end MEASUREMENT
/begin MEASUREMENT vMLRCR_C#3_R#7 "A mixed ratio learning map (the right bank)" UWORD COMP_0031 1 100 0 255.99609375 ECU_ADDRESS 0xFFFFA6E8 /begin FUNCTION_LIST KF7-314.1F[1] R901.1.Diag_on_can_app_1_6_2 /end FUNCTION_LIST /end MEASUREMENT
/begin MEASUREMENT vMLRCR_C#3_R#8 "A mixed ratio learning map (the right bank)" UWORD COMP_0031 1 100 0 255.99609375 ECU_ADDRESS 0xFFFFA6EA /begin FUNCTION_LIST KF7-314.1F[1] R901.1.Diag_on_can_app_1_6_2 /end FUNCTION_LIST /end MEASUREMENT
/begin MEASUREMENT vMLRCR_C#4_R#1 "A mixed ratio learning map (the right bank)" UWORD COMP_0031 1 100 0 255.99609375 ECU_ADDRESS 0xFFFFA6EC /begin FUNCTION_LIST KF7-314.1F[1] R901.1.Diag_on_can_app_1_6_2 /end FUNCTION_LIST /end MEASUREMENT
/begin MEASUREMENT vMLRCR_C#4_R#2 "A mixed ratio learning map (the right bank)" UWORD COMP_0031 1 100 0 255.99609375 ECU_ADDRESS 0xFFFFA6EE /begin FUNCTION_LIST KF7-314.1F[1] R901.1.Diag_on_can_app_1_6_2 /end FUNCTION_LIST /end MEASUREMENT
/begin MEASUREMENT vMLRCR_C#4_R#3 "A mixed ratio learning map (the right bank)" UWORD COMP_0031 1 100 0 255.99609375 ECU_ADDRESS 0xFFFFA6F0 /begin FUNCTION_LIST KF7-314.1F[1] R901.1.Diag_on_can_app_1_6_2 /end FUNCTION_LIST /end MEASUREMENT
/begin MEASUREMENT vMLRCR_C#4_R#4 "A mixed ratio learning map (the right bank)" UWORD COMP_0031 1 100 0 255.99609375 ECU_ADDRESS 0xFFFFA6F2 /begin FUNCTION_LIST KF7-314.1F[1] R901.1.Diag_on_can_app_1_6_2 /end FUNCTION_LIST /end MEASUREMENT
/begin MEASUREMENT vMLRCR_C#4_R#5 "A mixed ratio learning map (the right bank)" UWORD COMP_0031 1 100 0 255.99609375 ECU_ADDRESS 0xFFFFA6F4 /begin FUNCTION_LIST KF7-314.1F[1] R901.1.Diag_on_can_app_1_6_2 /end FUNCTION_LIST /end MEASUREMENT
/begin MEASUREMENT vMLRCR_C#4_R#6 "A mixed ratio learning map (the right bank)" UWORD COMP_0031 1 100 0 255.99609375 ECU_ADDRESS 0xFFFFA6F6 /begin FUNCTION_LIST KF7-314.1F[1] R901.1.Diag_on_can_app_1_6_2 /end FUNCTION_LIST /end MEASUREMENT
/begin MEASUREMENT vMLRCR_C#4_R#7 "A mixed ratio learning map (the right bank)" UWORD COMP_0031 1 100 0 255.99609375 ECU_ADDRESS 0xFFFFA6F8 /begin FUNCTION_LIST KF7-314.1F[1] R901.1.Diag_on_can_app_1_6_2 /end FUNCTION_LIST /end MEASUREMENT
/begin MEASUREMENT vMLRCR_C#4_R#8 "A mixed ratio learning map (the right bank)" UWORD COMP_0031 1 100 0 255.99609375 ECU_ADDRESS 0xFFFFA6FA /begin FUNCTION_LIST KF7-314.1F[1] R901.1.Diag_on_can_app_1_6_2 /end FUNCTION_LIST /end MEASUREMENT
/begin MEASUREMENT vMLRCR_C#5_R#1 "A mixed ratio learning map (the right bank)" UWORD COMP_0031 1 100 0 255.99609375 ECU_ADDRESS 0xFFFFA6FC /begin FUNCTION_LIST KF7-314.1F[1] R901.1.Diag_on_can_app_1_6_2 /end FUNCTION_LIST /end MEASUREMENT
/begin MEASUREMENT vMLRCR_C#5_R#2 "A mixed ratio learning map (the right bank)" UWORD COMP_0031 1 100 0 255.99609375 ECU_ADDRESS 0xFFFFA6FE /begin FUNCTION_LIST KF7-314.1F[1] R901.1.Diag_on_can_app_1_6_2 /end FUNCTION_LIST /end MEASUREMENT
/begin MEASUREMENT vMLRCR_C#5_R#3 "A mixed ratio learning map (the right bank)" UWORD COMP_0031 1 100 0 255.99609375 ECU_ADDRESS 0xFFFFA700 /begin FUNCTION_LIST KF7-314.1F[1] R901.1.Diag_on_can_app_1_6_2 /end FUNCTION_LIST /end MEASUREMENT
/begin MEASUREMENT vMLRCR_C#5_R#4 "A mixed ratio learning map (the right bank)" UWORD COMP_0031 1 100 0 255.99609375 ECU_ADDRESS 0xFFFFA702 /begin FUNCTION_LIST KF7-314.1F[1] R901.1.Diag_on_can_app_1_6_2 /end FUNCTION_LIST /end MEASUREMENT
/begin MEASUREMENT vMLRCR_C#5_R#5 "A mixed ratio learning map (the right bank)" UWORD COMP_0031 1 100 0 255.99609375 ECU_ADDRESS 0xFFFFA704 /begin FUNCTION_LIST KF7-314.1F[1] R901.1.Diag_on_can_app_1_6_2 /end FUNCTION_LIST /end MEASUREMENT
/begin MEASUREMENT vMLRCR_C#5_R#6 "A mixed ratio learning map (the right bank)" UWORD COMP_0031 1 100 0 255.99609375 ECU_ADDRESS 0xFFFFA706 /begin FUNCTION_LIST KF7-314.1F[1] R901.1.Diag_on_can_app_1_6_2 /end FUNCTION_LIST /end MEASUREMENT
/begin MEASUREMENT vMLRCR_C#5_R#7 "A mixed ratio learning map (the right bank)" UWORD COMP_0031 1 100 0 255.99609375 ECU_ADDRESS 0xFFFFA708 /begin FUNCTION_LIST KF7-314.1F[1] R901.1.Diag_on_can_app_1_6_2 /end FUNCTION_LIST /end MEASUREMENT
/begin MEASUREMENT vMLRCR_C#5_R#8 "A mixed ratio learning map (the right bank)" UWORD COMP_0031 1 100 0 255.99609375 ECU_ADDRESS 0xFFFFA70A /begin FUNCTION_LIST KF7-314.1F[1] R901.1.Diag_on_can_app_1_6_2 /end FUNCTION_LIST /end MEASUREMENT
/begin MEASUREMENT vMLRCR_C#6_R#1 "A mixed ratio learning map (the right bank)" UWORD COMP_0031 1 100 0 255.99609375 ECU_ADDRESS 0xFFFFA70C /begin FUNCTION_LIST KF7-314.1F[1] R901.1.Diag_on_can_app_1_6_2 /end FUNCTION_LIST /end MEASUREMENT
/begin MEASUREMENT vMLRCR_C#6_R#2 "A mixed ratio learning map (the right bank)" UWORD COMP_0031 1 100 0 255.99609375 ECU_ADDRESS 0xFFFFA70E /begin FUNCTION_LIST KF7-314.1F[1] R901.1.Diag_on_can_app_1_6_2 /end FUNCTION_LIST /end MEASUREMENT
/begin MEASUREMENT vMLRCR_C#6_R#3 "A mixed ratio learning map (the right bank)" UWORD COMP_0031 1 100 0 255.99609375 ECU_ADDRESS 0xFFFFA710 /begin FUNCTION_LIST KF7-314.1F[1] R901.1.Diag_on_can_app_1_6_2 /end FUNCTION_LIST /end MEASUREMENT
/begin MEASUREMENT vMLRCR_C#6_R#4 "A mixed ratio learning map (the right bank)" UWORD COMP_0031 1 100 0 255.99609375 ECU_ADDRESS 0xFFFFA712 /begin FUNCTION_LIST KF7-314.1F[1] R901.1.Diag_on_can_app_1_6_2 /end FUNCTION_LIST /end MEASUREMENT
/begin MEASUREMENT vMLRCR_C#6_R#5 "A mixed ratio learning map (the right bank)" UWORD COMP_0031 1 100 0 255.99609375 ECU_ADDRESS 0xFFFFA714 /begin FUNCTION_LIST KF7-314.1F[1] R901.1.Diag_on_can_app_1_6_2 /end FUNCTION_LIST /end MEASUREMENT
/begin MEASUREMENT vMLRCR_C#6_R#6 "A mixed ratio learning map (the right bank)" UWORD COMP_0031 1 100 0 255.99609375 ECU_ADDRESS 0xFFFFA716 /begin FUNCTION_LIST KF7-314.1F[1] R901.1.Diag_on_can_app_1_6_2 /end FUNCTION_LIST /end MEASUREMENT
/begin MEASUREMENT vMLRCR_C#6_R#7 "A mixed ratio learning map (the right bank)" UWORD COMP_0031 1 100 0 255.99609375 ECU_ADDRESS 0xFFFFA718 /begin FUNCTION_LIST KF7-314.1F[1] R901.1.Diag_on_can_app_1_6_2 /end FUNCTION_LIST /end MEASUREMENT
/begin MEASUREMENT vMLRCR_C#6_R#8 "A mixed ratio learning map (the right bank)" UWORD COMP_0031 1 100 0 255.99609375 ECU_ADDRESS 0xFFFFA71A /begin FUNCTION_LIST KF7-314.1F[1] R901.1.Diag_on_can_app_1_6_2 /end FUNCTION_LIST /end MEASUREMENT
/begin MEASUREMENT vMLRCR_C#7_R#1 "A mixed ratio learning map (the right bank)" UWORD COMP_0031 1 100 0 255.99609375 ECU_ADDRESS 0xFFFFA71C /begin FUNCTION_LIST KF7-314.1F[1] R901.1.Diag_on_can_app_1_6_2 /end FUNCTION_LIST /end MEASUREMENT
/begin MEASUREMENT vMLRCR_C#7_R#2 "A mixed ratio learning map (the right bank)" UWORD COMP_0031 1 100 0 255.99609375 ECU_ADDRESS 0xFFFFA71E /begin FUNCTION_LIST KF7-314.1F[1] R901.1.Diag_on_can_app_1_6_2 /end FUNCTION_LIST /end MEASUREMENT
/begin MEASUREMENT vMLRCR_C#7_R#3 "A mixed ratio learning map (the right bank)" UWORD COMP_0031 1 100 0 255.99609375 ECU_ADDRESS 0xFFFFA720 /begin FUNCTION_LIST KF7-314.1F[1] R901.1.Diag_on_can_app_1_6_2 /end FUNCTION_LIST /end MEASUREMENT
/begin MEASUREMENT vMLRCR_C#7_R#4 "A mixed ratio learning map (the right bank)" UWORD COMP_0031 1 100 0 255.99609375 ECU_ADDRESS 0xFFFFA722 /begin FUNCTION_LIST KF7-314.1F[1] R901.1.Diag_on_can_app_1_6_2 /end FUNCTION_LIST /end MEASUREMENT
/begin MEASUREMENT vMLRCR_C#7_R#5 "A mixed ratio learning map (the right bank)" UWORD COMP_0031 1 100 0 255.99609375 ECU_ADDRESS 0xFFFFA724 /begin FUNCTION_LIST KF7-314.1F[1] R901.1.Diag_on_can_app_1_6_2 /end FUNCTION_LIST /end MEASUREMENT
/begin MEASUREMENT vMLRCR_C#7_R#6 "A mixed ratio learning map (the right bank)" UWORD COMP_0031 1 100 0 255.99609375 ECU_ADDRESS 0xFFFFA726 /begin FUNCTION_LIST KF7-314.1F[1] R901.1.Diag_on_can_app_1_6_2 /end FUNCTION_LIST /end MEASUREMENT
/begin MEASUREMENT vMLRCR_C#7_R#7 "A mixed ratio learning map (the right bank)" UWORD COMP_0031 1 100 0 255.99609375 ECU_ADDRESS 0xFFFFA728 /begin FUNCTION_LIST KF7-314.1F[1] R901.1.Diag_on_can_app_1_6_2 /end FUNCTION_LIST /end MEASUREMENT
/begin MEASUREMENT vMLRCR_C#7_R#8 "A mixed ratio learning map (the right bank)" UWORD COMP_0031 1 100 0 255.99609375 ECU_ADDRESS 0xFFFFA72A /begin FUNCTION_LIST KF7-314.1F[1] R901.1.Diag_on_can_app_1_6_2 /end FUNCTION_LIST /end MEASUREMENT
/begin MEASUREMENT vMLRCR_C#8_R#1 "A mixed ratio learning map (the right bank)" UWORD COMP_0031 1 100 0 255.99609375 ECU_ADDRESS 0xFFFFA72C /begin FUNCTION_LIST KF7-314.1F[1] R901.1.Diag_on_can_app_1_6_2 /end FUNCTION_LIST /end MEASUREMENT
/begin MEASUREMENT vMLRCR_C#8_R#2 "A mixed ratio learning map (the right bank)" UWORD COMP_0031 1 100 0 255.99609375 ECU_ADDRESS 0xFFFFA72E /begin FUNCTION_LIST KF7-314.1F[1] R901.1.Diag_on_can_app_1_6_2 /end FUNCTION_LIST /end MEASUREMENT
/begin MEASUREMENT vMLRCR_C#8_R#3 "A mixed ratio learning map (the right bank)" UWORD COMP_0031 1 100 0 255.99609375 ECU_ADDRESS 0xFFFFA730 /begin FUNCTION_LIST KF7-314.1F[1] R901.1.Diag_on_can_app_1_6_2 /end FUNCTION_LIST /end MEASUREMENT
/begin MEASUREMENT vMLRCR_C#8_R#4 "A mixed ratio learning map (the right bank)" UWORD COMP_0031 1 100 0 255.99609375 ECU_ADDRESS 0xFFFFA732 /begin FUNCTION_LIST KF7-314.1F[1] R901.1.Diag_on_can_app_1_6_2 /end FUNCTION_LIST /end MEASUREMENT
/begin MEASUREMENT vMLRCR_C#8_R#5 "A mixed ratio learning map (the right bank)" UWORD COMP_0031 1 100 0 255.99609375 ECU_ADDRESS 0xFFFFA734 /begin FUNCTION_LIST KF7-314.1F[1] R901.1.Diag_on_can_app_1_6_2 /end FUNCTION_LIST /end MEASUREMENT
/begin MEASUREMENT vMLRCR_C#8_R#6 "A mixed ratio learning map (the right bank)" UWORD COMP_0031 1 100 0 255.99609375 ECU_ADDRESS 0xFFFFA736 /begin FUNCTION_LIST KF7-314.1F[1] R901.1.Diag_on_can_app_1_6_2 /end FUNCTION_LIST /end MEASUREMENT
/begin MEASUREMENT vMLRCR_C#8_R#7 "A mixed ratio learning map (the right bank)" UWORD COMP_0031 1 100 0 255.99609375 ECU_ADDRESS 0xFFFFA738 /begin FUNCTION_LIST KF7-314.1F[1] R901.1.Diag_on_can_app_1_6_2 /end FUNCTION_LIST /end MEASUREMENT
/begin MEASUREMENT vMLRCR_C#8_R#8 "A mixed ratio learning map (the right bank)" UWORD COMP_0031 1 100 0 255.99609375 ECU_ADDRESS 0xFFFFA73A /begin FUNCTION_LIST KF7-314.1F[1] R901.1.Diag_on_can_app_1_6_2 /end FUNCTION_LIST /end MEASUREMENT
/begin MEASUREMENT vMPR "Target purge rate" UWORD COMP_0568_S 1 100 0 64.001481 ECU_ADDRESS 0xFFFF2FE6 /begin FUNCTION_LIST KF7-314.1F[1] KF7-371.1E[15] /end FUNCTION_LIST /end MEASUREMENT
/begin MEASUREMENT vNINPAT "AT input shaft speed" UWORD COMP_0065 1 100 0 204796.875 ECU_ADDRESS 0xFFFF300C /begin FUNCTION_LIST KF7-320A.2[3] /end FUNCTION_LIST /end MEASUREMENT
/begin MEASUREMENT vOSCIDLT "Idle measuring time timer" UBYTE COMP_0049 1 100 0 255 ECU_ADDRESS 0xFFFF3052 /begin FUNCTION_LIST KF7-313C.4[3] /end FUNCTION_LIST /end MEASUREMENT
/begin MEASUREMENT vRFBCNT "During the rest O2/S feedback control, the number of RFBRO2 anti-turns" UBYTE COMP_0016 1 100 0 255 ECU_ADDRESS 0xFFFF3126 /begin FUNCTION_LIST KF7-313C.9[3] KF7-500.21[19] KF7-500.24[10] /end FUNCTION_LIST /end MEASUREMENT
/begin MEASUREMENT vRFBCNT_R#1 "During the rest O2/S feedback control, the number of RFBRO2 anti-turns" UBYTE COMP_0016 1 100 0 255 ECU_ADDRESS 0xFFFF3126 /begin FUNCTION_LIST KF7-313C.9[3] KF7-500.21[19] KF7-500.24[10] /end FUNCTION_LIST /end MEASUREMENT
/begin MEASUREMENT vRFBCNT_R#2 "During the rest O2/S feedback control, the number of RFBRO2 anti-turns" UBYTE COMP_0016 1 100 0 255 ECU_ADDRESS 0xFFFF3127 /begin FUNCTION_LIST KF7-313C.9[3] KF7-500.21[19] KF7-500.24[10] /end FUNCTION_LIST /end MEASUREMENT
/begin MEASUREMENT vRFBRO2 "The rest O2 sensor smoothing voltage for the rest O2 sensor feedback" UWORD COMP_0475 1 100 0 2559.9609375 ECU_ADDRESS 0xFFFF3128 /begin FUNCTION_LIST KF7-313C.9[3] KF7-500.21[19] KF7-500.24[10] /end FUNCTION_LIST /end MEASUREMENT
/begin MEASUREMENT vRFBRO2_R#1 "The rest O2 sensor smoothing voltage for the rest O2 sensor feedback" UWORD COMP_0475 1 100 0 2559.9609375 ECU_ADDRESS 0xFFFF3128 /begin FUNCTION_LIST KF7-313C.9[3] KF7-500.21[19] KF7-500.24[10] /end FUNCTION_LIST /end MEASUREMENT
/begin MEASUREMENT vRFBRO2_R#2 "The rest O2 sensor smoothing voltage for the rest O2 sensor feedback" UWORD COMP_0475 1 100 0 2559.9609375 ECU_ADDRESS 0xFFFF312A /begin FUNCTION_LIST KF7-313C.9[3] KF7-500.21[19] KF7-500.24[10] /end FUNCTION_LIST /end MEASUREMENT
/begin MEASUREMENT vRFBSL "The rest O2 sensor slice level for the rest O2 sensor feedback" UBYTE COMP_0104 1 100 0 2550 ECU_ADDRESS 0xFFFF312C /begin FUNCTION_LIST KF7-313C.9[3] /end FUNCTION_LIST /end MEASUREMENT
/begin MEASUREMENT vRFBSL_R#1 "The rest O2 sensor slice level for the rest O2 sensor feedback" UBYTE COMP_0104 1 100 0 2550 ECU_ADDRESS 0xFFFF312C /begin FUNCTION_LIST KF7-313C.9[3] /end FUNCTION_LIST /end MEASUREMENT
/begin MEASUREMENT vRFBSL_R#2 "The rest O2 sensor slice level for the rest O2 sensor feedback" UBYTE COMP_0104 1 100 0 2550 ECU_ADDRESS 0xFFFF312D /begin FUNCTION_LIST KF7-313C.9[3] /end FUNCTION_LIST /end MEASUREMENT
/begin MEASUREMENT vRFO2TM "Diagnosis region timer" UBYTE COMP_0013 1 100 0 255 ECU_ADDRESS 0xFFFF312F /begin FUNCTION_LIST KF7-313C.9[3] KF7-500.24[10] /end FUNCTION_LIST /end MEASUREMENT
/begin MEASUREMENT vRMDHOS "Air-fuel ratio compensation coefficient" UBYTE COMP_0009 1 100 0 199.21875 ECU_ADDRESS 0xFFFF1754 /begin FUNCTION_LIST KF7-320A.8[2] /end FUNCTION_LIST /end MEASUREMENT
/begin MEASUREMENT vROU "Unburned gas density" UBYTE COMP_0303 1 100 0 31875 ECU_ADDRESS 0xFFFF176D /begin FUNCTION_LIST KF7-320A.8[2] /end FUNCTION_LIST /end MEASUREMENT
/begin MEASUREMENT vRROFMT "The rest O2 sensor feedback tense periodic monitor time" UBYTE COMP_0049 1 100 0 255 ECU_ADDRESS 0xFFFF318D /begin FUNCTION_LIST KF7-313C.9[3] /end FUNCTION_LIST /end MEASUREMENT
/begin MEASUREMENT vRROFMT_R#1 "The rest O2 sensor feedback tense periodic monitor time" UBYTE COMP_0049 1 100 0 255 ECU_ADDRESS 0xFFFF318D /begin FUNCTION_LIST KF7-313C.9[3] /end FUNCTION_LIST /end MEASUREMENT
/begin MEASUREMENT vRROFMT_R#2 "The rest O2 sensor feedback tense periodic monitor time" UBYTE COMP_0049 1 100 0 255 ECU_ADDRESS 0xFFFF318E /begin FUNCTION_LIST KF7-313C.9[3] /end FUNCTION_LIST /end MEASUREMENT
/begin MEASUREMENT vSCKRET "The amount of re-acceleration shock retard" UBYTE COMP_0017 1 100 0 255 ECU_ADDRESS 0xFFFF422E /begin FUNCTION_LIST KF7-320A.1[6] KF7-320A.2[3] R301.23.ADV_calculation_1_1_2 /end FUNCTION_LIST /end MEASUREMENT
/begin MEASUREMENT vSCKRET0 "The amount of re-acceleration shock retard" UWORD COMP_0081 1 100 0 255.99609375 ECU_ADDRESS 0xFFFF31C0 /begin FUNCTION_LIST KF7-320A.2[3] R301.23.ADV_calculation_1_1_2 /end FUNCTION_LIST /end MEASUREMENT
/begin MEASUREMENT vSCVTF "SCV, very, disorder variable" UBYTE COMP_0095 1 100 0 398.4375 ECU_ADDRESS 0xFFFF177C /begin FUNCTION_LIST KF7-320A.8[2] /end FUNCTION_LIST /end MEASUREMENT
/begin MEASUREMENT vSTRAG "O2 sensor storage index number" UBYTE COMP_0085_S 1 100 0 255 ECU_ADDRESS 0xFFFF3217 /begin FUNCTION_LIST KF7-313C.9[3] KF7-500.21[19] KF7-500.24[10] /end FUNCTION_LIST /end MEASUREMENT
/begin MEASUREMENT vSTRAG_R#1 "O2 sensor storage index number" UBYTE COMP_0085_S 1 100 0 255 ECU_ADDRESS 0xFFFF3217 /begin FUNCTION_LIST KF7-313C.9[3] KF7-500.21[19] KF7-500.24[10] /end FUNCTION_LIST /end MEASUREMENT
/begin MEASUREMENT vSTRAG_R#2 "O2 sensor storage index number" UBYTE COMP_0085_S 1 100 0 255 ECU_ADDRESS 0xFFFF3218 /begin FUNCTION_LIST KF7-313C.9[3] KF7-500.21[19] KF7-500.24[10] /end FUNCTION_LIST /end MEASUREMENT
/begin MEASUREMENT vSUMOXY "At the time of the rest O2 sensor feedback, the amount of O2 integration" ULONG COMP_0068 1 100 0 4294967295 ECU_ADDRESS 0xFFFF3240 /begin FUNCTION_LIST KF7-313C.9[3] KF7-500.21[19] /end FUNCTION_LIST /end MEASUREMENT
/begin MEASUREMENT vSUMOXY_R#1 "At the time of the rest O2 sensor feedback, the amount of O2 integration" ULONG COMP_0068 1 100 0 4294967295 ECU_ADDRESS 0xFFFF3240 /begin FUNCTION_LIST KF7-313C.9[3] KF7-500.21[19] /end FUNCTION_LIST /end MEASUREMENT
/begin MEASUREMENT vSUMOXY_R#2 "At the time of the rest O2 sensor feedback, the amount of O2 integration" ULONG COMP_0068 1 100 0 4294967295 ECU_ADDRESS 0xFFFF3244 /begin FUNCTION_LIST KF7-313C.9[3] KF7-500.21[19] /end FUNCTION_LIST /end MEASUREMENT
/begin MEASUREMENT vTADVM "A basic ignition timing" SBYTE COMP_0018 1 100 -128 127 ECU_ADDRESS 0xFFFF2407
 /begin FUNCTION_LIST KF7-320A.1[6] KF7-320A.10[14] KF7-320A.19[7] KF7-320A.20[2] KF7-385.2[18] KF7-386.1[4] KF7-386.2[4] KF7-390.1A[3] KF7-460.1[6] R301.1.Torque_realization_1_0_3 R301.23.ADV_calculation_1_1_2 /end FUNCTION_LIST
/end MEASUREMENT
/begin MEASUREMENT vTADVMnm "At the time of usual, a basic ignition timing" SBYTE COMP_0018 1 100 -128 127 ECU_ADDRESS 0xFFFF17FC /begin FUNCTION_LIST KF7-320A.10[14] KF7-320A.18[4] KF7-320A.20[2] /end FUNCTION_LIST /end MEASUREMENT
/begin MEASUREMENT vTCAJA2 "Stage 2 diagnosis region timer" UBYTE COMP_0013 1 100 0 255 ECU_ADDRESS 0xFFFF32B8 /begin FUNCTION_LIST KF7-313C.9[3] KF7-500.21[19] /end FUNCTION_LIST /end MEASUREMENT
/begin MEASUREMENT vTCAJA2_R#1 "Stage 2 diagnosis region timer" UBYTE COMP_0013 1 100 0 255 ECU_ADDRESS 0xFFFF32B8 /begin FUNCTION_LIST KF7-313C.9[3] KF7-500.21[19] /end FUNCTION_LIST /end MEASUREMENT
/begin MEASUREMENT vTCAJA2_R#2 "Stage 2 diagnosis region timer" UBYTE COMP_0013 1 100 0 255 ECU_ADDRESS 0xFFFF32B9 /begin FUNCTION_LIST KF7-313C.9[3] KF7-500.21[19] /end FUNCTION_LIST /end MEASUREMENT
/begin MEASUREMENT vTCATKOS "IGN SW At the time of off, catalyst estimated temperature" UBYTE COMP_0062 1 100 0 1020 ECU_ADDRESS 0xFFFFB240 /begin FUNCTION_LIST KF7-313C.7[1] R000.4.EepAlloc_1_2_2 /end FUNCTION_LIST /end MEASUREMENT
/begin MEASUREMENT vTDWLLB "Dwell energizing time basic value" UBYTE COMP_0017 1 100 0 255 ECU_ADDRESS 0xFFFF1842 /begin FUNCTION_LIST KF7-320A.6[3] KF7-320A.21[N] /end FUNCTION_LIST /end MEASUREMENT
/begin MEASUREMENT vTDWLLH "Dwell energizing time fever limitation value" UBYTE COMP_0017 1 100 0 255 ECU_ADDRESS 0xFFFF1843 /begin FUNCTION_LIST KF7-320A.6[3] KF7-320A.21[N] /end FUNCTION_LIST /end MEASUREMENT
/begin MEASUREMENT vTFBYAC "Fuel air-fuel ratio" UWORD COMP_0057 1 100 0 3.999941832 ECU_ADDRESS 0xFFFF18CA /begin FUNCTION_LIST KF7-320A.8[2] /end FUNCTION_LIST /end MEASUREMENT
/begin MEASUREMENT vTLALPL "Map learning value (L)" UWORD COMP_0031 1 100 0 255.99609375 ECU_ADDRESS 0xFFFFB266 /begin FUNCTION_LIST KF7-314.1F[1] /end FUNCTION_LIST /end MEASUREMENT
/begin MEASUREMENT vTLALPL_C#1_R#1 "Map learning value (L)" UWORD COMP_0031 1 100 0 255.99609375 ECU_ADDRESS 0xFFFFB266 /begin FUNCTION_LIST KF7-314.1F[1] /end FUNCTION_LIST /end MEASUREMENT
/begin MEASUREMENT vTLALPL_C#1_R#2 "Map learning value (L)" UWORD COMP_0031 1 100 0 255.99609375 ECU_ADDRESS 0xFFFFB268 /begin FUNCTION_LIST KF7-314.1F[1] /end FUNCTION_LIST /end MEASUREMENT
/begin MEASUREMENT vTLALPL_C#1_R#3 "Map learning value (L)" UWORD COMP_0031 1 100 0 255.99609375 ECU_ADDRESS 0xFFFFB26A /begin FUNCTION_LIST KF7-314.1F[1] /end FUNCTION_LIST /end MEASUREMENT
/begin MEASUREMENT vTLALPL_C#1_R#4 "Map learning value (L)" UWORD COMP_0031 1 100 0 255.99609375 ECU_ADDRESS 0xFFFFB26C /begin FUNCTION_LIST KF7-314.1F[1] /end FUNCTION_LIST /end MEASUREMENT
/begin MEASUREMENT vTLALPL_C#2_R#1 "Map learning value (L)" UWORD COMP_0031 1 100 0 255.99609375 ECU_ADDRESS 0xFFFFB26E /begin FUNCTION_LIST KF7-314.1F[1] /end FUNCTION_LIST /end MEASUREMENT
/begin MEASUREMENT vTLALPL_C#2_R#2 "Map learning value (L)" UWORD COMP_0031 1 100 0 255.99609375 ECU_ADDRESS 0xFFFFB270 /begin FUNCTION_LIST KF7-314.1F[1] /end FUNCTION_LIST /end MEASUREMENT
/begin MEASUREMENT vTLALPL_C#2_R#3 "Map learning value (L)" UWORD COMP_0031 1 100 0 255.99609375 ECU_ADDRESS 0xFFFFB272 /begin FUNCTION_LIST KF7-314.1F[1] /end FUNCTION_LIST /end MEASUREMENT
/begin MEASUREMENT vTLALPL_C#2_R#4 "Map learning value (L)" UWORD COMP_0031 1 100 0 255.99609375 ECU_ADDRESS 0xFFFFB274 /begin FUNCTION_LIST KF7-314.1F[1] /end FUNCTION_LIST /end MEASUREMENT
/begin MEASUREMENT vTLALPL_C#3_R#1 "Map learning value (L)" UWORD COMP_0031 1 100 0 255.99609375 ECU_ADDRESS 0xFFFFB276 /begin FUNCTION_LIST KF7-314.1F[1] /end FUNCTION_LIST /end MEASUREMENT
/begin MEASUREMENT vTLALPL_C#3_R#2 "Map learning value (L)" UWORD COMP_0031 1 100 0 255.99609375 ECU_ADDRESS 0xFFFFB278 /begin FUNCTION_LIST KF7-314.1F[1] /end FUNCTION_LIST /end MEASUREMENT
/begin MEASUREMENT vTLALPL_C#3_R#3 "Map learning value (L)" UWORD COMP_0031 1 100 0 255.99609375 ECU_ADDRESS 0xFFFFB27A /begin FUNCTION_LIST KF7-314.1F[1] /end FUNCTION_LIST /end MEASUREMENT
/begin MEASUREMENT vTLALPL_C#3_R#4 "Map learning value (L)" UWORD COMP_0031 1 100 0 255.99609375 ECU_ADDRESS 0xFFFFB27C /begin FUNCTION_LIST KF7-314.1F[1] /end FUNCTION_LIST /end MEASUREMENT
/begin MEASUREMENT vTLALPL_C#4_R#1 "Map learning value (L)" UWORD COMP_0031 1 100 0 255.99609375 ECU_ADDRESS 0xFFFFB27E /begin FUNCTION_LIST KF7-314.1F[1] /end FUNCTION_LIST /end MEASUREMENT
/begin MEASUREMENT vTLALPL_C#4_R#2 "Map learning value (L)" UWORD COMP_0031 1 100 0 255.99609375 ECU_ADDRESS 0xFFFFB280 /begin FUNCTION_LIST KF7-314.1F[1] /end FUNCTION_LIST /end MEASUREMENT
/begin MEASUREMENT vTLALPL_C#4_R#3 "Map learning value (L)" UWORD COMP_0031 1 100 0 255.99609375 ECU_ADDRESS 0xFFFFB282 /begin FUNCTION_LIST KF7-314.1F[1] /end FUNCTION_LIST /end MEASUREMENT
/begin MEASUREMENT vTLALPL_C#4_R#4 "Map learning value (L)" UWORD COMP_0031 1 100 0 255.99609375 ECU_ADDRESS 0xFFFFB284 /begin FUNCTION_LIST KF7-314.1F[1] /end FUNCTION_LIST /end MEASUREMENT
/begin MEASUREMENT vTLALPR "Map learning value (R)" UWORD COMP_0031 1 100 0 255.99609375 ECU_ADDRESS 0xFFFFB286 /begin FUNCTION_LIST KF7-314.1F[1] /end FUNCTION_LIST /end MEASUREMENT
/begin MEASUREMENT vTLALPR_C#1_R#1 "Map learning value (R)" UWORD COMP_0031 1 100 0 255.99609375 ECU_ADDRESS 0xFFFFB286 /begin FUNCTION_LIST KF7-314.1F[1] /end FUNCTION_LIST /end MEASUREMENT
/begin MEASUREMENT vTLALPR_C#1_R#2 "Map learning value (R)" UWORD COMP_0031 1 100 0 255.99609375 ECU_ADDRESS 0xFFFFB288 /begin FUNCTION_LIST KF7-314.1F[1] /end FUNCTION_LIST /end MEASUREMENT
/begin MEASUREMENT vTLALPR_C#1_R#3 "Map learning value (R)" UWORD COMP_0031 1 100 0 255.99609375 ECU_ADDRESS 0xFFFFB28A /begin FUNCTION_LIST KF7-314.1F[1] /end FUNCTION_LIST /end MEASUREMENT
/begin MEASUREMENT vTLALPR_C#1_R#4 "Map learning value (R)" UWORD COMP_0031 1 100 0 255.99609375 ECU_ADDRESS 0xFFFFB28C /begin FUNCTION_LIST KF7-314.1F[1] /end FUNCTION_LIST /end MEASUREMENT
/begin MEASUREMENT vTLALPR_C#2_R#1 "Map learning value (R)" UWORD COMP_0031 1 100 0 255.99609375 ECU_ADDRESS 0xFFFFB28E /begin FUNCTION_LIST KF7-314.1F[1] /end FUNCTION_LIST /end MEASUREMENT
/begin MEASUREMENT vTLALPR_C#2_R#2 "Map learning value (R)" UWORD COMP_0031 1 100 0 255.99609375 ECU_ADDRESS 0xFFFFB290 /begin FUNCTION_LIST KF7-314.1F[1] /end FUNCTION_LIST /end MEASUREMENT
/begin MEASUREMENT vTLALPR_C#2_R#3 "Map learning value (R)" UWORD COMP_0031 1 100 0 255.99609375 ECU_ADDRESS 0xFFFFB292 /begin FUNCTION_LIST KF7-314.1F[1] /end FUNCTION_LIST /end MEASUREMENT
/begin MEASUREMENT vTLALPR_C#2_R#4 "Map learning value (R)" UWORD COMP_0031 1 100 0 255.99609375 ECU_ADDRESS 0xFFFFB294 /begin FUNCTION_LIST KF7-314.1F[1] /end FUNCTION_LIST /end MEASUREMENT
/begin MEASUREMENT vTLALPR_C#3_R#1 "Map learning value (R)" UWORD COMP_0031 1 100 0 255.99609375 ECU_ADDRESS 0xFFFFB296 /begin FUNCTION_LIST KF7-314.1F[1] /end FUNCTION_LIST /end MEASUREMENT
/begin MEASUREMENT vTLALPR_C#3_R#2 "Map learning value (R)" UWORD COMP_0031 1 100 0 255.99609375 ECU_ADDRESS 0xFFFFB298 /begin FUNCTION_LIST KF7-314.1F[1] /end FUNCTION_LIST /end MEASUREMENT
/begin MEASUREMENT vTLALPR_C#3_R#3 "Map learning value (R)" UWORD COMP_0031 1 100 0 255.99609375 ECU_ADDRESS 0xFFFFB29A /begin FUNCTION_LIST KF7-314.1F[1] /end FUNCTION_LIST /end MEASUREMENT
/begin MEASUREMENT vTLALPR_C#3_R#4 "Map learning value (R)" UWORD COMP_0031 1 100 0 255.99609375 ECU_ADDRESS 0xFFFFB29C /begin FUNCTION_LIST KF7-314.1F[1] /end FUNCTION_LIST /end MEASUREMENT
/begin MEASUREMENT vTLALPR_C#4_R#1 "Map learning value (R)" UWORD COMP_0031 1 100 0 255.99609375 ECU_ADDRESS 0xFFFFB29E /begin FUNCTION_LIST KF7-314.1F[1] /end FUNCTION_LIST /end MEASUREMENT
/begin MEASUREMENT vTLALPR_C#4_R#2 "Map learning value (R)" UWORD COMP_0031 1 100 0 255.99609375 ECU_ADDRESS 0xFFFFB2A0 /begin FUNCTION_LIST KF7-314.1F[1] /end FUNCTION_LIST /end MEASUREMENT
/begin MEASUREMENT vTLALPR_C#4_R#3 "Map learning value (R)" UWORD COMP_0031 1 100 0 255.99609375 ECU_ADDRESS 0xFFFFB2A2 /begin FUNCTION_LIST KF7-314.1F[1] /end FUNCTION_LIST /end MEASUREMENT
/begin MEASUREMENT vTLALPR_C#4_R#4 "Map learning value (R)" UWORD COMP_0031 1 100 0 255.99609375 ECU_ADDRESS 0xFFFFB2A4 /begin FUNCTION_LIST KF7-314.1F[1] /end FUNCTION_LIST /end MEASUREMENT
/begin MEASUREMENT vTQRET "The amount of retard control" SBYTE COMP_0018 1 100 -128 127 ECU_ADDRESS 0xFFFF8A54
 /begin FUNCTION_LIST KF7-320A.1[6] KF7-385.2[18] KF7-386.1[4] KF7-386.2[4] KF7-390.1A[3] KF7-460.1[6] R301.23.ADV_calculation_1_1_2 /end FUNCTION_LIST
/end MEASUREMENT
/begin MEASUREMENT vTRMOLD "The trimming-map compensation value ADVTRM of the 10 ms front" UWORD COMP_0516 1 100 -64 191.99609375 ECU_ADDRESS 0xFFFF19C0 /begin FUNCTION_LIST KF7-320A.9[9] /end FUNCTION_LIST /end MEASUREMENT
/begin MEASUREMENT vTWHOS "Coolant temperature compensation coefficient 2" UBYTE COMP_0009 1 100 0 199.21875 ECU_ADDRESS 0xFFFF1A40 /begin FUNCTION_LIST KF7-320A.8[2] /end FUNCTION_LIST /end MEASUREMENT
/begin MEASUREMENT vVAFSTIK "Lambda point output mean" UWORD COMP_0023 1 100 0 327675 ECU_ADDRESS 0xFFFF3FB4 /begin FUNCTION_LIST KF7-313C.3[1] /end FUNCTION_LIST /end MEASUREMENT
/begin MEASUREMENT vVTCADV "VTC ignition timing compensation value" UBYTE COMP_0245 1 100 -64 191 ECU_ADDRESS 0xFFFF1AA6 /begin FUNCTION_LIST KF7-320A.10[14] KF7-320A.18[4] KF7-320A.22[5] /end FUNCTION_LIST /end MEASUREMENT
/begin MEASUREMENT vWKSTRG "Work RAM for the STRAG operation" ULONG COMP_0068 1 100 0 4294967295 ECU_ADDRESS 0xFFFF4010 /begin FUNCTION_LIST KF7-313C.9[3] KF7-500.21[19] KF7-500.24[10] /end FUNCTION_LIST /end MEASUREMENT
/begin MEASUREMENT vWKSTRG_R#1 "Work RAM for the STRAG operation" ULONG COMP_0068 1 100 0 4294967295 ECU_ADDRESS 0xFFFF4010 /begin FUNCTION_LIST KF7-313C.9[3] KF7-500.21[19] KF7-500.24[10] /end FUNCTION_LIST /end MEASUREMENT
/begin MEASUREMENT vWKSTRG_R#2 "Work RAM for the STRAG operation" ULONG COMP_0068 1 100 0 4294967295 ECU_ADDRESS 0xFFFF4014 /begin FUNCTION_LIST KF7-313C.9[3] KF7-500.21[19] KF7-500.24[10] /end FUNCTION_LIST /end MEASUREMENT
/begin MEASUREMENT vfAFDCST "Diagnosis permission condition formation flag" UBYTE COMP_0068 1 100 0 255 ECU_ADDRESS 0xFFFF2CE7 /begin FUNCTION_LIST KF7-314.1F[1] /end FUNCTION_LIST /end MEASUREMENT
/begin MEASUREMENT vfAFDCST_R#1 "Diagnosis permission condition formation flag" UBYTE COMP_0068 1 100 0 255 ECU_ADDRESS 0xFFFF2CE7 /begin FUNCTION_LIST KF7-314.1F[1] /end FUNCTION_LIST /end MEASUREMENT
/begin MEASUREMENT vfAFDCST_R#2 "Diagnosis permission condition formation flag" UBYTE COMP_0068 1 100 0 255 ECU_ADDRESS 0xFFFF2CE8 /begin FUNCTION_LIST KF7-314.1F[1] /end FUNCTION_LIST /end MEASUREMENT
/begin MEASUREMENT vfAFDEND "Diagnosis completion control flag" UBYTE COMP_0068 1 100 0 255 ECU_ADDRESS 0xFFFF2CE9 /begin FUNCTION_LIST KF7-314.1F[1] /end FUNCTION_LIST /end MEASUREMENT
/begin MEASUREMENT vfAFDEND_R#1 "Diagnosis completion control flag" UBYTE COMP_0068 1 100 0 255 ECU_ADDRESS 0xFFFF2CE9 /begin FUNCTION_LIST KF7-314.1F[1] /end FUNCTION_LIST /end MEASUREMENT
/begin MEASUREMENT vfAFDEND_R#2 "Diagnosis completion control flag" UBYTE COMP_0068 1 100 0 255 ECU_ADDRESS 0xFFFF2CEA /begin FUNCTION_LIST KF7-314.1F[1] /end FUNCTION_LIST /end MEASUREMENT
/begin MEASUREMENT vtCALPDLY_R#1 "Reference A/F convergent time" UWORD COMP_0165_S 1 100 0 655.35 ECU_ADDRESS 0xFFFF32BC /begin FUNCTION_LIST KF7-313C.1[36] /end FUNCTION_LIST /end MEASUREMENT
/begin MEASUREMENT vtCALPDLY_R#2 "Reference A/F convergent time" UWORD COMP_0165_S 1 100 0 655.35 ECU_ADDRESS 0xFFFF32BE /begin FUNCTION_LIST KF7-313C.1[36] /end FUNCTION_LIST /end MEASUREMENT
/begin MEASUREMENT vtTGTIME "Rich/lean switching time" UWORD COMP_0165_S 1 100 0 655.35 ECU_ADDRESS 0xFFFF3408 /begin FUNCTION_LIST KF7-313C.1[36] /end FUNCTION_LIST /end MEASUREMENT
/begin MEASUREMENT vtTGTIME_R#1 "Rich/lean switching time" UWORD COMP_0165_S 1 100 0 655.35 ECU_ADDRESS 0xFFFF3408 /begin FUNCTION_LIST KF7-313C.1[36] /end FUNCTION_LIST /end MEASUREMENT
/begin MEASUREMENT vtTGTIME_R#2 "Rich/lean switching time" UWORD COMP_0165_S 1 100 0 655.35 ECU_ADDRESS 0xFFFF340A /begin FUNCTION_LIST KF7-313C.1[36] /end FUNCTION_LIST /end MEASUREMENT
/begin MEASUREMENT wvAVGAFH "Heater electric current value A/D value weighted average value" UWORD COMP_0023 1 100 0 327675 ECU_ADDRESS 0xFFFF47EE /begin FUNCTION_LIST KF7-313C.2[4] KF7-378.3B[5] KF7-500.59[6] /end FUNCTION_LIST /end MEASUREMENT
/begin MEASUREMENT wvCURGPV "Actual gear position estimated value" UBYTE COMP_0068 1 100 0 255 ECU_ADDRESS 0xFFFF88BD /begin FUNCTION_LIST KF7-320A.2[3] KF7-360.12[6] /end FUNCTION_LIST /end MEASUREMENT
/begin MEASUREMENT wvFADV "A final ignition timing" UBYTE COMP_0017 1 100 0 255 ECU_ADDRESS 0xFFFF8A03
 /begin FUNCTION_LIST KF7-320A.5[N] KF7-450.9A[5] KF7-450.50[10] KF7-500.1[54] KF7-525.2[6] /end FUNCTION_LIST
/end MEASUREMENT
/begin MEASUREMENT wvHTARTDR "High intake air temperature retard value (after the change width limiter)" UBYTE COMP_0017 1 100 0 255 ECU_ADDRESS 0xFFFF8A07 /begin FUNCTION_LIST KF7-320A.9[9] /end FUNCTION_LIST /end MEASUREMENT
/begin MEASUREMENT wvTQRET "The amount of retard control" SBYTE COMP_0018 1 100 -128 127 ECU_ADDRESS 0xFFFF8A1C
 /begin FUNCTION_LIST KF7-320A.1[6] KF7-385.2[18] KF7-386.1[4] KF7-386.2[4] KF7-390.1A[3] KF7-460.1[6] /end FUNCTION_LIST
/end MEASUREMENT
/begin MEASUREMENT CAT1NG "RAM value CAT1NG" UBYTE COMP_0068 1 100 0 255 ECU_ADDRESS 0xFFFF9C90 /begin FUNCTION_LIST KF7-313C.1[36] KF7-500.2A[29] KF7-500.21[19] /end FUNCTION_LIST /end MEASUREMENT
/begin MEASUREMENT CAT2NG "RAM value CAT2NG" UBYTE COMP_0068 1 100 0 255 ECU_ADDRESS 0xFFFF9C93 /begin FUNCTION_LIST KF7-313C.1[36] KF7-500.2A[29] KF7-500.21[19] /end FUNCTION_LIST /end MEASUREMENT
/begin MEASUREMENT vCAT2NG "RAM value vCAT2NG" UWORD COMP_0068 1 100 0 65535 ECU_ADDRESS 0xFFFF9C94 /begin FUNCTION_LIST KF7-313C.1[36] KF7-500.2A[29] KF7-500.21[19] /end FUNCTION_LIST /end MEASUREMENT
/* COMPU_METHOD --------------------------------------------------------- */
/begin COMPU_METHOD COMP_0017 "1deg" RAT_FUNC "%8.2" "deg" COEFFS 0 1 0 0 0 1 /end COMPU_METHOD
/begin COMPU_METHOD COMP_0205_S "fixed axis Long" RAT_FUNC "%8.2" "Long" COEFFS 0 1 0 0 0 1 /end COMPU_METHOD
/begin COMPU_METHOD COMP_0068 "1-" RAT_FUNC "%8.2" "-" COEFFS 0 1 0 0 0 1 /end COMPU_METHOD
/begin COMPU_METHOD COMP_0004 "1Å|" RAT_FUNC "%8.2" "Å|" COEFFS 0 1 0 0 0 1 /end COMPU_METHOD
/begin COMPU_METHOD COMP_0061 "5mv" RAT_FUNC "%8.2" "mv" COEFFS 0 1 0 0 0 5 /end COMPU_METHOD
/begin COMPU_METHOD COMP_0023 "5mV" RAT_FUNC "%8.2" "mV" COEFFS 0 1 0 0 0 5 /end COMPU_METHOD
/begin COMPU_METHOD COMP_0001 "1/8ms" RAT_FUNC "%8.2" "ms" COEFFS 0 1 0 0 0 0.125 /end COMPU_METHOD
/begin COMPU_METHOD COMP_0020 "50rpm" RAT_FUNC "%8.2" "rpm" COEFFS 0 1 0 0 0 50 /end COMPU_METHOD
/begin COMPU_METHOD COMP_0002 "0.35deg" RAT_FUNC "%8.2" "deg" COEFFS 0 1 0 0 0 0.35 /end COMPU_METHOD
/begin COMPU_METHOD COMP_0003 "1Åé" RAT_FUNC "%8.2" "Åé" COEFFS 0 1 0 0 0 1 /end COMPU_METHOD
/begin COMPU_METHOD COMP_0453 "0.002-" RAT_FUNC "%8.4" "-" COEFFS 0 1 0 0 0 0.002 /end COMPU_METHOD
/begin COMPU_METHOD COMP_0014 "10ms" RAT_FUNC "%8.2" "ms" COEFFS 0 1 0 0 0 10 /end COMPU_METHOD
/begin COMPU_METHOD COMP_0006 "12.5rpm" RAT_FUNC "%8.2" "rpm" COEFFS 0 1 0 0 0 12.5 /end COMPU_METHOD
/begin COMPU_METHOD COMP_0008 "100ms" RAT_FUNC "%8.2" "ms" COEFFS 0 1 0 0 0 100 /end COMPU_METHOD
/begin COMPU_METHOD COMP_0009 "100/128%" RAT_FUNC "%8.2" "%" COEFFS 0 1 0 0 0 0.78125 /end COMPU_METHOD
/begin COMPU_METHOD COMP_0013 "1s" RAT_FUNC "%8.2" "s" COEFFS 0 1 0 0 0 1 /end COMPU_METHOD
/begin COMPU_METHOD COMP_0000 "25rpm" RAT_FUNC "%8.2" "rpm" COEFFS 0 1 0 0 0 25 /end COMPU_METHOD
/begin COMPU_METHOD COMP_0163 "1/16%" RAT_FUNC "%8.3" "%" COEFFS 0 1 0 0 0 0.0625 /end COMPU_METHOD
/begin COMPU_METHOD COMP_0353 "5mV" RAT_FUNC "%8.2" "mV" COEFFS 0 1 0 0 0 5 /end COMPU_METHOD
/begin COMPU_METHOD COMP_0018 "1deg" RAT_FUNC "%8.2" "deg" COEFFS 0 1 0 0 0 1 /end COMPU_METHOD
/begin COMPU_METHOD COMP_0081 "1/256deg" RAT_FUNC "%8.4" "deg" COEFFS 0 1 0 0 0 0.00390625 /end COMPU_METHOD
/begin COMPU_METHOD COMP_0340_S "1REF/deg" RAT_FUNC "%8.2" "REF/deg" COEFFS 0 1 0 0 0 1 /end COMPU_METHOD
/begin COMPU_METHOD COMP_0007 "2km/h" RAT_FUNC "%8.2" "km/h" COEFFS 0 1 0 0 0 2 /end COMPU_METHOD
/begin COMPU_METHOD COMP_0021 "100/256%" RAT_FUNC "%8.2" "%" COEFFS 0 1 0 0 0 0.390625 /end COMPU_METHOD
/begin COMPU_METHOD COMP_0217 "1/16384-" RAT_FUNC "%8.6" "-" COEFFS 0 1 0 0 0 0.0000610352 /end COMPU_METHOD
/begin COMPU_METHOD COMP_0033 "80mV" RAT_FUNC "%8.2" "mV" COEFFS 0 1 0 0 0 80 /end COMPU_METHOD
/begin COMPU_METHOD COMP_0027 "1%" RAT_FUNC "%8.2" "%" COEFFS 0 1 0 0 0 1 /end COMPU_METHOD
/begin COMPU_METHOD COMP_0267_S "0.1sec" RAT_FUNC "%8.2" "sec" COEFFS 0 1 0 0 0 0.1 /end COMPU_METHOD
/begin COMPU_METHOD COMP_0165_S "secsec" RAT_FUNC "%8.3" "sec" COEFFS 0 1 0 0 0 0.01 /end COMPU_METHOD
/begin COMPU_METHOD COMP_0049 "1sec" RAT_FUNC "%8.2" "sec" COEFFS 0 1 0 0 0 1 /end COMPU_METHOD
/begin COMPU_METHOD COMP_0032 "1/256Å|" RAT_FUNC "%8.4" "Å|" COEFFS 0 1 0 0 0 0.00390625 /end COMPU_METHOD
/begin COMPU_METHOD COMP_0030 "1âÒ" RAT_FUNC "%8.2" "âÒ" COEFFS 0 1 0 0 0 1 /end COMPU_METHOD
/begin COMPU_METHOD COMP_0341_S "0.002-" RAT_FUNC "%8.4" "-" COEFFS 0 1 0 0 0 0.002 /end COMPU_METHOD
/begin COMPU_METHOD COMP_0031 "1/256%" RAT_FUNC "%8.4" "%" COEFFS 0 1 0 0 0 0.00390625 /end COMPU_METHOD
/begin COMPU_METHOD COMP_0053_S "deg/150msdeg/150m" RAT_FUNC "%8.2" "deg/150m" COEFFS 0 1 0 0 0 0.35 /end COMPU_METHOD
/begin COMPU_METHOD COMP_0005 "0.11deg" RAT_FUNC "%8.2" "deg" COEFFS 0 1 0 0 0 0.11 /end COMPU_METHOD
/begin COMPU_METHOD COMP_0044 "1/128Å|" RAT_FUNC "%8.4" "Å|" COEFFS 0 1 0 0 0 0.0078125 /end COMPU_METHOD
/begin COMPU_METHOD COMP_0016 "1count" RAT_FUNC "%8.2" "count" COEFFS 0 1 0 0 0 1 /end COMPU_METHOD
/begin COMPU_METHOD COMP_0035 "X-50Åé" RAT_FUNC "%8.2" "Åé" COEFFS 0 1 50 0 0 1 /end COMPU_METHOD
/begin COMPU_METHOD COMP_0085_S "ms/2^(STUG#-13)ms/2^(ST" RAT_FUNC "%8.2" "ms/2^(ST" COEFFS 0 1 0 0 0 1 /end COMPU_METHOD
/begin COMPU_METHOD COMP_0095 "400/256%" RAT_FUNC "%8.2" "%" COEFFS 0 1 0 0 0 1.5625 /end COMPU_METHOD
/begin COMPU_METHOD COMP_0215_S "1deg/ref" RAT_FUNC "%8.2" "deg/ref" COEFFS 0 1 0 0 0 1 /end COMPU_METHOD
/begin COMPU_METHOD COMP_0108 "1/256/10ms" RAT_FUNC "%8.4" "/10ms" COEFFS 0 1 0 0 0 0.00390625 /end COMPU_METHOD
/begin COMPU_METHOD COMP_0104 "10mV" RAT_FUNC "%8.2" "mV" COEFFS 0 1 0 0 0 10 /end COMPU_METHOD
/begin COMPU_METHOD COMP_0228_S "3/256deg(V/rp" RAT_FUNC "%8.3" "deg(V/rp" COEFFS 0 1 0 0 0 0.0117188 /end COMPU_METHOD
/begin COMPU_METHOD COMP_0404_S "8/256deg(V/rp" RAT_FUNC "%8.3" "deg(V/rp" COEFFS 0 1 0 0 0 0.03125 /end COMPU_METHOD
/begin COMPU_METHOD COMP_0405_S "10/256-" RAT_FUNC "%8.3" "-" COEFFS 0 1 0 0 0 0.0391 /end COMPU_METHOD
/begin COMPU_METHOD COMP_0136 "0.02sec" RAT_FUNC "%8.3" "sec" COEFFS 0 1 0 0 0 0.02 /end COMPU_METHOD
/begin COMPU_METHOD COMP_0026 "80mv" RAT_FUNC "%8.2" "mv" COEFFS 0 1 0 0 0 80 /end COMPU_METHOD
/begin COMPU_METHOD COMP_0314 "X-128deg" RAT_FUNC "%8.2" "deg" COEFFS 0 1 128 0 0 1 /end COMPU_METHOD
/begin COMPU_METHOD COMP_0415_S "38368É∂" RAT_FUNC "%8.3" "É∂" COEFFS 0 1 0 0 0 0.0625 /end COMPU_METHOD
/begin COMPU_METHOD COMP_0094_S "mgmg" RAT_FUNC "%8.3" "mg" COEFFS 0 1 0 0 0 0.01 /end COMPU_METHOD
/begin COMPU_METHOD COMP_0191 "1REV" RAT_FUNC "%8.2" "REV" COEFFS 0 1 0 0 0 1 /end COMPU_METHOD
/begin COMPU_METHOD COMP_0062 "4Åé" RAT_FUNC "%8.2" "Åé" COEFFS 0 1 0 0 0 4 /end COMPU_METHOD
/begin COMPU_METHOD COMP_0119_S "deg/10Åédeg/10Åé" RAT_FUNC "%8.3" "deg/10Åé" COEFFS 0 1 0 0 0 0.015625 /end COMPU_METHOD
/begin COMPU_METHOD COMP_0248 "1/256g" RAT_FUNC "%8.4" "g" COEFFS 0 1 0 0 0 0.00390625 /end COMPU_METHOD
/begin COMPU_METHOD COMP_0244_S "32/256X10^-6m^3/sec/" RAT_FUNC "%8.6" "m^3/sec/" COEFFS 0 1 0 0 0 0.000000125 /end COMPU_METHOD
/begin COMPU_METHOD COMP_0254 "1/16deg/%" RAT_FUNC "%8.3" "deg/%" COEFFS 0 1 0 0 0 0.0625 /end COMPU_METHOD
/begin COMPU_METHOD COMP_0255 "1/8deg/10ms" RAT_FUNC "%8.2" "deg/10ms" COEFFS 0 1 0 0 0 0.125 /end COMPU_METHOD
/begin COMPU_METHOD COMP_0159 "256Å|" RAT_FUNC "%8.2" "Å|" COEFFS 0 1 0 0 0 256 /end COMPU_METHOD
/begin COMPU_METHOD COMP_0065 "3.125rpm" RAT_FUNC "%8.2" "rpm" COEFFS 0 1 0 0 0 3.125 /end COMPU_METHOD
/begin COMPU_METHOD COMP_0092 "1bit" RAT_FUNC "%8.2" "bit" COEFFS 0 1 0 0 0 1 /end COMPU_METHOD
/begin COMPU_METHOD COMP_0262_S "5/256ms" RAT_FUNC "%8.3" "ms" COEFFS 0 1 0 0 0 0.0195313 /end COMPU_METHOD
/begin COMPU_METHOD COMP_0057 "1/16384Å|" RAT_FUNC "%8.6" "Å|" COEFFS 0 1 0 0 0 0.0000610352 /end COMPU_METHOD
/begin COMPU_METHOD COMP_0265_S "128(mv^2)se" RAT_FUNC "%8.2" "(mv^2)se" COEFFS 0 1 0 0 0 128 /end COMPU_METHOD
/begin COMPU_METHOD COMP_0245 "X-64deg" RAT_FUNC "%8.2" "deg" COEFFS 0 1 64 0 0 1 /end COMPU_METHOD
/begin COMPU_METHOD COMP_0273_S "fixed axis rpm" RAT_FUNC "%8.2" "rpm" COEFFS 0 1 -400 0 0 400 /end COMPU_METHOD
/begin COMPU_METHOD COMP_0253 "16/256X10^-3m^3/sec" RAT_FUNC "%8.6" "m^3/sec" COEFFS 0 1 0 0 0 0.0000625 /end COMPU_METHOD
/begin COMPU_METHOD COMP_0278_S "fixed axis Åé" RAT_FUNC "%8.2" "Åé" COEFFS 0 1 40 0 0 20 /end COMPU_METHOD
/begin COMPU_METHOD COMP_0271_S "fixed axis rpm" RAT_FUNC "%8.2" "rpm" COEFFS 0 1 0 0 0 400 /end COMPU_METHOD
/begin COMPU_METHOD COMP_0271 "100/128/256%" RAT_FUNC "%8.4" "%" COEFFS 0 1 0 0 0 0.003051758 /end COMPU_METHOD
/begin COMPU_METHOD COMP_0280_S "fixed axis Åé" RAT_FUNC "%8.2" "Åé" COEFFS 0 1 40 0 0 10 /end COMPU_METHOD
/begin COMPU_METHOD COMP_0314_S "fixed axis deg" RAT_FUNC "%8.2" "deg" COEFFS 0 1 0 0 0 7.04 /end COMPU_METHOD
/begin COMPU_METHOD COMP_0122_S "msms" RAT_FUNC "%8.2" "ms" COEFFS 0 1 0 0 0 2 /end COMPU_METHOD
/begin COMPU_METHOD COMP_0303 "32/256X10^3g/m^3" RAT_FUNC "%8.2" "g/m^3" COEFFS 0 1 0 0 0 125 /end COMPU_METHOD
/begin COMPU_METHOD COMP_0316_S "fixed axis %" RAT_FUNC "%8.2" "%" COEFFS 0 1 0 0 0 25 /end COMPU_METHOD
/begin COMPU_METHOD COMP_0057_S "rpm^(2/3)rpm^(2/3" RAT_FUNC "%8.2" "rpm^(2/3" COEFFS 0 1 0 0 0 2 /end COMPU_METHOD
/begin COMPU_METHOD COMP_0318_S "fixed axis rpm" RAT_FUNC "%8.2" "rpm" COEFFS 0 1 0 0 0 1600 /end COMPU_METHOD
/begin COMPU_METHOD COMP_0319_S "0.4/2561/V^(2/3" RAT_FUNC "%8.4" "1/V^(2/3" COEFFS 0 1 0 0 0 0.0015625 /end COMPU_METHOD
/begin COMPU_METHOD COMP_0320_S "fixed axis mV" RAT_FUNC "%8.2" "mV" COEFFS 0 1 0 0 0 2560 /end COMPU_METHOD
/begin COMPU_METHOD COMP_0323_S "fixed axis " RAT_FUNC "%8.2" "" COEFFS 0 1 -0.5 0 0 0.125 /end COMPU_METHOD
/begin COMPU_METHOD COMP_0517_S "X-128deg" RAT_FUNC "%8.2" "deg" COEFFS 0 1 128 0 0 1 /end COMPU_METHOD
/begin COMPU_METHOD COMP_0312_S "fixed axis rpm" RAT_FUNC "%8.2" "rpm" COEFFS 0 1 0 0 0 800 /end COMPU_METHOD
/begin COMPU_METHOD COMP_0283 "1flag" RAT_FUNC "%8.2" "flag" COEFFS 0 1 0 0 0 1 /end COMPU_METHOD
/begin COMPU_METHOD COMP_0201_S "1s1s" RAT_FUNC "%8.2" "1s" COEFFS 0 1 0 0 0 1 /end COMPU_METHOD
/begin COMPU_METHOD COMP_0202_S "100ms100ms" RAT_FUNC "%8.2" "100ms" COEFFS 0 1 0 0 0 1 /end COMPU_METHOD
/begin COMPU_METHOD COMP_0203_S "10ms10ms" RAT_FUNC "%8.2" "10ms" COEFFS 0 1 0 0 0 1 /end COMPU_METHOD
/begin COMPU_METHOD COMP_0287 "1REF" RAT_FUNC "%8.2" "REF" COEFFS 0 1 0 0 0 1 /end COMPU_METHOD
/begin COMPU_METHOD COMP_0421 "1ãCìõ" RAT_FUNC "%8.2" "ãCìõ" COEFFS 0 1 0 0 0 1 /end COMPU_METHOD
/begin COMPU_METHOD COMP_0458 "10/256É S" RAT_FUNC "%8.3" "É S" COEFFS 0 1 1280 0 0 0.0390625 /end COMPU_METHOD
/begin COMPU_METHOD COMP_0141 "50/256%" RAT_FUNC "%8.2" "%" COEFFS 0 1 0 0 0 0.1953125 /end COMPU_METHOD
/begin COMPU_METHOD COMP_0568_S "%%" RAT_FUNC "%8.5" "%" COEFFS 0 1 0 0 0 0.0009766 /end COMPU_METHOD
/begin COMPU_METHOD COMP_0438 "1/256%" RAT_FUNC "%8.4" "%" COEFFS 0 1 0 0 0 0.00390625 /end COMPU_METHOD
/begin COMPU_METHOD COMP_0058_S "(1/V)^(2/3)(1/V)^(2" RAT_FUNC "%8.4" "(1/V)^(2" COEFFS 0 1 0 0 0 0.0015625 /end COMPU_METHOD
/begin COMPU_METHOD COMP_0430 "1/65536m^3/sec" RAT_FUNC "%8.6" "m^3/sec" COEFFS 0 1 0 0 0 0.0000152588 /end COMPU_METHOD
/begin COMPU_METHOD COMP_0460 "50/65536Å|" RAT_FUNC "%8.5" "Å|" COEFFS 0 1 0 0 0 0.000762939 /end COMPU_METHOD
/begin COMPU_METHOD COMP_0471 "1/16deg" RAT_FUNC "%8.3" "deg" COEFFS 0 1 0 0 0 0.0625 /end COMPU_METHOD
/begin COMPU_METHOD COMP_0475 "10/256mV" RAT_FUNC "%8.3" "mV" COEFFS 0 1 0 0 0 0.0390625 /end COMPU_METHOD
/begin COMPU_METHOD COMP_0516 "(X-16384)/256deg" RAT_FUNC "%8.4" "deg" COEFFS 0 1 64 0 0 0.00390625 /end COMPU_METHOD
/* RECORD_LAYOUT ------------------------------------------------------ */
/begin RECORD_LAYOUT REC_UBYTE_C FNC_VALUES 1 UBYTE COLUMN_DIR DIRECT /end RECORD_LAYOUT
/begin RECORD_LAYOUT REC_UWORD_C FNC_VALUES 1 UWORD COLUMN_DIR DIRECT /end RECORD_LAYOUT
/begin RECORD_LAYOUT REC_SWORD_C FNC_VALUES 1 SWORD COLUMN_DIR DIRECT /end RECORD_LAYOUT
/begin RECORD_LAYOUT REC_SBYTE_C FNC_VALUES 1 SBYTE COLUMN_DIR DIRECT /end RECORD_LAYOUT
/begin RECORD_LAYOUT REC_SLONG_C FNC_VALUES 1 SLONG COLUMN_DIR DIRECT /end RECORD_LAYOUT
/begin RECORD_LAYOUT REC_AXIS_UBYTE AXIS_PTS_X 1 UBYTE INDEX_INCR DIRECT /end RECORD_LAYOUT
/end MODULE
/end PROJECT
