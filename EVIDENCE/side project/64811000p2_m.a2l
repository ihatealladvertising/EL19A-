ASAP2_VERSION 1 3_BETA
/begin PROJECT TK_X91_EUR_VC ""
/begin HEADER "" /* key HEADER ++ "comment" Ç… Par.scomment */ PROJECT_NO TK_X91_EUR_VC /* key PROJECT_NO ++ project number Ç… car_eng_desti_lot */ VERSION "7V4YHZEB2" /* key VERSION ++ version number Ç… mProgver */ /end HEADER
/begin MODULE DIM ""
/begin MOD_COMMON "" DEPOSIT ABSOLUTE BYTE_ORDER MSB_FIRST /* ﬁ≤ƒµ∞¿ﬁ∞Ç™ÿÃﬂ⁄∞ΩÇ≥ÇÍÇÈ */ /end MOD_COMMON
/begin MEASUREMENT afCFAPSC "Confirmed failure of pedal safety case" UBYTE COMP_0283 1 100 0 1 BIT_MASK 0x0010 ECU_ADDRESS 0xFFFF434E /begin FUNCTION_LIST /end FUNCTION_LIST /end MEASUREMENT
/begin MEASUREMENT afCFAPSOC1 "Confirmed failure of accelerator pedal track 1 open circuit" UBYTE COMP_0283 1 100 0 1 BIT_MASK 0x0008 ECU_ADDRESS 0xFFFF434E /begin FUNCTION_LIST /end FUNCTION_LIST /end MEASUREMENT
/begin MEASUREMENT afCFAPSOC2 "Confirmed failure of accelerator pedal track 2 open circuit" UBYTE COMP_0283 1 100 0 1 BIT_MASK 0x0004 ECU_ADDRESS 0xFFFF434E /begin FUNCTION_LIST /end FUNCTION_LIST /end MEASUREMENT
/begin MEASUREMENT afCFAPSSC1 "Confirmed failure of accelerator pedal track 1 short circuit" UBYTE COMP_0283 1 100 0 1 BIT_MASK 0x0002 ECU_ADDRESS 0xFFFF434E /begin FUNCTION_LIST /end FUNCTION_LIST /end MEASUREMENT
/begin MEASUREMENT afCFAPSSC2 "Confirmed failure of accelerator pedal track 2 short circuit" UBYTE COMP_0283 1 100 0 1 BIT_MASK 0x0001 ECU_ADDRESS 0xFFFF434E /begin FUNCTION_LIST /end FUNCTION_LIST /end MEASUREMENT
/begin MEASUREMENT afCFAVCC1 "Confirmed failure of power supply 1 (accelerator pedal track 1)" UBYTE COMP_0283 1 100 0 1 BIT_MASK 0x0080 ECU_ADDRESS 0xFFFF434F /begin FUNCTION_LIST /end FUNCTION_LIST /end MEASUREMENT
/begin MEASUREMENT afCFAVCC2 "Confirmed failure of power supply 2 (accelerator pedal track 2)" UBYTE COMP_0283 1 100 0 1 BIT_MASK 0x0040 ECU_ADDRESS 0xFFFF434F /begin FUNCTION_LIST /end FUNCTION_LIST /end MEASUREMENT
/begin MEASUREMENT afCFCSCHR "Cruise Control Main Switch Coherence" UBYTE COMP_0283 1 100 0 1 BIT_MASK 0x0020 ECU_ADDRESS 0xFFFF434F /begin FUNCTION_LIST /end FUNCTION_LIST /end MEASUREMENT
/begin MEASUREMENT afCFCSNOK "CCSL steering wheel switches blocked button stored confirmed failure" UBYTE COMP_0283 1 100 0 1 BIT_MASK 0x0010 ECU_ADDRESS 0xFFFF434F /begin FUNCTION_LIST /end FUNCTION_LIST /end MEASUREMENT
/begin MEASUREMENT afCFCSOCS "CCSL steering wheel switches open circuit stored confirmed failure" UBYTE COMP_0283 1 100 0 1 BIT_MASK 0x0008 ECU_ADDRESS 0xFFFF434F /begin FUNCTION_LIST /end FUNCTION_LIST /end MEASUREMENT
/begin MEASUREMENT afCFCSOOR "CCSL steering wheel switches invalid value stored confirmed failure" UBYTE COMP_0283 1 100 0 1 BIT_MASK 0x0004 ECU_ADDRESS 0xFFFF434F /begin FUNCTION_LIST /end FUNCTION_LIST /end MEASUREMENT
/begin MEASUREMENT afCGKMHMPH "The displayed speed unit has changed during CC/SL activation" UBYTE COMP_0283 1 100 0 1 BIT_MASK 0x0002 ECU_ADDRESS 0xFFFF434F /begin FUNCTION_LIST /end FUNCTION_LIST /end MEASUREMENT
/begin MEASUREMENT afCLIGVCMX "Cruise control and speed limiter warning (overspeed) sent on the CAN network" UBYTE COMP_0283 1 100 0 1 BIT_MASK 0x0001 ECU_ADDRESS 0xFFFF434F /begin FUNCTION_LIST /end FUNCTION_LIST /end MEASUREMENT
/begin MEASUREMENT afCLUSWNF "Filtered unavailable clutch pedal status information" UBYTE COMP_0283 1 100 0 1 BIT_MASK 0x0080 ECU_ADDRESS 0xFFFF4350 /begin FUNCTION_LIST /end FUNCTION_LIST /end MEASUREMENT
/begin MEASUREMENT afCMDMDF1D "Low speed engine fan delayed command" UBYTE COMP_0283 1 100 0 1 BIT_MASK 0x0040 ECU_ADDRESS 0xFFFF4350 /begin FUNCTION_LIST /end FUNCTION_LIST /end MEASUREMENT
/begin MEASUREMENT afCMDMDF2D "High speed engine fan delayed command" UBYTE COMP_0283 1 100 0 1 BIT_MASK 0x0020 ECU_ADDRESS 0xFFFF4350 /begin FUNCTION_LIST /end FUNCTION_LIST /end MEASUREMENT
/begin MEASUREMENT afCRUISE "In the cruise, flag" UBYTE COMP_0283 1 100 0 1 BIT_MASK 0x0010 ECU_ADDRESS 0xFFFF4350 /begin FUNCTION_LIST /end FUNCTION_LIST /end MEASUREMENT
/begin MEASUREMENT afCRUISEON "Cruise lamp ON/ off flag" UBYTE COMP_0283 1 100 0 1 BIT_MASK 0x0008 ECU_ADDRESS 0xFFFF4350 /begin FUNCTION_LIST /end FUNCTION_LIST /end MEASUREMENT
/begin MEASUREMENT afCRULMP "Cruise lamp ON/ off flag" UBYTE COMP_0283 1 100 0 1 BIT_MASK 0x0004 ECU_ADDRESS 0xFFFF4350 /begin FUNCTION_LIST /end FUNCTION_LIST /end MEASUREMENT
/begin MEASUREMENT afCRUMSTR "Arbitrated powertrain setpoint equal to Cruise Control setpoint" UBYTE COMP_0283 1 100 0 1 BIT_MASK 0x0002 ECU_ADDRESS 0xFFFF4350 /begin FUNCTION_LIST /end FUNCTION_LIST /end MEASUREMENT
/begin MEASUREMENT afCUTOFBIN "Cut off condition, output of shut off and limitation conditions to the CAN" UBYTE COMP_0283 1 100 0 1 BIT_MASK 0x0001 ECU_ADDRESS 0xFFFF4350 /begin FUNCTION_LIST /end FUNCTION_LIST /end MEASUREMENT
/begin MEASUREMENT afD2ALSTPD "Air-fuel ratio learning and air-fuel ratio feedback control stop flag" UBYTE COMP_0283 1 100 0 1 BIT_MASK 0x0080 ECU_ADDRESS 0xFFFF4351 /begin FUNCTION_LIST /end FUNCTION_LIST /end MEASUREMENT
/begin MEASUREMENT afD2LNCLED "Learning value clear flag" UBYTE COMP_0283 1 100 0 1 BIT_MASK 0x0040 ECU_ADDRESS 0xFFFF4351 /begin FUNCTION_LIST /end FUNCTION_LIST /end MEASUREMENT
/begin MEASUREMENT afDFAPMUX "Detected failure : invalid value of    the alternator power transmitted by the USM." UBYTE COMP_0283 1 100 0 1 BIT_MASK 0x0008 ECU_ADDRESS 0xFFFF4351 /begin FUNCTION_LIST /end FUNCTION_LIST /end MEASUREMENT
/begin MEASUREMENT afDFAPSC1 "Detected failure of accelerator pedal safety case" UBYTE COMP_0283 1 100 0 1 BIT_MASK 0x0004 ECU_ADDRESS 0xFFFF4351 /begin FUNCTION_LIST /end FUNCTION_LIST /end MEASUREMENT
/begin MEASUREMENT afDFAPSC2 "Detected failure of accelerator pedal safety case N Åã 2 (activates irreversible downgraded mode)" UBYTE COMP_0283 1 100 0 1 BIT_MASK 0x0002 ECU_ADDRESS 0xFFFF4351 /begin FUNCTION_LIST /end FUNCTION_LIST /end MEASUREMENT
/begin MEASUREMENT afDFCSNOK "CCSL Steering Wheel Command Switch blocked button detected failure" UBYTE COMP_0283 1 100 0 1 BIT_MASK 0x0001 ECU_ADDRESS 0xFFFF4351 /begin FUNCTION_LIST /end FUNCTION_LIST /end MEASUREMENT
/begin MEASUREMENT afDFCSOCS "CCSL Steering Wheel Command Switch open circuit detected failure" UBYTE COMP_0283 1 100 0 1 BIT_MASK 0x0080 ECU_ADDRESS 0xFFFF4352 /begin FUNCTION_LIST /end FUNCTION_LIST /end MEASUREMENT
/begin MEASUREMENT afDFCSOOR "CCSL Steering Wheel Command Switch invalid value detected failure" UBYTE COMP_0283 1 100 0 1 BIT_MASK 0x0040 ECU_ADDRESS 0xFFFF4352 /begin FUNCTION_LIST /end FUNCTION_LIST /end MEASUREMENT
/begin MEASUREMENT afDFVSCMP "NO. coherence between displayed speed and real speed" UBYTE COMP_0283 1 100 0 1 BIT_MASK 0x0020 ECU_ADDRESS 0xFFFF4352 /begin FUNCTION_LIST /end FUNCTION_LIST /end MEASUREMENT
/begin MEASUREMENT afDRARBTON "Virtual driver operation flag" UBYTE COMP_0283 1 100 0 1 BIT_MASK 0x0010 ECU_ADDRESS 0xFFFF4352 /begin FUNCTION_LIST /end FUNCTION_LIST /end MEASUREMENT
/begin MEASUREMENT afDSPABDLY "Displayed vehicle speed received on the CAN network not present after a filtering time" UBYTE COMP_0283 1 100 0 1 BIT_MASK 0x0008 ECU_ADDRESS 0xFFFF4352 /begin FUNCTION_LIST /end FUNCTION_LIST /end MEASUREMENT
/begin MEASUREMENT afDSPNKDLY "Displayed vehicle speed received on the CAN network not available after a filtering time" UBYTE COMP_0283 1 100 0 1 BIT_MASK 0x0004 ECU_ADDRESS 0xFFFF4352 /begin FUNCTION_LIST /end FUNCTION_LIST /end MEASUREMENT
/begin MEASUREMENT afESPACK "ESP acknowledgement flag" UBYTE COMP_0283 1 100 0 1 BIT_MASK 0x0080 ECU_ADDRESS 0xFFFF4353 /begin FUNCTION_LIST /end FUNCTION_LIST /end MEASUREMENT
/begin MEASUREMENT afETAMXCLF "Filtered clutch pedal status information absence" UBYTE COMP_0283 1 100 0 1 BIT_MASK 0x0040 ECU_ADDRESS 0xFFFF4353 /begin FUNCTION_LIST /end FUNCTION_LIST /end MEASUREMENT
/begin MEASUREMENT afETCCLEND "Diag on CAN ETC learning clear completion" UBYTE COMP_0283 1 100 0 1 BIT_MASK 0x0020 ECU_ADDRESS 0xFFFF4353 /begin FUNCTION_LIST /end FUNCTION_LIST /end MEASUREMENT
/begin MEASUREMENT afETSACK "ETS acknowledgement flag" UBYTE COMP_0283 1 100 0 1 BIT_MASK 0x0008 ECU_ADDRESS 0xFFFF4353 /begin FUNCTION_LIST /end FUNCTION_LIST /end MEASUREMENT
/begin MEASUREMENT afFDACNRV "Vehicle speed is too small in comparison on the requested speed to enter in speed regulation" UBYTE COMP_0283 1 100 0 1 BIT_MASK 0x0004 ECU_ADDRESS 0xFFFF4353 /begin FUNCTION_LIST /end FUNCTION_LIST /end MEASUREMENT
/begin MEASUREMENT afFFDCLRF "Reverse side FFD clear requirement flag" UBYTE COMP_0283 1 100 0 1 BIT_MASK 0x0001 ECU_ADDRESS 0xFFFF4353 /begin FUNCTION_LIST /end FUNCTION_LIST /end MEASUREMENT
/begin MEASUREMENT afFGPDGN "Fuel level gauge function diagnosis permission condition flag" UBYTE COMP_0283 1 100 0 1 BIT_MASK 0x0080 ECU_ADDRESS 0xFFFF4354 /begin FUNCTION_LIST /end FUNCTION_LIST /end MEASUREMENT
/begin MEASUREMENT afFMFJAR2 "Misfire diagnosis permission condition (A STSW condition is removed.)" UBYTE COMP_0283 1 100 0 1 BIT_MASK 0x0020 ECU_ADDRESS 0xFFFF4354 /begin FUNCTION_LIST /end FUNCTION_LIST /end MEASUREMENT
/begin MEASUREMENT afFQLRNED "Learning treatment condition by the DDL requirement" UBYTE COMP_0283 1 100 0 1 BIT_MASK 0x0008 ECU_ADDRESS 0xFFFF4354 /begin FUNCTION_LIST /end FUNCTION_LIST /end MEASUREMENT
/begin MEASUREMENT afFRZOTBIN "Output of freeze condition, to the CAN" UBYTE COMP_0283 1 100 0 1 BIT_MASK 0x0004 ECU_ADDRESS 0xFFFF4354 /begin FUNCTION_LIST /end FUNCTION_LIST /end MEASUREMENT
/begin MEASUREMENT afFSDFTGIH "Flag used to detect when free shift can not be calculated" UBYTE COMP_0283 1 100 0 1 BIT_MASK 0x0002 ECU_ADDRESS 0xFFFF4354 /begin FUNCTION_LIST /end FUNCTION_LIST /end MEASUREMENT
/begin MEASUREMENT afFSLAM1 "Severity_1_lamp_control_Flag" UBYTE COMP_0283 1 100 0 1 BIT_MASK 0x0001 ECU_ADDRESS 0xFFFF4354 /begin FUNCTION_LIST /end FUNCTION_LIST /end MEASUREMENT
/begin MEASUREMENT afFSLAM2 "Severity_2_lamp_control_Flag" UBYTE COMP_0283 1 100 0 1 BIT_MASK 0x0080 ECU_ADDRESS 0xFFFF4355 /begin FUNCTION_LIST /end FUNCTION_LIST /end MEASUREMENT
/begin MEASUREMENT afGEARDFT "Gear engaged default identification" UBYTE COMP_0283 1 100 0 1 BIT_MASK 0x0040 ECU_ADDRESS 0xFFFF4355 /begin FUNCTION_LIST /end FUNCTION_LIST /end MEASUREMENT
/begin MEASUREMENT afGEARLIH "The gear input is in Limp home (message=limp home or confirmed absent)" UBYTE COMP_0283 1 100 0 1 BIT_MASK 0x0020 ECU_ADDRESS 0xFFFF4355 /begin FUNCTION_LIST /end FUNCTION_LIST /end MEASUREMENT
/begin MEASUREMENT afGMVOUT1 "Fan1 activation request from water temperature" UBYTE COMP_0283 1 100 0 1 BIT_MASK 0x0010 ECU_ADDRESS 0xFFFF4355 /begin FUNCTION_LIST /end FUNCTION_LIST /end MEASUREMENT
/begin MEASUREMENT afGMVOUT2 "Fan2 activation request from water temperature" UBYTE COMP_0283 1 100 0 1 BIT_MASK 0x0008 ECU_ADDRESS 0xFFFF4355 /begin FUNCTION_LIST /end FUNCTION_LIST /end MEASUREMENT
/begin MEASUREMENT afGRAVITY1 "Engine default gravity 1" UBYTE COMP_0283 1 100 0 1 BIT_MASK 0x0004 ECU_ADDRESS 0xFFFF4355 /begin FUNCTION_LIST /end FUNCTION_LIST /end MEASUREMENT
/begin MEASUREMENT afGRAVITY2 "Engine default gravity 2" UBYTE COMP_0283 1 100 0 1 BIT_MASK 0x0002 ECU_ADDRESS 0xFFFF4355 /begin FUNCTION_LIST /end FUNCTION_LIST /end MEASUREMENT
/begin MEASUREMENT afICRUISE "In the cruise, flag mirror value" UBYTE COMP_0283 1 100 0 1 BIT_MASK 0x0001 ECU_ADDRESS 0xFFFF4355 /begin FUNCTION_LIST /end FUNCTION_LIST /end MEASUREMENT
/begin MEASUREMENT afLEDONR "MIL operation requirement" UBYTE COMP_0283 1 100 0 1 BIT_MASK 0x0080 ECU_ADDRESS 0xFFFF4356 /begin FUNCTION_LIST /end FUNCTION_LIST /end MEASUREMENT
/begin MEASUREMENT afLMDINI "Lambda control experience flag" UBYTE COMP_0283 1 100 0 1 BIT_MASK 0x0040 ECU_ADDRESS 0xFFFF4356 /begin FUNCTION_LIST /end FUNCTION_LIST /end MEASUREMENT
/begin MEASUREMENT afMCMOUTC "Output check treatment requirement" UBYTE COMP_0283 1 100 0 1 BIT_MASK 0x0010 ECU_ADDRESS 0xFFFF4356 /begin FUNCTION_LIST /end FUNCTION_LIST /end MEASUREMENT
/begin MEASUREMENT afMFPRSOC "Air conditioning pressure sensor open circuit memorized failure" UBYTE COMP_0283 1 100 0 1 BIT_MASK 0x0008 ECU_ADDRESS 0xFFFF4356 /begin FUNCTION_LIST /end FUNCTION_LIST /end MEASUREMENT
/begin MEASUREMENT afMFPRSSC "Air conditioning pressure sensor short circuit memorized failure" UBYTE COMP_0283 1 100 0 1 BIT_MASK 0x0004 ECU_ADDRESS 0xFFFF4356 /begin FUNCTION_LIST /end FUNCTION_LIST /end MEASUREMENT
/begin MEASUREMENT afONEACCRT "A realtime is accelerating once, flag" UBYTE COMP_0283 1 100 0 1 BIT_MASK 0x0001 ECU_ADDRESS 0xFFFF4356 /begin FUNCTION_LIST /end FUNCTION_LIST /end MEASUREMENT
/begin MEASUREMENT afOUTOFF "Output stop requirement flag" UBYTE COMP_0283 1 100 0 1 BIT_MASK 0x0080 ECU_ADDRESS 0xFFFF4357 /begin FUNCTION_LIST /end FUNCTION_LIST /end MEASUREMENT
/begin MEASUREMENT afOVHJUG "Overheat condition flag" UBYTE COMP_0283 1 100 0 1 BIT_MASK 0x0040 ECU_ADDRESS 0xFFFF4357 /begin FUNCTION_LIST /end FUNCTION_LIST /end MEASUREMENT
/begin MEASUREMENT afPPXCFRE "Braking detected for cruise control" UBYTE COMP_0283 1 100 0 1 BIT_MASK 0x0010 ECU_ADDRESS 0xFFFF4357 /begin FUNCTION_LIST /end FUNCTION_LIST /end MEASUREMENT
/begin MEASUREMENT afPPXCFRES "Sudden braking detected for cruise control" UBYTE COMP_0283 1 100 0 1 BIT_MASK 0x0008 ECU_ADDRESS 0xFFFF4357 /begin FUNCTION_LIST /end FUNCTION_LIST /end MEASUREMENT
/begin MEASUREMENT afSETLMPON "Set lamp ON/ off flag" UBYTE COMP_0283 1 100 0 1 BIT_MASK 0x0001 ECU_ADDRESS 0xFFFF4357 /begin FUNCTION_LIST /end FUNCTION_LIST /end MEASUREMENT
/begin MEASUREMENT afSLDSB "Engine control req for SL system deactivation" UBYTE COMP_0283 1 100 0 1 BIT_MASK 0x0080 ECU_ADDRESS 0xFFFF4358 /begin FUNCTION_LIST /end FUNCTION_LIST /end MEASUREMENT
/begin MEASUREMENT afSLDSBSYS "Engine control req for SL system deactivation" UBYTE COMP_0283 1 100 0 1 BIT_MASK 0x0040 ECU_ADDRESS 0xFFFF4358 /begin FUNCTION_LIST /end FUNCTION_LIST /end MEASUREMENT
/begin MEASUREMENT afSPDCTINH "Speed control is being prohibited, flag" UBYTE COMP_0283 1 100 0 1 BIT_MASK 0x0020 ECU_ADDRESS 0xFFFF4358 /begin FUNCTION_LIST /end FUNCTION_LIST /end MEASUREMENT
/begin MEASUREMENT afSTSWA "The START button has been pressed" UBYTE COMP_0283 1 100 0 1 BIT_MASK 0x0010 ECU_ADDRESS 0xFFFF4358 /begin FUNCTION_LIST /end FUNCTION_LIST /end MEASUREMENT
/begin MEASUREMENT afSVCLON "Control loop active" UBYTE COMP_0283 1 100 0 1 BIT_MASK 0x0008 ECU_ADDRESS 0xFFFF4358 /begin FUNCTION_LIST /end FUNCTION_LIST /end MEASUREMENT
/begin MEASUREMENT afTQ12ENGN "Condition to send unavailable value in estimated torque CAN signal" UBYTE COMP_0283 1 100 0 1 BIT_MASK 0x0004 ECU_ADDRESS 0xFFFF4358 /begin FUNCTION_LIST /end FUNCTION_LIST /end MEASUREMENT
/begin MEASUREMENT afTQARBTON "Torque inter-system operation flag" UBYTE COMP_0283 1 100 0 1 BIT_MASK 0x0002 ECU_ADDRESS 0xFFFF4358 /begin FUNCTION_LIST /end FUNCTION_LIST /end MEASUREMENT
/begin MEASUREMENT afTXFS1 "The flag 1 which a TCS/VDC system unusually judges" UBYTE COMP_0283 1 100 0 1 BIT_MASK 0x0001 ECU_ADDRESS 0xFFFF4358 /begin FUNCTION_LIST /end FUNCTION_LIST /end MEASUREMENT
/begin MEASUREMENT afTXFS2 "The flag 2 which a TCS/VDC system unusually judges" UBYTE COMP_0283 1 100 0 1 BIT_MASK 0x0080 ECU_ADDRESS 0xFFFF4359 /begin FUNCTION_LIST /end FUNCTION_LIST /end MEASUREMENT
/begin MEASUREMENT afTXFS3 "The flag 3 which a TCS/VDC system unusually judges" UBYTE COMP_0283 1 100 0 1 BIT_MASK 0x0040 ECU_ADDRESS 0xFFFF4359 /begin FUNCTION_LIST /end FUNCTION_LIST /end MEASUREMENT
/begin MEASUREMENT afTXFS4 "The flag 4 which a TCS/VDC system unusually judges" UBYTE COMP_0283 1 100 0 1 BIT_MASK 0x0020 ECU_ADDRESS 0xFFFF4359 /begin FUNCTION_LIST /end FUNCTION_LIST /end MEASUREMENT
/begin MEASUREMENT afVSABDLY "VSP not received on the CAN present" UBYTE COMP_0283 1 100 0 1 BIT_MASK 0x0010 ECU_ADDRESS 0xFFFF4359 /begin FUNCTION_LIST /end FUNCTION_LIST /end MEASUREMENT
/begin MEASUREMENT afVSNKDLY "VSP eceived on the CAN not available" UBYTE COMP_0283 1 100 0 1 BIT_MASK 0x0008 ECU_ADDRESS 0xFFFF4359 /begin FUNCTION_LIST /end FUNCTION_LIST /end MEASUREMENT
/begin MEASUREMENT afDARBON_S "During virtual driver operation, flag (vice-operation part)" UBYTE COMP_0283 1 100 0 1 BIT_MASK 0x0002 ECU_ADDRESS 0xFFFF4359 /begin FUNCTION_LIST /end FUNCTION_LIST /end MEASUREMENT
/begin MEASUREMENT fADVCYO "Ignition timing adjustment flag" UBYTE COMP_0283 1 100 0 1 BIT_MASK 0x0020 ECU_ADDRESS 0xFFFF435B /begin FUNCTION_LIST /end FUNCTION_LIST /end MEASUREMENT
/begin MEASUREMENT fADVDDL "Ignition timing adjustment flag" UBYTE COMP_0283 1 100 0 1 BIT_MASK 0x0010 ECU_ADDRESS 0xFFFF435B /begin FUNCTION_LIST /end FUNCTION_LIST /end MEASUREMENT
/begin MEASUREMENT fASCDFAIL "ASCD fail flag" UBYTE COMP_0283 1 100 0 1 BIT_MASK 0x0080 ECU_ADDRESS 0xFFFF435C /begin FUNCTION_LIST /end FUNCTION_LIST /end MEASUREMENT
/begin MEASUREMENT fASCDNEUT "A neutral SW flag for ASCD" UBYTE COMP_0283 1 100 0 1 BIT_MASK 0x0040 ECU_ADDRESS 0xFFFF435C /begin FUNCTION_LIST /end FUNCTION_LIST /end MEASUREMENT
/begin MEASUREMENT fBCVBV "CVBV output" UBYTE COMP_0283 1 100 0 1 BIT_MASK 0x0010 ECU_ADDRESS 0xFFFF435C /begin FUNCTION_LIST /end FUNCTION_LIST /end MEASUREMENT
/begin MEASUREMENT fBIDETCCOK "DDL2ETC learning clear completion" UBYTE COMP_0283 1 100 0 1 BIT_MASK 0x0008 ECU_ADDRESS 0xFFFF435C /begin FUNCTION_LIST /end FUNCTION_LIST /end MEASUREMENT
/begin MEASUREMENT fBIDFFDCOK "DDL2 reverse side FFD clear completion" UBYTE COMP_0283 1 100 0 1 BIT_MASK 0x0004 ECU_ADDRESS 0xFFFF435C /begin FUNCTION_LIST /end FUNCTION_LIST /end MEASUREMENT
/begin MEASUREMENT fBIDNTASOK "DDL2, usually, TAS learning clear completion" UBYTE COMP_0283 1 100 0 1 BIT_MASK 0x0002 ECU_ADDRESS 0xFFFF435C /begin FUNCTION_LIST /end FUNCTION_LIST /end MEASUREMENT
/begin MEASUREMENT fBIDRTASOK "DDL2 rapid TAS learning clear completion" UBYTE COMP_0283 1 100 0 1 BIT_MASK 0x0001 ECU_ADDRESS 0xFFFF435C /begin FUNCTION_LIST /end FUNCTION_LIST /end MEASUREMENT
/begin MEASUREMENT fBPFS_NC "BPFS NC flag" UBYTE COMP_0283 1 100 0 1 BIT_MASK 0x0020 ECU_ADDRESS 0xFFFF435D /begin FUNCTION_LIST /end FUNCTION_LIST /end MEASUREMENT
/begin MEASUREMENT fCANOK "-" UBYTE COMP_0283 1 100 0 1 BIT_MASK 0x0001 ECU_ADDRESS 0xFFFF435D /begin FUNCTION_LIST /end FUNCTION_LIST /end MEASUREMENT
/begin MEASUREMENT fCCSLAPN "Comfortable stop of the speed regulation" UBYTE COMP_0283 1 100 0 1 BIT_MASK 0x0004 ECU_ADDRESS 0xFFFF435E /begin FUNCTION_LIST /end FUNCTION_LIST /end MEASUREMENT
/begin MEASUREMENT fCRUISE "In the cruise, flag" UBYTE COMP_0283 1 100 0 1 BIT_MASK 0x0010 ECU_ADDRESS 0xFFFF4361 /begin FUNCTION_LIST /end FUNCTION_LIST /end MEASUREMENT
/begin MEASUREMENT fCRUISEON "Cruise lamp ON/ off flag" UBYTE COMP_0283 1 100 0 1 BIT_MASK 0x0008 ECU_ADDRESS 0xFFFF4361 /begin FUNCTION_LIST /end FUNCTION_LIST /end MEASUREMENT
/begin MEASUREMENT fCRULMP "Cruise lamp ON/ off flag" UBYTE COMP_0283 1 100 0 1 BIT_MASK 0x0004 ECU_ADDRESS 0xFFFF4361 /begin FUNCTION_LIST /end FUNCTION_LIST /end MEASUREMENT
/begin MEASUREMENT fD2ALSTPD "Air-fuel ratio learning and air-fuel ratio feedback control stop flag" UBYTE COMP_0283 1 100 0 1 BIT_MASK 0x0080 ECU_ADDRESS 0xFFFF4362 /begin FUNCTION_LIST /end FUNCTION_LIST /end MEASUREMENT
/begin MEASUREMENT fD2LNCLED "Learning value clear flag" UBYTE COMP_0283 1 100 0 1 BIT_MASK 0x0040 ECU_ADDRESS 0xFFFF4362 /begin FUNCTION_LIST /end FUNCTION_LIST /end MEASUREMENT
/begin MEASUREMENT fETCCLEND "Diag on CAN ETC learning clear completion" UBYTE COMP_0283 1 100 0 1 BIT_MASK 0x0020 ECU_ADDRESS 0xFFFF4364 /begin FUNCTION_LIST /end FUNCTION_LIST /end MEASUREMENT
/begin MEASUREMENT fFFDCLRF "Reverse side FFD clear requirement flag" UBYTE COMP_0283 1 100 0 1 BIT_MASK 0x0001 ECU_ADDRESS 0xFFFF4364 /begin FUNCTION_LIST /end FUNCTION_LIST /end MEASUREMENT
/begin MEASUREMENT fFGPDGN "Fuel level gauge function diagnosis permission condition flag" UBYTE COMP_0283 1 100 0 1 BIT_MASK 0x0080 ECU_ADDRESS 0xFFFF4365 /begin FUNCTION_LIST /end FUNCTION_LIST /end MEASUREMENT
/begin MEASUREMENT fFMFJAR2 "Misfire diagnosis permission condition (A STSW condition is removed.)" UBYTE COMP_0283 1 100 0 1 BIT_MASK 0x0020 ECU_ADDRESS 0xFFFF4365 /begin FUNCTION_LIST /end FUNCTION_LIST /end MEASUREMENT
/begin MEASUREMENT fFQLRNED "Learning treatment condition by the DDL requirement" UBYTE COMP_0283 1 100 0 1 BIT_MASK 0x0008 ECU_ADDRESS 0xFFFF4365 /begin FUNCTION_LIST /end FUNCTION_LIST /end MEASUREMENT
/begin MEASUREMENT fICRUISE "In the cruise, flag mirror value" UBYTE COMP_0283 1 100 0 1 BIT_MASK 0x0001 ECU_ADDRESS 0xFFFF4366 /begin FUNCTION_LIST /end FUNCTION_LIST /end MEASUREMENT
/begin MEASUREMENT fLMDINI "Lambda control experience flag" UBYTE COMP_0283 1 100 0 1 BIT_MASK 0x0040 ECU_ADDRESS 0xFFFF4367 /begin FUNCTION_LIST /end FUNCTION_LIST /end MEASUREMENT
/begin MEASUREMENT fMCMOUTC "Output check treatment requirement" UBYTE COMP_0283 1 100 0 1 BIT_MASK 0x0010 ECU_ADDRESS 0xFFFF4367 /begin FUNCTION_LIST /end FUNCTION_LIST /end MEASUREMENT
/begin MEASUREMENT fOUTOFF "Output stop requirement flag" UBYTE COMP_0283 1 100 0 1 BIT_MASK 0x0080 ECU_ADDRESS 0xFFFF4368 /begin FUNCTION_LIST /end FUNCTION_LIST /end MEASUREMENT
/begin MEASUREMENT fSETLMPON "Set lamp ON/ off flag" UBYTE COMP_0283 1 100 0 1 BIT_MASK 0x0001 ECU_ADDRESS 0xFFFF4368 /begin FUNCTION_LIST /end FUNCTION_LIST /end MEASUREMENT
/begin MEASUREMENT fSPDCTINH "Speed control is being prohibited, flag" UBYTE COMP_0283 1 100 0 1 BIT_MASK 0x0020 ECU_ADDRESS 0xFFFF4369 /begin FUNCTION_LIST /end FUNCTION_LIST /end MEASUREMENT
/begin MEASUREMENT fTXFS1 "The flag 1 which a TCS/VDC system unusually judges" UBYTE COMP_0283 1 100 0 1 BIT_MASK 0x0001 ECU_ADDRESS 0xFFFF4369 /begin FUNCTION_LIST /end FUNCTION_LIST /end MEASUREMENT
/begin MEASUREMENT fTXFS2 "The flag 2 which a TCS/VDC system unusually judges" UBYTE COMP_0283 1 100 0 1 BIT_MASK 0x0080 ECU_ADDRESS 0xFFFF436A /begin FUNCTION_LIST /end FUNCTION_LIST /end MEASUREMENT
/begin MEASUREMENT fTXFS3 "The flag 3 which a TCS/VDC system unusually judges" UBYTE COMP_0283 1 100 0 1 BIT_MASK 0x0040 ECU_ADDRESS 0xFFFF436A /begin FUNCTION_LIST /end FUNCTION_LIST /end MEASUREMENT
/begin MEASUREMENT fTXFS4 "The flag 4 which a TCS/VDC system unusually judges" UBYTE COMP_0283 1 100 0 1 BIT_MASK 0x0020 ECU_ADDRESS 0xFFFF436A /begin FUNCTION_LIST /end FUNCTION_LIST /end MEASUREMENT
/begin MEASUREMENT wfFSAFM "Mass airflow meter failsafe flag" UBYTE COMP_0283 1 100 0 1 BIT_MASK 0x0080 ECU_ADDRESS 0xFFFF8A78 /begin FUNCTION_LIST /end FUNCTION_LIST /end MEASUREMENT
/begin MEASUREMENT fFSAFM "Mass airflow meter failsafe flag" UBYTE COMP_0283 1 100 0 1 BIT_MASK 0x0080 ECU_ADDRESS 0xFFFF8A79 /begin FUNCTION_LIST /end FUNCTION_LIST /end MEASUREMENT
/begin MEASUREMENT wfCHOSCAN1 "Diagnosis NG éû CHOS cancellation condition flag" UBYTE COMP_0283 1 100 0 1 BIT_MASK 0x0080 ECU_ADDRESS 0xFFFF8A7E /begin FUNCTION_LIST /end FUNCTION_LIST /end MEASUREMENT
/begin MEASUREMENT fCHOSCAN1 "Diagnosis NG éû CHOS cancellation condition flag" UBYTE COMP_0283 1 100 0 1 BIT_MASK 0x0080 ECU_ADDRESS 0xFFFF8A7F /begin FUNCTION_LIST /end FUNCTION_LIST /end MEASUREMENT
/begin MEASUREMENT wfACCACT "ACC operation flag" UBYTE COMP_0283 1 100 0 1 BIT_MASK 0x0080 ECU_ADDRESS 0xFFFF8A80 /begin FUNCTION_LIST /end FUNCTION_LIST /end MEASUREMENT
/begin MEASUREMENT wfATOP "At the time of the acceleration, a TOP judgement flag for the ADV phase control" UBYTE COMP_0283 1 100 0 1 BIT_MASK 0x0040 ECU_ADDRESS 0xFFFF8A8F /begin FUNCTION_LIST /end FUNCTION_LIST /end MEASUREMENT
/begin MEASUREMENT wfIDLSOFIS "At the time of IDLE, SOFIS control prohibition flag" UBYTE COMP_0283 1 100 0 1 BIT_MASK 0x0080 ECU_ADDRESS 0xFFFF8A90 /begin FUNCTION_LIST /end FUNCTION_LIST /end MEASUREMENT
/begin MEASUREMENT wfMIDLE "Mechanical idle SW" UBYTE COMP_0283 1 100 0 1 BIT_MASK 0x0040 ECU_ADDRESS 0xFFFF8A90 /begin FUNCTION_LIST /end FUNCTION_LIST /end MEASUREMENT
/begin MEASUREMENT fATOP "ADV phase control Top judgement" UBYTE COMP_0283 1 100 0 1 BIT_MASK 0x0040 ECU_ADDRESS 0xFFFF8A92 /begin FUNCTION_LIST /end FUNCTION_LIST /end MEASUREMENT
/begin MEASUREMENT fMIDLE "Mechanical idle SW" UBYTE COMP_0283 1 100 0 1 BIT_MASK 0x0040 ECU_ADDRESS 0xFFFF8A93 /begin FUNCTION_LIST /end FUNCTION_LIST /end MEASUREMENT
/begin MEASUREMENT bfCPCHK "Canister purge check middle flag" UBYTE COMP_0283 1 100 0 1 BIT_MASK 0x0080 ECU_ADDRESS 0xFFFF2456 /begin FUNCTION_LIST /end FUNCTION_LIST /end MEASUREMENT
/begin MEASUREMENT bfCSTLU "During lockup, slowdown tense condition formation" UBYTE COMP_0283 1 100 0 1 BIT_MASK 0x0040 ECU_ADDRESS 0xFFFF2456 /begin FUNCTION_LIST /end FUNCTION_LIST /end MEASUREMENT
/begin MEASUREMENT bfEGRCUT "EGR cut requirement flag" UBYTE COMP_0283 1 100 0 1 BIT_MASK 0x0020 ECU_ADDRESS 0xFFFF2456 /begin FUNCTION_LIST /end FUNCTION_LIST /end MEASUREMENT
/begin MEASUREMENT bfFEVCTRL "At the time of the running loss test, EVPCNT condition formation flag" UBYTE COMP_0283 1 100 0 1 BIT_MASK 0x0010 ECU_ADDRESS 0xFFFF2456 /begin FUNCTION_LIST /end FUNCTION_LIST /end MEASUREMENT
/begin MEASUREMENT bfFPGINH "Purge control is being prohibited, flag" UBYTE COMP_0283 1 100 0 1 BIT_MASK 0x0004 ECU_ADDRESS 0xFFFF2456 /begin FUNCTION_LIST /end FUNCTION_LIST /end MEASUREMENT
/begin MEASUREMENT bfKARAPA "Empty purge" UBYTE COMP_0283 1 100 0 1 BIT_MASK 0x0040 ECU_ADDRESS 0xFFFF2457 /begin FUNCTION_LIST /end FUNCTION_LIST /end MEASUREMENT
/begin MEASUREMENT bfLIMNOT "Target purge rate change quantity limitation flag" UBYTE COMP_0283 1 100 0 1 BIT_MASK 0x0020 ECU_ADDRESS 0xFFFF2457 /begin FUNCTION_LIST /end FUNCTION_LIST /end MEASUREMENT
/begin MEASUREMENT bfRACLU "During lockup, re-acceleration tense condition formation flag" UBYTE COMP_0283 1 100 0 1 BIT_MASK 0x0008 ECU_ADDRESS 0xFFFF2457 /begin FUNCTION_LIST /end FUNCTION_LIST /end MEASUREMENT
/begin MEASUREMENT bfREGGASz2 "High-octane 0/ regular 3 judgement" UBYTE COMP_0283 1 100 0 1 BIT_MASK 0x0004 ECU_ADDRESS 0xFFFF2457 /begin FUNCTION_LIST /end FUNCTION_LIST /end MEASUREMENT
/begin MEASUREMENT fEMIDLE "Idle/shake region judgement" UBYTE COMP_0283 1 100 0 1 BIT_MASK 0x0004 ECU_ADDRESS 0xFFFF2458 /begin FUNCTION_LIST /end FUNCTION_LIST /end MEASUREMENT
/begin MEASUREMENT fFLUOFFN "During lockup, flag" UBYTE COMP_0283 1 100 0 1 BIT_MASK 0x0040 ECU_ADDRESS 0xFFFF2459 /begin FUNCTION_LIST /end FUNCTION_LIST /end MEASUREMENT
/begin MEASUREMENT fFVTCLRNE "VTC maximum-retard degree position learning condition flag" UBYTE COMP_0283 1 100 0 1 BIT_MASK 0x0010 ECU_ADDRESS 0xFFFF2459 /begin FUNCTION_LIST /end FUNCTION_LIST /end MEASUREMENT
/begin MEASUREMENT fFVTCLRNI "VTC maximum-retard degree position learning condition flag" UBYTE COMP_0283 1 100 0 1 BIT_MASK 0x0008 ECU_ADDRESS 0xFFFF2459 /begin FUNCTION_LIST /end FUNCTION_LIST /end MEASUREMENT
/begin MEASUREMENT fQCK0CP "QCK0 renewal permission flag" UBYTE COMP_0283 1 100 0 1 BIT_MASK 0x0080 ECU_ADDRESS 0xFFFF245A /begin FUNCTION_LIST /end FUNCTION_LIST /end MEASUREMENT
/begin MEASUREMENT fTFKAP "The KAP clamp judgement of TFBYA" UBYTE COMP_0283 1 100 0 1 BIT_MASK 0x0004 ECU_ADDRESS 0xFFFF245A /begin FUNCTION_LIST /end FUNCTION_LIST /end MEASUREMENT
/begin MEASUREMENT fVBEGOF "VB condition flag" UBYTE COMP_0283 1 100 0 1 BIT_MASK 0x0002 ECU_ADDRESS 0xFFFF245A /begin FUNCTION_LIST /end FUNCTION_LIST /end MEASUREMENT
/begin MEASUREMENT fVTCTWN "VTC coolant temperature condition formation flag" UBYTE COMP_0283 1 100 0 1 BIT_MASK 0x0001 ECU_ADDRESS 0xFFFF245A /begin FUNCTION_LIST /end FUNCTION_LIST /end MEASUREMENT
/begin MEASUREMENT fVTLNMVE "A VTC operation completion permission flag for VTC operation angle deviation quantity integral value learning" UBYTE COMP_0283 1 100 0 1 BIT_MASK 0x0040 ECU_ADDRESS 0xFFFF245B /begin FUNCTION_LIST /end FUNCTION_LIST /end MEASUREMENT
/begin MEASUREMENT fVTLNMVI "A VTC operation completion permission flag for VTC operation angle deviation quantity integral value learning" UBYTE COMP_0283 1 100 0 1 BIT_MASK 0x0020 ECU_ADDRESS 0xFFFF245B /begin FUNCTION_LIST /end FUNCTION_LIST /end MEASUREMENT
/begin MEASUREMENT fABSACT "ABS movement signal" UBYTE COMP_0283 1 100 0 1 BIT_MASK 0x0020 ECU_ADDRESS 0xFFFF2460 /begin FUNCTION_LIST /end FUNCTION_LIST /end MEASUREMENT
/begin MEASUREMENT fACCMDFAL "The flag which unusually judges ACC order value" UBYTE COMP_0283 1 100 0 1 BIT_MASK 0x0008 ECU_ADDRESS 0xFFFF2460 /begin FUNCTION_LIST /end FUNCTION_LIST /end MEASUREMENT
/begin MEASUREMENT fACCUT31 "At the time of the start, time air-conditioning cut control executive flag" UBYTE COMP_0283 1 100 0 1 BIT_MASK 0x0080 ECU_ADDRESS 0xFFFF2461 /begin FUNCTION_LIST /end FUNCTION_LIST /end MEASUREMENT
/begin MEASUREMENT fACCUT32 "At the time of the low rotation, air-conditioning cut control executive flag" UBYTE COMP_0283 1 100 0 1 BIT_MASK 0x0040 ECU_ADDRESS 0xFFFF2461 /begin FUNCTION_LIST /end FUNCTION_LIST /end MEASUREMENT
/begin MEASUREMENT fACLNC "Air-conditioning cut engine rotation decline tense condition" UBYTE COMP_0283 1 100 0 1 BIT_MASK 0x0010 ECU_ADDRESS 0xFFFF2462 /begin FUNCTION_LIST /end FUNCTION_LIST /end MEASUREMENT
/begin MEASUREMENT fACLNCS "After the initialization, N>=ACCUTN#+ACRECN# experience" UBYTE COMP_0283 1 100 0 1 BIT_MASK 0x0008 ECU_ADDRESS 0xFFFF2462 /begin FUNCTION_LIST /end FUNCTION_LIST /end MEASUREMENT
/begin MEASUREMENT fACRLYZ "A flag for AC relay & ignition F/F sympathizing" UBYTE COMP_0283 1 100 0 1 BIT_MASK 0x0020 ECU_ADDRESS 0xFFFF2463 /begin FUNCTION_LIST /end FUNCTION_LIST /end MEASUREMENT
/begin MEASUREMENT fACTSOL "The exhaust the second air cut solenoid drive flag" UBYTE COMP_0283 1 100 0 1 BIT_MASK 0x0002 ECU_ADDRESS 0xFFFF2463 /begin FUNCTION_LIST /end FUNCTION_LIST /end MEASUREMENT
/begin MEASUREMENT fALEV16F "Beginning ALPEVP16 renewal condition" UBYTE COMP_0283 1 100 0 1 BIT_MASK 0x0004 ECU_ADDRESS 0xFFFF2464 /begin FUNCTION_LIST /end FUNCTION_LIST /end MEASUREMENT
/begin MEASUREMENT fALSFT "Alpha shift addition condition judgement" UBYTE COMP_0283 1 100 0 1 BIT_MASK 0x0080 ECU_ADDRESS 0xFFFF2465 /begin FUNCTION_LIST /end FUNCTION_LIST /end MEASUREMENT
/begin MEASUREMENT fALTCHK13 "Alternator generating electricity voltage variable control condition 13 flag" UBYTE COMP_0283 1 100 0 1 BIT_MASK 0x0040 ECU_ADDRESS 0xFFFF2465 /begin FUNCTION_LIST /end FUNCTION_LIST /end MEASUREMENT
/begin MEASUREMENT fALTCHK5 "Alternator generating electricity variable control condition 5 flag" UBYTE COMP_0283 1 100 0 1 BIT_MASK 0x0020 ECU_ADDRESS 0xFFFF2465 /begin FUNCTION_LIST /end FUNCTION_LIST /end MEASUREMENT
/begin MEASUREMENT fALTCNTZ "Alternator generating electricity voltage variable control permission flag previous value" UBYTE COMP_0283 1 100 0 1 BIT_MASK 0x0010 ECU_ADDRESS 0xFFFF2465 /begin FUNCTION_LIST /end FUNCTION_LIST /end MEASUREMENT
/begin MEASUREMENT fAPSMSF "APO un-adjustment diagnosis permission condition formation flag" UBYTE COMP_0283 1 100 0 1 BIT_MASK 0x0002 ECU_ADDRESS 0xFFFF2465 /begin FUNCTION_LIST /end FUNCTION_LIST /end MEASUREMENT
/begin MEASUREMENT fAPSSNG1 "APS Single trouble judgement flag previous value (MAIN)" UBYTE COMP_0283 1 100 0 1 BIT_MASK 0x0001 ECU_ADDRESS 0xFFFF2465 /begin FUNCTION_LIST /end FUNCTION_LIST /end MEASUREMENT
/begin MEASUREMENT fAPSXNG1 "APS Single trouble judgement self-diagnosis flag previous value (MAIN)" UBYTE COMP_0283 1 100 0 1 BIT_MASK 0x0080 ECU_ADDRESS 0xFFFF2466 /begin FUNCTION_LIST /end FUNCTION_LIST /end MEASUREMENT
/begin MEASUREMENT fATRETFCA "ATRET activated during F/C" UBYTE COMP_0283 1 100 0 1 BIT_MASK 0x0020 ECU_ADDRESS 0xFFFF2466 /begin FUNCTION_LIST /end FUNCTION_LIST /end MEASUREMENT
/begin MEASUREMENT fBASLRNE "VTC reference angle position learning experience flag" UBYTE COMP_0283 1 100 0 1 BIT_MASK 0x0004 ECU_ADDRESS 0xFFFF2466 /begin FUNCTION_LIST /end FUNCTION_LIST /end MEASUREMENT
/begin MEASUREMENT fBASLRNI "VTC reference angle position learning experience flag" UBYTE COMP_0283 1 100 0 1 BIT_MASK 0x0002 ECU_ADDRESS 0xFFFF2466 /begin FUNCTION_LIST /end FUNCTION_LIST /end MEASUREMENT
/begin MEASUREMENT fCATEVPR "Purge cut condition (5) formation" UBYTE COMP_0283 1 100 0 1 BIT_MASK 0x0020 ECU_ADDRESS 0xFFFF2468 /begin FUNCTION_LIST /end FUNCTION_LIST /end MEASUREMENT
/begin MEASUREMENT fCATEVPRD "A purge cut condition (5) has ever been concluded." UBYTE COMP_0283 1 100 0 1 BIT_MASK 0x0010 ECU_ADDRESS 0xFFFF2468 /begin FUNCTION_LIST /end FUNCTION_LIST /end MEASUREMENT
/begin MEASUREMENT fCCHG "Generating electricity voltage variable control-in-progress charging requirement flag" UBYTE COMP_0283 1 100 0 1 BIT_MASK 0x0008 ECU_ADDRESS 0xFFFF2468 /begin FUNCTION_LIST /end FUNCTION_LIST /end MEASUREMENT
/begin MEASUREMENT fCCHGZ "The previous value of fCCHG" UBYTE COMP_0283 1 100 0 1 BIT_MASK 0x0004 ECU_ADDRESS 0xFFFF2468 /begin FUNCTION_LIST /end FUNCTION_LIST /end MEASUREMENT
/begin MEASUREMENT fCDCCKOK1 "Drain-cut diagnosis permission condition formation flag" UBYTE COMP_0283 1 100 0 1 BIT_MASK 0x0002 ECU_ADDRESS 0xFFFF2468 /begin FUNCTION_LIST /end FUNCTION_LIST /end MEASUREMENT
/begin MEASUREMENT fCDCCKOK2 "Reference pressure EVP3 renewal flag" UBYTE COMP_0283 1 100 0 1 BIT_MASK 0x0001 ECU_ADDRESS 0xFFFF2468 /begin FUNCTION_LIST /end FUNCTION_LIST /end MEASUREMENT
/begin MEASUREMENT fCDCCKOK3 "Drain-cut NG diagnosis condition formation flag" UBYTE COMP_0283 1 100 0 1 BIT_MASK 0x0080 ECU_ADDRESS 0xFFFF2469 /begin FUNCTION_LIST /end FUNCTION_LIST /end MEASUREMENT
/begin MEASUREMENT fCDCKYOK1 "Drain-cut diagnosis (3) permission condition formation flag" UBYTE COMP_0283 1 100 0 1 BIT_MASK 0x0040 ECU_ADDRESS 0xFFFF2469 /begin FUNCTION_LIST /end FUNCTION_LIST /end MEASUREMENT
/begin MEASUREMENT fCDCKYOK2 "Reference pressure EVP4 renewal flag" UBYTE COMP_0283 1 100 0 1 BIT_MASK 0x0020 ECU_ADDRESS 0xFFFF2469 /begin FUNCTION_LIST /end FUNCTION_LIST /end MEASUREMENT
/begin MEASUREMENT fCDCKYOK3 "Drain-cut NG diagnosis (3) condition formation flag" UBYTE COMP_0283 1 100 0 1 BIT_MASK 0x0010 ECU_ADDRESS 0xFFFF2469 /begin FUNCTION_LIST /end FUNCTION_LIST /end MEASUREMENT
/begin MEASUREMENT fCHGOKHS "Charging complete judgement electric current value hysteresis flag" UBYTE COMP_0283 1 100 0 1 BIT_MASK 0x0008 ECU_ADDRESS 0xFFFF2469 /begin FUNCTION_LIST /end FUNCTION_LIST /end MEASUREMENT
/begin MEASUREMENT fCHK1ST "The first judgement" UBYTE COMP_0283 1 100 0 1 BIT_MASK 0x0004 ECU_ADDRESS 0xFFFF2469 /begin FUNCTION_LIST /end FUNCTION_LIST /end MEASUREMENT
/begin MEASUREMENT fCHTGE "A VTC operation permission condition formation judgement for VTC operation angle deviation quantity integral value learning" UBYTE COMP_0283 1 100 0 1 BIT_MASK 0x0002 ECU_ADDRESS 0xFFFF2469 /begin FUNCTION_LIST /end FUNCTION_LIST /end MEASUREMENT
/begin MEASUREMENT fCNACNT "CNSNG count rise flag" UBYTE COMP_0283 1 100 0 1 BIT_MASK 0x0020 ECU_ADDRESS 0xFFFF246A /begin FUNCTION_LIST /end FUNCTION_LIST /end MEASUREMENT
/begin MEASUREMENT fCPCHKSUB "Canister purge check sub-flag" UBYTE COMP_0283 1 100 0 1 BIT_MASK 0x0008 ECU_ADDRESS 0xFFFF246A /begin FUNCTION_LIST /end FUNCTION_LIST /end MEASUREMENT
/begin MEASUREMENT fCPCHKWK "Canister purge check requirement flag" UBYTE COMP_0283 1 100 0 1 BIT_MASK 0x0004 ECU_ADDRESS 0xFFFF246A /begin FUNCTION_LIST /end FUNCTION_LIST /end MEASUREMENT
/begin MEASUREMENT fCPCHKWK1 "Canister purge check work flag 1" UBYTE COMP_0283 1 100 0 1 BIT_MASK 0x0002 ECU_ADDRESS 0xFFFF246A /begin FUNCTION_LIST /end FUNCTION_LIST /end MEASUREMENT
/begin MEASUREMENT fCPCHKWK2 "Canister purge check work flag 2" UBYTE COMP_0283 1 100 0 1 BIT_MASK 0x0001 ECU_ADDRESS 0xFFFF246A /begin FUNCTION_LIST /end FUNCTION_LIST /end MEASUREMENT
/begin MEASUREMENT fCPFIRST "Canister purge check the first time flag" UBYTE COMP_0283 1 100 0 1 BIT_MASK 0x0080 ECU_ADDRESS 0xFFFF246B /begin FUNCTION_LIST /end FUNCTION_LIST /end MEASUREMENT
/begin MEASUREMENT fCSPHNG "At the time of the Phase start, at the time of breakage diagnosis ÅEPhase usual, breakage diagnosis NG judgement flag (at the time of the NG judgement, for all the cylinder ignitions)" UBYTE COMP_0283 1 100 0 1 BIT_MASK 0x0010 ECU_ADDRESS 0xFFFF246B /begin FUNCTION_LIST /end FUNCTION_LIST /end MEASUREMENT
/begin MEASUREMENT fCSSTCAN "Condition cancellation by START_SW" UBYTE COMP_0283 1 100 0 1 BIT_MASK 0x0008 ECU_ADDRESS 0xFFFF246B /begin FUNCTION_LIST /end FUNCTION_LIST /end MEASUREMENT
/begin MEASUREMENT fCSSTON "START SW On experience flag" UBYTE COMP_0283 1 100 0 1 BIT_MASK 0x0004 ECU_ADDRESS 0xFFFF246B /begin FUNCTION_LIST /end FUNCTION_LIST /end MEASUREMENT
/begin MEASUREMENT fDADVIDL "Phase control idle condition formation flag" UBYTE COMP_0283 1 100 0 1 BIT_MASK 0x0080 ECU_ADDRESS 0xFFFF246C /begin FUNCTION_LIST /end FUNCTION_LIST /end MEASUREMENT
/begin MEASUREMENT fDCVNGCD "Drain-cut /V function diagnosis NG" UBYTE COMP_0283 1 100 0 1 BIT_MASK 0x0020 ECU_ADDRESS 0xFFFF246C /begin FUNCTION_LIST /end FUNCTION_LIST /end MEASUREMENT
/begin MEASUREMENT fDCVNGD "Drain-cut /V function diagnosis 1 stage 2NG flag" UBYTE COMP_0283 1 100 0 1 BIT_MASK 0x0010 ECU_ADDRESS 0xFFFF246C /begin FUNCTION_LIST /end FUNCTION_LIST /end MEASUREMENT
/begin MEASUREMENT fDLFLUP1 "(#IDLE==0) && lockup control-in-progress judgement flag" UBYTE COMP_0283 1 100 0 1 BIT_MASK 0x0001 ECU_ADDRESS 0xFFFF246C /begin FUNCTION_LIST /end FUNCTION_LIST /end MEASUREMENT
/begin MEASUREMENT fDLFLUP2 "L/U prohibition ECVT= 1 o'clock hysteresis flag" UBYTE COMP_0283 1 100 0 1 BIT_MASK 0x0080 ECU_ADDRESS 0xFFFF246D /begin FUNCTION_LIST /end FUNCTION_LIST /end MEASUREMENT
/begin MEASUREMENT fDLGRPM0 "L/U prohibition engine speed hysteresis flag" UBYTE COMP_0283 1 100 0 1 BIT_MASK 0x0020 ECU_ADDRESS 0xFFFF246D /begin FUNCTION_LIST /end FUNCTION_LIST /end MEASUREMENT
/begin MEASUREMENT fDLV2ON "Lockup permission signal vehicle speed condition judgement flag" UBYTE COMP_0283 1 100 0 1 BIT_MASK 0x0002 ECU_ADDRESS 0xFFFF246D /begin FUNCTION_LIST /end FUNCTION_LIST /end MEASUREMENT
/begin MEASUREMENT fDLVSP "Lockup permission signal vehicle speed condition judgement flag" UBYTE COMP_0283 1 100 0 1 BIT_MASK 0x0001 ECU_ADDRESS 0xFFFF246D /begin FUNCTION_LIST /end FUNCTION_LIST /end MEASUREMENT
/begin MEASUREMENT fDQAGBDYN "vDQAGBDYN dec flag" UBYTE COMP_0283 1 100 0 1 BIT_MASK 0x0010 ECU_ADDRESS 0xFFFF246E /begin FUNCTION_LIST /end FUNCTION_LIST /end MEASUREMENT
/begin MEASUREMENT fDTEVPS "EVPS by the DUTYUP pull-down control requirement" UBYTE COMP_0283 1 100 0 1 BIT_MASK 0x0002 ECU_ADDRESS 0xFFFF246E /begin FUNCTION_LIST /end FUNCTION_LIST /end MEASUREMENT
/begin MEASUREMENT fDTFCTV "Hysteresis flag" UBYTE COMP_0283 1 100 0 1 BIT_MASK 0x0080 ECU_ADDRESS 0xFFFF246F /begin FUNCTION_LIST /end FUNCTION_LIST /end MEASUREMENT
/begin MEASUREMENT fDTLUIN "Hysteresis flag" UBYTE COMP_0283 1 100 0 1 BIT_MASK 0x0020 ECU_ADDRESS 0xFFFF246F /begin FUNCTION_LIST /end FUNCTION_LIST /end MEASUREMENT
/begin MEASUREMENT fDTNGZ "A/T signal line condition previous value" UBYTE COMP_0283 1 100 0 1 BIT_MASK 0x0010 ECU_ADDRESS 0xFFFF246F /begin FUNCTION_LIST /end FUNCTION_LIST /end MEASUREMENT
/begin MEASUREMENT fDTVOCMP "Throttle open-degree change quantity absolute value comparative flag" UBYTE COMP_0283 1 100 0 1 BIT_MASK 0x0008 ECU_ADDRESS 0xFFFF246F /begin FUNCTION_LIST /end FUNCTION_LIST /end MEASUREMENT
/begin MEASUREMENT fDYN20 "An urgent pushing/urgent slowdown judgement 20mS flag" UBYTE COMP_0283 1 100 0 1 BIT_MASK 0x0010 ECU_ADDRESS 0xFFFF2470 /begin FUNCTION_LIST /end FUNCTION_LIST /end MEASUREMENT
/begin MEASUREMENT fEGRCUT1 "EGR cut condition 1 OK" UBYTE COMP_0283 1 100 0 1 BIT_MASK 0x0002 ECU_ADDRESS 0xFFFF2470 /begin FUNCTION_LIST /end FUNCTION_LIST /end MEASUREMENT
/begin MEASUREMENT fEGRCUT10 "EGR cut condition 10 OK" UBYTE COMP_0283 1 100 0 1 BIT_MASK 0x0001 ECU_ADDRESS 0xFFFF2470 /begin FUNCTION_LIST /end FUNCTION_LIST /end MEASUREMENT
/begin MEASUREMENT fEGRCUT11 "EGR cut condition 11 OK" UBYTE COMP_0283 1 100 0 1 BIT_MASK 0x0080 ECU_ADDRESS 0xFFFF2471 /begin FUNCTION_LIST /end FUNCTION_LIST /end MEASUREMENT
/begin MEASUREMENT fEGRCUT2 "EGR cut condition 2 OK" UBYTE COMP_0283 1 100 0 1 BIT_MASK 0x0040 ECU_ADDRESS 0xFFFF2471 /begin FUNCTION_LIST /end FUNCTION_LIST /end MEASUREMENT
/begin MEASUREMENT fEGRCUT3 "EGR cut condition 3 OK" UBYTE COMP_0283 1 100 0 1 BIT_MASK 0x0020 ECU_ADDRESS 0xFFFF2471 /begin FUNCTION_LIST /end FUNCTION_LIST /end MEASUREMENT
/begin MEASUREMENT fEGRCUT4 "EGR cut condition 4 OK" UBYTE COMP_0283 1 100 0 1 BIT_MASK 0x0010 ECU_ADDRESS 0xFFFF2471 /begin FUNCTION_LIST /end FUNCTION_LIST /end MEASUREMENT
/begin MEASUREMENT fEGRCUT5 "EGR cut condition 5 OK" UBYTE COMP_0283 1 100 0 1 BIT_MASK 0x0008 ECU_ADDRESS 0xFFFF2471 /begin FUNCTION_LIST /end FUNCTION_LIST /end MEASUREMENT
/begin MEASUREMENT fEGRCUT6 "EGR cut condition 6 OK" UBYTE COMP_0283 1 100 0 1 BIT_MASK 0x0004 ECU_ADDRESS 0xFFFF2471 /begin FUNCTION_LIST /end FUNCTION_LIST /end MEASUREMENT
/begin MEASUREMENT fEGRCUT7 "EGR cut condition 7 OK" UBYTE COMP_0283 1 100 0 1 BIT_MASK 0x0002 ECU_ADDRESS 0xFFFF2471 /begin FUNCTION_LIST /end FUNCTION_LIST /end MEASUREMENT
/begin MEASUREMENT fEGRCUT8 "EGR cut condition 8 OK" UBYTE COMP_0283 1 100 0 1 BIT_MASK 0x0001 ECU_ADDRESS 0xFFFF2471 /begin FUNCTION_LIST /end FUNCTION_LIST /end MEASUREMENT
/begin MEASUREMENT fEGRCUT9 "EGR cut condition 9 OK" UBYTE COMP_0283 1 100 0 1 BIT_MASK 0x0080 ECU_ADDRESS 0xFFFF2472 /begin FUNCTION_LIST /end FUNCTION_LIST /end MEASUREMENT
/begin MEASUREMENT fEGROFF1 "EGR cut on condition (c) judgement flag" UBYTE COMP_0283 1 100 0 1 BIT_MASK 0x0040 ECU_ADDRESS 0xFFFF2472 /begin FUNCTION_LIST /end FUNCTION_LIST /end MEASUREMENT
/begin MEASUREMENT fEGROFF2 "EGR cut on condition (d) judgement flag" UBYTE COMP_0283 1 100 0 1 BIT_MASK 0x0020 ECU_ADDRESS 0xFFFF2472 /begin FUNCTION_LIST /end FUNCTION_LIST /end MEASUREMENT
/begin MEASUREMENT fEGRTVH "Hysteresis flag" UBYTE COMP_0283 1 100 0 1 BIT_MASK 0x0010 ECU_ADDRESS 0xFFFF2472 /begin FUNCTION_LIST /end FUNCTION_LIST /end MEASUREMENT
/begin MEASUREMENT fEMIGN "IGN SW OFFON" UBYTE COMP_0283 1 100 0 1 BIT_MASK 0x0008 ECU_ADDRESS 0xFFFF2472 /begin FUNCTION_LIST /end FUNCTION_LIST /end MEASUREMENT
/begin MEASUREMENT fEMNRPM "MNRPM>=SMNRN#" UBYTE COMP_0283 1 100 0 1 BIT_MASK 0x0004 ECU_ADDRESS 0xFFFF2472 /begin FUNCTION_LIST /end FUNCTION_LIST /end MEASUREMENT
/begin MEASUREMENT fEMNTN "EMNTN# hysteresis judgement" UBYTE COMP_0283 1 100 0 1 BIT_MASK 0x0002 ECU_ADDRESS 0xFFFF2472 /begin FUNCTION_LIST /end FUNCTION_LIST /end MEASUREMENT
/begin MEASUREMENT fEMSTSW "START SW ONOFF" UBYTE COMP_0283 1 100 0 1 BIT_MASK 0x0001 ECU_ADDRESS 0xFFFF2472 /begin FUNCTION_LIST /end FUNCTION_LIST /end MEASUREMENT
/begin MEASUREMENT fEMVSP "EMVSP# hysteresis judgement" UBYTE COMP_0283 1 100 0 1 BIT_MASK 0x0080 ECU_ADDRESS 0xFFFF2473 /begin FUNCTION_LIST /end FUNCTION_LIST /end MEASUREMENT
/begin MEASUREMENT fENSTST1 "At the time of the start, compensation control permission judgement flag" UBYTE COMP_0283 1 100 0 1 BIT_MASK 0x0020 ECU_ADDRESS 0xFFFF2473 /begin FUNCTION_LIST /end FUNCTION_LIST /end MEASUREMENT
/begin MEASUREMENT fENSTST2 "At the time of the start, compensation control permission judgement flag" UBYTE COMP_0283 1 100 0 1 BIT_MASK 0x0010 ECU_ADDRESS 0xFFFF2473 /begin FUNCTION_LIST /end FUNCTION_LIST /end MEASUREMENT
/begin MEASUREMENT fEPRNGDO "Line pressure sensor diagnosis opening NG judgement flag" UBYTE COMP_0283 1 100 0 1 BIT_MASK 0x0008 ECU_ADDRESS 0xFFFF2473 /begin FUNCTION_LIST /end FUNCTION_LIST /end MEASUREMENT
/begin MEASUREMENT fEPRNGDS "Line pressure sensor diagnosis short circuit NG judgement flag" UBYTE COMP_0283 1 100 0 1 BIT_MASK 0x0004 ECU_ADDRESS 0xFFFF2473 /begin FUNCTION_LIST /end FUNCTION_LIST /end MEASUREMENT
/begin MEASUREMENT fERRLEEL "VTC operation angle deviation quantity integral value, usually, learning renewal treatment completion judgement" UBYTE COMP_0283 1 100 0 1 BIT_MASK 0x0002 ECU_ADDRESS 0xFFFF2473 /begin FUNCTION_LIST /end FUNCTION_LIST /end MEASUREMENT
/begin MEASUREMENT fERRLEER "VTC operation angle deviation quantity integral value, usually, learning renewal treatment completion judgement" UBYTE COMP_0283 1 100 0 1 BIT_MASK 0x0001 ECU_ADDRESS 0xFFFF2473 /begin FUNCTION_LIST /end FUNCTION_LIST /end MEASUREMENT
/begin MEASUREMENT fERRLEIL "VTC operation angle deviation quantity integral value, usually, learning renewal treatment completion judgement" UBYTE COMP_0283 1 100 0 1 BIT_MASK 0x0080 ECU_ADDRESS 0xFFFF2474 /begin FUNCTION_LIST /end FUNCTION_LIST /end MEASUREMENT
/begin MEASUREMENT fERRLEIR "VTC operation angle deviation quantity integral value, usually, learning renewal treatment completion judgement" UBYTE COMP_0283 1 100 0 1 BIT_MASK 0x0040 ECU_ADDRESS 0xFFFF2474 /begin FUNCTION_LIST /end FUNCTION_LIST /end MEASUREMENT
/begin MEASUREMENT fERRSEEL "VTC operation angle deviation quantity integral value rapid learning renewal treatment completion judgement" UBYTE COMP_0283 1 100 0 1 BIT_MASK 0x0020 ECU_ADDRESS 0xFFFF2474 /begin FUNCTION_LIST /end FUNCTION_LIST /end MEASUREMENT
/begin MEASUREMENT fERRSEER "VTC operation angle deviation quantity integral value rapid learning renewal treatment completion judgement" UBYTE COMP_0283 1 100 0 1 BIT_MASK 0x0010 ECU_ADDRESS 0xFFFF2474 /begin FUNCTION_LIST /end FUNCTION_LIST /end MEASUREMENT
/begin MEASUREMENT fERRSEIL "VTC operation angle deviation quantity integral value rapid learning renewal treatment completion judgement" UBYTE COMP_0283 1 100 0 1 BIT_MASK 0x0008 ECU_ADDRESS 0xFFFF2474 /begin FUNCTION_LIST /end FUNCTION_LIST /end MEASUREMENT
/begin MEASUREMENT fERRSEIR "VTC operation angle deviation quantity integral value rapid learning renewal treatment completion judgement" UBYTE COMP_0283 1 100 0 1 BIT_MASK 0x0004 ECU_ADDRESS 0xFFFF2474 /begin FUNCTION_LIST /end FUNCTION_LIST /end MEASUREMENT
/begin MEASUREMENT fERRSTBE "VTCERRE (n) stable experience flag" UBYTE COMP_0283 1 100 0 1 BIT_MASK 0x0002 ECU_ADDRESS 0xFFFF2474 /begin FUNCTION_LIST /end FUNCTION_LIST /end MEASUREMENT
/begin MEASUREMENT fERRSTBI "VTCERRI (n) stable experience flag" UBYTE COMP_0283 1 100 0 1 BIT_MASK 0x0001 ECU_ADDRESS 0xFFFF2474 /begin FUNCTION_LIST /end FUNCTION_LIST /end MEASUREMENT
/begin MEASUREMENT fEVCNNGD "Diagnosis judgement flag" UBYTE COMP_0283 1 100 0 1 BIT_MASK 0x0080 ECU_ADDRESS 0xFFFF2475 /begin FUNCTION_LIST /end FUNCTION_LIST /end MEASUREMENT
/begin MEASUREMENT fEVCNOKD "Diagnosis judgement flag" UBYTE COMP_0283 1 100 0 1 BIT_MASK 0x0040 ECU_ADDRESS 0xFFFF2475 /begin FUNCTION_LIST /end FUNCTION_LIST /end MEASUREMENT
/begin MEASUREMENT fEVPCMP "Realtime purge magnification comparative flag" UBYTE COMP_0283 1 100 0 1 BIT_MASK 0x0020 ECU_ADDRESS 0xFFFF2475 /begin FUNCTION_LIST /end FUNCTION_LIST /end MEASUREMENT
/begin MEASUREMENT fEVPCNTCMP "Accumulation purge quantity comparative flag" UBYTE COMP_0283 1 100 0 1 BIT_MASK 0x0010 ECU_ADDRESS 0xFFFF2475 /begin FUNCTION_LIST /end FUNCTION_LIST /end MEASUREMENT
/begin MEASUREMENT fEXNFCJG "Continuous NO. Load high rotation cut condition judgement" UBYTE COMP_0283 1 100 0 1 BIT_MASK 0x0004 ECU_ADDRESS 0xFFFF2475 /begin FUNCTION_LIST /end FUNCTION_LIST /end MEASUREMENT
/begin MEASUREMENT fEXNFCTM "NLCNT renewal condition judgement" UBYTE COMP_0283 1 100 0 1 BIT_MASK 0x0002 ECU_ADDRESS 0xFFFF2475 /begin FUNCTION_LIST /end FUNCTION_LIST /end MEASUREMENT
/begin MEASUREMENT fF10MSBGJ "10mS BGJ in-progress flag" UBYTE COMP_0283 1 100 0 1 BIT_MASK 0x0001 ECU_ADDRESS 0xFFFF2475 /begin FUNCTION_LIST /end FUNCTION_LIST /end MEASUREMENT
/begin MEASUREMENT fFALPDAG "Alpha limiter expansion diagnosis" UBYTE COMP_0283 1 100 0 1 BIT_MASK 0x0020 ECU_ADDRESS 0xFFFF2476 /begin FUNCTION_LIST /end FUNCTION_LIST /end MEASUREMENT
/begin MEASUREMENT fFAPOTIM "IDLESW 1-> The judgement flag of the 0 time" UBYTE COMP_0283 1 100 0 1 BIT_MASK 0x0080 ECU_ADDRESS 0xFFFF2477 /begin FUNCTION_LIST /end FUNCTION_LIST /end MEASUREMENT
/begin MEASUREMENT fFAVEPPSV "AVEPPSV first treatment executive flag" UBYTE COMP_0283 1 100 0 1 BIT_MASK 0x0010 ECU_ADDRESS 0xFFFF2477 /begin FUNCTION_LIST /end FUNCTION_LIST /end MEASUREMENT
/begin MEASUREMENT fFCD "After the fuel cut condition formation, beginning" UBYTE COMP_0283 1 100 0 1 BIT_MASK 0x0008 ECU_ADDRESS 0xFFFF2477 /begin FUNCTION_LIST /end FUNCTION_LIST /end MEASUREMENT
/begin MEASUREMENT fFCKBLTJ "(CK) Control interruption judgement for the belt slide" UBYTE COMP_0283 1 100 0 1 BIT_MASK 0x0001 ECU_ADDRESS 0xFFFF2477 /begin FUNCTION_LIST /end FUNCTION_LIST /end MEASUREMENT
/begin MEASUREMENT fFCKSTTM "After the start, time arrival judgement flag" UBYTE COMP_0283 1 100 0 1 BIT_MASK 0x0040 ECU_ADDRESS 0xFFFF2478 /begin FUNCTION_LIST /end FUNCTION_LIST /end MEASUREMENT
/begin MEASUREMENT fFCKTDTM "Torque limiter completion time arrival judgement flag" UBYTE COMP_0283 1 100 0 1 BIT_MASK 0x0020 ECU_ADDRESS 0xFFFF2478 /begin FUNCTION_LIST /end FUNCTION_LIST /end MEASUREMENT
/begin MEASUREMENT fFCUTALL "All the cylinder fuel cut experience flags" UBYTE COMP_0283 1 100 0 1 BIT_MASK 0x0008 ECU_ADDRESS 0xFFFF2478 /begin FUNCTION_LIST /end FUNCTION_LIST /end MEASUREMENT
/begin MEASUREMENT fFCUTRN "Flag for F/C inhibition control" UBYTE COMP_0283 1 100 0 1 BIT_MASK 0x0004 ECU_ADDRESS 0xFFFF2478 /begin FUNCTION_LIST /end FUNCTION_LIST /end MEASUREMENT
/begin MEASUREMENT fFDCV1NG "Function diagnosis (1) stage 1NG flag" UBYTE COMP_0283 1 100 0 1 BIT_MASK 0x0002 ECU_ADDRESS 0xFFFF2478 /begin FUNCTION_LIST /end FUNCTION_LIST /end MEASUREMENT
/begin MEASUREMENT fFDCV3HNT "NG judgement start flag" UBYTE COMP_0283 1 100 0 1 BIT_MASK 0x0001 ECU_ADDRESS 0xFFFF2478 /begin FUNCTION_LIST /end FUNCTION_LIST /end MEASUREMENT
/begin MEASUREMENT fFDECCLC "Purge cut condition (7) formation" UBYTE COMP_0283 1 100 0 1 BIT_MASK 0x0080 ECU_ADDRESS 0xFFFF2479 /begin FUNCTION_LIST /end FUNCTION_LIST /end MEASUREMENT
/begin MEASUREMENT fFDECCLCD "A purge cut condition (7) has ever been concluded." UBYTE COMP_0283 1 100 0 1 BIT_MASK 0x0040 ECU_ADDRESS 0xFFFF2479 /begin FUNCTION_LIST /end FUNCTION_LIST /end MEASUREMENT
/begin MEASUREMENT fFDIRE8 "After the judgement, use of control DIREI8" UBYTE COMP_0283 1 100 0 1 BIT_MASK 0x0020 ECU_ADDRESS 0xFFFF2479 /begin FUNCTION_LIST /end FUNCTION_LIST /end MEASUREMENT
/begin MEASUREMENT fFDLEPX1 "DLEPX1 monitor flag" UBYTE COMP_0283 1 100 0 1 BIT_MASK 0x0010 ECU_ADDRESS 0xFFFF2479 /begin FUNCTION_LIST /end FUNCTION_LIST /end MEASUREMENT
/begin MEASUREMENT fFDTRGE "Polarity judgement flag (exhaust)" UBYTE COMP_0283 1 100 0 1 BIT_MASK 0x0004 ECU_ADDRESS 0xFFFF2479 /begin FUNCTION_LIST /end FUNCTION_LIST /end MEASUREMENT
/begin MEASUREMENT fFDTRGI "Polarity judgement flag (intake)" UBYTE COMP_0283 1 100 0 1 BIT_MASK 0x0002 ECU_ADDRESS 0xFFFF2479 /begin FUNCTION_LIST /end FUNCTION_LIST /end MEASUREMENT
/begin MEASUREMENT fFESYSCON "PCVST5 open-degree completion flag" UBYTE COMP_0283 1 100 0 1 BIT_MASK 0x0080 ECU_ADDRESS 0xFFFF247A /begin FUNCTION_LIST /end FUNCTION_LIST /end MEASUREMENT
/begin MEASUREMENT fFESYSDP "Diagnosis permission condition formation flag" UBYTE COMP_0283 1 100 0 1 BIT_MASK 0x0040 ECU_ADDRESS 0xFFFF247A /begin FUNCTION_LIST /end FUNCTION_LIST /end MEASUREMENT
/begin MEASUREMENT fFEVCMON1 "DLEPX2 operation beginning" UBYTE COMP_0283 1 100 0 1 BIT_MASK 0x0020 ECU_ADDRESS 0xFFFF247A /begin FUNCTION_LIST /end FUNCTION_LIST /end MEASUREMENT
/begin MEASUREMENT fFEVMON1 "EPRS11 monitor formation flag" UBYTE COMP_0283 1 100 0 1 BIT_MASK 0x0010 ECU_ADDRESS 0xFFFF247A /begin FUNCTION_LIST /end FUNCTION_LIST /end MEASUREMENT
/begin MEASUREMENT fFEVMON2 "EPRS12 monitor formation flag" UBYTE COMP_0283 1 100 0 1 BIT_MASK 0x0008 ECU_ADDRESS 0xFFFF247A /begin FUNCTION_LIST /end FUNCTION_LIST /end MEASUREMENT
/begin MEASUREMENT fFEVPDC "Purge cut condition (3) formation" UBYTE COMP_0283 1 100 0 1 BIT_MASK 0x0004 ECU_ADDRESS 0xFFFF247A /begin FUNCTION_LIST /end FUNCTION_LIST /end MEASUREMENT
/begin MEASUREMENT fFEVPDCD "A purge cut condition (3) has ever been concluded." UBYTE COMP_0283 1 100 0 1 BIT_MASK 0x0002 ECU_ADDRESS 0xFFFF247A /begin FUNCTION_LIST /end FUNCTION_LIST /end MEASUREMENT
/begin MEASUREMENT fFEVPDIC "Purge cut condition (2) formation" UBYTE COMP_0283 1 100 0 1 BIT_MASK 0x0001 ECU_ADDRESS 0xFFFF247A /begin FUNCTION_LIST /end FUNCTION_LIST /end MEASUREMENT
/begin MEASUREMENT fFEVPDICD "A purge cut condition (2) has ever been concluded." UBYTE COMP_0283 1 100 0 1 BIT_MASK 0x0080 ECU_ADDRESS 0xFFFF247B /begin FUNCTION_LIST /end FUNCTION_LIST /end MEASUREMENT
/begin MEASUREMENT fFEVPFIX "At the time of the evapo diagnosis EVPSS fixed value,, as soon as possible, KDUTY=0" UBYTE COMP_0283 1 100 0 1 BIT_MASK 0x0040 ECU_ADDRESS 0xFFFF247B /begin FUNCTION_LIST /end FUNCTION_LIST /end MEASUREMENT
/begin MEASUREMENT fFEVPFIX2 "At the time of the evapo diagnosis EVPSS fixed value, gradual KDUTY=0" UBYTE COMP_0283 1 100 0 1 BIT_MASK 0x0020 ECU_ADDRESS 0xFFFF247B /begin FUNCTION_LIST /end FUNCTION_LIST /end MEASUREMENT
/begin MEASUREMENT fFEVPTRC "Purge cut condition (1) (a) formation" UBYTE COMP_0283 1 100 0 1 BIT_MASK 0x0010 ECU_ADDRESS 0xFFFF247B /begin FUNCTION_LIST /end FUNCTION_LIST /end MEASUREMENT
/begin MEASUREMENT fFEVPTRCD "A purge cut condition (1) (a) has ever been concluded." UBYTE COMP_0283 1 100 0 1 BIT_MASK 0x0008 ECU_ADDRESS 0xFFFF247B /begin FUNCTION_LIST /end FUNCTION_LIST /end MEASUREMENT
/begin MEASUREMENT fFEVSST2 "EPRS21 monitor formation flag" UBYTE COMP_0283 1 100 0 1 BIT_MASK 0x0004 ECU_ADDRESS 0xFFFF247B /begin FUNCTION_LIST /end FUNCTION_LIST /end MEASUREMENT
/begin MEASUREMENT fFEVSTG12 "Stage 12 start flag" UBYTE COMP_0283 1 100 0 1 BIT_MASK 0x0002 ECU_ADDRESS 0xFFFF247B /begin FUNCTION_LIST /end FUNCTION_LIST /end MEASUREMENT
/begin MEASUREMENT fFEVSTG12V "Stage 1 imaginary stage 2 start flag" UBYTE COMP_0283 1 100 0 1 BIT_MASK 0x0001 ECU_ADDRESS 0xFFFF247B /begin FUNCTION_LIST /end FUNCTION_LIST /end MEASUREMENT
/begin MEASUREMENT fFIDLPGC "Purge cut condition (8) formation" UBYTE COMP_0283 1 100 0 1 BIT_MASK 0x0040 ECU_ADDRESS 0xFFFF247C /begin FUNCTION_LIST /end FUNCTION_LIST /end MEASUREMENT
/begin MEASUREMENT fFIDLPGCD "A purge cut condition (8) has ever been concluded." UBYTE COMP_0283 1 100 0 1 BIT_MASK 0x0020 ECU_ADDRESS 0xFFFF247C /begin FUNCTION_LIST /end FUNCTION_LIST /end MEASUREMENT
/begin MEASUREMENT fFITRTFL "TITM full increase treatment full increase judgement condition flag" UBYTE COMP_0283 1 100 0 1 BIT_MASK 0x0010 ECU_ADDRESS 0xFFFF247C /begin FUNCTION_LIST /end FUNCTION_LIST /end MEASUREMENT
/begin MEASUREMENT fFITRTM "During the TITM full increase treatment engine rotation, condition flag" UBYTE COMP_0283 1 100 0 1 BIT_MASK 0x0008 ECU_ADDRESS 0xFFFF247C /begin FUNCTION_LIST /end FUNCTION_LIST /end MEASUREMENT
/begin MEASUREMENT fFIUP1 "DUETTE idle rise requirement flag" UBYTE COMP_0283 1 100 0 1 BIT_MASK 0x0002 ECU_ADDRESS 0xFFFF247C /begin FUNCTION_LIST /end FUNCTION_LIST /end MEASUREMENT
/begin MEASUREMENT fFIUPHNT "Idle rise requirement control judgement" UBYTE COMP_0283 1 100 0 1 BIT_MASK 0x0001 ECU_ADDRESS 0xFFFF247C /begin FUNCTION_LIST /end FUNCTION_LIST /end MEASUREMENT
/begin MEASUREMENT fFKDOWN "KDUTY UP control (b) formation" UBYTE COMP_0283 1 100 0 1 BIT_MASK 0x0080 ECU_ADDRESS 0xFFFF247D /begin FUNCTION_LIST /end FUNCTION_LIST /end MEASUREMENT
/begin MEASUREMENT fFKDWNIMM "KDUTY UP control (a) formation" UBYTE COMP_0283 1 100 0 1 BIT_MASK 0x0040 ECU_ADDRESS 0xFFFF247D /begin FUNCTION_LIST /end FUNCTION_LIST /end MEASUREMENT
/begin MEASUREMENT fFKGZSS "vKGZR plus and minus judgement flag" UBYTE COMP_0283 1 100 0 1 BIT_MASK 0x0020 ECU_ADDRESS 0xFFFF247D /begin FUNCTION_LIST /end FUNCTION_LIST /end MEASUREMENT
/begin MEASUREMENT fFKHABS "KHOT change width plus and minus judgement flag" UBYTE COMP_0283 1 100 0 1 BIT_MASK 0x0010 ECU_ADDRESS 0xFFFF247D /begin FUNCTION_LIST /end FUNCTION_LIST /end MEASUREMENT
/begin MEASUREMENT fFKSTBLMD "KSTBLMD operation experience flag" UBYTE COMP_0283 1 100 0 1 BIT_MASK 0x0002 ECU_ADDRESS 0xFFFF247D /begin FUNCTION_LIST /end FUNCTION_LIST /end MEASUREMENT
/begin MEASUREMENT fFKUP2 "KDUTY UP control (b) formation" UBYTE COMP_0283 1 100 0 1 BIT_MASK 0x0001 ECU_ADDRESS 0xFFFF247D /begin FUNCTION_LIST /end FUNCTION_LIST /end MEASUREMENT
/begin MEASUREMENT fFKUPIMM "KDUTY UP control (a) formation" UBYTE COMP_0283 1 100 0 1 BIT_MASK 0x0080 ECU_ADDRESS 0xFFFF247E /begin FUNCTION_LIST /end FUNCTION_LIST /end MEASUREMENT
/begin MEASUREMENT fFLG20MS "Operation timing 20mS progress judgement flag" UBYTE COMP_0283 1 100 0 1 BIT_MASK 0x0040 ECU_ADDRESS 0xFFFF247E /begin FUNCTION_LIST /end FUNCTION_LIST /end MEASUREMENT
/begin MEASUREMENT fFLMCSTTW "LMCSTTW operation experience flag" UBYTE COMP_0283 1 100 0 1 BIT_MASK 0x0010 ECU_ADDRESS 0xFFFF247E /begin FUNCTION_LIST /end FUNCTION_LIST /end MEASUREMENT
/begin MEASUREMENT fFLNEFST "The flag which has established RLFLTNE first value" UBYTE COMP_0283 1 100 0 1 BIT_MASK 0x0008 ECU_ADDRESS 0xFFFF247E /begin FUNCTION_LIST /end FUNCTION_LIST /end MEASUREMENT
/begin MEASUREMENT fFLU "Lockup judgement" UBYTE COMP_0283 1 100 0 1 BIT_MASK 0x0002 ECU_ADDRESS 0xFFFF247E /begin FUNCTION_LIST /end FUNCTION_LIST /end MEASUREMENT
/begin MEASUREMENT fFMDLTCLR "Rotation synchronous control limit torque clear requirement flag" UBYTE COMP_0283 1 100 0 1 BIT_MASK 0x0080 ECU_ADDRESS 0xFFFF247F /begin FUNCTION_LIST /end FUNCTION_LIST /end MEASUREMENT
/begin MEASUREMENT fFMDLTSET "Rotation synchronous control limit torque operation requirement flag" UBYTE COMP_0283 1 100 0 1 BIT_MASK 0x0040 ECU_ADDRESS 0xFFFF247F /begin FUNCTION_LIST /end FUNCTION_LIST /end MEASUREMENT
/begin MEASUREMENT fFMPNEH "FMP operation permission engine speed upper limit judgement" UBYTE COMP_0283 1 100 0 1 BIT_MASK 0x0020 ECU_ADDRESS 0xFFFF247F /begin FUNCTION_LIST /end FUNCTION_LIST /end MEASUREMENT
/begin MEASUREMENT fFMRDGNC "Purge cut condition (4) formation" UBYTE COMP_0283 1 100 0 1 BIT_MASK 0x0010 ECU_ADDRESS 0xFFFF247F /begin FUNCTION_LIST /end FUNCTION_LIST /end MEASUREMENT
/begin MEASUREMENT fFMRDGNCD "A purge cut condition (4) has ever been concluded." UBYTE COMP_0283 1 100 0 1 BIT_MASK 0x0008 ECU_ADDRESS 0xFFFF247F /begin FUNCTION_LIST /end FUNCTION_LIST /end MEASUREMENT
/begin MEASUREMENT fFPCHKC "Purge cut condition (6) formation" UBYTE COMP_0283 1 100 0 1 BIT_MASK 0x0002 ECU_ADDRESS 0xFFFF247F /begin FUNCTION_LIST /end FUNCTION_LIST /end MEASUREMENT
/begin MEASUREMENT fFPCHKCD "A purge cut condition (6) has ever been concluded." UBYTE COMP_0283 1 100 0 1 BIT_MASK 0x0001 ECU_ADDRESS 0xFFFF247F /begin FUNCTION_LIST /end FUNCTION_LIST /end MEASUREMENT
/begin MEASUREMENT fFPCTHS "FPCM coolant temperature condition hysteresis flag" UBYTE COMP_0283 1 100 0 1 BIT_MASK 0x0080 ECU_ADDRESS 0xFFFF2480 /begin FUNCTION_LIST /end FUNCTION_LIST /end MEASUREMENT
/begin MEASUREMENT fFPRESM "EVPRES monitor flag" UBYTE COMP_0283 1 100 0 1 BIT_MASK 0x0040 ECU_ADDRESS 0xFFFF2480 /begin FUNCTION_LIST /end FUNCTION_LIST /end MEASUREMENT
/begin MEASUREMENT fFPRSMON1 "The first flag" UBYTE COMP_0283 1 100 0 1 BIT_MASK 0x0020 ECU_ADDRESS 0xFFFF2480 /begin FUNCTION_LIST /end FUNCTION_LIST /end MEASUREMENT
/begin MEASUREMENT fFPTION "FPOFDY progress judgement flag" UBYTE COMP_0283 1 100 0 1 BIT_MASK 0x0008 ECU_ADDRESS 0xFFFF2480 /begin FUNCTION_LIST /end FUNCTION_LIST /end MEASUREMENT
/begin MEASUREMENT fFRMKS "Minus KTW RPM" UBYTE COMP_0283 1 100 0 1 BIT_MASK 0x0010 ECU_ADDRESS 0xFFFF2481 /begin FUNCTION_LIST /end FUNCTION_LIST /end MEASUREMENT
/begin MEASUREMENT fFRTM1 "ST After off, delay flag 1" UBYTE COMP_0283 1 100 0 1 BIT_MASK 0x0008 ECU_ADDRESS 0xFFFF2481 /begin FUNCTION_LIST /end FUNCTION_LIST /end MEASUREMENT
/begin MEASUREMENT fFRTM2 "ST After off, delay flag 2" UBYTE COMP_0283 1 100 0 1 BIT_MASK 0x0004 ECU_ADDRESS 0xFFFF2481 /begin FUNCTION_LIST /end FUNCTION_LIST /end MEASUREMENT
/begin MEASUREMENT fFRWIPD "A front wiper movement flag with the delay" UBYTE COMP_0283 1 100 0 1 BIT_MASK 0x0080 ECU_ADDRESS 0xFFFF2482 /begin FUNCTION_LIST /end FUNCTION_LIST /end MEASUREMENT
/begin MEASUREMENT fFSAFMNG "Mass airflow meter failsafe flag" UBYTE COMP_0283 1 100 0 1 BIT_MASK 0x0020 ECU_ADDRESS 0xFFFF2482 /begin FUNCTION_LIST /end FUNCTION_LIST /end MEASUREMENT
/begin MEASUREMENT fFSAFMNGZ "Mass airflow meter failsafe detection one-shot flag" UBYTE COMP_0283 1 100 0 1 BIT_MASK 0x0010 ECU_ADDRESS 0xFFFF2482 /begin FUNCTION_LIST /end FUNCTION_LIST /end MEASUREMENT
/begin MEASUREMENT fFSCVD "SCV ON/ off for the SCADMP addition" UBYTE COMP_0283 1 100 0 1 BIT_MASK 0x0008 ECU_ADDRESS 0xFFFF2482 /begin FUNCTION_LIST /end FUNCTION_LIST /end MEASUREMENT
/begin MEASUREMENT fFSCVID "An one_shot flag for SCV" UBYTE COMP_0283 1 100 0 1 BIT_MASK 0x0004 ECU_ADDRESS 0xFFFF2482 /begin FUNCTION_LIST /end FUNCTION_LIST /end MEASUREMENT
/begin MEASUREMENT fFSHYSTW "At the time of the coolant temperature sensor trouble, fuel cut hysteresis" UBYTE COMP_0283 1 100 0 1 BIT_MASK 0x0002 ECU_ADDRESS 0xFFFF2482 /begin FUNCTION_LIST /end FUNCTION_LIST /end MEASUREMENT
/begin MEASUREMENT fFSLPDEC0 "SLPDEC0 operation condition formation experience flag" UBYTE COMP_0283 1 100 0 1 BIT_MASK 0x0001 ECU_ADDRESS 0xFFFF2482 /begin FUNCTION_LIST /end FUNCTION_LIST /end MEASUREMENT
/begin MEASUREMENT fFSTTI "An initial initial injection condition judgement" UBYTE COMP_0283 1 100 0 1 BIT_MASK 0x0040 ECU_ADDRESS 0xFFFF2483 /begin FUNCTION_LIST /end FUNCTION_LIST /end MEASUREMENT
/begin MEASUREMENT fFTHTWINT "TWNTMN, TWNTMX, with TWINT, initialization completion" UBYTE COMP_0283 1 100 0 1 BIT_MASK 0x0004 ECU_ADDRESS 0xFFFF2483 /begin FUNCTION_LIST /end FUNCTION_LIST /end MEASUREMENT
/begin MEASUREMENT fFTMISSL "Transient state compensation time timer start experience flag" UBYTE COMP_0283 1 100 0 1 BIT_MASK 0x0002 ECU_ADDRESS 0xFFFF2483 /begin FUNCTION_LIST /end FUNCTION_LIST /end MEASUREMENT
/begin MEASUREMENT fFTQH0IF "Hysteresis flag" UBYTE COMP_0283 1 100 0 1 BIT_MASK 0x0001 ECU_ADDRESS 0xFFFF2483 /begin FUNCTION_LIST /end FUNCTION_LIST /end MEASUREMENT
/begin MEASUREMENT fFTRGE "A basic target angle judgement flag (exhaust)" UBYTE COMP_0283 1 100 0 1 BIT_MASK 0x0040 ECU_ADDRESS 0xFFFF2484 /begin FUNCTION_LIST /end FUNCTION_LIST /end MEASUREMENT
/begin MEASUREMENT fFTRGI "A basic target angle judgement flag (intake)" UBYTE COMP_0283 1 100 0 1 BIT_MASK 0x0020 ECU_ADDRESS 0xFFFF2484 /begin FUNCTION_LIST /end FUNCTION_LIST /end MEASUREMENT
/begin MEASUREMENT fFTRQMDLT "Rotation synchronous control limit torque operation experience flag" UBYTE COMP_0283 1 100 0 1 BIT_MASK 0x0010 ECU_ADDRESS 0xFFFF2484 /begin FUNCTION_LIST /end FUNCTION_LIST /end MEASUREMENT
/begin MEASUREMENT fFTWCPCC "Purge cut condition (1) (b) formation" UBYTE COMP_0283 1 100 0 1 BIT_MASK 0x0004 ECU_ADDRESS 0xFFFF2484 /begin FUNCTION_LIST /end FUNCTION_LIST /end MEASUREMENT
/begin MEASUREMENT fFTWCPCCD "A purge cut condition (1) (b) has ever been concluded." UBYTE COMP_0283 1 100 0 1 BIT_MASK 0x0002 ECU_ADDRESS 0xFFFF2484 /begin FUNCTION_LIST /end FUNCTION_LIST /end MEASUREMENT
/begin MEASUREMENT fFTWNXNG "Coolant temperature sensor condition flag" UBYTE COMP_0283 1 100 0 1 BIT_MASK 0x0001 ECU_ADDRESS 0xFFFF2484 /begin FUNCTION_LIST /end FUNCTION_LIST /end MEASUREMENT
/begin MEASUREMENT fFUNLOCKT "The control of the timer which measures actual lockup release delay" UBYTE COMP_0283 1 100 0 1 BIT_MASK 0x0080 ECU_ADDRESS 0xFFFF2485 /begin FUNCTION_LIST /end FUNCTION_LIST /end MEASUREMENT
/begin MEASUREMENT fFVTCKTE "VTC reference angle fixed judgement flag" UBYTE COMP_0283 1 100 0 1 BIT_MASK 0x0020 ECU_ADDRESS 0xFFFF2485 /begin FUNCTION_LIST /end FUNCTION_LIST /end MEASUREMENT
/begin MEASUREMENT fFVTCKTI "VTC reference angle fixed judgement flag" UBYTE COMP_0283 1 100 0 1 BIT_MASK 0x0010 ECU_ADDRESS 0xFFFF2485 /begin FUNCTION_LIST /end FUNCTION_LIST /end MEASUREMENT
/begin MEASUREMENT fFVTCOKI "VTC drive permission condition flag" UBYTE COMP_0283 1 100 0 1 BIT_MASK 0x0002 ECU_ADDRESS 0xFFFF2485 /begin FUNCTION_LIST /end FUNCTION_LIST /end MEASUREMENT
/begin MEASUREMENT fFVTWNID "VTC coolant temperature condition formation switchover flag" UBYTE COMP_0283 1 100 0 1 BIT_MASK 0x0001 ECU_ADDRESS 0xFFFF2485 /begin FUNCTION_LIST /end FUNCTION_LIST /end MEASUREMENT
/begin MEASUREMENT fGNDSLCTW "After the start, during the lean limit expansion system, N-D select flag (to the engine stall judgement)" UBYTE COMP_0283 1 100 0 1 BIT_MASK 0x0040 ECU_ADDRESS 0xFFFF2486 /begin FUNCTION_LIST /end FUNCTION_LIST /end MEASUREMENT
/begin MEASUREMENT fGOVFLAG "GOVDMP decrement treatment executive flag" UBYTE COMP_0283 1 100 0 1 BIT_MASK 0x0010 ECU_ADDRESS 0xFFFF2486 /begin FUNCTION_LIST /end FUNCTION_LIST /end MEASUREMENT
/begin MEASUREMENT fGSCVZ "-" UBYTE COMP_0283 1 100 0 1 BIT_MASK 0x0008 ECU_ADDRESS 0xFFFF2486 /begin FUNCTION_LIST /end FUNCTION_LIST /end MEASUREMENT
/begin MEASUREMENT fHACONPH "Hysteresis flag (HI)" UBYTE COMP_0283 1 100 0 1 BIT_MASK 0x0002 ECU_ADDRESS 0xFFFF2486 /begin FUNCTION_LIST /end FUNCTION_LIST /end MEASUREMENT
/begin MEASUREMENT fHACONPL "Hysteresis flag (LO)" UBYTE COMP_0283 1 100 0 1 BIT_MASK 0x0001 ECU_ADDRESS 0xFFFF2486 /begin FUNCTION_LIST /end FUNCTION_LIST /end MEASUREMENT
/begin MEASUREMENT fHHTQLRN "Compensation quantity operation permission flag" UBYTE COMP_0283 1 100 0 1 BIT_MASK 0x0080 ECU_ADDRESS 0xFFFF2487 /begin FUNCTION_LIST /end FUNCTION_LIST /end MEASUREMENT
/begin MEASUREMENT fHNDLYTWN "NSET00 setup coolant temperature condition hysteresis flag" UBYTE COMP_0283 1 100 0 1 BIT_MASK 0x0020 ECU_ADDRESS 0xFFFF2487 /begin FUNCTION_LIST /end FUNCTION_LIST /end MEASUREMENT
/begin MEASUREMENT fHRVSPH "Hysteresis flag" UBYTE COMP_0283 1 100 0 1 BIT_MASK 0x0010 ECU_ADDRESS 0xFFFF2487 /begin FUNCTION_LIST /end FUNCTION_LIST /end MEASUREMENT
/begin MEASUREMENT fHRVSPL "Hysteresis flag" UBYTE COMP_0283 1 100 0 1 BIT_MASK 0x0008 ECU_ADDRESS 0xFFFF2487 /begin FUNCTION_LIST /end FUNCTION_LIST /end MEASUREMENT
/begin MEASUREMENT fHYNEGR "At the time of the EGR/V breakage, F/C rotation hysteresis flag" UBYTE COMP_0283 1 100 0 1 BIT_MASK 0x0004 ECU_ADDRESS 0xFFFF2487 /begin FUNCTION_LIST /end FUNCTION_LIST /end MEASUREMENT
/begin MEASUREMENT fIDELAYC "Step load control switchover flag" UBYTE COMP_0283 1 100 0 1 BIT_MASK 0x0080 ECU_ADDRESS 0xFFFF2488 /begin FUNCTION_LIST /end FUNCTION_LIST /end MEASUREMENT
/begin MEASUREMENT fIDELAYCZ "Step load control switchover flag (previous value) self-renewal type" UBYTE COMP_0283 1 100 0 1 BIT_MASK 0x0040 ECU_ADDRESS 0xFFFF2488 /begin FUNCTION_LIST /end FUNCTION_LIST /end MEASUREMENT
/begin MEASUREMENT fIDLFCREC "IDLE SW Fuel cut recover judgement by ONOFF" UBYTE COMP_0283 1 100 0 1 BIT_MASK 0x0020 ECU_ADDRESS 0xFFFF2488 /begin FUNCTION_LIST /end FUNCTION_LIST /end MEASUREMENT
/begin MEASUREMENT fIDLOFK "SLPDEC0 operation condition IDLE off experience flag" UBYTE COMP_0283 1 100 0 1 BIT_MASK 0x0010 ECU_ADDRESS 0xFFFF2488 /begin FUNCTION_LIST /end FUNCTION_LIST /end MEASUREMENT
/begin MEASUREMENT fISCACRD "Air-conditioning judgement ON-off delay flag" UBYTE COMP_0283 1 100 0 1 BIT_MASK 0x0002 ECU_ADDRESS 0xFFFF2488 /begin FUNCTION_LIST /end FUNCTION_LIST /end MEASUREMENT
/begin MEASUREMENT fISCID "Idle speed learning value subtraction side renewal delay flag" UBYTE COMP_0283 1 100 0 1 BIT_MASK 0x0001 ECU_ADDRESS 0xFFFF2488 /begin FUNCTION_LIST /end FUNCTION_LIST /end MEASUREMENT
/begin MEASUREMENT fISR1ST "ISC learning operation flag" UBYTE COMP_0283 1 100 0 1 BIT_MASK 0x0008 ECU_ADDRESS 0xFFFF2489 /begin FUNCTION_LIST /end FUNCTION_LIST /end MEASUREMENT
/begin MEASUREMENT fISRBUF "ISC learning condition judgement operation flag" UBYTE COMP_0283 1 100 0 1 BIT_MASK 0x0004 ECU_ADDRESS 0xFFFF2489 /begin FUNCTION_LIST /end FUNCTION_LIST /end MEASUREMENT
/begin MEASUREMENT fISRTM "ISC learning condition judgement operation flag" UBYTE COMP_0283 1 100 0 1 BIT_MASK 0x0002 ECU_ADDRESS 0xFFFF2489 /begin FUNCTION_LIST /end FUNCTION_LIST /end MEASUREMENT
/begin MEASUREMENT fKCADV1ST "KCRADV initialization flag" UBYTE COMP_0283 1 100 0 1 BIT_MASK 0x0001 ECU_ADDRESS 0xFFFF2489 /begin FUNCTION_LIST /end FUNCTION_LIST /end MEASUREMENT
/begin MEASUREMENT fKCRADVON "KCRADV operation executive flag" UBYTE COMP_0283 1 100 0 1 BIT_MASK 0x0080 ECU_ADDRESS 0xFFFF248A /begin FUNCTION_LIST /end FUNCTION_LIST /end MEASUREMENT
/begin MEASUREMENT fKGZAL "KGZ1 addition flag (all half-cylinders cut cylinder recover)" UBYTE COMP_0283 1 100 0 1 BIT_MASK 0x0040 ECU_ADDRESS 0xFFFF248A /begin FUNCTION_LIST /end FUNCTION_LIST /end MEASUREMENT
/begin MEASUREMENT fKGZHF "KGZ1 addition flag (all the cylinder cut half-cylinder recovers)" UBYTE COMP_0283 1 100 0 1 BIT_MASK 0x0020 ECU_ADDRESS 0xFFFF248A /begin FUNCTION_LIST /end FUNCTION_LIST /end MEASUREMENT
/begin MEASUREMENT fKHRPHYS "KHOT operation speed condition judgement flag" UBYTE COMP_0283 1 100 0 1 BIT_MASK 0x0010 ECU_ADDRESS 0xFFFF248A /begin FUNCTION_LIST /end FUNCTION_LIST /end MEASUREMENT
/begin MEASUREMENT fKHTRPTW "KHOT operation condition judgement flag" UBYTE COMP_0283 1 100 0 1 BIT_MASK 0x0008 ECU_ADDRESS 0xFFFF248A /begin FUNCTION_LIST /end FUNCTION_LIST /end MEASUREMENT
/begin MEASUREMENT fKHTTHYS "KHOT operation coolant temperature condition 2 judgement flag" UBYTE COMP_0283 1 100 0 1 BIT_MASK 0x0004 ECU_ADDRESS 0xFFFF248A /begin FUNCTION_LIST /end FUNCTION_LIST /end MEASUREMENT
/begin MEASUREMENT fKHTTRG "KHOT first operation judgement flag" UBYTE COMP_0283 1 100 0 1 BIT_MASK 0x0002 ECU_ADDRESS 0xFFFF248A /begin FUNCTION_LIST /end FUNCTION_LIST /end MEASUREMENT
/begin MEASUREMENT fKHTWHYS "KHOT operation coolant temperature condition 1 judgement flag" UBYTE COMP_0283 1 100 0 1 BIT_MASK 0x0001 ECU_ADDRESS 0xFFFF248A /begin FUNCTION_LIST /end FUNCTION_LIST /end MEASUREMENT
/begin MEASUREMENT fKMRNE3 "KMR delay rotation condition" UBYTE COMP_0283 1 100 0 1 BIT_MASK 0x0020 ECU_ADDRESS 0xFFFF248B /begin FUNCTION_LIST /end FUNCTION_LIST /end MEASUREMENT
/begin MEASUREMENT fKMRNE4 "KMR delay permission condition (lower limit rotation)" UBYTE COMP_0283 1 100 0 1 BIT_MASK 0x0010 ECU_ADDRESS 0xFFFF248B /begin FUNCTION_LIST /end FUNCTION_LIST /end MEASUREMENT
/begin MEASUREMENT fKNKFST "Knock treatment first flag" UBYTE COMP_0283 1 100 0 1 BIT_MASK 0x0008 ECU_ADDRESS 0xFFFF248B /begin FUNCTION_LIST /end FUNCTION_LIST /end MEASUREMENT
/begin MEASUREMENT fKTNDCUT "At the time of KT low oil temperature, at the time of the NDorR select, fuel cut flag" UBYTE COMP_0283 1 100 0 1 BIT_MASK 0x0040 ECU_ADDRESS 0xFFFF248C /begin FUNCTION_LIST /end FUNCTION_LIST /end MEASUREMENT
/begin MEASUREMENT fKTNDJG "At the time of KT low oil temperature, NDorR select tense condition formation flag" UBYTE COMP_0283 1 100 0 1 BIT_MASK 0x0020 ECU_ADDRESS 0xFFFF248C /begin FUNCTION_LIST /end FUNCTION_LIST /end MEASUREMENT
/begin MEASUREMENT fLCCLS "ÉâÉÄÉ_ÉRÉìÉgÉç-Éã CLOSE rest, always, on flag" UBYTE COMP_0283 1 100 0 1 BIT_MASK 0x0010 ECU_ADDRESS 0xFFFF248C /begin FUNCTION_LIST /end FUNCTION_LIST /end MEASUREMENT
/begin MEASUREMENT fLCOPN "ÉâÉÄÉ_ÉRÉìÉgÉç-Éã OPENLOOP flag" UBYTE COMP_0283 1 100 0 1 BIT_MASK 0x0008 ECU_ADDRESS 0xFFFF248C /begin FUNCTION_LIST /end FUNCTION_LIST /end MEASUREMENT
/begin MEASUREMENT fLRCSET "Idle speed learning value addition side renewal flag" UBYTE COMP_0283 1 100 0 1 BIT_MASK 0x0020 ECU_ADDRESS 0xFFFF248D /begin FUNCTION_LIST /end FUNCTION_LIST /end MEASUREMENT
/begin MEASUREMENT fLRCSET2 "Idle speed learning value subtraction side renewal flag" UBYTE COMP_0283 1 100 0 1 BIT_MASK 0x0010 ECU_ADDRESS 0xFFFF248D /begin FUNCTION_LIST /end FUNCTION_LIST /end MEASUREMENT
/begin MEASUREMENT fLRNADP "Idle speed learning value addition side renewal prohibition flag" UBYTE COMP_0283 1 100 0 1 BIT_MASK 0x0008 ECU_ADDRESS 0xFFFF248D /begin FUNCTION_LIST /end FUNCTION_LIST /end MEASUREMENT
/begin MEASUREMENT fLRNANGE "BASOFSE limiter flag" UBYTE COMP_0283 1 100 0 1 BIT_MASK 0x0004 ECU_ADDRESS 0xFFFF248D /begin FUNCTION_LIST /end FUNCTION_LIST /end MEASUREMENT
/begin MEASUREMENT fLRNANGI "BASOFSI limiter flag" UBYTE COMP_0283 1 100 0 1 BIT_MASK 0x0002 ECU_ADDRESS 0xFFFF248D /begin FUNCTION_LIST /end FUNCTION_LIST /end MEASUREMENT
/begin MEASUREMENT fLSLNJP "In the purge, the renewal condition flag of the learning value" UBYTE COMP_0283 1 100 0 1 BIT_MASK 0x0001 ECU_ADDRESS 0xFFFF248D /begin FUNCTION_LIST /end FUNCTION_LIST /end MEASUREMENT
/begin MEASUREMENT fLTIST "Injector magnification compensation table switching judgement condition" UBYTE COMP_0283 1 100 0 1 BIT_MASK 0x0080 ECU_ADDRESS 0xFFFF248E /begin FUNCTION_LIST /end FUNCTION_LIST /end MEASUREMENT
/begin MEASUREMENT fMALPCMP "ALPHA weighted average comparative flag" UBYTE COMP_0283 1 100 0 1 BIT_MASK 0x0020 ECU_ADDRESS 0xFFFF248E /begin FUNCTION_LIST /end FUNCTION_LIST /end MEASUREMENT
/begin MEASUREMENT fMFREQ1 "The formation trigger flag of Q>=MFDTY" UBYTE COMP_0283 1 100 0 1 BIT_MASK 0x0008 ECU_ADDRESS 0xFFFF248E /begin FUNCTION_LIST /end FUNCTION_LIST /end MEASUREMENT
/begin MEASUREMENT fMFREQ2 "The formation trigger flag of Q<MFDTY" UBYTE COMP_0283 1 100 0 1 BIT_MASK 0x0004 ECU_ADDRESS 0xFFFF248E /begin FUNCTION_LIST /end FUNCTION_LIST /end MEASUREMENT
/begin MEASUREMENT fMKSTSW "Minus KTW start" UBYTE COMP_0283 1 100 0 1 BIT_MASK 0x0002 ECU_ADDRESS 0xFFFF248E /begin FUNCTION_LIST /end FUNCTION_LIST /end MEASUREMENT
/begin MEASUREMENT fMKVSP "Minus KTW VSP" UBYTE COMP_0283 1 100 0 1 BIT_MASK 0x0080 ECU_ADDRESS 0xFFFF248F /begin FUNCTION_LIST /end FUNCTION_LIST /end MEASUREMENT
/begin MEASUREMENT fN1000 "N>=1000 experience flag" UBYTE COMP_0283 1 100 0 1 BIT_MASK 0x0040 ECU_ADDRESS 0xFFFF248F /begin FUNCTION_LIST /end FUNCTION_LIST /end MEASUREMENT
/begin MEASUREMENT fNDCUT "N- >D select fuel cut condition" UBYTE COMP_0283 1 100 0 1 BIT_MASK 0x0002 ECU_ADDRESS 0xFFFF248F /begin FUNCTION_LIST /end FUNCTION_LIST /end MEASUREMENT
/begin MEASUREMENT fNEUTDCHG "#NEUTD In the delay which 1->0 limit takes its place of, flag" UBYTE COMP_0283 1 100 0 1 BIT_MASK 0x0001 ECU_ADDRESS 0xFFFF248F /begin FUNCTION_LIST /end FUNCTION_LIST /end MEASUREMENT
/begin MEASUREMENT fNMAX2TM "At the time of the high rotation, all the cylinder condition judgements" UBYTE COMP_0283 1 100 0 1 BIT_MASK 0x0040 ECU_ADDRESS 0xFFFF2490 /begin FUNCTION_LIST /end FUNCTION_LIST /end MEASUREMENT
/begin MEASUREMENT fNSCVOF "SCV rotation judgement hysteresis flag lower limit" UBYTE COMP_0283 1 100 0 1 BIT_MASK 0x0020 ECU_ADDRESS 0xFFFF2490 /begin FUNCTION_LIST /end FUNCTION_LIST /end MEASUREMENT
/begin MEASUREMENT fNSCVON "SCV rotation judgement hysteresis flag upper limit" UBYTE COMP_0283 1 100 0 1 BIT_MASK 0x0010 ECU_ADDRESS 0xFFFF2490 /begin FUNCTION_LIST /end FUNCTION_LIST /end MEASUREMENT
/begin MEASUREMENT fNSETBRK "Brake SW reversal" UBYTE COMP_0283 1 100 0 1 BIT_MASK 0x0008 ECU_ADDRESS 0xFFFF2490 /begin FUNCTION_LIST /end FUNCTION_LIST /end MEASUREMENT
/begin MEASUREMENT fNSETND "NSET0 computed delay flag" UBYTE COMP_0283 1 100 0 1 BIT_MASK 0x0004 ECU_ADDRESS 0xFFFF2490 /begin FUNCTION_LIST /end FUNCTION_LIST /end MEASUREMENT
/begin MEASUREMENT fNSETPWST "Power steering SW reversal" UBYTE COMP_0283 1 100 0 1 BIT_MASK 0x0002 ECU_ADDRESS 0xFFFF2490 /begin FUNCTION_LIST /end FUNCTION_LIST /end MEASUREMENT
/begin MEASUREMENT fNSETRV "Reverse reversal" UBYTE COMP_0283 1 100 0 1 BIT_MASK 0x0001 ECU_ADDRESS 0xFFFF2490 /begin FUNCTION_LIST /end FUNCTION_LIST /end MEASUREMENT
/begin MEASUREMENT fO2HQM40 "SUMQM40 judgement flag" UBYTE COMP_0283 1 100 0 1 BIT_MASK 0x0080 ECU_ADDRESS 0xFFFF2491 /begin FUNCTION_LIST /end FUNCTION_LIST /end MEASUREMENT
/begin MEASUREMENT fO2HRVB "The rest O2 heater control voltage lower limit condition" UBYTE COMP_0283 1 100 0 1 BIT_MASK 0x0008 ECU_ADDRESS 0xFFFF2491 /begin FUNCTION_LIST /end FUNCTION_LIST /end MEASUREMENT
/begin MEASUREMENT fO2HTWN5 "After the start, by the delay progress, 5Åé under the experience" UBYTE COMP_0283 1 100 0 1 BIT_MASK 0x0002 ECU_ADDRESS 0xFFFF2491 /begin FUNCTION_LIST /end FUNCTION_LIST /end MEASUREMENT
/begin MEASUREMENT fO2HTWNCHK "A delay has passed under 5Åé after the experience and the start." UBYTE COMP_0283 1 100 0 1 BIT_MASK 0x0001 ECU_ADDRESS 0xFFFF2491 /begin FUNCTION_LIST /end FUNCTION_LIST /end MEASUREMENT
/begin MEASUREMENT fOPNMOT "Motor drive circuit ON/ off flag" UBYTE COMP_0283 1 100 0 1 BIT_MASK 0x0040 ECU_ADDRESS 0xFFFF2492 /begin FUNCTION_LIST /end FUNCTION_LIST /end MEASUREMENT
/begin MEASUREMENT fOVLOAD1 "The judgement flag that an electric load for the battery charging complete judgement is excessive" UBYTE COMP_0283 1 100 0 1 BIT_MASK 0x0010 ECU_ADDRESS 0xFFFF2492 /begin FUNCTION_LIST /end FUNCTION_LIST /end MEASUREMENT
/begin MEASUREMENT fPBCUT "PB fuel cut" UBYTE COMP_0283 1 100 0 1 BIT_MASK 0x0008 ECU_ADDRESS 0xFFFF2492 /begin FUNCTION_LIST /end FUNCTION_LIST /end MEASUREMENT
/begin MEASUREMENT fPBCUT2 "PB fuel condition formation flag" UBYTE COMP_0283 1 100 0 1 BIT_MASK 0x0004 ECU_ADDRESS 0xFFFF2492 /begin FUNCTION_LIST /end FUNCTION_LIST /end MEASUREMENT
/begin MEASUREMENT fPCUTFLD2 "high load condition n Åã 2" UBYTE COMP_0283 1 100 0 1 BIT_MASK 0x0001 ECU_ADDRESS 0xFFFF2492 /begin FUNCTION_LIST /end FUNCTION_LIST /end MEASUREMENT
/begin MEASUREMENT fPCUTFLD3 "high load condition n Åã 3" UBYTE COMP_0283 1 100 0 1 BIT_MASK 0x0080 ECU_ADDRESS 0xFFFF2493 /begin FUNCTION_LIST /end FUNCTION_LIST /end MEASUREMENT
/begin MEASUREMENT fPDAVOK "A/C load stable distinction flag" UBYTE COMP_0283 1 100 0 1 BIT_MASK 0x0010 ECU_ADDRESS 0xFFFF2494 /begin FUNCTION_LIST /end FUNCTION_LIST /end MEASUREMENT
/begin MEASUREMENT fPFRCF "PFRD computed first flag" UBYTE COMP_0283 1 100 0 1 BIT_MASK 0x0040 ECU_ADDRESS 0xFFFF2495 /begin FUNCTION_LIST /end FUNCTION_LIST /end MEASUREMENT
/begin MEASUREMENT fPGINHAC "Purge control prohibition flag" UBYTE COMP_0283 1 100 0 1 BIT_MASK 0x0020 ECU_ADDRESS 0xFFFF2495 /begin FUNCTION_LIST /end FUNCTION_LIST /end MEASUREMENT
/begin MEASUREMENT fPGINHCK "Purge control prohibition sub-flag" UBYTE COMP_0283 1 100 0 1 BIT_MASK 0x0010 ECU_ADDRESS 0xFFFF2495 /begin FUNCTION_LIST /end FUNCTION_LIST /end MEASUREMENT
/begin MEASUREMENT fPGINHE "Purge control prohibition flag" UBYTE COMP_0283 1 100 0 1 BIT_MASK 0x0008 ECU_ADDRESS 0xFFFF2495 /begin FUNCTION_LIST /end FUNCTION_LIST /end MEASUREMENT
/begin MEASUREMENT fPGUSUL "Usually, purge control upper limit value limitation judgement" UBYTE COMP_0283 1 100 0 1 BIT_MASK 0x0004 ECU_ADDRESS 0xFFFF2495 /begin FUNCTION_LIST /end FUNCTION_LIST /end MEASUREMENT
/begin MEASUREMENT fPHOPSH "At the time of the Phase start, at the time of breakage diagnosis ÅEPhase usual, at the time of the breakage diagnosis NG judgement, all the cylinder ignition flags" UBYTE COMP_0283 1 100 0 1 BIT_MASK 0x0002 ECU_ADDRESS 0xFFFF2495 /begin FUNCTION_LIST /end FUNCTION_LIST /end MEASUREMENT
/begin MEASUREMENT fPOWRMODE "Power mode" UBYTE COMP_0283 1 100 0 1 BIT_MASK 0x0010 ECU_ADDRESS 0xFFFF2496 /begin FUNCTION_LIST /end FUNCTION_LIST /end MEASUREMENT
/begin MEASUREMENT fPRDYMEM "M>=PREOK#, PREDLY# experience judgement" UBYTE COMP_0283 1 100 0 1 BIT_MASK 0x0008 ECU_ADDRESS 0xFFFF2496 /begin FUNCTION_LIST /end FUNCTION_LIST /end MEASUREMENT
/begin MEASUREMENT fPRSNGDO "Absolute pressure sensor diagnosis NG flag" UBYTE COMP_0283 1 100 0 1 BIT_MASK 0x0004 ECU_ADDRESS 0xFFFF2496 /begin FUNCTION_LIST /end FUNCTION_LIST /end MEASUREMENT
/begin MEASUREMENT fPRSNGDS "Absolute pressure sensor diagnosis NG flag" UBYTE COMP_0283 1 100 0 1 BIT_MASK 0x0002 ECU_ADDRESS 0xFFFF2496 /begin FUNCTION_LIST /end FUNCTION_LIST /end MEASUREMENT
/begin MEASUREMENT fPTNCUT "T/M requirement fuel cut control judgement flag" UBYTE COMP_0283 1 100 0 1 BIT_MASK 0x0020 ECU_ADDRESS 0xFFFF2497 /begin FUNCTION_LIST /end FUNCTION_LIST /end MEASUREMENT
/begin MEASUREMENT fPVTCTRGI "The test requirement intake side where an electromagnetic type is active" UBYTE COMP_0283 1 100 0 1 BIT_MASK 0x0008 ECU_ADDRESS 0xFFFF2497 /begin FUNCTION_LIST /end FUNCTION_LIST /end MEASUREMENT
/begin MEASUREMENT fQBCCON "QBC control-in-progress flag" UBYTE COMP_0283 1 100 0 1 BIT_MASK 0x0004 ECU_ADDRESS 0xFFFF2497 /begin FUNCTION_LIST /end FUNCTION_LIST /end MEASUREMENT
/begin MEASUREMENT fQBCOFF "QBC control-in-progress flag" UBYTE COMP_0283 1 100 0 1 BIT_MASK 0x0002 ECU_ADDRESS 0xFFFF2497 /begin FUNCTION_LIST /end FUNCTION_LIST /end MEASUREMENT
/begin MEASUREMENT fQDSPTBL "QDSPT table select" UBYTE COMP_0283 1 100 0 1 BIT_MASK 0x0001 ECU_ADDRESS 0xFFFF2497 /begin FUNCTION_LIST /end FUNCTION_LIST /end MEASUREMENT
/begin MEASUREMENT fQFBIHOJI "QFBI maintenance flag" UBYTE COMP_0283 1 100 0 1 BIT_MASK 0x0080 ECU_ADDRESS 0xFFFF2498 /begin FUNCTION_LIST /end FUNCTION_LIST /end MEASUREMENT
/begin MEASUREMENT fQH0TMP "Interruption injection condition áA (i) formation flag" UBYTE COMP_0283 1 100 0 1 BIT_MASK 0x0040 ECU_ADDRESS 0xFFFF2498 /begin FUNCTION_LIST /end FUNCTION_LIST /end MEASUREMENT
/begin MEASUREMENT fQTASED "After learning, treatment condition" UBYTE COMP_0283 1 100 0 1 BIT_MASK 0x0020 ECU_ADDRESS 0xFFFF2498 /begin FUNCTION_LIST /end FUNCTION_LIST /end MEASUREMENT
/begin MEASUREMENT fQTASST "Former treatment condition to learn" UBYTE COMP_0283 1 100 0 1 BIT_MASK 0x0010 ECU_ADDRESS 0xFFFF2498 /begin FUNCTION_LIST /end FUNCTION_LIST /end MEASUREMENT
/begin MEASUREMENT fRACRLY "Rear air-conditioning relay flag" UBYTE COMP_0283 1 100 0 1 BIT_MASK 0x0008 ECU_ADDRESS 0xFFFF2498 /begin FUNCTION_LIST /end FUNCTION_LIST /end MEASUREMENT
/begin MEASUREMENT fRECGAK2 "GAK2 addition condition fuel cut recover flag" UBYTE COMP_0283 1 100 0 1 BIT_MASK 0x0004 ECU_ADDRESS 0xFFFF2498 /begin FUNCTION_LIST /end FUNCTION_LIST /end MEASUREMENT
/begin MEASUREMENT fRECGALL "GAK2 addition flag (for all the cylinders)" UBYTE COMP_0283 1 100 0 1 BIT_MASK 0x0002 ECU_ADDRESS 0xFFFF2498 /begin FUNCTION_LIST /end FUNCTION_LIST /end MEASUREMENT
/begin MEASUREMENT fRECGHALF "GAK2 addition flag (for the half-cylinder)" UBYTE COMP_0283 1 100 0 1 BIT_MASK 0x0001 ECU_ADDRESS 0xFFFF2498 /begin FUNCTION_LIST /end FUNCTION_LIST /end MEASUREMENT
/begin MEASUREMENT fREGJUD "A regular for the W/G solenoid, high-octane condition judgement" UBYTE COMP_0283 1 100 0 1 BIT_MASK 0x0080 ECU_ADDRESS 0xFFFF2499 /begin FUNCTION_LIST /end FUNCTION_LIST /end MEASUREMENT
/begin MEASUREMENT fREQIUP "Idle rise requirement condition judgement" UBYTE COMP_0283 1 100 0 1 BIT_MASK 0x0040 ECU_ADDRESS 0xFFFF2499 /begin FUNCTION_LIST /end FUNCTION_LIST /end MEASUREMENT
/begin MEASUREMENT fRFOEVPRD "A purge cut condition (5) ' has ever come into being." UBYTE COMP_0283 1 100 0 1 BIT_MASK 0x0004 ECU_ADDRESS 0xFFFF2499 /begin FUNCTION_LIST /end FUNCTION_LIST /end MEASUREMENT
/begin MEASUREMENT fRFTWH "RFN For the SW operation" UBYTE COMP_0283 1 100 0 1 BIT_MASK 0x0001 ECU_ADDRESS 0xFFFF2499 /begin FUNCTION_LIST /end FUNCTION_LIST /end MEASUREMENT
/begin MEASUREMENT fRFTWL "RFN For the SW operation" UBYTE COMP_0283 1 100 0 1 BIT_MASK 0x0040 ECU_ADDRESS 0xFFFF249A /begin FUNCTION_LIST /end FUNCTION_LIST /end MEASUREMENT
/begin MEASUREMENT fRGOFFST "Beginning NSET0 acquisition completion flag" UBYTE COMP_0283 1 100 0 1 BIT_MASK 0x0020 ECU_ADDRESS 0xFFFF249A /begin FUNCTION_LIST /end FUNCTION_LIST /end MEASUREMENT
/begin MEASUREMENT fRPMCMP "Engine speed comparative flag" UBYTE COMP_0283 1 100 0 1 BIT_MASK 0x0002 ECU_ADDRESS 0xFFFF249A /begin FUNCTION_LIST /end FUNCTION_LIST /end MEASUREMENT
/begin MEASUREMENT fRPMFCREC "A fuel cut recover judgement due to speed decline" UBYTE COMP_0283 1 100 0 1 BIT_MASK 0x0001 ECU_ADDRESS 0xFFFF249A /begin FUNCTION_LIST /end FUNCTION_LIST /end MEASUREMENT
/begin MEASUREMENT fRSPIKEFC "A fuel cut judgement for the rich spike" UBYTE COMP_0283 1 100 0 1 BIT_MASK 0x0040 ECU_ADDRESS 0xFFFF249B /begin FUNCTION_LIST /end FUNCTION_LIST /end MEASUREMENT
/begin MEASUREMENT fSMTTM "Electric engine mount control condition judgement áD condition" UBYTE COMP_0283 1 100 0 1 BIT_MASK 0x0010 ECU_ADDRESS 0xFFFF249B /begin FUNCTION_LIST /end FUNCTION_LIST /end MEASUREMENT
/begin MEASUREMENT fSOKTPFC "Catalyst protection fuel cut" UBYTE COMP_0283 1 100 0 1 BIT_MASK 0x0004 ECU_ADDRESS 0xFFFF249B /begin FUNCTION_LIST /end FUNCTION_LIST /end MEASUREMENT
/begin MEASUREMENT fST2NTP "Stage 2 diagnosis region condition flag" UBYTE COMP_0283 1 100 0 1 BIT_MASK 0x0001 ECU_ADDRESS 0xFFFF249B /begin FUNCTION_LIST /end FUNCTION_LIST /end MEASUREMENT
/begin MEASUREMENT fSTARTFC "At the time of the start, during the fuel cut, judgement flag" UBYTE COMP_0283 1 100 0 1 BIT_MASK 0x0080 ECU_ADDRESS 0xFFFF249C /begin FUNCTION_LIST /end FUNCTION_LIST /end MEASUREMENT
/begin MEASUREMENT fSTEPFK "Step load control flag" UBYTE COMP_0283 1 100 0 1 BIT_MASK 0x0020 ECU_ADDRESS 0xFFFF249C /begin FUNCTION_LIST /end FUNCTION_LIST /end MEASUREMENT
/begin MEASUREMENT fSTOKTM "Battery charging complete judgement flag" UBYTE COMP_0283 1 100 0 1 BIT_MASK 0x0010 ECU_ADDRESS 0xFFFF249C /begin FUNCTION_LIST /end FUNCTION_LIST /end MEASUREMENT
/begin MEASUREMENT fSTPHYS "Hysteresis flag" UBYTE COMP_0283 1 100 0 1 BIT_MASK 0x0008 ECU_ADDRESS 0xFFFF249C /begin FUNCTION_LIST /end FUNCTION_LIST /end MEASUREMENT
/begin MEASUREMENT fSTPHYSL "Hysteresis flag" UBYTE COMP_0283 1 100 0 1 BIT_MASK 0x0004 ECU_ADDRESS 0xFFFF249C /begin FUNCTION_LIST /end FUNCTION_LIST /end MEASUREMENT
/begin MEASUREMENT fSTRTONOF "START SW On    off experience flag" UBYTE COMP_0283 1 100 0 1 BIT_MASK 0x0002 ECU_ADDRESS 0xFFFF249C /begin FUNCTION_LIST /end FUNCTION_LIST /end MEASUREMENT
/begin MEASUREMENT fSTSTATOF "The ONOFF experience flag of STSW" UBYTE COMP_0283 1 100 0 1 BIT_MASK 0x0001 ECU_ADDRESS 0xFFFF249C /begin FUNCTION_LIST /end FUNCTION_LIST /end MEASUREMENT
/begin MEASUREMENT fSTSWEX "ST SW experience flag" UBYTE COMP_0283 1 100 0 1 BIT_MASK 0x0080 ECU_ADDRESS 0xFFFF249D /begin FUNCTION_LIST /end FUNCTION_LIST /end MEASUREMENT
/begin MEASUREMENT fSYSNGD "System diagnosis NG judgement flag" UBYTE COMP_0283 1 100 0 1 BIT_MASK 0x0010 ECU_ADDRESS 0xFFFF249D /begin FUNCTION_LIST /end FUNCTION_LIST /end MEASUREMENT
/begin MEASUREMENT fSYSOKD "System diagnosis OK judgement flag" UBYTE COMP_0283 1 100 0 1 BIT_MASK 0x0008 ECU_ADDRESS 0xFFFF249D /begin FUNCTION_LIST /end FUNCTION_LIST /end MEASUREMENT
/begin MEASUREMENT fTASKDGNST "Task periodic order diagnosis condition formation flag" UBYTE COMP_0283 1 100 0 1 BIT_MASK 0x0002 ECU_ADDRESS 0xFFFF249D /begin FUNCTION_LIST /end FUNCTION_LIST /end MEASUREMENT
/begin MEASUREMENT fTCANDCNT "Between TCANDYs, formation flag" UBYTE COMP_0283 1 100 0 1 BIT_MASK 0x0001 ECU_ADDRESS 0xFFFF249D /begin FUNCTION_LIST /end FUNCTION_LIST /end MEASUREMENT
/begin MEASUREMENT fTFAHYS "TFBYA0 hysteresis (OUT : 0/IN:1)" UBYTE COMP_0283 1 100 0 1 BIT_MASK 0x0040 ECU_ADDRESS 0xFFFF249E /begin FUNCTION_LIST /end FUNCTION_LIST /end MEASUREMENT
/begin MEASUREMENT fTFDAP "The change quantity control timing of TFBYA" UBYTE COMP_0283 1 100 0 1 BIT_MASK 0x0020 ECU_ADDRESS 0xFFFF249E /begin FUNCTION_LIST /end FUNCTION_LIST /end MEASUREMENT
/begin MEASUREMENT fTFDTWIN "vTWINTF initialization completion flag" UBYTE COMP_0283 1 100 0 1 BIT_MASK 0x0010 ECU_ADDRESS 0xFFFF249E /begin FUNCTION_LIST /end FUNCTION_LIST /end MEASUREMENT
/begin MEASUREMENT fTFNCMP "Fuel temperature comparative flag" UBYTE COMP_0283 1 100 0 1 BIT_MASK 0x0008 ECU_ADDRESS 0xFFFF249E /begin FUNCTION_LIST /end FUNCTION_LIST /end MEASUREMENT
/begin MEASUREMENT fTGALP "Purge gain learning value initialization" UBYTE COMP_0283 1 100 0 1 BIT_MASK 0x0004 ECU_ADDRESS 0xFFFF249E /begin FUNCTION_LIST /end FUNCTION_LIST /end MEASUREMENT
/begin MEASUREMENT fTMDTD1 "Torque down time measurement 1 flag" UBYTE COMP_0283 1 100 0 1 BIT_MASK 0x0002 ECU_ADDRESS 0xFFFF249E /begin FUNCTION_LIST /end FUNCTION_LIST /end MEASUREMENT
/begin MEASUREMENT fTMDTD2 "Torque down time measurement 2 flag" UBYTE COMP_0283 1 100 0 1 BIT_MASK 0x0001 ECU_ADDRESS 0xFFFF249E /begin FUNCTION_LIST /end FUNCTION_LIST /end MEASUREMENT
/begin MEASUREMENT fTMOBEV "After the heat resisting purge cut, time formation flag" UBYTE COMP_0283 1 100 0 1 BIT_MASK 0x0010 ECU_ADDRESS 0xFFFF249F /begin FUNCTION_LIST /end FUNCTION_LIST /end MEASUREMENT
/begin MEASUREMENT fTPCMP "Cylinder intake quantity equivalent pulse width comparative flag" UBYTE COMP_0283 1 100 0 1 BIT_MASK 0x0004 ECU_ADDRESS 0xFFFF249F /begin FUNCTION_LIST /end FUNCTION_LIST /end MEASUREMENT
/begin MEASUREMENT fTPCUT "TP fuel cut" UBYTE COMP_0283 1 100 0 1 BIT_MASK 0x0002 ECU_ADDRESS 0xFFFF249F /begin FUNCTION_LIST /end FUNCTION_LIST /end MEASUREMENT
/begin MEASUREMENT fTPCUT2 "TP fuel condition formation flag" UBYTE COMP_0283 1 100 0 1 BIT_MASK 0x0001 ECU_ADDRESS 0xFFFF249F /begin FUNCTION_LIST /end FUNCTION_LIST /end MEASUREMENT
/begin MEASUREMENT fTPSCV1 "SCVTP condition 1 judgement flag" UBYTE COMP_0283 1 100 0 1 BIT_MASK 0x0080 ECU_ADDRESS 0xFFFF24A0 /begin FUNCTION_LIST /end FUNCTION_LIST /end MEASUREMENT
/begin MEASUREMENT fTPSCV2 "SCVTP condition 2 judgement flag" UBYTE COMP_0283 1 100 0 1 BIT_MASK 0x0040 ECU_ADDRESS 0xFFFF24A0 /begin FUNCTION_LIST /end FUNCTION_LIST /end MEASUREMENT
/begin MEASUREMENT fTPSSNG1 "TPS Single trouble judgement flag previous value (MAIN)" UBYTE COMP_0283 1 100 0 1 BIT_MASK 0x0020 ECU_ADDRESS 0xFFFF24A0 /begin FUNCTION_LIST /end FUNCTION_LIST /end MEASUREMENT
/begin MEASUREMENT fTPSXNG1 "TPS Single trouble judgement self-diagnosis flag previous value (MAIN)" UBYTE COMP_0283 1 100 0 1 BIT_MASK 0x0010 ECU_ADDRESS 0xFFFF24A0 /begin FUNCTION_LIST /end FUNCTION_LIST /end MEASUREMENT
/begin MEASUREMENT fTQDNEDCK "Torque going down control condition completion treatment choice flag" UBYTE COMP_0283 1 100 0 1 BIT_MASK 0x0008 ECU_ADDRESS 0xFFFF24A0 /begin FUNCTION_LIST /end FUNCTION_LIST /end MEASUREMENT
/begin MEASUREMENT fTTEFST "TTETBL first confirmation flag" UBYTE COMP_0283 1 100 0 1 BIT_MASK 0x0001 ECU_ADDRESS 0xFFFF24A0 /begin FUNCTION_LIST /end FUNCTION_LIST /end MEASUREMENT
/begin MEASUREMENT fTVSCV1 "SCVTVO condition judgement flag" UBYTE COMP_0283 1 100 0 1 BIT_MASK 0x0040 ECU_ADDRESS 0xFFFF24A1 /begin FUNCTION_LIST /end FUNCTION_LIST /end MEASUREMENT
/begin MEASUREMENT fTWCMPA "Intermadiate coolant temperature retard addition judgement coolant temperature difference flag" UBYTE COMP_0283 1 100 0 1 BIT_MASK 0x0020 ECU_ADDRESS 0xFFFF24A1 /begin FUNCTION_LIST /end FUNCTION_LIST /end MEASUREMENT
/begin MEASUREMENT fTWCMPF "First idle retard addition judgement coolant temperature difference flag" UBYTE COMP_0283 1 100 0 1 BIT_MASK 0x0010 ECU_ADDRESS 0xFFFF24A1 /begin FUNCTION_LIST /end FUNCTION_LIST /end MEASUREMENT
/begin MEASUREMENT fTWHEGR "Hysteresis flag" UBYTE COMP_0283 1 100 0 1 BIT_MASK 0x0008 ECU_ADDRESS 0xFFFF24A1 /begin FUNCTION_LIST /end FUNCTION_LIST /end MEASUREMENT
/begin MEASUREMENT fTWLEGR "Hysteresis flag" UBYTE COMP_0283 1 100 0 1 BIT_MASK 0x0040 ECU_ADDRESS 0xFFFF24A2 /begin FUNCTION_LIST /end FUNCTION_LIST /end MEASUREMENT
/begin MEASUREMENT fTWSCV1 "SCV coolant temperature condition 1 judgement flag" UBYTE COMP_0283 1 100 0 1 BIT_MASK 0x0001 ECU_ADDRESS 0xFFFF24A2 /begin FUNCTION_LIST /end FUNCTION_LIST /end MEASUREMENT
/begin MEASUREMENT fTWSCV1H "A hysteresis flag for the SCV coolant temperature judgement" UBYTE COMP_0283 1 100 0 1 BIT_MASK 0x0080 ECU_ADDRESS 0xFFFF24A3 /begin FUNCTION_LIST /end FUNCTION_LIST /end MEASUREMENT
/begin MEASUREMENT fTWSCV1L "A hysteresis flag for the SCV coolant temperature judgement" UBYTE COMP_0283 1 100 0 1 BIT_MASK 0x0040 ECU_ADDRESS 0xFFFF24A3 /begin FUNCTION_LIST /end FUNCTION_LIST /end MEASUREMENT
/begin MEASUREMENT fTWSCV2H "A hysteresis flag for the SCV coolant temperature judgement" UBYTE COMP_0283 1 100 0 1 BIT_MASK 0x0020 ECU_ADDRESS 0xFFFF24A3 /begin FUNCTION_LIST /end FUNCTION_LIST /end MEASUREMENT
/begin MEASUREMENT fTWSCV2L "A hysteresis flag for the SCV coolant temperature judgement" UBYTE COMP_0283 1 100 0 1 BIT_MASK 0x0010 ECU_ADDRESS 0xFFFF24A3 /begin FUNCTION_LIST /end FUNCTION_LIST /end MEASUREMENT
/begin MEASUREMENT fTWSCV3 "SCV coolant temperature condition 3 judgement flag" UBYTE COMP_0283 1 100 0 1 BIT_MASK 0x0008 ECU_ADDRESS 0xFFFF24A3 /begin FUNCTION_LIST /end FUNCTION_LIST /end MEASUREMENT
/begin MEASUREMENT fTWSCV4 "SCV coolant temperature condition 4 judgement flag" UBYTE COMP_0283 1 100 0 1 BIT_MASK 0x0004 ECU_ADDRESS 0xFFFF24A3 /begin FUNCTION_LIST /end FUNCTION_LIST /end MEASUREMENT
/begin MEASUREMENT fTWWGH "A coolant temperature judgement (High) for the W/G solenoid" UBYTE COMP_0283 1 100 0 1 BIT_MASK 0x0002 ECU_ADDRESS 0xFFFF24A3 /begin FUNCTION_LIST /end FUNCTION_LIST /end MEASUREMENT
/begin MEASUREMENT fTWWGHJ "A coolant temperature condition judgement (High) for the W/G solenoid" UBYTE COMP_0283 1 100 0 1 BIT_MASK 0x0001 ECU_ADDRESS 0xFFFF24A3 /begin FUNCTION_LIST /end FUNCTION_LIST /end MEASUREMENT
/begin MEASUREMENT fTWWGL "A coolant temperature judgement (Low) for the W/G solenoid" UBYTE COMP_0283 1 100 0 1 BIT_MASK 0x0080 ECU_ADDRESS 0xFFFF24A4 /begin FUNCTION_LIST /end FUNCTION_LIST /end MEASUREMENT
/begin MEASUREMENT fTWWGLJ "A coolant temperature condition judgement (Low) for the W/G solenoid" UBYTE COMP_0283 1 100 0 1 BIT_MASK 0x0040 ECU_ADDRESS 0xFFFF24A4 /begin FUNCTION_LIST /end FUNCTION_LIST /end MEASUREMENT
/begin MEASUREMENT fVBEGOF01 "-" UBYTE COMP_0283 1 100 0 1 BIT_MASK 0x0020 ECU_ADDRESS 0xFFFF24A4 /begin FUNCTION_LIST /end FUNCTION_LIST /end MEASUREMENT
/begin MEASUREMENT fVCKBLHHY "(CK) After the dealing with the belt slide is controlled, a hysteresis flag for the accelerator open-degree operation" UBYTE COMP_0283 1 100 0 1 BIT_MASK 0x0010 ECU_ADDRESS 0xFFFF24A4 /begin FUNCTION_LIST /end FUNCTION_LIST /end MEASUREMENT
/begin MEASUREMENT fVCKBLLHY "(CK) After the dealing with the belt slide is controlled, a hysteresis flag for the accelerator open-degree operation" UBYTE COMP_0283 1 100 0 1 BIT_MASK 0x0008 ECU_ADDRESS 0xFFFF24A4 /begin FUNCTION_LIST /end FUNCTION_LIST /end MEASUREMENT
/begin MEASUREMENT fVCSHOTON "VCSHOT set judgement flag" UBYTE COMP_0283 1 100 0 1 BIT_MASK 0x0001 ECU_ADDRESS 0xFFFF24A4 /begin FUNCTION_LIST /end FUNCTION_LIST /end MEASUREMENT
/begin MEASUREMENT fVIAHN1 "VIASN1# hysteresis judgement" UBYTE COMP_0283 1 100 0 1 BIT_MASK 0x0080 ECU_ADDRESS 0xFFFF24A5 /begin FUNCTION_LIST /end FUNCTION_LIST /end MEASUREMENT
/begin MEASUREMENT fVIAHN2 "VIASN2# hysteresis judgement" UBYTE COMP_0283 1 100 0 1 BIT_MASK 0x0040 ECU_ADDRESS 0xFFFF24A5 /begin FUNCTION_LIST /end FUNCTION_LIST /end MEASUREMENT
/begin MEASUREMENT fVIAHN4 "400rpm hysteresis judgement" UBYTE COMP_0283 1 100 0 1 BIT_MASK 0x0020 ECU_ADDRESS 0xFFFF24A5 /begin FUNCTION_LIST /end FUNCTION_LIST /end MEASUREMENT
/begin MEASUREMENT fVIAHTP1 "VIAST1# hysteresis judgement" UBYTE COMP_0283 1 100 0 1 BIT_MASK 0x0010 ECU_ADDRESS 0xFFFF24A5 /begin FUNCTION_LIST /end FUNCTION_LIST /end MEASUREMENT
/begin MEASUREMENT fVIAHTP2 "VIAST2# hysteresis judgement" UBYTE COMP_0283 1 100 0 1 BIT_MASK 0x0008 ECU_ADDRESS 0xFFFF24A5 /begin FUNCTION_LIST /end FUNCTION_LIST /end MEASUREMENT
/begin MEASUREMENT fVIAHTW "VIASTW# hysteresis judgement" UBYTE COMP_0283 1 100 0 1 BIT_MASK 0x0004 ECU_ADDRESS 0xFFFF24A5 /begin FUNCTION_LIST /end FUNCTION_LIST /end MEASUREMENT
/begin MEASUREMENT fVSP20 "For the radiator fan control" UBYTE COMP_0283 1 100 0 1 BIT_MASK 0x0002 ECU_ADDRESS 0xFFFF24A5 /begin FUNCTION_LIST /end FUNCTION_LIST /end MEASUREMENT
/begin MEASUREMENT fVSP80 "For the radiator fan control" UBYTE COMP_0283 1 100 0 1 BIT_MASK 0x0001 ECU_ADDRESS 0xFFFF24A5 /begin FUNCTION_LIST /end FUNCTION_LIST /end MEASUREMENT
/begin MEASUREMENT fVSPCMP "Vehicle speed comparative flag" UBYTE COMP_0283 1 100 0 1 BIT_MASK 0x0080 ECU_ADDRESS 0xFFFF24A6 /begin FUNCTION_LIST /end FUNCTION_LIST /end MEASUREMENT
/begin MEASUREMENT fVSPCT2TM "At the time of the high vehicle speed, all the cylinder delay judgements" UBYTE COMP_0283 1 100 0 1 BIT_MASK 0x0020 ECU_ADDRESS 0xFFFF24A6 /begin FUNCTION_LIST /end FUNCTION_LIST /end MEASUREMENT
/begin MEASUREMENT fVSPREC "At the time of the high rotation, all the cylinder recovers" UBYTE COMP_0283 1 100 0 1 BIT_MASK 0x0008 ECU_ADDRESS 0xFFFF24A6 /begin FUNCTION_LIST /end FUNCTION_LIST /end MEASUREMENT
/begin MEASUREMENT fVTBSNEHE "LNRPM<=VTBSNEH# (hysteresis ÅE200 rpm)" UBYTE COMP_0283 1 100 0 1 BIT_MASK 0x0004 ECU_ADDRESS 0xFFFF24A6 /begin FUNCTION_LIST /end FUNCTION_LIST /end MEASUREMENT
/begin MEASUREMENT fVTCACT "VTTRGI>=VTCACT# (hysteresis-HYVTAC#)" UBYTE COMP_0283 1 100 0 1 BIT_MASK 0x0002 ECU_ADDRESS 0xFFFF24A6 /begin FUNCTION_LIST /end FUNCTION_LIST /end MEASUREMENT
/begin MEASUREMENT fVTCACTE "VTTRGE>=VTCACT# (hysteresis-HYVTAC#)" UBYTE COMP_0283 1 100 0 1 BIT_MASK 0x0001 ECU_ADDRESS 0xFFFF24A6 /begin FUNCTION_LIST /end FUNCTION_LIST /end MEASUREMENT
/begin MEASUREMENT fVTCIPR "I-gain renewal prohibition judgement" UBYTE COMP_0283 1 100 0 1 BIT_MASK 0x0040 ECU_ADDRESS 0xFFFF24A7 /begin FUNCTION_LIST /end FUNCTION_LIST /end MEASUREMENT
/begin MEASUREMENT fVTCLRNJE "VTC maximum-retard degree position learning condition (1 - 4) flag" UBYTE COMP_0283 1 100 0 1 BIT_MASK 0x0020 ECU_ADDRESS 0xFFFF24A7 /begin FUNCTION_LIST /end FUNCTION_LIST /end MEASUREMENT
/begin MEASUREMENT fVTCLRNJG "VTC maximum-retard degree position learning condition judgement flag" UBYTE COMP_0283 1 100 0 1 BIT_MASK 0x0010 ECU_ADDRESS 0xFFFF24A7 /begin FUNCTION_LIST /end FUNCTION_LIST /end MEASUREMENT
/begin MEASUREMENT fVTCLRNJI "VTC maximum-retard degree position learning condition (1 - 4) flag" UBYTE COMP_0283 1 100 0 1 BIT_MASK 0x0008 ECU_ADDRESS 0xFFFF24A7 /begin FUNCTION_LIST /end FUNCTION_LIST /end MEASUREMENT
/begin MEASUREMENT fVTCNEHE "VTC drive diagnosis permission engine speed upper limit" UBYTE COMP_0283 1 100 0 1 BIT_MASK 0x0004 ECU_ADDRESS 0xFFFF24A7 /begin FUNCTION_LIST /end FUNCTION_LIST /end MEASUREMENT
/begin MEASUREMENT fVTCNEHI "VTC drive diagnosis permission engine speed upper limit" UBYTE COMP_0283 1 100 0 1 BIT_MASK 0x0002 ECU_ADDRESS 0xFFFF24A7 /begin FUNCTION_LIST /end FUNCTION_LIST /end MEASUREMENT
/begin MEASUREMENT fVTCNELE "VTC drive diagnosis permission engine speed lower limit" UBYTE COMP_0283 1 100 0 1 BIT_MASK 0x0080 ECU_ADDRESS 0xFFFF24A8 /begin FUNCTION_LIST /end FUNCTION_LIST /end MEASUREMENT
/begin MEASUREMENT fVTCNELI "VTC drive diagnosis permission engine speed lower limit" UBYTE COMP_0283 1 100 0 1 BIT_MASK 0x0040 ECU_ADDRESS 0xFFFF24A8 /begin FUNCTION_LIST /end FUNCTION_LIST /end MEASUREMENT
/begin MEASUREMENT fVTCNELV "VTC drive permission engine rotation lower limit judgement (at the time of mVTCVSPL>wvVSP)" UBYTE COMP_0283 1 100 0 1 BIT_MASK 0x0020 ECU_ADDRESS 0xFFFF24A8 /begin FUNCTION_LIST /end FUNCTION_LIST /end MEASUREMENT
/begin MEASUREMENT fVTCTWHDE "TWN<=VTCTWH# (hysteresis ÅE3Åé)" UBYTE COMP_0283 1 100 0 1 BIT_MASK 0x0004 ECU_ADDRESS 0xFFFF24A8 /begin FUNCTION_LIST /end FUNCTION_LIST /end MEASUREMENT
/begin MEASUREMENT fVTCTWHE "VTC drive diagnosis permission coolant temperature upper limit" UBYTE COMP_0283 1 100 0 1 BIT_MASK 0x0002 ECU_ADDRESS 0xFFFF24A8 /begin FUNCTION_LIST /end FUNCTION_LIST /end MEASUREMENT
/begin MEASUREMENT fVTCTWHI "VTC drive diagnosis permission coolant temperature upper limit" UBYTE COMP_0283 1 100 0 1 BIT_MASK 0x0001 ECU_ADDRESS 0xFFFF24A8 /begin FUNCTION_LIST /end FUNCTION_LIST /end MEASUREMENT
/begin MEASUREMENT fVTCTWLDE "VTCTWL#<TWN (hysteresis -3Åé)" UBYTE COMP_0283 1 100 0 1 BIT_MASK 0x0040 ECU_ADDRESS 0xFFFF24A9 /begin FUNCTION_LIST /end FUNCTION_LIST /end MEASUREMENT
/begin MEASUREMENT fVTCTWLE "VTC drive diagnosis permission coolant temperature lower limit" UBYTE COMP_0283 1 100 0 1 BIT_MASK 0x0020 ECU_ADDRESS 0xFFFF24A9 /begin FUNCTION_LIST /end FUNCTION_LIST /end MEASUREMENT
/begin MEASUREMENT fVTCTWLI "VTC drive diagnosis permission coolant temperature lower limit" UBYTE COMP_0283 1 100 0 1 BIT_MASK 0x0010 ECU_ADDRESS 0xFFFF24A9 /begin FUNCTION_LIST /end FUNCTION_LIST /end MEASUREMENT
/begin MEASUREMENT fVTCVSPL "VTC drive permission engine rotation lower limit switching vehicle speed judgement" UBYTE COMP_0283 1 100 0 1 BIT_MASK 0x0002 ECU_ADDRESS 0xFFFF24A9 /begin FUNCTION_LIST /end FUNCTION_LIST /end MEASUREMENT
/begin MEASUREMENT fVTINELE "VTC alignment check diagnosis permission engine speed lower limit (for idle éû)" UBYTE COMP_0283 1 100 0 1 BIT_MASK 0x0001 ECU_ADDRESS 0xFFFF24A9 /begin FUNCTION_LIST /end FUNCTION_LIST /end MEASUREMENT
/begin MEASUREMENT fVTINELI "VTC alignment check diagnosis permission engine speed lower limit (for idle éû)" UBYTE COMP_0283 1 100 0 1 BIT_MASK 0x0080 ECU_ADDRESS 0xFFFF24AA /begin FUNCTION_LIST /end FUNCTION_LIST /end MEASUREMENT
/begin MEASUREMENT fVTITWLE "VTC alignment check diagnosis permission coolant temperature lower limit (for idle éû)" UBYTE COMP_0283 1 100 0 1 BIT_MASK 0x0040 ECU_ADDRESS 0xFFFF24AA /begin FUNCTION_LIST /end FUNCTION_LIST /end MEASUREMENT
/begin MEASUREMENT fVTITWLI "VTC alignment check diagnosis permission coolant temperature lower limit (for idle éû)" UBYTE COMP_0283 1 100 0 1 BIT_MASK 0x0020 ECU_ADDRESS 0xFFFF24AA /begin FUNCTION_LIST /end FUNCTION_LIST /end MEASUREMENT
/begin MEASUREMENT fVTLNE "VTC operation angle deviation quantity integral value, usually, learning permission flag" UBYTE COMP_0283 1 100 0 1 BIT_MASK 0x0010 ECU_ADDRESS 0xFFFF24AA /begin FUNCTION_LIST /end FUNCTION_LIST /end MEASUREMENT
/begin MEASUREMENT fVTLNI "VTC operation angle deviation quantity integral value, usually, learning permission flag" UBYTE COMP_0283 1 100 0 1 BIT_MASK 0x0008 ECU_ADDRESS 0xFFFF24AA /begin FUNCTION_LIST /end FUNCTION_LIST /end MEASUREMENT
/begin MEASUREMENT fVTLRNEH "LNRPM<=VTLRNEH# (hysteresis ÅE200 rpm)" UBYTE COMP_0283 1 100 0 1 BIT_MASK 0x0004 ECU_ADDRESS 0xFFFF24AA /begin FUNCTION_LIST /end FUNCTION_LIST /end MEASUREMENT
/begin MEASUREMENT fVTONEHE "VTC alignment check diagnosis permission engine speed upper limit" UBYTE COMP_0283 1 100 0 1 BIT_MASK 0x0002 ECU_ADDRESS 0xFFFF24AA /begin FUNCTION_LIST /end FUNCTION_LIST /end MEASUREMENT
/begin MEASUREMENT fVTONEHI "VTC alignment check diagnosis permission engine speed upper limit" UBYTE COMP_0283 1 100 0 1 BIT_MASK 0x0001 ECU_ADDRESS 0xFFFF24AA /begin FUNCTION_LIST /end FUNCTION_LIST /end MEASUREMENT
/begin MEASUREMENT fVTONELE "VTC alignment check diagnosis permission engine speed lower limit" UBYTE COMP_0283 1 100 0 1 BIT_MASK 0x0080 ECU_ADDRESS 0xFFFF24AB /begin FUNCTION_LIST /end FUNCTION_LIST /end MEASUREMENT
/begin MEASUREMENT fVTONELI "VTC alignment check diagnosis permission engine speed lower limit" UBYTE COMP_0283 1 100 0 1 BIT_MASK 0x0040 ECU_ADDRESS 0xFFFF24AB /begin FUNCTION_LIST /end FUNCTION_LIST /end MEASUREMENT
/begin MEASUREMENT fVTOTWHE "VTC alignment check diagnosis permission coolant temperature upper limit" UBYTE COMP_0283 1 100 0 1 BIT_MASK 0x0020 ECU_ADDRESS 0xFFFF24AB /begin FUNCTION_LIST /end FUNCTION_LIST /end MEASUREMENT
/begin MEASUREMENT fVTOTWHI "VTC alignment check diagnosis permission coolant temperature upper limit" UBYTE COMP_0283 1 100 0 1 BIT_MASK 0x0010 ECU_ADDRESS 0xFFFF24AB /begin FUNCTION_LIST /end FUNCTION_LIST /end MEASUREMENT
/begin MEASUREMENT fVTOTWLE "VTC alignment check diagnosis permission coolant temperature lower limit" UBYTE COMP_0283 1 100 0 1 BIT_MASK 0x0008 ECU_ADDRESS 0xFFFF24AB /begin FUNCTION_LIST /end FUNCTION_LIST /end MEASUREMENT
/begin MEASUREMENT fVTOTWLI "VTC alignment check diagnosis permission coolant temperature lower limit" UBYTE COMP_0283 1 100 0 1 BIT_MASK 0x0004 ECU_ADDRESS 0xFFFF24AB /begin FUNCTION_LIST /end FUNCTION_LIST /end MEASUREMENT
/begin MEASUREMENT fVTPONLE "Hysteresis flag" UBYTE COMP_0283 1 100 0 1 BIT_MASK 0x0002 ECU_ADDRESS 0xFFFF24AB /begin FUNCTION_LIST /end FUNCTION_LIST /end MEASUREMENT
/begin MEASUREMENT fVTRLNE "VTC operation angle deviation quantity integral value rapid learning renewal control-in-progress flag" UBYTE COMP_0283 1 100 0 1 BIT_MASK 0x0001 ECU_ADDRESS 0xFFFF24AB /begin FUNCTION_LIST /end FUNCTION_LIST /end MEASUREMENT
/begin MEASUREMENT fVTRLNEHE "HNRPM<=VTRLNEH# (hysteresis +HYLNNEE#)" UBYTE COMP_0283 1 100 0 1 BIT_MASK 0x0080 ECU_ADDRESS 0xFFFF24AC /begin FUNCTION_LIST /end FUNCTION_LIST /end MEASUREMENT
/begin MEASUREMENT fVTRLNEHI "HNRPM<=VTRLNEH# (hysteresis +HYLNNEI#)" UBYTE COMP_0283 1 100 0 1 BIT_MASK 0x0040 ECU_ADDRESS 0xFFFF24AC /begin FUNCTION_LIST /end FUNCTION_LIST /end MEASUREMENT
/begin MEASUREMENT fVTRLNELE "VTRLNEL# (hysteresis-HYLNNEE#) <=HNRPM" UBYTE COMP_0283 1 100 0 1 BIT_MASK 0x0020 ECU_ADDRESS 0xFFFF24AC /begin FUNCTION_LIST /end FUNCTION_LIST /end MEASUREMENT
/begin MEASUREMENT fVTRLNELI "VTRLNEL# (hysteresis-HYLNNEI#) <=HNRPM" UBYTE COMP_0283 1 100 0 1 BIT_MASK 0x0010 ECU_ADDRESS 0xFFFF24AC /begin FUNCTION_LIST /end FUNCTION_LIST /end MEASUREMENT
/begin MEASUREMENT fVTRLNI "VTC operation angle deviation quantity integral value rapid learning renewal control-in-progress flag" UBYTE COMP_0283 1 100 0 1 BIT_MASK 0x0008 ECU_ADDRESS 0xFFFF24AC /begin FUNCTION_LIST /end FUNCTION_LIST /end MEASUREMENT
/begin MEASUREMENT fVTRLVSPE "VSP<=VTRLVSPE# (hysteresis +HYRVSPE#)" UBYTE COMP_0283 1 100 0 1 BIT_MASK 0x0004 ECU_ADDRESS 0xFFFF24AC /begin FUNCTION_LIST /end FUNCTION_LIST /end MEASUREMENT
/begin MEASUREMENT fVTRLVSPI "VSP<=VTRLVSPI# (hysteresis +HYRVSPI#)" UBYTE COMP_0283 1 100 0 1 BIT_MASK 0x0002 ECU_ADDRESS 0xFFFF24AC /begin FUNCTION_LIST /end FUNCTION_LIST /end MEASUREMENT
/begin MEASUREMENT fWGTVO "A throttle open-degree judgement for the W/G solenoid" UBYTE COMP_0283 1 100 0 1 BIT_MASK 0x0001 ECU_ADDRESS 0xFFFF24AC /begin FUNCTION_LIST /end FUNCTION_LIST /end MEASUREMENT
/begin MEASUREMENT fFTPSST_S "TPS learning condition flag" UBYTE COMP_0283 1 100 0 1 BIT_MASK 0x0020 ECU_ADDRESS 0xFFFF24AD /begin FUNCTION_LIST /end FUNCTION_LIST /end MEASUREMENT
/begin MEASUREMENT fVCSHOTZ "Cleaning mode requirement judgement flag (previous value)" UBYTE COMP_0283 1 100 0 1 BIT_MASK 0x0040 ECU_ADDRESS 0xFFFF24AE /begin FUNCTION_LIST /end FUNCTION_LIST /end MEASUREMENT
/begin MEASUREMENT fDSTART "Start SW sampling value" UBYTE COMP_0283 1 100 0 1 BIT_MASK 0x0080 ECU_ADDRESS 0xFFFF24AF /begin FUNCTION_LIST /end FUNCTION_LIST /end MEASUREMENT
/begin MEASUREMENT fF2MSJOB "2mS JOB in-progress flag" UBYTE COMP_0283 1 100 0 1 BIT_MASK 0x0040 ECU_ADDRESS 0xFFFF24AF /begin FUNCTION_LIST /end FUNCTION_LIST /end MEASUREMENT
/begin MEASUREMENT fF706MS "On every 706mS, a flag for the operation" UBYTE COMP_0283 1 100 0 1 BIT_MASK 0x0020 ECU_ADDRESS 0xFFFF24AF /begin FUNCTION_LIST /end FUNCTION_LIST /end MEASUREMENT
/begin MEASUREMENT fVSP1ST "VSP1,2 initial value setup flag" UBYTE COMP_0283 1 100 0 1 BIT_MASK 0x0002 ECU_ADDRESS 0xFFFF24AF /begin FUNCTION_LIST /end FUNCTION_LIST /end MEASUREMENT
/begin MEASUREMENT fVSPGATE "706mS progress judgement flag" UBYTE COMP_0283 1 100 0 1 BIT_MASK 0x0001 ECU_ADDRESS 0xFFFF24AF /begin FUNCTION_LIST /end FUNCTION_LIST /end MEASUREMENT
/begin MEASUREMENT fVSPGATES "176.5mS window" UBYTE COMP_0283 1 100 0 1 BIT_MASK 0x0080 ECU_ADDRESS 0xFFFF24B0 /begin FUNCTION_LIST /end FUNCTION_LIST /end MEASUREMENT
/begin MEASUREMENT fAVTQH "Taking in advance compensation equation judgement condition" UBYTE COMP_0283 1 100 0 1 BIT_MASK 0x0080 ECU_ADDRESS 0xFFFF24B3 /begin FUNCTION_LIST /end FUNCTION_LIST /end MEASUREMENT
/begin MEASUREMENT fDEGRINT "EGR breakage diagnosis initialization flag" UBYTE COMP_0283 1 100 0 1 BIT_MASK 0x0040 ECU_ADDRESS 0xFFFF24B3 /begin FUNCTION_LIST /end FUNCTION_LIST /end MEASUREMENT
/begin MEASUREMENT fF4MSJOB "4mS JOB in-progress flag" UBYTE COMP_0283 1 100 0 1 BIT_MASK 0x0020 ECU_ADDRESS 0xFFFF24B3 /begin FUNCTION_LIST /end FUNCTION_LIST /end MEASUREMENT
/begin MEASUREMENT fFEGRCT "Step motor control conditions flag (EGR)" UBYTE COMP_0283 1 100 0 1 BIT_MASK 0x0010 ECU_ADDRESS 0xFFFF24B3 /begin FUNCTION_LIST /end FUNCTION_LIST /end MEASUREMENT
/begin MEASUREMENT fGENSOKU "Slowdown judgement" UBYTE COMP_0283 1 100 0 1 BIT_MASK 0x0008 ECU_ADDRESS 0xFFFF24B3 /begin FUNCTION_LIST /end FUNCTION_LIST /end MEASUREMENT
/begin MEASUREMENT fITANDMCH "ITANDM It changes, judgement flag" UBYTE COMP_0283 1 100 0 1 BIT_MASK 0x0004 ECU_ADDRESS 0xFFFF24B3 /begin FUNCTION_LIST /end FUNCTION_LIST /end MEASUREMENT
/begin MEASUREMENT fKASOKU "Acceleration judgement" UBYTE COMP_0283 1 100 0 1 BIT_MASK 0x0002 ECU_ADDRESS 0xFFFF24B3 /begin FUNCTION_LIST /end FUNCTION_LIST /end MEASUREMENT
/begin MEASUREMENT fQTCCAL "QTC addition condition judgement" UBYTE COMP_0283 1 100 0 1 BIT_MASK 0x0010 ECU_ADDRESS 0xFFFF24B4 /begin FUNCTION_LIST /end FUNCTION_LIST /end MEASUREMENT
/begin MEASUREMENT fAACOUTZ "afACOUTold" UBYTE COMP_0283 1 100 0 1 BIT_MASK 0x0080 ECU_ADDRESS 0xFFFF24B5 /begin FUNCTION_LIST /end FUNCTION_LIST /end MEASUREMENT
/begin MEASUREMENT fACANTSTZ "afACANTSTT condition flag" UBYTE COMP_0283 1 100 0 1 BIT_MASK 0x0040 ECU_ADDRESS 0xFFFF24B5 /begin FUNCTION_LIST /end FUNCTION_LIST /end MEASUREMENT
/begin MEASUREMENT fBATSKINI "The initialization flag of BATSENK" UBYTE COMP_0283 1 100 0 1 BIT_MASK 0x0008 ECU_ADDRESS 0xFFFF24B5 /begin FUNCTION_LIST /end FUNCTION_LIST /end MEASUREMENT
/begin MEASUREMENT fCACSW "CAN receiving air-conditioning SW" UBYTE COMP_0283 1 100 0 1 BIT_MASK 0x0004 ECU_ADDRESS 0xFFFF24B5 /begin FUNCTION_LIST /end FUNCTION_LIST /end MEASUREMENT
/begin MEASUREMENT fCANACSW "CAN receiving air-conditioning input SW" UBYTE COMP_0283 1 100 0 1 BIT_MASK 0x0002 ECU_ADDRESS 0xFFFF24B5 /begin FUNCTION_LIST /end FUNCTION_LIST /end MEASUREMENT
/begin MEASUREMENT fCANHFNSW "CAN receiving air-conditioning load SW" UBYTE COMP_0283 1 100 0 1 BIT_MASK 0x0001 ECU_ADDRESS 0xFFFF24B5 /begin FUNCTION_LIST /end FUNCTION_LIST /end MEASUREMENT
/begin MEASUREMENT fCANHLPSW "CAN receiving electric load SW (head lamp)" UBYTE COMP_0283 1 100 0 1 BIT_MASK 0x0080 ECU_ADDRESS 0xFFFF24B6 /begin FUNCTION_LIST /end FUNCTION_LIST /end MEASUREMENT
/begin MEASUREMENT fCANLOAD1 "CAN receiving electric load SW" UBYTE COMP_0283 1 100 0 1 BIT_MASK 0x0040 ECU_ADDRESS 0xFFFF24B6 /begin FUNCTION_LIST /end FUNCTION_LIST /end MEASUREMENT
/begin MEASUREMENT fCANLOAD2 "CAN receiving electric load SW2" UBYTE COMP_0283 1 100 0 1 BIT_MASK 0x0020 ECU_ADDRESS 0xFFFF24B6 /begin FUNCTION_LIST /end FUNCTION_LIST /end MEASUREMENT
/begin MEASUREMENT fCANLTASW "CAN receiving air-conditioning low air temperature SW" UBYTE COMP_0283 1 100 0 1 BIT_MASK 0x0010 ECU_ADDRESS 0xFFFF24B6 /begin FUNCTION_LIST /end FUNCTION_LIST /end MEASUREMENT
/begin MEASUREMENT fCANRDFSW "CAN receiving electric load SW (rear defogger-)" UBYTE COMP_0283 1 100 0 1 BIT_MASK 0x0008 ECU_ADDRESS 0xFFFF24B6 /begin FUNCTION_LIST /end FUNCTION_LIST /end MEASUREMENT
/begin MEASUREMENT fCLOAD2 "CAN receiving electric load SW2" UBYTE COMP_0283 1 100 0 1 BIT_MASK 0x0004 ECU_ADDRESS 0xFFFF24B6 /begin FUNCTION_LIST /end FUNCTION_LIST /end MEASUREMENT
/begin MEASUREMENT fEXADC "A/D cut flag" UBYTE COMP_0283 1 100 0 1 BIT_MASK 0x0020 ECU_ADDRESS 0xFFFF24B7 /begin FUNCTION_LIST /end FUNCTION_LIST /end MEASUREMENT
/begin MEASUREMENT fF10MSJOB "10mS JOB in-progress flag" UBYTE COMP_0283 1 100 0 1 BIT_MASK 0x0010 ECU_ADDRESS 0xFFFF24B7 /begin FUNCTION_LIST /end FUNCTION_LIST /end MEASUREMENT
/begin MEASUREMENT fF1PRESN "PRESN_set first flag" UBYTE COMP_0283 1 100 0 1 BIT_MASK 0x0008 ECU_ADDRESS 0xFFFF24B7 /begin FUNCTION_LIST /end FUNCTION_LIST /end MEASUREMENT
/begin MEASUREMENT fFACCUT1 "A flag for an ACUUT 1 set bit judgement" UBYTE COMP_0283 1 100 0 1 BIT_MASK 0x0004 ECU_ADDRESS 0xFFFF24B7 /begin FUNCTION_LIST /end FUNCTION_LIST /end MEASUREMENT
/begin MEASUREMENT fFASOL "AT shift ASOL flag" UBYTE COMP_0283 1 100 0 1 BIT_MASK 0x0002 ECU_ADDRESS 0xFFFF24B7 /begin FUNCTION_LIST /end FUNCTION_LIST /end MEASUREMENT
/begin MEASUREMENT fFLUZ "Lockup judgement (previous value)" UBYTE COMP_0283 1 100 0 1 BIT_MASK 0x0040 ECU_ADDRESS 0xFFFF24B8 /begin FUNCTION_LIST /end FUNCTION_LIST /end MEASUREMENT
/begin MEASUREMENT fFPEVPIN "EVPRES The first flag" UBYTE COMP_0283 1 100 0 1 BIT_MASK 0x0020 ECU_ADDRESS 0xFFFF24B8 /begin FUNCTION_LIST /end FUNCTION_LIST /end MEASUREMENT
/begin MEASUREMENT fFPEVPIN2 "EVPRES2 The first flag" UBYTE COMP_0283 1 100 0 1 BIT_MASK 0x0010 ECU_ADDRESS 0xFFFF24B8 /begin FUNCTION_LIST /end FUNCTION_LIST /end MEASUREMENT
/begin MEASUREMENT fFPRESIN "PRESS_set first flag" UBYTE COMP_0283 1 100 0 1 BIT_MASK 0x0008 ECU_ADDRESS 0xFFFF24B8 /begin FUNCTION_LIST /end FUNCTION_LIST /end MEASUREMENT
/begin MEASUREMENT fFST10MS "After the engine stall, the first 10mS Job judgement" UBYTE COMP_0283 1 100 0 1 BIT_MASK 0x0002 ECU_ADDRESS 0xFFFF24B8 /begin FUNCTION_LIST /end FUNCTION_LIST /end MEASUREMENT
/begin MEASUREMENT fFSTF "Fuel temperature sensor failsafe" UBYTE COMP_0283 1 100 0 1 BIT_MASK 0x0001 ECU_ADDRESS 0xFFFF24B8 /begin FUNCTION_LIST /end FUNCTION_LIST /end MEASUREMENT
/begin MEASUREMENT fFSTTMOK "At the time of the extreme low temperature, engine initial judgement time arrival judgement flag" UBYTE COMP_0283 1 100 0 1 BIT_MASK 0x0080 ECU_ADDRESS 0xFFFF24B9 /begin FUNCTION_LIST /end FUNCTION_LIST /end MEASUREMENT
/begin MEASUREMENT fFTFKITS "TF The first flag" UBYTE COMP_0283 1 100 0 1 BIT_MASK 0x0020 ECU_ADDRESS 0xFFFF24B9 /begin FUNCTION_LIST /end FUNCTION_LIST /end MEASUREMENT
/begin MEASUREMENT fGRRTOHLD "Gear ratio switching flag" UBYTE COMP_0283 1 100 0 1 BIT_MASK 0x0010 ECU_ADDRESS 0xFFFF24B9 /begin FUNCTION_LIST /end FUNCTION_LIST /end MEASUREMENT
/begin MEASUREMENT fHFANSW "Air-conditioning load SW" UBYTE COMP_0283 1 100 0 1 BIT_MASK 0x0008 ECU_ADDRESS 0xFFFF24B9 /begin FUNCTION_LIST /end FUNCTION_LIST /end MEASUREMENT
/begin MEASUREMENT fHIDN1 "Soft idle SW1 judgement hysteresis flag" UBYTE COMP_0283 1 100 0 1 BIT_MASK 0x0004 ECU_ADDRESS 0xFFFF24B9 /begin FUNCTION_LIST /end FUNCTION_LIST /end MEASUREMENT
/begin MEASUREMENT fHIDN2 "Soft idle SW2 judgement hysteresis flag" UBYTE COMP_0283 1 100 0 1 BIT_MASK 0x0002 ECU_ADDRESS 0xFFFF24B9 /begin FUNCTION_LIST /end FUNCTION_LIST /end MEASUREMENT
/begin MEASUREMENT fHLAMPSW "An electric load SW (head lamp)" UBYTE COMP_0283 1 100 0 1 BIT_MASK 0x0001 ECU_ADDRESS 0xFFFF24B9 /begin FUNCTION_LIST /end FUNCTION_LIST /end MEASUREMENT
/begin MEASUREMENT fIDLSFS "At the time of IDLE, SOFIS control prohibition flag (previous value maintenance)" UBYTE COMP_0283 1 100 0 1 BIT_MASK 0x0010 ECU_ADDRESS 0xFFFF24BA /begin FUNCTION_LIST /end FUNCTION_LIST /end MEASUREMENT
/begin MEASUREMENT fIREVFLI "It is carried out in the CVT input speed filtering beginning flag." UBYTE COMP_0283 1 100 0 1 BIT_MASK 0x0008 ECU_ADDRESS 0xFFFF24BA /begin FUNCTION_LIST /end FUNCTION_LIST /end MEASUREMENT
/begin MEASUREMENT fKHRPAHYS "KHOT calcuration engine speed condition judgment flag" UBYTE COMP_0283 1 100 0 1 BIT_MASK 0x0002 ECU_ADDRESS 0xFFFF24BA /begin FUNCTION_LIST /end FUNCTION_LIST /end MEASUREMENT
/begin MEASUREMENT fKHTTAHYS "KHOT calcuration intake-air temp. condition judgment flag" UBYTE COMP_0283 1 100 0 1 BIT_MASK 0x0001 ECU_ADDRESS 0xFFFF24BA /begin FUNCTION_LIST /end FUNCTION_LIST /end MEASUREMENT
/begin MEASUREMENT fKTOP "A TOP judgement flag for KMR" UBYTE COMP_0283 1 100 0 1 BIT_MASK 0x0080 ECU_ADDRESS 0xFFFF24BB /begin FUNCTION_LIST /end FUNCTION_LIST /end MEASUREMENT
/begin MEASUREMENT fLNSTSW "Soft starter switch on condition flag" UBYTE COMP_0283 1 100 0 1 BIT_MASK 0x0040 ECU_ADDRESS 0xFFFF24BB /begin FUNCTION_LIST /end FUNCTION_LIST /end MEASUREMENT
/begin MEASUREMENT fMANUAUP "Manual mode automatic up-shift function switching flag" UBYTE COMP_0283 1 100 0 1 BIT_MASK 0x0010 ECU_ADDRESS 0xFFFF24BB /begin FUNCTION_LIST /end FUNCTION_LIST /end MEASUREMENT
/begin MEASUREMENT fMANUMOD "Manual mode gear shift function switching flag" UBYTE COMP_0283 1 100 0 1 BIT_MASK 0x0008 ECU_ADDRESS 0xFFFF24BB /begin FUNCTION_LIST /end FUNCTION_LIST /end MEASUREMENT
/begin MEASUREMENT fMANUPOS "Manual mode step number switching flag" UBYTE COMP_0283 1 100 0 1 BIT_MASK 0x0004 ECU_ADDRESS 0xFFFF24BB /begin FUNCTION_LIST /end FUNCTION_LIST /end MEASUREMENT
/begin MEASUREMENT fOBDFCTM "ST/SW On experience flag" UBYTE COMP_0283 1 100 0 1 BIT_MASK 0x0001 ECU_ADDRESS 0xFFFF24BB /begin FUNCTION_LIST /end FUNCTION_LIST /end MEASUREMENT
/begin MEASUREMENT fOREVFLI "It is carried out in the CVT output speed filtering beginning flag." UBYTE COMP_0283 1 100 0 1 BIT_MASK 0x0040 ECU_ADDRESS 0xFFFF24BC /begin FUNCTION_LIST /end FUNCTION_LIST /end MEASUREMENT
/begin MEASUREMENT fOUTRVINI "OUTREV first judgement flag" UBYTE COMP_0283 1 100 0 1 BIT_MASK 0x0020 ECU_ADDRESS 0xFFFF24BC /begin FUNCTION_LIST /end FUNCTION_LIST /end MEASUREMENT
/begin MEASUREMENT fPDSW "-" UBYTE COMP_0283 1 100 0 1 BIT_MASK 0x0010 ECU_ADDRESS 0xFFFF24BC /begin FUNCTION_LIST /end FUNCTION_LIST /end MEASUREMENT
/begin MEASUREMENT fPLMINTLM "In Plmin, torque limiter requirement signal flag" UBYTE COMP_0283 1 100 0 1 BIT_MASK 0x0008 ECU_ADDRESS 0xFFFF24BC /begin FUNCTION_LIST /end FUNCTION_LIST /end MEASUREMENT
/begin MEASUREMENT fQCK1 "QCK1 renewal convergent flag" UBYTE COMP_0283 1 100 0 1 BIT_MASK 0x0002 ECU_ADDRESS 0xFFFF24BC /begin FUNCTION_LIST /end FUNCTION_LIST /end MEASUREMENT
/begin MEASUREMENT fQCKINIT "QCK_cal initial treatment flag" UBYTE COMP_0283 1 100 0 1 BIT_MASK 0x0001 ECU_ADDRESS 0xFFFF24BC /begin FUNCTION_LIST /end FUNCTION_LIST /end MEASUREMENT
/begin MEASUREMENT fRDEFSW "An electric load SW (rear defogger-)" UBYTE COMP_0283 1 100 0 1 BIT_MASK 0x0080 ECU_ADDRESS 0xFFFF24BD /begin FUNCTION_LIST /end FUNCTION_LIST /end MEASUREMENT
/begin MEASUREMENT fSMLUFLG "Smooth LU inside signal" UBYTE COMP_0283 1 100 0 1 BIT_MASK 0x0020 ECU_ADDRESS 0xFFFF24BD /begin FUNCTION_LIST /end FUNCTION_LIST /end MEASUREMENT
/begin MEASUREMENT fSRBSTSW "ST/SW On experience flag" UBYTE COMP_0283 1 100 0 1 BIT_MASK 0x0010 ECU_ADDRESS 0xFFFF24BD /begin FUNCTION_LIST /end FUNCTION_LIST /end MEASUREMENT
/begin MEASUREMENT fSSTSWOFF "Soft starter switch off condition flag" UBYTE COMP_0283 1 100 0 1 BIT_MASK 0x0008 ECU_ADDRESS 0xFFFF24BD /begin FUNCTION_LIST /end FUNCTION_LIST /end MEASUREMENT
/begin MEASUREMENT fSSTSWON "Soft starter switch on condition flag" UBYTE COMP_0283 1 100 0 1 BIT_MASK 0x0004 ECU_ADDRESS 0xFFFF24BD /begin FUNCTION_LIST /end FUNCTION_LIST /end MEASUREMENT
/begin MEASUREMENT fst_one "VO2 first treatment executive judgement flag" UBYTE COMP_0283 1 100 0 1 BIT_MASK 0x0002 ECU_ADDRESS 0xFFFF24BD /begin FUNCTION_LIST /end FUNCTION_LIST /end MEASUREMENT
/begin MEASUREMENT fTAILLPSW "An electric load SW" UBYTE COMP_0283 1 100 0 1 BIT_MASK 0x0001 ECU_ADDRESS 0xFFFF24BD /begin FUNCTION_LIST /end FUNCTION_LIST /end MEASUREMENT
/begin MEASUREMENT fTFEX "An unusual value judgement flag" UBYTE COMP_0283 1 100 0 1 BIT_MASK 0x0040 ECU_ADDRESS 0xFFFF24BE /begin FUNCTION_LIST /end FUNCTION_LIST /end MEASUREMENT
/begin MEASUREMENT fTFKINT "TFKINT value renewal condition judgement" UBYTE COMP_0283 1 100 0 1 BIT_MASK 0x0010 ECU_ADDRESS 0xFFFF24BE /begin FUNCTION_LIST /end FUNCTION_LIST /end MEASUREMENT
/begin MEASUREMENT fTOEX "Oil temperature sensor input voltage unusual value judgement flag" UBYTE COMP_0283 1 100 0 1 BIT_MASK 0x0008 ECU_ADDRESS 0xFFFF24BE /begin FUNCTION_LIST /end FUNCTION_LIST /end MEASUREMENT
/begin MEASUREMENT fTVINC "At the time of the TVOINT renewal, flag" UBYTE COMP_0283 1 100 0 1 BIT_MASK 0x0004 ECU_ADDRESS 0xFFFF24BE /begin FUNCTION_LIST /end FUNCTION_LIST /end MEASUREMENT
/begin MEASUREMENT fTVST "After starter SW off, at the time of beginning A/D conversion, flag" UBYTE COMP_0283 1 100 0 1 BIT_MASK 0x0002 ECU_ADDRESS 0xFFFF24BE /begin FUNCTION_LIST /end FUNCTION_LIST /end MEASUREMENT
/begin MEASUREMENT fTVUP "When it is renewed on the TVOINT coolant temperature condition, flag" UBYTE COMP_0283 1 100 0 1 BIT_MASK 0x0001 ECU_ADDRESS 0xFFFF24BE /begin FUNCTION_LIST /end FUNCTION_LIST /end MEASUREMENT
/begin MEASUREMENT fUHFIRST "UH data receive and transmit flag" UBYTE COMP_0283 1 100 0 1 BIT_MASK 0x0040 ECU_ADDRESS 0xFFFF24BF /begin FUNCTION_LIST /end FUNCTION_LIST /end MEASUREMENT
/begin MEASUREMENT fUHREGNG "UH registor setup value judgement flag" UBYTE COMP_0283 1 100 0 1 BIT_MASK 0x0020 ECU_ADDRESS 0xFFFF24BF /begin FUNCTION_LIST /end FUNCTION_LIST /end MEASUREMENT
/begin MEASUREMENT fUPSFTTDL "Up-shift torque going down L requirement signal" UBYTE COMP_0283 1 100 0 1 BIT_MASK 0x0010 ECU_ADDRESS 0xFFFF24BF /begin FUNCTION_LIST /end FUNCTION_LIST /end MEASUREMENT
/begin MEASUREMENT fVPRESEX "VPRES Unusual value judgement" UBYTE COMP_0283 1 100 0 1 BIT_MASK 0x0004 ECU_ADDRESS 0xFFFF24BF /begin FUNCTION_LIST /end FUNCTION_LIST /end MEASUREMENT
/begin MEASUREMENT fVSPGATE2 "706mS progress judgement flag" UBYTE COMP_0283 1 100 0 1 BIT_MASK 0x0002 ECU_ADDRESS 0xFFFF24BF /begin FUNCTION_LIST /end FUNCTION_LIST /end MEASUREMENT
/begin MEASUREMENT fMAIN_SWA "The ACC main thing SW" UBYTE COMP_0283 1 100 0 1 BIT_MASK 0x0080 ECU_ADDRESS 0xFFFF24C0 /begin FUNCTION_LIST /end FUNCTION_LIST /end MEASUREMENT
/begin MEASUREMENT fADVBLP "A switching experience flag from the PI control to the P control" UBYTE COMP_0283 1 100 0 1 BIT_MASK 0x0040 ECU_ADDRESS 0xFFFF24C1 /begin FUNCTION_LIST /end FUNCTION_LIST /end MEASUREMENT
/begin MEASUREMENT fADVL1ST "ADVL operation first flag" UBYTE COMP_0283 1 100 0 1 BIT_MASK 0x0010 ECU_ADDRESS 0xFFFF24C1 /begin FUNCTION_LIST /end FUNCTION_LIST /end MEASUREMENT
/begin MEASUREMENT fCAMNOISE "CAM sensor noise, momentary-disconnection detection" UBYTE COMP_0283 1 100 0 1 BIT_MASK 0x0008 ECU_ADDRESS 0xFFFF24C1 /begin FUNCTION_LIST /end FUNCTION_LIST /end MEASUREMENT
/begin MEASUREMENT fCSBUFST "The judgement flag which has renewed the crank angle sensor trouble tense beginning CYLGATE, CYLDWL" UBYTE COMP_0283 1 100 0 1 BIT_MASK 0x0002 ECU_ADDRESS 0xFFFF24C1 /begin FUNCTION_LIST /end FUNCTION_LIST /end MEASUREMENT
/begin MEASUREMENT fEVAPGO "ÉfÉÖÅ[ÉeÉBÅ[ output timing flag" UBYTE COMP_0283 1 100 0 1 BIT_MASK 0x0001 ECU_ADDRESS 0xFFFF24C1 /begin FUNCTION_LIST /end FUNCTION_LIST /end MEASUREMENT
/begin MEASUREMENT fEVAPST "Coil electric current weighted average value first flag" UBYTE COMP_0283 1 100 0 1 BIT_MASK 0x0080 ECU_ADDRESS 0xFFFF24C2 /begin FUNCTION_LIST /end FUNCTION_LIST /end MEASUREMENT
/begin MEASUREMENT fEVDLYCHK "Purge control valve on delay flag" UBYTE COMP_0283 1 100 0 1 BIT_MASK 0x0040 ECU_ADDRESS 0xFFFF24C2 /begin FUNCTION_LIST /end FUNCTION_LIST /end MEASUREMENT
/begin MEASUREMENT fEVPOPORT "Purge control valve output flag" UBYTE COMP_0283 1 100 0 1 BIT_MASK 0x0020 ECU_ADDRESS 0xFFFF24C2 /begin FUNCTION_LIST /end FUNCTION_LIST /end MEASUREMENT
/begin MEASUREMENT fFADVVSPZ "Vehicle speed condition judgement previous value flag" UBYTE COMP_0283 1 100 0 1 BIT_MASK 0x0010 ECU_ADDRESS 0xFFFF24C2 /begin FUNCTION_LIST /end FUNCTION_LIST /end MEASUREMENT
/begin MEASUREMENT fFINJINT "The switchover judgement flag that the same time is sequential" UBYTE COMP_0283 1 100 0 1 BIT_MASK 0x0008 ECU_ADDRESS 0xFFFF24C2 /begin FUNCTION_LIST /end FUNCTION_LIST /end MEASUREMENT
/begin MEASUREMENT fFISCVSPZ "Vehicle speed condition judgement previous value flag" UBYTE COMP_0283 1 100 0 1 BIT_MASK 0x0004 ECU_ADDRESS 0xFFFF24C2 /begin FUNCTION_LIST /end FUNCTION_LIST /end MEASUREMENT
/begin MEASUREMENT fFSQST "A sequential injection start flag" UBYTE COMP_0283 1 100 0 1 BIT_MASK 0x0002 ECU_ADDRESS 0xFFFF24C2 /begin FUNCTION_LIST /end FUNCTION_LIST /end MEASUREMENT
/begin MEASUREMENT fFSTINJ "The first simultaneous injection flag" UBYTE COMP_0283 1 100 0 1 BIT_MASK 0x0001 ECU_ADDRESS 0xFFFF24C2 /begin FUNCTION_LIST /end FUNCTION_LIST /end MEASUREMENT
/begin MEASUREMENT fFSTPOS "At the time of the engine start, beginning POS input judgement flag" UBYTE COMP_0283 1 100 0 1 BIT_MASK 0x0080 ECU_ADDRESS 0xFFFF24C3 /begin FUNCTION_LIST /end FUNCTION_LIST /end MEASUREMENT
/begin MEASUREMENT fIDELAYZ "ISC CLOSED control switchover flag" UBYTE COMP_0283 1 100 0 1 BIT_MASK 0x0010 ECU_ADDRESS 0xFFFF24C3 /begin FUNCTION_LIST /end FUNCTION_LIST /end MEASUREMENT
/begin MEASUREMENT fIDELAYZ1 "ADV CLOSED control switchover flag" UBYTE COMP_0283 1 100 0 1 BIT_MASK 0x0008 ECU_ADDRESS 0xFFFF24C3 /begin FUNCTION_LIST /end FUNCTION_LIST /end MEASUREMENT
/begin MEASUREMENT fIDLERZ "IDLEz for QREF" UBYTE COMP_0283 1 100 0 1 BIT_MASK 0x0004 ECU_ADDRESS 0xFFFF24C3 /begin FUNCTION_LIST /end FUNCTION_LIST /end MEASUREMENT
/begin MEASUREMENT fISCFBZ "ISC OPEN/CLOSED judgement" UBYTE COMP_0283 1 100 0 1 BIT_MASK 0x0002 ECU_ADDRESS 0xFFFF24C3 /begin FUNCTION_LIST /end FUNCTION_LIST /end MEASUREMENT
/begin MEASUREMENT fPOSNOISE "POS10 sensor noise, momentary-disconnection detection" UBYTE COMP_0283 1 100 0 1 BIT_MASK 0x0020 ECU_ADDRESS 0xFFFF24C4 /begin FUNCTION_LIST /end FUNCTION_LIST /end MEASUREMENT
/begin MEASUREMENT fQADVFBPIZ "The previous value of the PI control flag #QADVFBPI" UBYTE COMP_0283 1 100 0 1 BIT_MASK 0x0008 ECU_ADDRESS 0xFFFF24C4 /begin FUNCTION_LIST /end FUNCTION_LIST /end MEASUREMENT
/begin MEASUREMENT fREFFST "After the engine stall, beginning REFJOB judgement flag" UBYTE COMP_0283 1 100 0 1 BIT_MASK 0x0004 ECU_ADDRESS 0xFFFF24C4 /begin FUNCTION_LIST /end FUNCTION_LIST /end MEASUREMENT
/begin MEASUREMENT fFTWCP1 "CLOSE control permission coolant temperature condition flag" UBYTE COMP_0283 1 100 0 1 BIT_MASK 0x0040 ECU_ADDRESS 0xFFFF24C5 /begin FUNCTION_LIST /end FUNCTION_LIST /end MEASUREMENT
/begin MEASUREMENT afACANTSTT "Air conditioning activation compensation airflow trigger" UBYTE COMP_0283 1 100 0 1 BIT_MASK 0x0080 ECU_ADDRESS 0xFFFF24C9 /begin FUNCTION_LIST /end FUNCTION_LIST /end MEASUREMENT
/begin MEASUREMENT afACOUTR "Air conditioning relay control raw flag" UBYTE COMP_0283 1 100 0 1 BIT_MASK 0x0040 ECU_ADDRESS 0xFFFF24C9 /begin FUNCTION_LIST /end FUNCTION_LIST /end MEASUREMENT
/begin MEASUREMENT afACCFAIL "ACC fail flag" UBYTE COMP_0283 1 100 0 1 BIT_MASK 0x0080 ECU_ADDRESS 0xFFFF24CD /begin FUNCTION_LIST /end FUNCTION_LIST /end MEASUREMENT
/begin MEASUREMENT afACOUTV "Air-conditioning relay control output flag (only for QV)" UBYTE COMP_0283 1 100 0 1 BIT_MASK 0x0040 ECU_ADDRESS 0xFFFF24CD /begin FUNCTION_LIST /end FUNCTION_LIST /end MEASUREMENT
/begin MEASUREMENT afCSBUPHL "Crank angle sensor trouble tense judgement (PhaseLH NG)" UBYTE COMP_0283 1 100 0 1 BIT_MASK 0x0001 ECU_ADDRESS 0xFFFF24CD /begin FUNCTION_LIST /end FUNCTION_LIST /end MEASUREMENT
/begin MEASUREMENT afCSBUPHR "Crank angle sensor trouble tense judgement (PhaseRH NG)" UBYTE COMP_0283 1 100 0 1 BIT_MASK 0x0080 ECU_ADDRESS 0xFFFF24CE /begin FUNCTION_LIST /end FUNCTION_LIST /end MEASUREMENT
/begin MEASUREMENT afCSBUPOS "Crank angle sensor trouble tense judgement (POS NG)" UBYTE COMP_0283 1 100 0 1 BIT_MASK 0x0040 ECU_ADDRESS 0xFFFF24CE /begin FUNCTION_LIST /end FUNCTION_LIST /end MEASUREMENT
/begin MEASUREMENT afCSBUST "Crank angle sensor backup start condition flag" UBYTE COMP_0283 1 100 0 1 BIT_MASK 0x0020 ECU_ADDRESS 0xFFFF24CE /begin FUNCTION_LIST /end FUNCTION_LIST /end MEASUREMENT
/begin MEASUREMENT afDEGRDGNS "0:ïsê¨óß  1:ê¨óß" UBYTE COMP_0283 1 100 0 1 BIT_MASK 0x0010 ECU_ADDRESS 0xFFFF24CE /begin FUNCTION_LIST /end FUNCTION_LIST /end MEASUREMENT
/begin MEASUREMENT afEMNT1ON "EMNT1 terminal output" UBYTE COMP_0283 1 100 0 1 BIT_MASK 0x0008 ECU_ADDRESS 0xFFFF24CE /begin FUNCTION_LIST /end FUNCTION_LIST /end MEASUREMENT
/begin MEASUREMENT afEMNT2ON "EMNT2 terminal output" UBYTE COMP_0283 1 100 0 1 BIT_MASK 0x0004 ECU_ADDRESS 0xFFFF24CE /begin FUNCTION_LIST /end FUNCTION_LIST /end MEASUREMENT
/begin MEASUREMENT afFABCSOL "Intake manifold pressure/atomospheric pressure switching SOL flag" UBYTE COMP_0283 1 100 0 1 BIT_MASK 0x0002 ECU_ADDRESS 0xFFFF24CE /begin FUNCTION_LIST /end FUNCTION_LIST /end MEASUREMENT
/begin MEASUREMENT afFCRLUP "Lockup judgement flag for the fuel cut recover" UBYTE COMP_0283 1 100 0 1 BIT_MASK 0x0001 ECU_ADDRESS 0xFFFF24CE /begin FUNCTION_LIST /end FUNCTION_LIST /end MEASUREMENT
/begin MEASUREMENT afFFPRTM "F/P relay on time integration timer" UBYTE COMP_0283 1 100 0 1 BIT_MASK 0x0010 ECU_ADDRESS 0xFFFF24CF /begin FUNCTION_LIST /end FUNCTION_LIST /end MEASUREMENT
/begin MEASUREMENT afFNEIJT "vTITM extreme low temperature initial injection timing experience flag" UBYTE COMP_0283 1 100 0 1 BIT_MASK 0x0002 ECU_ADDRESS 0xFFFF24CF /begin FUNCTION_LIST /end FUNCTION_LIST /end MEASUREMENT
/begin MEASUREMENT afFPRON "Fuel pump relay flag" UBYTE COMP_0283 1 100 0 1 BIT_MASK 0x0080 ECU_ADDRESS 0xFFFF24D0 /begin FUNCTION_LIST /end FUNCTION_LIST /end MEASUREMENT
/begin MEASUREMENT afFTWIJT "Pole low coolant temperature judgement flag" UBYTE COMP_0283 1 100 0 1 BIT_MASK 0x0040 ECU_ADDRESS 0xFFFF24D0 /begin FUNCTION_LIST /end FUNCTION_LIST /end MEASUREMENT
/begin MEASUREMENT afREFCPDJG "Cylinder distinction clear condition (1) (2) formation judgement flag" UBYTE COMP_0283 1 100 0 1 BIT_MASK 0x0010 ECU_ADDRESS 0xFFFF24D1 /begin FUNCTION_LIST /end FUNCTION_LIST /end MEASUREMENT
/begin MEASUREMENT afREVGZNCL "Speed clear flag for the GZTP renewal condition" UBYTE COMP_0283 1 100 0 1 BIT_MASK 0x0008 ECU_ADDRESS 0xFFFF24D1 /begin FUNCTION_LIST /end FUNCTION_LIST /end MEASUREMENT
/begin MEASUREMENT afVTERE "A VTC operation permission flag for VTC operation angle deviation quantity integral value learning" UBYTE COMP_0283 1 100 0 1 BIT_MASK 0x0004 ECU_ADDRESS 0xFFFF24D2 /begin FUNCTION_LIST /end FUNCTION_LIST /end MEASUREMENT
/begin MEASUREMENT afWGCSOL "W/G solenoid control (output)" UBYTE COMP_0283 1 100 0 1 BIT_MASK 0x0002 ECU_ADDRESS 0xFFFF24D2 /begin FUNCTION_LIST /end FUNCTION_LIST /end MEASUREMENT
/begin MEASUREMENT afASCACT_S "ASCD permission flag" UBYTE COMP_0283 1 100 0 1 BIT_MASK 0x0001 ECU_ADDRESS 0xFFFF24D2 /begin FUNCTION_LIST /end FUNCTION_LIST /end MEASUREMENT
/begin MEASUREMENT fACCFAIL "ACC fail flag" UBYTE COMP_0283 1 100 0 1 BIT_MASK 0x0080 ECU_ADDRESS 0xFFFF24D4 /begin FUNCTION_LIST /end FUNCTION_LIST /end MEASUREMENT
/begin MEASUREMENT fACOUTV "Air-conditioning relay control output flag (only for QV)" UBYTE COMP_0283 1 100 0 1 BIT_MASK 0x0040 ECU_ADDRESS 0xFFFF24D4 /begin FUNCTION_LIST /end FUNCTION_LIST /end MEASUREMENT
/begin MEASUREMENT fCSBUPHL "Crank angle sensor trouble tense judgement (PhaseLH NG)" UBYTE COMP_0283 1 100 0 1 BIT_MASK 0x0001 ECU_ADDRESS 0xFFFF24D4 /begin FUNCTION_LIST /end FUNCTION_LIST /end MEASUREMENT
/begin MEASUREMENT fCSBUPHR "Crank angle sensor trouble tense judgement (PhaseRH NG)" UBYTE COMP_0283 1 100 0 1 BIT_MASK 0x0080 ECU_ADDRESS 0xFFFF24D5 /begin FUNCTION_LIST /end FUNCTION_LIST /end MEASUREMENT
/begin MEASUREMENT fCSBUPOS "Crank angle sensor trouble tense judgement (POS NG)" UBYTE COMP_0283 1 100 0 1 BIT_MASK 0x0040 ECU_ADDRESS 0xFFFF24D5 /begin FUNCTION_LIST /end FUNCTION_LIST /end MEASUREMENT
/begin MEASUREMENT fCSBUST "Crank angle sensor backup start condition flag" UBYTE COMP_0283 1 100 0 1 BIT_MASK 0x0020 ECU_ADDRESS 0xFFFF24D5 /begin FUNCTION_LIST /end FUNCTION_LIST /end MEASUREMENT
/begin MEASUREMENT fDEGRDGNST "EGR breakage diagnosis condition flag" UBYTE COMP_0283 1 100 0 1 BIT_MASK 0x0010 ECU_ADDRESS 0xFFFF24D5 /begin FUNCTION_LIST /end FUNCTION_LIST /end MEASUREMENT
/begin MEASUREMENT fEMNT1ON "EMNT1 terminal output" UBYTE COMP_0283 1 100 0 1 BIT_MASK 0x0008 ECU_ADDRESS 0xFFFF24D5 /begin FUNCTION_LIST /end FUNCTION_LIST /end MEASUREMENT
/begin MEASUREMENT fEMNT2ON "EMNT2 terminal output" UBYTE COMP_0283 1 100 0 1 BIT_MASK 0x0004 ECU_ADDRESS 0xFFFF24D5 /begin FUNCTION_LIST /end FUNCTION_LIST /end MEASUREMENT
/begin MEASUREMENT fFABCSOL "Intake manifold pressure/atomospheric pressure switching SOL flag" UBYTE COMP_0283 1 100 0 1 BIT_MASK 0x0002 ECU_ADDRESS 0xFFFF24D5 /begin FUNCTION_LIST /end FUNCTION_LIST /end MEASUREMENT
/begin MEASUREMENT fFCRLUP "Lockup judgement flag for the fuel cut recover" UBYTE COMP_0283 1 100 0 1 BIT_MASK 0x0001 ECU_ADDRESS 0xFFFF24D5 /begin FUNCTION_LIST /end FUNCTION_LIST /end MEASUREMENT
/begin MEASUREMENT fFFPRTM "F/P relay on time integration timer" UBYTE COMP_0283 1 100 0 1 BIT_MASK 0x0010 ECU_ADDRESS 0xFFFF24D6 /begin FUNCTION_LIST /end FUNCTION_LIST /end MEASUREMENT
/begin MEASUREMENT fFNEIJT "vTITM extreme low temperature initial injection timing experience flag" UBYTE COMP_0283 1 100 0 1 BIT_MASK 0x0002 ECU_ADDRESS 0xFFFF24D6 /begin FUNCTION_LIST /end FUNCTION_LIST /end MEASUREMENT
/begin MEASUREMENT fFTWIJT "Pole low coolant temperature judgement flag" UBYTE COMP_0283 1 100 0 1 BIT_MASK 0x0040 ECU_ADDRESS 0xFFFF24D7 /begin FUNCTION_LIST /end FUNCTION_LIST /end MEASUREMENT
/begin MEASUREMENT fREFCPDJG "Cylinder distinction clear condition (1) (2) formation judgement flag" UBYTE COMP_0283 1 100 0 1 BIT_MASK 0x0010 ECU_ADDRESS 0xFFFF24D8 /begin FUNCTION_LIST /end FUNCTION_LIST /end MEASUREMENT
/begin MEASUREMENT fREVGZNCL "Speed clear flag for the GZTP renewal condition" UBYTE COMP_0283 1 100 0 1 BIT_MASK 0x0008 ECU_ADDRESS 0xFFFF24D8 /begin FUNCTION_LIST /end FUNCTION_LIST /end MEASUREMENT
/begin MEASUREMENT fVTERE "A VTC operation permission flag for VTC operation angle deviation quantity integral value learning" UBYTE COMP_0283 1 100 0 1 BIT_MASK 0x0004 ECU_ADDRESS 0xFFFF24D9 /begin FUNCTION_LIST /end FUNCTION_LIST /end MEASUREMENT
/begin MEASUREMENT fWGCSOL "W/G solenoid control" UBYTE COMP_0283 1 100 0 1 BIT_MASK 0x0002 ECU_ADDRESS 0xFFFF24D9 /begin FUNCTION_LIST /end FUNCTION_LIST /end MEASUREMENT
/begin MEASUREMENT fASCACT_S "ASCD permission flag" UBYTE COMP_0283 1 100 0 1 BIT_MASK 0x0001 ECU_ADDRESS 0xFFFF24D9 /begin FUNCTION_LIST /end FUNCTION_LIST /end MEASUREMENT
/begin MEASUREMENT wfCCEPMINH "Boolean that indicates the write-on-the-flight on cruise control activation and deactivation strategy is inhibited" UBYTE COMP_0283 1 100 0 1 BIT_MASK 0x0080 ECU_ADDRESS 0xFFFFB7D8 /begin FUNCTION_LIST /end FUNCTION_LIST /end MEASUREMENT
/begin MEASUREMENT wfCCSLIBFS "cruise control activation and shut-off" UBYTE COMP_0283 1 100 0 1 BIT_MASK 0x0040 ECU_ADDRESS 0xFFFFB7D8 /begin FUNCTION_LIST /end FUNCTION_LIST /end MEASUREMENT
/begin MEASUREMENT wfCNXSDL "Detect the Speed Distance Limiter option. Stored in E? PROM." UBYTE COMP_0283 1 100 0 1 BIT_MASK 0x0020 ECU_ADDRESS 0xFFFFB7D8 /begin FUNCTION_LIST /end FUNCTION_LIST /end MEASUREMENT
/begin MEASUREMENT wfCNXUCE7 "ACC frame presence detection with security on configuration detection. Stored in E? PROM" UBYTE COMP_0283 1 100 0 1 BIT_MASK 0x0010 ECU_ADDRESS 0xFFFFB7D8 /begin FUNCTION_LIST /end FUNCTION_LIST /end MEASUREMENT
/begin MEASUREMENT wfCNXUCE8 "conection status with ECU NO.8" UBYTE COMP_0283 1 100 0 1 BIT_MASK 0x0008 ECU_ADDRESS 0xFFFFB7D8 /begin FUNCTION_LIST /end FUNCTION_LIST /end MEASUREMENT
/begin MEASUREMENT wfCNXUCE9 "conection status with ECU NO.9" UBYTE COMP_0283 1 100 0 1 BIT_MASK 0x0004 ECU_ADDRESS 0xFFFFB7D8 /begin FUNCTION_LIST /end FUNCTION_LIST /end MEASUREMENT
/begin MEASUREMENT wfFIRSTDEM "First starting flag" UBYTE COMP_0283 1 100 0 1 BIT_MASK 0x0002 ECU_ADDRESS 0xFFFFB7D8 /begin FUNCTION_LIST /end FUNCTION_LIST /end MEASUREMENT
/begin MEASUREMENT wfSLOPE "Slope judgement" UBYTE COMP_0283 1 100 0 1 BIT_MASK 0x0001 ECU_ADDRESS 0xFFFFB7D8 /begin FUNCTION_LIST /end FUNCTION_LIST /end MEASUREMENT
/begin MEASUREMENT wfSLOSH "Slosh judgement" UBYTE COMP_0283 1 100 0 1 BIT_MASK 0x0080 ECU_ADDRESS 0xFFFFB7D9 /begin FUNCTION_LIST /end FUNCTION_LIST /end MEASUREMENT
/begin MEASUREMENT fSLOPE "Slope judgement" UBYTE COMP_0283 1 100 0 1 BIT_MASK 0x0001 ECU_ADDRESS 0xFFFFB7DA /begin FUNCTION_LIST /end FUNCTION_LIST /end MEASUREMENT
/begin MEASUREMENT fSLOSH "Slosh judgement" UBYTE COMP_0283 1 100 0 1 BIT_MASK 0x0080 ECU_ADDRESS 0xFFFFB7DB /begin FUNCTION_LIST /end FUNCTION_LIST /end MEASUREMENT
/begin MEASUREMENT fDACACM "Abnormal cru/sl deactivation, due to engine control, has been produced" UBYTE COMP_0283 1 100 0 1 BIT_MASK 0x0010 ECU_ADDRESS 0xFFFFB7DC /begin FUNCTION_LIST /end FUNCTION_LIST /end MEASUREMENT
/begin MEASUREMENT fDACAPVV "Abnormal cru/sl deactivation, due to vehicle speed failure, has been produced" UBYTE COMP_0283 1 100 0 1 BIT_MASK 0x0008 ECU_ADDRESS 0xFFFFB7DC /begin FUNCTION_LIST /end FUNCTION_LIST /end MEASUREMENT
/begin MEASUREMENT fDACARVLV "Abnormal cru/sl deactivation due to cru/sl failure detection has been produced" UBYTE COMP_0283 1 100 0 1 BIT_MASK 0x0004 ECU_ADDRESS 0xFFFFB7DC /begin FUNCTION_LIST /end FUNCTION_LIST /end MEASUREMENT
/begin MEASUREMENT fDACBVLH "Abnormal cru/sl deactivation, due to gearbox limp home, has been produced" UBYTE COMP_0283 1 100 0 1 BIT_MASK 0x0002 ECU_ADDRESS 0xFFFFB7DC /begin FUNCTION_LIST /end FUNCTION_LIST /end MEASUREMENT
/begin MEASUREMENT fEMPTY "Fuel level gauge EMPTY dead-zone" UBYTE COMP_0283 1 100 0 1 BIT_MASK 0x0080 ECU_ADDRESS 0xFFFFB7DD /begin FUNCTION_LIST /end FUNCTION_LIST /end MEASUREMENT
/begin MEASUREMENT fFCNXEMB "Clutch contact connection detection. Stored in E^PROM." UBYTE COMP_0283 1 100 0 1 BIT_MASK 0x0002 ECU_ADDRESS 0xFFFFB7DD /begin FUNCTION_LIST /end FUNCTION_LIST /end MEASUREMENT
/begin MEASUREMENT fFCNXFR3 "Open brake contact connection detection. Stored in E^PROM." UBYTE COMP_0283 1 100 0 1 BIT_MASK 0x0001 ECU_ADDRESS 0xFFFFB7DD /begin FUNCTION_LIST /end FUNCTION_LIST /end MEASUREMENT
/begin MEASUREMENT fFTFNGO "Fuel temperature sensor Hoigh Input diagnosis NG buffer" UBYTE COMP_0283 1 100 0 1 BIT_MASK 0x0004 ECU_ADDRESS 0xFFFFB7DF /begin FUNCTION_LIST /end FUNCTION_LIST /end MEASUREMENT
/begin MEASUREMENT fFTFNGR "Fuel temperature sensor function diagnosis NG buffer" UBYTE COMP_0283 1 100 0 1 BIT_MASK 0x0002 ECU_ADDRESS 0xFFFFB7DF /begin FUNCTION_LIST /end FUNCTION_LIST /end MEASUREMENT
/begin MEASUREMENT fFTFNGS "Fuel temperature sensor Low Input diagnosis NG buffer" UBYTE COMP_0283 1 100 0 1 BIT_MASK 0x0001 ECU_ADDRESS 0xFFFFB7DF /begin FUNCTION_LIST /end FUNCTION_LIST /end MEASUREMENT
/begin MEASUREMENT fINJFSCUT1 "#1 Injector circuit VB Short NG flag" UBYTE COMP_0283 1 100 0 1 BIT_MASK 0x0010 ECU_ADDRESS 0xFFFFB7E0 /begin FUNCTION_LIST /end FUNCTION_LIST /end MEASUREMENT
/begin MEASUREMENT fINJFSCUT2 "#2 Injector circuit VB Short NG flag" UBYTE COMP_0283 1 100 0 1 BIT_MASK 0x0008 ECU_ADDRESS 0xFFFFB7E0 /begin FUNCTION_LIST /end FUNCTION_LIST /end MEASUREMENT
/begin MEASUREMENT fINJFSCUT3 "#3 Injector circuit VB Short NG flag" UBYTE COMP_0283 1 100 0 1 BIT_MASK 0x0004 ECU_ADDRESS 0xFFFFB7E0 /begin FUNCTION_LIST /end FUNCTION_LIST /end MEASUREMENT
/begin MEASUREMENT fINJFSCUT4 "#4 Injector circuit VB Short NG flag" UBYTE COMP_0283 1 100 0 1 BIT_MASK 0x0002 ECU_ADDRESS 0xFFFFB7E0 /begin FUNCTION_LIST /end FUNCTION_LIST /end MEASUREMENT
/begin MEASUREMENT fINJFSCUT5 "#5 Injector circuit VB Short NG flag" UBYTE COMP_0283 1 100 0 1 BIT_MASK 0x0001 ECU_ADDRESS 0xFFFFB7E0 /begin FUNCTION_LIST /end FUNCTION_LIST /end MEASUREMENT
/begin MEASUREMENT fINJFSCUT6 "#6 Injector circuit VB Short NG flag" UBYTE COMP_0283 1 100 0 1 BIT_MASK 0x0080 ECU_ADDRESS 0xFFFFB7E1 /begin FUNCTION_LIST /end FUNCTION_LIST /end MEASUREMENT
/begin MEASUREMENT fMILEMAX "MILEAGE Storage" UBYTE COMP_0283 1 100 0 1 BIT_MASK 0x0008 ECU_ADDRESS 0xFFFFB7E1 /begin FUNCTION_LIST /end FUNCTION_LIST /end MEASUREMENT
/begin MEASUREMENT fPM1CFRE "One of brake switch memorized failure. Stored in non-volatile memory." UBYTE COMP_0283 1 100 0 1 BIT_MASK 0x0020 ECU_ADDRESS 0xFFFFB7E2 /begin FUNCTION_LIST /end FUNCTION_LIST /end MEASUREMENT
/begin MEASUREMENT fPM2CFRE "Both of brake switch memorized failure. Stored in non-volatile memory." UBYTE COMP_0283 1 100 0 1 BIT_MASK 0x0010 ECU_ADDRESS 0xFFFFB7E2 /begin FUNCTION_LIST /end FUNCTION_LIST /end MEASUREMENT
/begin MEASUREMENT fPMBOUTMA "Cru/sl main button memorized failure. Stored in non-volatile memory." UBYTE COMP_0283 1 100 0 1 BIT_MASK 0x0008 ECU_ADDRESS 0xFFFFB7E2 /begin FUNCTION_LIST /end FUNCTION_LIST /end MEASUREMENT
/begin MEASUREMENT fPMCOMVOL "Steering wheel command button memorized failure. Stored in non-volatile memory." UBYTE COMP_0283 1 100 0 1 BIT_MASK 0x0004 ECU_ADDRESS 0xFFFFB7E2 /begin FUNCTION_LIST /end FUNCTION_LIST /end MEASUREMENT
/begin MEASUREMENT fPMGBRCPT "AGB reception confirmed failure" UBYTE COMP_0283 1 100 0 1 BIT_MASK 0x0002 ECU_ADDRESS 0xFFFFB7E2 /begin FUNCTION_LIST /end FUNCTION_LIST /end MEASUREMENT
/begin MEASUREMENT fPMGBTQNG "Confirmed failure for invalid value" UBYTE COMP_0283 1 100 0 1 BIT_MASK 0x0001 ECU_ADDRESS 0xFFFFB7E2 /begin FUNCTION_LIST /end FUNCTION_LIST /end MEASUREMENT
/begin MEASUREMENT fPMPRSCLM "Air conditioning pressure sensor memorized failure" UBYTE COMP_0283 1 100 0 1 BIT_MASK 0x0080 ECU_ADDRESS 0xFFFFB7E3 /begin FUNCTION_LIST /end FUNCTION_LIST /end MEASUREMENT
/begin MEASUREMENT fEEPWRT_S "During writing, flag" UBYTE COMP_0283 1 100 0 1 BIT_MASK 0x0004 ECU_ADDRESS 0xFFFFB7E3 /begin FUNCTION_LIST /end FUNCTION_LIST /end MEASUREMENT
/begin MEASUREMENT fMTPFIRST "vMTPIDL computed first distinction flag" UBYTE COMP_0283 1 100 0 1 BIT_MASK 0x0080 ECU_ADDRESS 0xFFFFB7E4 /begin FUNCTION_LIST /end FUNCTION_LIST /end MEASUREMENT
/begin MEASUREMENT fCNXUCE12 "conection status with ECU NO.12" UBYTE COMP_0283 1 100 0 1 BIT_MASK 0x0040 ECU_ADDRESS 0xFFFFB7E5 /begin FUNCTION_LIST /end FUNCTION_LIST /end MEASUREMENT
/begin MEASUREMENT fCNXUCESP "ESP automatic detection" UBYTE COMP_0283 1 100 0 1 BIT_MASK 0x0080 ECU_ADDRESS 0xFFFFB7E6 /begin FUNCTION_LIST /end FUNCTION_LIST /end MEASUREMENT
/begin MEASUREMENT fDMOBCMSV "BCM receptin diagnostic indicator detected and saved" UBYTE COMP_0283 1 100 0 1 BIT_MASK 0x0020 ECU_ADDRESS 0xFFFFB7E6 /begin FUNCTION_LIST /end FUNCTION_LIST /end MEASUREMENT
/begin MEASUREMENT fEMUL "clear cskey" UBYTE COMP_0283 1 100 0 1 BIT_MASK 0x0010 ECU_ADDRESS 0xFFFFB7E6 /begin FUNCTION_LIST /end FUNCTION_LIST /end MEASUREMENT
/begin MEASUREMENT fFSTMIL "MIL conditions flag" UBYTE COMP_0283 1 100 0 1 BIT_MASK 0x0004 ECU_ADDRESS 0xFFFFB7E6 /begin FUNCTION_LIST /end FUNCTION_LIST /end MEASUREMENT
/begin MEASUREMENT fFSTMILZ "MIL conditions flag (previous value)" UBYTE COMP_0283 1 100 0 1 BIT_MASK 0x0002 ECU_ADDRESS 0xFFFFB7E6 /begin FUNCTION_LIST /end FUNCTION_LIST /end MEASUREMENT
/begin MEASUREMENT fPMDEFMAJ "Major BVR failure reception present failure" UBYTE COMP_0283 1 100 0 1 BIT_MASK 0x0010 ECU_ADDRESS 0xFFFFB7E7 /begin FUNCTION_LIST /end FUNCTION_LIST /end MEASUREMENT
/begin MEASUREMENT fFRGST1 "RGSTR1 fixed flag" UBYTE COMP_0283 1 100 0 1 BIT_MASK 0x0080 ECU_ADDRESS 0xFFFFB7E8 /begin FUNCTION_LIST /end FUNCTION_LIST /end MEASUREMENT
/begin MEASUREMENT fFRGST2 "RGSTR2 fixed flag" UBYTE COMP_0283 1 100 0 1 BIT_MASK 0x0040 ECU_ADDRESS 0xFFFFB7E8 /begin FUNCTION_LIST /end FUNCTION_LIST /end MEASUREMENT
/begin MEASUREMENT fITAADJH "Hysteresis flag" UBYTE COMP_0283 1 100 0 1 BIT_MASK 0x0020 ECU_ADDRESS 0xFFFFB7E8 /begin FUNCTION_LIST /end FUNCTION_LIST /end MEASUREMENT
/begin MEASUREMENT fITAADJL "Hysteresis flag" UBYTE COMP_0283 1 100 0 1 BIT_MASK 0x0010 ECU_ADDRESS 0xFFFFB7E8 /begin FUNCTION_LIST /end FUNCTION_LIST /end MEASUREMENT
/begin MEASUREMENT fTWNADJL "Hysteresis flag" UBYTE COMP_0283 1 100 0 1 BIT_MASK 0x0002 ECU_ADDRESS 0xFFFFB7E8 /begin FUNCTION_LIST /end FUNCTION_LIST /end MEASUREMENT
/begin MEASUREMENT afCNXAC "Air Conditioning option detection with security on configuration" UBYTE COMP_0283 1 100 0 1 BIT_MASK 0x0080 ECU_ADDRESS 0xFFFFB7E9 /begin FUNCTION_LIST /end FUNCTION_LIST /end MEASUREMENT
/begin MEASUREMENT afCNXBRKNC "Boolean for brake connection" UBYTE COMP_0283 1 100 0 1 BIT_MASK 0x0040 ECU_ADDRESS 0xFFFFB7E9 /begin FUNCTION_LIST /end FUNCTION_LIST /end MEASUREMENT
/begin MEASUREMENT afCNXCLURN "Begin stroke clutch switch connection detection. Stored in E? PROM." UBYTE COMP_0283 1 100 0 1 BIT_MASK 0x0020 ECU_ADDRESS 0xFFFFB7E9 /begin FUNCTION_LIST /end FUNCTION_LIST /end MEASUREMENT
/begin MEASUREMENT afCNXLV "speed limiter option detection with security on configuration detection. Stored in E^PROM." UBYTE COMP_0283 1 100 0 1 BIT_MASK 0x0010 ECU_ADDRESS 0xFFFFB7E9 /begin FUNCTION_LIST /end FUNCTION_LIST /end MEASUREMENT
/begin MEASUREMENT afCNXLVSW "Detect the speed limiter switch connection. Stored in E? PROM." UBYTE COMP_0283 1 100 0 1 BIT_MASK 0x0008 ECU_ADDRESS 0xFFFFB7E9 /begin FUNCTION_LIST /end FUNCTION_LIST /end MEASUREMENT
/begin MEASUREMENT afCNXRV "Detect cruise control option with security on configuration detection. Stored in E^PROM." UBYTE COMP_0283 1 100 0 1 BIT_MASK 0x0004 ECU_ADDRESS 0xFFFFB7E9 /begin FUNCTION_LIST /end FUNCTION_LIST /end MEASUREMENT
/begin MEASUREMENT afCNXRVSW "Detect the cruise control switch connection. Stored in E? PROM." UBYTE COMP_0283 1 100 0 1 BIT_MASK 0x0002 ECU_ADDRESS 0xFFFFB7E9 /begin FUNCTION_LIST /end FUNCTION_LIST /end MEASUREMENT
/begin MEASUREMENT afCRUSWI "Switch order memorized boolean" UBYTE COMP_0283 1 100 0 1 BIT_MASK 0x0001 ECU_ADDRESS 0xFFFFB7E9 /begin FUNCTION_LIST /end FUNCTION_LIST /end MEASUREMENT
/begin MEASUREMENT afCVN2EDBU "CVN operation completion flag (for GSTONCAN RN)" UBYTE COMP_0283 1 100 0 1 BIT_MASK 0x0080 ECU_ADDRESS 0xFFFFB7EA /begin FUNCTION_LIST /end FUNCTION_LIST /end MEASUREMENT
/begin MEASUREMENT afFCNXBTV "Steering wheel switches connection detection. Stored in E^PROM." UBYTE COMP_0283 1 100 0 1 BIT_MASK 0x0040 ECU_ADDRESS 0xFFFFB7EA /begin FUNCTION_LIST /end FUNCTION_LIST /end MEASUREMENT
/begin MEASUREMENT afFCNXPWST "-" UBYTE COMP_0283 1 100 0 1 BIT_MASK 0x0020 ECU_ADDRESS 0xFFFFB7EA /begin FUNCTION_LIST /end FUNCTION_LIST /end MEASUREMENT
/begin MEASUREMENT afM6PPHBU "At the time of the POSPHASE trouble, control-in-progress flag" UBYTE COMP_0283 1 100 0 1 BIT_MASK 0x0008 ECU_ADDRESS 0xFFFFB7EA /begin FUNCTION_LIST /end FUNCTION_LIST /end MEASUREMENT
/begin MEASUREMENT afM6REFBU "At the time of the REF trouble, control-in-progress flag" UBYTE COMP_0283 1 100 0 1 BIT_MASK 0x0004 ECU_ADDRESS 0xFFFFB7EA /begin FUNCTION_LIST /end FUNCTION_LIST /end MEASUREMENT
/begin MEASUREMENT afVTREXE "VTC operation angle deviation quantity integral value rapid learning experience flag" UBYTE COMP_0283 1 100 0 1 BIT_MASK 0x0002 ECU_ADDRESS 0xFFFFB7EA /begin FUNCTION_LIST /end FUNCTION_LIST /end MEASUREMENT
/begin MEASUREMENT fCVN2EDBU "CVN operation completion flag (for GSTONCAN RN)" UBYTE COMP_0283 1 100 0 1 BIT_MASK 0x0080 ECU_ADDRESS 0xFFFFB7EC /begin FUNCTION_LIST /end FUNCTION_LIST /end MEASUREMENT
/begin MEASUREMENT fM6PPHBU "At the time of the POSPHASE trouble, control-in-progress flag" UBYTE COMP_0283 1 100 0 1 BIT_MASK 0x0008 ECU_ADDRESS 0xFFFFB7EC /begin FUNCTION_LIST /end FUNCTION_LIST /end MEASUREMENT
/begin MEASUREMENT fM6REFBU "At the time of the REF trouble, control-in-progress flag" UBYTE COMP_0283 1 100 0 1 BIT_MASK 0x0004 ECU_ADDRESS 0xFFFFB7EC /begin FUNCTION_LIST /end FUNCTION_LIST /end MEASUREMENT
/begin MEASUREMENT fVTREXE "VTC operation angle deviation quantity integral value rapid learning experience flag" UBYTE COMP_0283 1 100 0 1 BIT_MASK 0x0002 ECU_ADDRESS 0xFFFFB7EC /begin FUNCTION_LIST /end FUNCTION_LIST /end MEASUREMENT
/begin MEASUREMENT tACONRD "After air-conditioning on, delay timer" UBYTE COMP_0201_S 1 100 0 255 ECU_ADDRESS 0xFFFF436C /begin FUNCTION_LIST /end FUNCTION_LIST /end MEASUREMENT
/begin MEASUREMENT tACVTM "VS activated judgment timer" UBYTE COMP_0201_S 1 100 0 255 ECU_ADDRESS 0xFFFF436D /begin FUNCTION_LIST /end FUNCTION_LIST /end MEASUREMENT
/begin MEASUREMENT tAFVNGT1C "A/F sensor breakage NG judgement time (for the diagnosis complete number of times count)" UBYTE COMP_0201_S 1 100 0 255 ECU_ADDRESS 0xFFFF4377 /begin FUNCTION_LIST /end FUNCTION_LIST /end MEASUREMENT
/begin MEASUREMENT tAPSDBLT1 "APS the second-fold CA judgement time" UBYTE COMP_0201_S 1 100 0 255 ECU_ADDRESS 0xFFFF4379 /begin FUNCTION_LIST /end FUNCTION_LIST /end MEASUREMENT
/begin MEASUREMENT tATCULAN "A timer for the ATCU diagnosis diagnosis permission condition" UBYTE COMP_0201_S 1 100 0 255 ECU_ADDRESS 0xFFFF437A /begin FUNCTION_LIST /end FUNCTION_LIST /end MEASUREMENT
/begin MEASUREMENT tBRKCHKT2 "Brake SWCA judgement time" UBYTE COMP_0201_S 1 100 0 255 ECU_ADDRESS 0xFFFF437B /begin FUNCTION_LIST /end FUNCTION_LIST /end MEASUREMENT
/begin MEASUREMENT tDLYCD3V "Imaginary stage 2 diagnosis condition disconnection delay" UBYTE COMP_0201_S 1 100 0 255 ECU_ADDRESS 0xFFFF4383 /begin FUNCTION_LIST /end FUNCTION_LIST /end MEASUREMENT
/begin MEASUREMENT tDSCVNG1 "Swirl control valve function diagnosis NG judgement delay 1" UBYTE COMP_0201_S 1 100 0 255 ECU_ADDRESS 0xFFFF4385 /begin FUNCTION_LIST /end FUNCTION_LIST /end MEASUREMENT
/begin MEASUREMENT tDSCVNG2 "Swirl control valve function diagnosis NG judgement delay 2" UBYTE COMP_0201_S 1 100 0 255 ECU_ADDRESS 0xFFFF4386 /begin FUNCTION_LIST /end FUNCTION_LIST /end MEASUREMENT
/begin MEASUREMENT tDTFRATE1 "Fuel temperature sensor judgement delay 1 (RATE law)" UBYTE COMP_0201_S 1 100 0 255 ECU_ADDRESS 0xFFFF4387 /begin FUNCTION_LIST /end FUNCTION_LIST /end MEASUREMENT
/begin MEASUREMENT tDTFRATE2 "Fuel temperature sensor judgement delay 2 (RATE law)" UBYTE COMP_0201_S 1 100 0 255 ECU_ADDRESS 0xFFFF4388 /begin FUNCTION_LIST /end FUNCTION_LIST /end MEASUREMENT
/begin MEASUREMENT tECNINHT "Electrical consumer inhibition time" UBYTE COMP_0201_S 1 100 0 255 ECU_ADDRESS 0xFFFF4389 /begin FUNCTION_LIST /end FUNCTION_LIST /end MEASUREMENT
/begin MEASUREMENT tEGROPD "An open diagnosis diagnosis timing" UBYTE COMP_0201_S 1 100 0 255 ECU_ADDRESS 0xFFFF438A /begin FUNCTION_LIST /end FUNCTION_LIST /end MEASUREMENT
/begin MEASUREMENT tETHSJDE "After the hot restart closed-diagnosis TEGR decline, diagnosis permission condition delay" UBYTE COMP_0201_S 1 100 0 255 ECU_ADDRESS 0xFFFF438B /begin FUNCTION_LIST /end FUNCTION_LIST /end MEASUREMENT
/begin MEASUREMENT tETWJD "Coolant temperature condition judgement delay" UBYTE COMP_0201_S 1 100 0 255 ECU_ADDRESS 0xFFFF438C /begin FUNCTION_LIST /end FUNCTION_LIST /end MEASUREMENT
/begin MEASUREMENT tFO2HDY "After O2 heater on, delay timer" UBYTE COMP_0201_S 1 100 0 255 ECU_ADDRESS 0xFFFF438D /begin FUNCTION_LIST /end FUNCTION_LIST /end MEASUREMENT
/begin MEASUREMENT tFSALTT1 "Alternator generating electricity voltage variable system trouble diagnosis delay timer 1" UBYTE COMP_0201_S 1 100 0 255 ECU_ADDRESS 0xFFFF438F /begin FUNCTION_LIST /end FUNCTION_LIST /end MEASUREMENT
/begin MEASUREMENT tFSALTT2 "Alternator generating electricity voltage variable system trouble diagnosis delay timer 2" UBYTE COMP_0201_S 1 100 0 255 ECU_ADDRESS 0xFFFF4390 /begin FUNCTION_LIST /end FUNCTION_LIST /end MEASUREMENT
/begin MEASUREMENT tFTSNGDLY "Fuel temperature sensor judgement time" UBYTE COMP_0201_S 1 100 0 255 ECU_ADDRESS 0xFFFF4393 /begin FUNCTION_LIST /end FUNCTION_LIST /end MEASUREMENT
/begin MEASUREMENT tIDLDLY "IDLESW delay timer" UBYTE COMP_0201_S 1 100 0 255 ECU_ADDRESS 0xFFFF4398 /begin FUNCTION_LIST /end FUNCTION_LIST /end MEASUREMENT
/begin MEASUREMENT tIDLDLY2 "IDLESW delay timer" UBYTE COMP_0201_S 1 100 0 255 ECU_ADDRESS 0xFFFF4399 /begin FUNCTION_LIST /end FUNCTION_LIST /end MEASUREMENT
/begin MEASUREMENT tIDSTTM "Idle set coolant temperature continuous time" UBYTE COMP_0201_S 1 100 0 255 ECU_ADDRESS 0xFFFF439A /begin FUNCTION_LIST /end FUNCTION_LIST /end MEASUREMENT
/begin MEASUREMENT tLMDRATE1 "A delay 1 for the closed-loop diagnosis judgement counter" UBYTE COMP_0201_S 1 100 0 255 ECU_ADDRESS 0xFFFF439C /begin FUNCTION_LIST /end FUNCTION_LIST /end MEASUREMENT
/begin MEASUREMENT tO2H1S "O2H Control timer" UBYTE COMP_0201_S 1 100 0 255 ECU_ADDRESS 0xFFFF439F /begin FUNCTION_LIST /end FUNCTION_LIST /end MEASUREMENT
/begin MEASUREMENT tO2HRODT "After unusual voltage judgement permission heater on, delay timer" UBYTE COMP_0201_S 1 100 0 255 ECU_ADDRESS 0xFFFF43A2 /begin FUNCTION_LIST /end FUNCTION_LIST /end MEASUREMENT
/begin MEASUREMENT tO2JD "O2 sensor breakage diagnosis region formation delay timer" UBYTE COMP_0201_S 1 100 0 255 ECU_ADDRESS 0xFFFF43A4 /begin FUNCTION_LIST /end FUNCTION_LIST /end MEASUREMENT
/begin MEASUREMENT tO2JDNG "O2 sensor breakage diagnosis NG judgement delay timer" UBYTE COMP_0201_S 1 100 0 255 ECU_ADDRESS 0xFFFF43A6 /begin FUNCTION_LIST /end FUNCTION_LIST /end MEASUREMENT
/begin MEASUREMENT tO2JDNG2 "O2 sensor breakage diagnosis frequency (Rate law) count rise judgement delay timer" UBYTE COMP_0201_S 1 100 0 255 ECU_ADDRESS 0xFFFF43A8 /begin FUNCTION_LIST /end FUNCTION_LIST /end MEASUREMENT
/begin MEASUREMENT tO2NGTM "O2 heater diagnosis NG judgement delay timer" UBYTE COMP_0201_S 1 100 0 255 ECU_ADDRESS 0xFFFF43AC /begin FUNCTION_LIST /end FUNCTION_LIST /end MEASUREMENT
/begin MEASUREMENT tOVHSTT "Over heat judging delay timer" UBYTE COMP_0201_S 1 100 0 255 ECU_ADDRESS 0xFFFF43AE /begin FUNCTION_LIST /end FUNCTION_LIST /end MEASUREMENT
/begin MEASUREMENT tRCMTIME "A timer counter for GST" UBYTE COMP_0201_S 1 100 0 255 ECU_ADDRESS 0xFFFF43AF /begin FUNCTION_LIST /end FUNCTION_LIST /end MEASUREMENT
/begin MEASUREMENT tRCMTIME2 "A timer counter for GST" UBYTE COMP_0201_S 1 100 0 255 ECU_ADDRESS 0xFFFF43B0 /begin FUNCTION_LIST /end FUNCTION_LIST /end MEASUREMENT
/begin MEASUREMENT tRFBALT_V "The rest O2/S diagnosis imaginary stage 2 region condition permission lambda control continuation time timer" UBYTE COMP_0201_S 1 100 0 255 ECU_ADDRESS 0xFFFF43B3 /begin FUNCTION_LIST /end FUNCTION_LIST /end MEASUREMENT
/begin MEASUREMENT tRFBALTT "3rdO2/S diagnosis stage 2 region condition permission lambda control continuation time timer" UBYTE COMP_0201_S 1 100 0 255 ECU_ADDRESS 0xFFFF43B5 /begin FUNCTION_LIST /end FUNCTION_LIST /end MEASUREMENT
/begin MEASUREMENT tRFBFCT_V "The rest O2/S diagnosis imaginary stage 2 region condition permission F/C inside continuation time timer" UBYTE COMP_0201_S 1 100 0 255 ECU_ADDRESS 0xFFFF43B9 /begin FUNCTION_LIST /end FUNCTION_LIST /end MEASUREMENT
/begin MEASUREMENT tRFBFCTT "3rdO2/S diagnosis stage 2 region condition permission F/C inside continuation time timer" UBYTE COMP_0201_S 1 100 0 255 ECU_ADDRESS 0xFFFF43BB /begin FUNCTION_LIST /end FUNCTION_LIST /end MEASUREMENT
/begin MEASUREMENT tRFBIDT_V "The rest O2/S diagnosis imaginary stage 2 region condition permission idle off continuation time timer" UBYTE COMP_0201_S 1 100 0 255 ECU_ADDRESS 0xFFFF43BF /begin FUNCTION_LIST /end FUNCTION_LIST /end MEASUREMENT
/begin MEASUREMENT tRFBIDTT "3rdO2/S diagnosis stage 2 region condition permission idle off continuation time timer" UBYTE COMP_0201_S 1 100 0 255 ECU_ADDRESS 0xFFFF43C1 /begin FUNCTION_LIST /end FUNCTION_LIST /end MEASUREMENT
/begin MEASUREMENT tRFBKMT_V "The rest O2/S diagnosis imaginary stage 2 region condition permission TFBYA0==1.0 continuation time timer" UBYTE COMP_0201_S 1 100 0 255 ECU_ADDRESS 0xFFFF43C5 /begin FUNCTION_LIST /end FUNCTION_LIST /end MEASUREMENT
/begin MEASUREMENT tRFBKMTT "3rdO2/S diagnosis stage 2 region condition permission TFBYA0==1.0 continuation time timer" UBYTE COMP_0201_S 1 100 0 255 ECU_ADDRESS 0xFFFF43C7 /begin FUNCTION_LIST /end FUNCTION_LIST /end MEASUREMENT
/begin MEASUREMENT tROHTML "The rest O2/H diagnosis (LowInput) NG judgement delay timer" UBYTE COMP_0201_S 1 100 0 255 ECU_ADDRESS 0xFFFF43CF /begin FUNCTION_LIST /end FUNCTION_LIST /end MEASUREMENT
/begin MEASUREMENT tROHTMT "3rdO2/H diagnosis NG judgement delay timer" UBYTE COMP_0201_S 1 100 0 255 ECU_ADDRESS 0xFFFF43D1 /begin FUNCTION_LIST /end FUNCTION_LIST /end MEASUREMENT
/begin MEASUREMENT tROHTMTL "3rdO2/H diagnosis (Low side) NG judgement delay timer" UBYTE COMP_0201_S 1 100 0 255 ECU_ADDRESS 0xFFFF43D3 /begin FUNCTION_LIST /end FUNCTION_LIST /end MEASUREMENT
/begin MEASUREMENT tROHTON "A heater on time delay for the rest O2 sensor initialization judgement" UBYTE COMP_0201_S 1 100 0 255 ECU_ADDRESS 0xFFFF43D5 /begin FUNCTION_LIST /end FUNCTION_LIST /end MEASUREMENT
/begin MEASUREMENT tROJFCDT "After the diagnosis permission judgement fuel cut, progress time timer" UBYTE COMP_0201_S 1 100 0 255 ECU_ADDRESS 0xFFFF43DF /begin FUNCTION_LIST /end FUNCTION_LIST /end MEASUREMENT
/begin MEASUREMENT tROXJSDT "After a diagnosis monitor start starts, delay timer" UBYTE COMP_0201_S 1 100 0 255 ECU_ADDRESS 0xFFFF43E2 /begin FUNCTION_LIST /end FUNCTION_LIST /end MEASUREMENT
/begin MEASUREMENT tSCOKDY "#FSCVOK switching delay timer" UBYTE COMP_0201_S 1 100 0 255 ECU_ADDRESS 0xFFFF43E3 /begin FUNCTION_LIST /end FUNCTION_LIST /end MEASUREMENT
/begin MEASUREMENT tSCVSDLY "After the vehicle speed condition formation for the supercharger diagnosis, delay" UBYTE COMP_0201_S 1 100 0 255 ECU_ADDRESS 0xFFFF43E4 /begin FUNCTION_LIST /end FUNCTION_LIST /end MEASUREMENT
/begin MEASUREMENT tSSAD "fCATDGPM set condition time progress watch timer" UBYTE COMP_0201_S 1 100 0 255 ECU_ADDRESS 0xFFFF43E5 /begin FUNCTION_LIST /end FUNCTION_LIST /end MEASUREMENT
/begin MEASUREMENT tSSAD1 "fCATDGSC set condition time progress watch timer" UBYTE COMP_0201_S 1 100 0 255 ECU_ADDRESS 0xFFFF43E6 /begin FUNCTION_LIST /end FUNCTION_LIST /end MEASUREMENT
/begin MEASUREMENT tTACDGN "Compressor sticking diagnosis interval timer" UBYTE COMP_0201_S 1 100 0 255 ECU_ADDRESS 0xFFFF43E7 /begin FUNCTION_LIST /end FUNCTION_LIST /end MEASUREMENT
/begin MEASUREMENT tTAF3NG "AFM middle delay NG timer" UBYTE COMP_0201_S 1 100 0 255 ECU_ADDRESS 0xFFFF43E8 /begin FUNCTION_LIST /end FUNCTION_LIST /end MEASUREMENT
/begin MEASUREMENT tTAFSNG1 "At the time of the AFM engine stop, NG timer" UBYTE COMP_0201_S 1 100 0 255 ECU_ADDRESS 0xFFFF43ED /begin FUNCTION_LIST /end FUNCTION_LIST /end MEASUREMENT
/begin MEASUREMENT tTBATSC "Battery electric current sensor middle trouble diagnosis judgement timer" UBYTE COMP_0201_S 1 100 0 255 ECU_ADDRESS 0xFFFF43EE /begin FUNCTION_LIST /end FUNCTION_LIST /end MEASUREMENT
/begin MEASUREMENT tTBATSH "Battery electric current sensor High_Output diagnosis judgement timer" UBYTE COMP_0201_S 1 100 0 255 ECU_ADDRESS 0xFFFF43EF /begin FUNCTION_LIST /end FUNCTION_LIST /end MEASUREMENT
/begin MEASUREMENT tTBATSL "Battery electric current sensor Low_Output diagnosis judgement timer" UBYTE COMP_0201_S 1 100 0 255 ECU_ADDRESS 0xFFFF43F0 /begin FUNCTION_LIST /end FUNCTION_LIST /end MEASUREMENT
/begin MEASUREMENT tTBATSR1 "Battery electric current sensor function diagnosis 1 judgement timer" UBYTE COMP_0201_S 1 100 0 255 ECU_ADDRESS 0xFFFF43F1 /begin FUNCTION_LIST /end FUNCTION_LIST /end MEASUREMENT
/begin MEASUREMENT tTBATSR2 "Battery electric current sensor function diagnosis 2 judgement timer" UBYTE COMP_0201_S 1 100 0 255 ECU_ADDRESS 0xFFFF43F2 /begin FUNCTION_LIST /end FUNCTION_LIST /end MEASUREMENT
/begin MEASUREMENT tTCDTM "PHOSA operation condition catalyst estimated temperature delay timer" UBYTE COMP_0201_S 1 100 0 255 ECU_ADDRESS 0xFFFF43F3 /begin FUNCTION_LIST /end FUNCTION_LIST /end MEASUREMENT
/begin MEASUREMENT tTCLO2D "Closed-loop diagnosis heater on delay timer" UBYTE COMP_0201_S 1 100 0 255 ECU_ADDRESS 0xFFFF43F4 /begin FUNCTION_LIST /end FUNCTION_LIST /end MEASUREMENT
/begin MEASUREMENT tTDCVOTM "After the drain-cut valve open, delay" UBYTE COMP_0201_S 1 100 0 255 ECU_ADDRESS 0xFFFF43F8 /begin FUNCTION_LIST /end FUNCTION_LIST /end MEASUREMENT
/begin MEASUREMENT tTDLYMF "After the start, delay timer" UBYTE COMP_0201_S 1 100 0 255 ECU_ADDRESS 0xFFFF43F9 /begin FUNCTION_LIST /end FUNCTION_LIST /end MEASUREMENT
/begin MEASUREMENT tTDTFNG1 "Fuel temperature sensor judgement delay 1" UBYTE COMP_0201_S 1 100 0 255 ECU_ADDRESS 0xFFFF43FE /begin FUNCTION_LIST /end FUNCTION_LIST /end MEASUREMENT
/begin MEASUREMENT tTDTFNG2 "Fuel temperature sensor judgement delay 2" UBYTE COMP_0201_S 1 100 0 255 ECU_ADDRESS 0xFFFF43FF /begin FUNCTION_LIST /end FUNCTION_LIST /end MEASUREMENT
/begin MEASUREMENT tTEGRCDN "EGR system non-warming judgement delay timer" UBYTE COMP_0201_S 1 100 0 255 ECU_ADDRESS 0xFFFF4400 /begin FUNCTION_LIST /end FUNCTION_LIST /end MEASUREMENT
/begin MEASUREMENT tTEGRIGN "IGN After on, diagnosis delay timer" UBYTE COMP_0201_S 1 100 0 255 ECU_ADDRESS 0xFFFF4401 /begin FUNCTION_LIST /end FUNCTION_LIST /end MEASUREMENT
/begin MEASUREMENT tTEGRWUP "EGR system warmth judgement delay timer" UBYTE COMP_0201_S 1 100 0 255 ECU_ADDRESS 0xFFFF4402 /begin FUNCTION_LIST /end FUNCTION_LIST /end MEASUREMENT
/begin MEASUREMENT tTHNGT "At the time of throttle opening and closing, sensor trouble judgement delay timer" UBYTE COMP_0201_S 1 100 0 255 ECU_ADDRESS 0xFFFF4403 /begin FUNCTION_LIST /end FUNCTION_LIST /end MEASUREMENT
/begin MEASUREMENT tTHRO21 "The rest O2 sensor unusual voltage NG judgement delay timer" UBYTE COMP_0201_S 1 100 0 255 ECU_ADDRESS 0xFFFF4406 /begin FUNCTION_LIST /end FUNCTION_LIST /end MEASUREMENT
/begin MEASUREMENT tTHRO2C "An unusual voltage judgement time measuring timer during catalyst diagnosis region running" UBYTE COMP_0201_S 1 100 0 255 ECU_ADDRESS 0xFFFF4408 /begin FUNCTION_LIST /end FUNCTION_LIST /end MEASUREMENT
/begin MEASUREMENT tTHRO2CT "An unusual voltage judgement time measuring timer" UBYTE COMP_0201_S 1 100 0 255 ECU_ADDRESS 0xFFFF440A /begin FUNCTION_LIST /end FUNCTION_LIST /end MEASUREMENT
/begin MEASUREMENT tTMATCK "A timer without an ATCU receiving data" UBYTE COMP_0201_S 1 100 0 255 ECU_ADDRESS 0xFFFF440F /begin FUNCTION_LIST /end FUNCTION_LIST /end MEASUREMENT
/begin MEASUREMENT tTMDOST "Diagnosis permission DOS formation time timer" UBYTE COMP_0201_S 1 100 0 255 ECU_ADDRESS 0xFFFF4412 /begin FUNCTION_LIST /end FUNCTION_LIST /end MEASUREMENT
/begin MEASUREMENT tTMEVLNS "Line pressure sensor function diagnosis time timer" UBYTE COMP_0201_S 1 100 0 255 ECU_ADDRESS 0xFFFF4414 /begin FUNCTION_LIST /end FUNCTION_LIST /end MEASUREMENT
/begin MEASUREMENT tTMISCCNT "A delay timer (for the RATE law) for the ISC function diagnosis frequency counter" UBYTE COMP_0201_S 1 100 0 255 ECU_ADDRESS 0xFFFF4415 /begin FUNCTION_LIST /end FUNCTION_LIST /end MEASUREMENT
/begin MEASUREMENT tTMO2H1 "After O2 heater on for the O2 heater diagnosis, delay timer" UBYTE COMP_0201_S 1 100 0 255 ECU_ADDRESS 0xFFFF4418 /begin FUNCTION_LIST /end FUNCTION_LIST /end MEASUREMENT
/begin MEASUREMENT tTMO2HS "O2H rush tense time" UBYTE COMP_0201_S 1 100 0 255 ECU_ADDRESS 0xFFFF441A /begin FUNCTION_LIST /end FUNCTION_LIST /end MEASUREMENT
/begin MEASUREMENT tTMONISC "ISC diagnosis NG judgement time" UBYTE COMP_0201_S 1 100 0 255 ECU_ADDRESS 0xFFFF441B /begin FUNCTION_LIST /end FUNCTION_LIST /end MEASUREMENT
/begin MEASUREMENT tTMRNSD "Diagnosis delay timer" UBYTE COMP_0201_S 1 100 0 255 ECU_ADDRESS 0xFFFF4424 /begin FUNCTION_LIST /end FUNCTION_LIST /end MEASUREMENT
/begin MEASUREMENT tTMRO2HT "3rdO2/H After ON/ off, delay timer" UBYTE COMP_0201_S 1 100 0 255 ECU_ADDRESS 0xFFFF4427 /begin FUNCTION_LIST /end FUNCTION_LIST /end MEASUREMENT
/begin MEASUREMENT tTMTRP5 "Trip 5 rush time measuring timer" UBYTE COMP_0201_S 1 100 0 255 ECU_ADDRESS 0xFFFF442B /begin FUNCTION_LIST /end FUNCTION_LIST /end MEASUREMENT
/begin MEASUREMENT tTMVSOK "VS normality judgement" UBYTE COMP_0201_S 1 100 0 255 ECU_ADDRESS 0xFFFF442D /begin FUNCTION_LIST /end FUNCTION_LIST /end MEASUREMENT
/begin MEASUREMENT tTNCONF "A high coolant temperature increase diagnosis common stage high coolant temperature increase timer" UBYTE COMP_0201_S 1 100 0 255 ECU_ADDRESS 0xFFFF442E /begin FUNCTION_LIST /end FUNCTION_LIST /end MEASUREMENT
/begin MEASUREMENT tTO2HTU "At the time of the first energizing, timer" UBYTE COMP_0201_S 1 100 0 255 ECU_ADDRESS 0xFFFF442F /begin FUNCTION_LIST /end FUNCTION_LIST /end MEASUREMENT
/begin MEASUREMENT tTPRGCTM "After the purge cut, delay" UBYTE COMP_0201_S 1 100 0 255 ECU_ADDRESS 0xFFFF4430 /begin FUNCTION_LIST /end FUNCTION_LIST /end MEASUREMENT
/begin MEASUREMENT tTSTOFFSF "Starter switch on continuation time upper limit" UBYTE COMP_0201_S 1 100 0 255 ECU_ADDRESS 0xFFFF4431 /begin FUNCTION_LIST /end FUNCTION_LIST /end MEASUREMENT
/begin MEASUREMENT tTTANVDY "Intake air temperature sensor diagnosis vehicle speed judgement delay" UBYTE COMP_0201_S 1 100 0 255 ECU_ADDRESS 0xFFFF4432 /begin FUNCTION_LIST /end FUNCTION_LIST /end MEASUREMENT
/begin MEASUREMENT tTTIMISC "ISC diagnosis permission delay timer" UBYTE COMP_0201_S 1 100 0 255 ECU_ADDRESS 0xFFFF4433 /begin FUNCTION_LIST /end FUNCTION_LIST /end MEASUREMENT
/begin MEASUREMENT tTTIMISCH "ISC High rpm diagnosis permission delay timer" UBYTE COMP_0201_S 1 100 0 255 ECU_ADDRESS 0xFFFF4434 /begin FUNCTION_LIST /end FUNCTION_LIST /end MEASUREMENT
/begin MEASUREMENT tTTIMISCL "ISC Low rpm diagnosis permission delay timer" UBYTE COMP_0201_S 1 100 0 255 ECU_ADDRESS 0xFFFF4435 /begin FUNCTION_LIST /end FUNCTION_LIST /end MEASUREMENT
/begin MEASUREMENT tTTIMST1 "ISC diagnosis condition (c) diagnosis time" UBYTE COMP_0201_S 1 100 0 255 ECU_ADDRESS 0xFFFF4436 /begin FUNCTION_LIST /end FUNCTION_LIST /end MEASUREMENT
/begin MEASUREMENT tTTMEVC3 "Pull-down region cancellation delay" UBYTE COMP_0201_S 1 100 0 255 ECU_ADDRESS 0xFFFF4437 /begin FUNCTION_LIST /end FUNCTION_LIST /end MEASUREMENT
/begin MEASUREMENT tTTWINTF "At least, coolant temperature judgement time" UBYTE COMP_0201_S 1 100 0 255 ECU_ADDRESS 0xFFFF4438 /begin FUNCTION_LIST /end FUNCTION_LIST /end MEASUREMENT
/begin MEASUREMENT tTVSNGTM "A timer for VS>=AFACTV" UBYTE COMP_0201_S 1 100 0 255 ECU_ADDRESS 0xFFFF4439 /begin FUNCTION_LIST /end FUNCTION_LIST /end MEASUREMENT
/begin MEASUREMENT tTVSPDGN "Vehicle speed sensor NG judgement delay timer" UBYTE COMP_0201_S 1 100 0 255 ECU_ADDRESS 0xFFFF443A /begin FUNCTION_LIST /end FUNCTION_LIST /end MEASUREMENT
/begin MEASUREMENT tVTTMEVC3 "Imaginary pull-down region cancellation delay" UBYTE COMP_0201_S 1 100 0 255 ECU_ADDRESS 0xFFFF443D /begin FUNCTION_LIST /end FUNCTION_LIST /end MEASUREMENT
/begin MEASUREMENT tETHSJDE_S "After the hot restart closed-diagnosis TEGR decline, diagnosis permission condition delay" UBYTE COMP_0201_S 1 100 0 255 ECU_ADDRESS 0xFFFF443F /begin FUNCTION_LIST /end FUNCTION_LIST /end MEASUREMENT
/begin MEASUREMENT tETWJD_S "Coolant temperature condition judgement delay" UBYTE COMP_0201_S 1 100 0 255 ECU_ADDRESS 0xFFFF4440 /begin FUNCTION_LIST /end FUNCTION_LIST /end MEASUREMENT
/begin MEASUREMENT tIDLDLY_S "IDLESW delay timer" UBYTE COMP_0201_S 1 100 0 255 ECU_ADDRESS 0xFFFF4441 /begin FUNCTION_LIST /end FUNCTION_LIST /end MEASUREMENT
/begin MEASUREMENT tACDNDY1 "After the compressor sticking diagnosis (STAGE#1) start, delay timer" UBYTE COMP_0202_S 1 100 0 255 ECU_ADDRESS 0xFFFF4443 /begin FUNCTION_LIST /end FUNCTION_LIST /end MEASUREMENT
/begin MEASUREMENT tACDNDY3 "After a clutch on sticking diagnosis starts, delay timer" UBYTE COMP_0202_S 1 100 0 255 ECU_ADDRESS 0xFFFF4444 /begin FUNCTION_LIST /end FUNCTION_LIST /end MEASUREMENT
/begin MEASUREMENT tAFHCTD "A/F sensor heater control permission judgement delay" UBYTE COMP_0202_S 1 100 0 255 ECU_ADDRESS 0xFFFF4447 /begin FUNCTION_LIST /end FUNCTION_LIST /end MEASUREMENT
/begin MEASUREMENT tAGBSIPNG "AGB SIP continuation time check NG judgement timer" UBYTE COMP_0202_S 1 100 0 255 ECU_ADDRESS 0xFFFF444B /begin FUNCTION_LIST /end FUNCTION_LIST /end MEASUREMENT
/begin MEASUREMENT tAGBTUPDL "AGB torque rise integral value clear delay timer" UBYTE COMP_0202_S 1 100 0 255 ECU_ADDRESS 0xFFFF444C /begin FUNCTION_LIST /end FUNCTION_LIST /end MEASUREMENT
/begin MEASUREMENT tASSWNGT2 "ASCD SW signal diagnosis (ASSWNG) NG judgement timer" UBYTE COMP_0202_S 1 100 0 255 ECU_ADDRESS 0xFFFF444F /begin FUNCTION_LIST /end FUNCTION_LIST /end MEASUREMENT
/begin MEASUREMENT tBKSWTMOK "Brake diagnosis OK judgement time" UBYTE COMP_0202_S 1 100 0 255 ECU_ADDRESS 0xFFFF4450 /begin FUNCTION_LIST /end FUNCTION_LIST /end MEASUREMENT
/begin MEASUREMENT tBNCCLRTM "Brake SW diagnosis trouble judgement timer" UBYTE COMP_0202_S 1 100 0 255 ECU_ADDRESS 0xFFFF4451 /begin FUNCTION_LIST /end FUNCTION_LIST /end MEASUREMENT
/begin MEASUREMENT tBNCINCTM "BNCSWTM increment timer" UBYTE COMP_0202_S 1 100 0 255 ECU_ADDRESS 0xFFFF4452 /begin FUNCTION_LIST /end FUNCTION_LIST /end MEASUREMENT
/begin MEASUREMENT tBNCPTNG1 "ASCD SW signal diagnosis (BNCPNG) NG judgement timer 1" UBYTE COMP_0202_S 1 100 0 255 ECU_ADDRESS 0xFFFF4453 /begin FUNCTION_LIST /end FUNCTION_LIST /end MEASUREMENT
/begin MEASUREMENT tBNCPTNG2 "ASCD SW signal diagnosis (BNCPNG) NG judgement timer 2" UBYTE COMP_0202_S 1 100 0 255 ECU_ADDRESS 0xFFFF4454 /begin FUNCTION_LIST /end FUNCTION_LIST /end MEASUREMENT
/begin MEASUREMENT tBNOBNCOK "ASCD SW signal diagnosis (ASBSNG) OK judgement timer" UBYTE COMP_0202_S 1 100 0 255 ECU_ADDRESS 0xFFFF4455 /begin FUNCTION_LIST /end FUNCTION_LIST /end MEASUREMENT
/begin MEASUREMENT tBNONCNG1 "ASCD SW signal diagnosis (ASBSNG) NG judgement timer 1" UBYTE COMP_0202_S 1 100 0 255 ECU_ADDRESS 0xFFFF4456 /begin FUNCTION_LIST /end FUNCTION_LIST /end MEASUREMENT
/begin MEASUREMENT tBNONCNG2 "ASCD SW signal diagnosis (ASBSNG) NG judgement timer 2" UBYTE COMP_0202_S 1 100 0 255 ECU_ADDRESS 0xFFFF4457 /begin FUNCTION_LIST /end FUNCTION_LIST /end MEASUREMENT
/begin MEASUREMENT tBPCHK "Between the sensors, response delay delay time" UBYTE COMP_0202_S 1 100 0 255 ECU_ADDRESS 0xFFFF4458 /begin FUNCTION_LIST /end FUNCTION_LIST /end MEASUREMENT
/begin MEASUREMENT tCANMTM1 "fCANMASK = The 1sec timer of 1->0 rest" UBYTE COMP_0202_S 1 100 0 255 ECU_ADDRESS 0xFFFF4459 /begin FUNCTION_LIST /end FUNCTION_LIST /end MEASUREMENT
/begin MEASUREMENT tCANMTM2 "fCANMASK = The 1sec timer of 1->0 rest" UBYTE COMP_0202_S 1 100 0 255 ECU_ADDRESS 0xFFFF445A /begin FUNCTION_LIST /end FUNCTION_LIST /end MEASUREMENT
/begin MEASUREMENT tCHECKTM2 "TAS learning start trigger judgement timer" UBYTE COMP_0202_S 1 100 0 255 ECU_ADDRESS 0xFFFF445C /begin FUNCTION_LIST /end FUNCTION_LIST /end MEASUREMENT
/begin MEASUREMENT tCLERTIME "VTC drive abnormality diagnosis prohibition time timer" UBYTE COMP_0202_S 1 100 0 255 ECU_ADDRESS 0xFFFF445D /begin FUNCTION_LIST /end FUNCTION_LIST /end MEASUREMENT
/begin MEASUREMENT tCLERTIMI "VTC drive abnormality diagnosis prohibition time timer" UBYTE COMP_0202_S 1 100 0 255 ECU_ADDRESS 0xFFFF445E /begin FUNCTION_LIST /end FUNCTION_LIST /end MEASUREMENT
/begin MEASUREMENT tCVBLNTM "Battery voltage decline condition continuation time" UBYTE COMP_0202_S 1 100 0 255 ECU_ADDRESS 0xFFFF4460 /begin FUNCTION_LIST /end FUNCTION_LIST /end MEASUREMENT
/begin MEASUREMENT tDEFMAJTM "Major BVR failure memorization delay timer" UBYTE COMP_0202_S 1 100 0 255 ECU_ADDRESS 0xFFFF4461 /begin FUNCTION_LIST /end FUNCTION_LIST /end MEASUREMENT
/begin MEASUREMENT tDLCVTFAL "CVTFAIL flag diagnosis delay time" UBYTE COMP_0202_S 1 100 0 255 ECU_ADDRESS 0xFFFF4462 /begin FUNCTION_LIST /end FUNCTION_LIST /end MEASUREMENT
/begin MEASUREMENT tDLTOQLF "A high-speed air learning condition formation delay timer" UBYTE COMP_0202_S 1 100 0 255 ECU_ADDRESS 0xFFFF4463 /begin FUNCTION_LIST /end FUNCTION_LIST /end MEASUREMENT
/begin MEASUREMENT tDRVTM "D/R voltage judgement delay timer" UBYTE COMP_0202_S 1 100 0 255 ECU_ADDRESS 0xFFFF4465 /begin FUNCTION_LIST /end FUNCTION_LIST /end MEASUREMENT
/begin MEASUREMENT tEGRSJD "EGR diagnosis starter SW delay timer" UBYTE COMP_0202_S 1 100 0 255 ECU_ADDRESS 0xFFFF446A /begin FUNCTION_LIST /end FUNCTION_LIST /end MEASUREMENT
/begin MEASUREMENT tEGRSNG2 "EGR diagnosis delay timer 2" UBYTE COMP_0202_S 1 100 0 255 ECU_ADDRESS 0xFFFF446B /begin FUNCTION_LIST /end FUNCTION_LIST /end MEASUREMENT
/begin MEASUREMENT tEGRTX "TEGR arrangement operation interval counter" UBYTE COMP_0202_S 1 100 0 255 ECU_ADDRESS 0xFFFF446C /begin FUNCTION_LIST /end FUNCTION_LIST /end MEASUREMENT
/begin MEASUREMENT tENSTDLY "Engine stall delay timer" UBYTE COMP_0202_S 1 100 0 255 ECU_ADDRESS 0xFFFF446D /begin FUNCTION_LIST /end FUNCTION_LIST /end MEASUREMENT
/begin MEASUREMENT tERRTIME "VTC alignment check diagnosis prohibition time timer" UBYTE COMP_0202_S 1 100 0 255 ECU_ADDRESS 0xFFFF4470 /begin FUNCTION_LIST /end FUNCTION_LIST /end MEASUREMENT
/begin MEASUREMENT tERRTIMG "Rationalization crank angle sensor Phase offset diagnosis prohibition time (for usual éû)" UBYTE COMP_0202_S 1 100 0 255 ECU_ADDRESS 0xFFFF4472 /begin FUNCTION_LIST /end FUNCTION_LIST /end MEASUREMENT
/begin MEASUREMENT tERRTIMI "VTC alignment check diagnosis prohibition time timer" UBYTE COMP_0202_S 1 100 0 255 ECU_ADDRESS 0xFFFF4473 /begin FUNCTION_LIST /end FUNCTION_LIST /end MEASUREMENT
/begin MEASUREMENT tERRTM3 "A delay timer for the C-VTC diagnosis" UBYTE COMP_0202_S 1 100 0 255 ECU_ADDRESS 0xFFFF4475 /begin FUNCTION_LIST /end FUNCTION_LIST /end MEASUREMENT
/begin MEASUREMENT tERRTM4 "A delay timer for the C-VTC diagnosis" UBYTE COMP_0202_S 1 100 0 255 ECU_ADDRESS 0xFFFF4477 /begin FUNCTION_LIST /end FUNCTION_LIST /end MEASUREMENT
/begin MEASUREMENT tETCSTT "During the cranking, control prohibition time measuring timer" UBYTE COMP_0202_S 1 100 0 255 ECU_ADDRESS 0xFFFF4479 /begin FUNCTION_LIST /end FUNCTION_LIST /end MEASUREMENT
/begin MEASUREMENT tEVNGOT "Purge control valve open judgement time" UBYTE COMP_0202_S 1 100 0 255 ECU_ADDRESS 0xFFFF447A /begin FUNCTION_LIST /end FUNCTION_LIST /end MEASUREMENT
/begin MEASUREMENT tGEARMTT "Gear shift recognition delay" UBYTE COMP_0202_S 1 100 0 255 ECU_ADDRESS 0xFFFF447D /begin FUNCTION_LIST /end FUNCTION_LIST /end MEASUREMENT
/begin MEASUREMENT tHCSSLNG "HCS SOL breakage/short trouble diagnosis NG timer" UBYTE COMP_0202_S 1 100 0 255 ECU_ADDRESS 0xFFFF447E /begin FUNCTION_LIST /end FUNCTION_LIST /end MEASUREMENT
/begin MEASUREMENT tHCSSLOK "HCS SOL breakage/short trouble diagnosis OK timer" UBYTE COMP_0202_S 1 100 0 255 ECU_ADDRESS 0xFFFF447F /begin FUNCTION_LIST /end FUNCTION_LIST /end MEASUREMENT
/begin MEASUREMENT tIDCSNG "Idle purge solenoid NG judgement timer" UBYTE COMP_0202_S 1 100 0 255 ECU_ADDRESS 0xFFFF4484 /begin FUNCTION_LIST /end FUNCTION_LIST /end MEASUREMENT
/begin MEASUREMENT tIDSTTM2 "Idle set TVO continuous time" UBYTE COMP_0202_S 1 100 0 255 ECU_ADDRESS 0xFFFF4485 /begin FUNCTION_LIST /end FUNCTION_LIST /end MEASUREMENT
/begin MEASUREMENT tIERRTIMG "Rationalization crank angle sensor Phase offset diagnosis prohibition time (for idle éû)" UBYTE COMP_0202_S 1 100 0 255 ECU_ADDRESS 0xFFFF4488 /begin FUNCTION_LIST /end FUNCTION_LIST /end MEASUREMENT
/begin MEASUREMENT tIERTIME "VTC alignment check diagnosis prohibition time timer (for idle éû)" UBYTE COMP_0202_S 1 100 0 255 ECU_ADDRESS 0xFFFF4489 /begin FUNCTION_LIST /end FUNCTION_LIST /end MEASUREMENT
/begin MEASUREMENT tIERTIMI "VTC alignment check diagnosis prohibition time timer (for idle éû)" UBYTE COMP_0202_S 1 100 0 255 ECU_ADDRESS 0xFFFF448B /begin FUNCTION_LIST /end FUNCTION_LIST /end MEASUREMENT
/begin MEASUREMENT tIGNCHK "IGN OFFON progress timer" UBYTE COMP_0202_S 1 100 0 255 ECU_ADDRESS 0xFFFF448E /begin FUNCTION_LIST /end FUNCTION_LIST /end MEASUREMENT
/begin MEASUREMENT tISC045 "Air current sound countermeasure SSOFF 4.5-second computed time" UBYTE COMP_0202_S 1 100 0 255 ECU_ADDRESS 0xFFFF4491 /begin FUNCTION_LIST /end FUNCTION_LIST /end MEASUREMENT
/begin MEASUREMENT tKCRADV1 "At the time of the start, ignition timing maintenance time timer" UBYTE COMP_0202_S 1 100 0 255 ECU_ADDRESS 0xFFFF4492 /begin FUNCTION_LIST /end FUNCTION_LIST /end MEASUREMENT
/begin MEASUREMENT tKEYON20 "KEY After on, 20-second watch timer" UBYTE COMP_0202_S 1 100 0 255 ECU_ADDRESS 0xFFFF4493 /begin FUNCTION_LIST /end FUNCTION_LIST /end MEASUREMENT
/begin MEASUREMENT tMODE2TM "IDLE SW After on, TVO (APO) >=60deg condition continuation timer" UBYTE COMP_0202_S 1 100 0 255 ECU_ADDRESS 0xFFFF4494 /begin FUNCTION_LIST /end FUNCTION_LIST /end MEASUREMENT
/begin MEASUREMENT tNPTIME "Negative pressure sensor OPEN/SHORT judgement delay time MIN value" UBYTE COMP_0202_S 1 100 0 255 ECU_ADDRESS 0xFFFF4495 /begin FUNCTION_LIST /end FUNCTION_LIST /end MEASUREMENT
/begin MEASUREMENT tNTDGTAG "Neutral switch diagnosis delay timer (AGB)" UBYTE COMP_0202_S 1 100 0 255 ECU_ADDRESS 0xFFFF4496 /begin FUNCTION_LIST /end FUNCTION_LIST /end MEASUREMENT
/begin MEASUREMENT tNTDGTMG "Neutral switch diagnosis delay timer (MGB)" UBYTE COMP_0202_S 1 100 0 255 ECU_ADDRESS 0xFFFF4497 /begin FUNCTION_LIST /end FUNCTION_LIST /end MEASUREMENT
/begin MEASUREMENT tO2100M "O2H Control timer" UBYTE COMP_0202_S 1 100 0 255 ECU_ADDRESS 0xFFFF4498 /begin FUNCTION_LIST /end FUNCTION_LIST /end MEASUREMENT
/begin MEASUREMENT tO2HFNG "A former O2 heater diagnosis NG judgement delay timer" UBYTE COMP_0202_S 1 100 0 255 ECU_ADDRESS 0xFFFF449C /begin FUNCTION_LIST /end FUNCTION_LIST /end MEASUREMENT
/begin MEASUREMENT tODACCT "OD cancellation judgement timer 1" UBYTE COMP_0202_S 1 100 0 255 ECU_ADDRESS 0xFFFF449E /begin FUNCTION_LIST /end FUNCTION_LIST /end MEASUREMENT
/begin MEASUREMENT tODBNRN "Learning prohibition judgement timer 3" UBYTE COMP_0202_S 1 100 0 255 ECU_ADDRESS 0xFFFF449F /begin FUNCTION_LIST /end FUNCTION_LIST /end MEASUREMENT
/begin MEASUREMENT tODBNRS "Learning prohibition judgement timer 1" UBYTE COMP_0202_S 1 100 0 255 ECU_ADDRESS 0xFFFF44A0 /begin FUNCTION_LIST /end FUNCTION_LIST /end MEASUREMENT
/begin MEASUREMENT tODBNTP "Learning prohibition judgement timer 2" UBYTE COMP_0202_S 1 100 0 255 ECU_ADDRESS 0xFFFF44A1 /begin FUNCTION_LIST /end FUNCTION_LIST /end MEASUREMENT
/begin MEASUREMENT tODCNRN "OD cancellation judgement timer 2" UBYTE COMP_0202_S 1 100 0 255 ECU_ADDRESS 0xFFFF44A2 /begin FUNCTION_LIST /end FUNCTION_LIST /end MEASUREMENT
/begin MEASUREMENT tORCSNG "Gauge orifice solenoid NG judgement timer" UBYTE COMP_0202_S 1 100 0 255 ECU_ADDRESS 0xFFFF44A3 /begin FUNCTION_LIST /end FUNCTION_LIST /end MEASUREMENT
/begin MEASUREMENT tPCHECK "IGN After on, timer" UBYTE COMP_0202_S 1 100 0 255 ECU_ADDRESS 0xFFFF44AC /begin FUNCTION_LIST /end FUNCTION_LIST /end MEASUREMENT
/begin MEASUREMENT tPHBPMST "At the time of the PHASE trouble, control (parameter monitor) STSWOFF timer" UBYTE COMP_0202_S 1 100 0 255 ECU_ADDRESS 0xFFFF44AD /begin FUNCTION_LIST /end FUNCTION_LIST /end MEASUREMENT
/begin MEASUREMENT tPHBPMSW "At the time of the PHASE trouble, control (parameter monitor) SW information preservation progress timer" UBYTE COMP_0202_S 1 100 0 255 ECU_ADDRESS 0xFFFF44AE /begin FUNCTION_LIST /end FUNCTION_LIST /end MEASUREMENT
/begin MEASUREMENT tPMDOFFDL "POWER mode off judgement timer" UBYTE COMP_0202_S 1 100 0 255 ECU_ADDRESS 0xFFFF44AF /begin FUNCTION_LIST /end FUNCTION_LIST /end MEASUREMENT
/begin MEASUREMENT tPMOFFDY "Power mode off judgement delay timer" UBYTE COMP_0202_S 1 100 0 255 ECU_ADDRESS 0xFFFF44B0 /begin FUNCTION_LIST /end FUNCTION_LIST /end MEASUREMENT
/begin MEASUREMENT tPSITM "PWST SW After ONOFF, delay timer" UBYTE COMP_0202_S 1 100 0 255 ECU_ADDRESS 0xFFFF44B1 /begin FUNCTION_LIST /end FUNCTION_LIST /end MEASUREMENT
/begin MEASUREMENT tRYONDY1 "After air-conditioning relay on, delay timer" UBYTE COMP_0202_S 1 100 0 255 ECU_ADDRESS 0xFFFF44B7 /begin FUNCTION_LIST /end FUNCTION_LIST /end MEASUREMENT
/begin MEASUREMENT tRYONDY2 "After air-conditioning relay on, delay timer" UBYTE COMP_0202_S 1 100 0 255 ECU_ADDRESS 0xFFFF44B8 /begin FUNCTION_LIST /end FUNCTION_LIST /end MEASUREMENT
/begin MEASUREMENT tRYONDY3 "After air-conditioning relay on, delay timer" UBYTE COMP_0202_S 1 100 0 255 ECU_ADDRESS 0xFFFF44B9 /begin FUNCTION_LIST /end FUNCTION_LIST /end MEASUREMENT
/begin MEASUREMENT tSADT "FLASH seed requirement delay" UBYTE COMP_0202_S 1 100 0 255 ECU_ADDRESS 0xFFFF44BA /begin FUNCTION_LIST /end FUNCTION_LIST /end MEASUREMENT
/begin MEASUREMENT tSCDGNDY "Supercharger diagnosis delay" UBYTE COMP_0202_S 1 100 0 255 ECU_ADDRESS 0xFFFF44BB /begin FUNCTION_LIST /end FUNCTION_LIST /end MEASUREMENT
/begin MEASUREMENT tSENSTDLY "An engine stall delay timer for the self-shut-off permission judgement" UBYTE COMP_0202_S 1 100 0 255 ECU_ADDRESS 0xFFFF44BC /begin FUNCTION_LIST /end FUNCTION_LIST /end MEASUREMENT
/begin MEASUREMENT tSSOFFDLY "Self-shut-off delay timer" UBYTE COMP_0202_S 1 100 0 255 ECU_ADDRESS 0xFFFF44BD /begin FUNCTION_LIST /end FUNCTION_LIST /end MEASUREMENT
/begin MEASUREMENT tSSOFFDLY1 "Self-shut-off delay timer" UBYTE COMP_0202_S 1 100 0 255 ECU_ADDRESS 0xFFFF44BE /begin FUNCTION_LIST /end FUNCTION_LIST /end MEASUREMENT
/begin MEASUREMENT tSSOFFRFN "Self-shut-off radiator fan delay timer" UBYTE COMP_0202_S 1 100 0 255 ECU_ADDRESS 0xFFFF44BF /begin FUNCTION_LIST /end FUNCTION_LIST /end MEASUREMENT
/begin MEASUREMENT tSTCHECK "STSW After ONOFF, timer" UBYTE COMP_0202_S 1 100 0 255 ECU_ADDRESS 0xFFFF44C0 /begin FUNCTION_LIST /end FUNCTION_LIST /end MEASUREMENT
/begin MEASUREMENT tT2CSNG "The second air cut solenoid NG judgement timer" UBYTE COMP_0202_S 1 100 0 255 ECU_ADDRESS 0xFFFF44C5 /begin FUNCTION_LIST /end FUNCTION_LIST /end MEASUREMENT
/begin MEASUREMENT tTABCNG "Intake manifold pressure/atomospheric pressure switching solenoid OK judgement delay" UBYTE COMP_0202_S 1 100 0 255 ECU_ADDRESS 0xFFFF44C6 /begin FUNCTION_LIST /end FUNCTION_LIST /end MEASUREMENT
/begin MEASUREMENT tTABCOK "Intake manifold pressure/atomospheric pressure switching solenoid NG judgement delay" UBYTE COMP_0202_S 1 100 0 255 ECU_ADDRESS 0xFFFF44C7 /begin FUNCTION_LIST /end FUNCTION_LIST /end MEASUREMENT
/begin MEASUREMENT tTACRLYOF "Relay compulsory off permission delay timer" UBYTE COMP_0202_S 1 100 0 255 ECU_ADDRESS 0xFFFF44C8 /begin FUNCTION_LIST /end FUNCTION_LIST /end MEASUREMENT
/begin MEASUREMENT tTAFESD "At the time of the engine stall, AFM diagnosis delay" UBYTE COMP_0202_S 1 100 0 255 ECU_ADDRESS 0xFFFF44C9 /begin FUNCTION_LIST /end FUNCTION_LIST /end MEASUREMENT
/begin MEASUREMENT tTAFPOD "At the time of the first power supply injection, AFM diagnosis delay timer" UBYTE COMP_0202_S 1 100 0 255 ECU_ADDRESS 0xFFFF44CA /begin FUNCTION_LIST /end FUNCTION_LIST /end MEASUREMENT
/begin MEASUREMENT tTANGTIM "Intake air temperature sensor voltage NG judgement delay" UBYTE COMP_0202_S 1 100 0 255 ECU_ADDRESS 0xFFFF44CB /begin FUNCTION_LIST /end FUNCTION_LIST /end MEASUREMENT
/begin MEASUREMENT tTANGTM2 "Intake air temperature sensor NG judgement delay (High)" UBYTE COMP_0202_S 1 100 0 255 ECU_ADDRESS 0xFFFF44CC /begin FUNCTION_LIST /end FUNCTION_LIST /end MEASUREMENT
/begin MEASUREMENT tTASLRD1 "Learning operation start delay 1" UBYTE COMP_0202_S 1 100 0 255 ECU_ADDRESS 0xFFFF44CD /begin FUNCTION_LIST /end FUNCTION_LIST /end MEASUREMENT
/begin MEASUREMENT tTASTIM1 "Learning start trigger delay 1 (for TAS learning)" UBYTE COMP_0202_S 1 100 0 255 ECU_ADDRESS 0xFFFF44CE /begin FUNCTION_LIST /end FUNCTION_LIST /end MEASUREMENT
/begin MEASUREMENT tTATIGN "After ATCU diagnosis IGN SW OFF-> on, progress timer" UBYTE COMP_0202_S 1 100 0 255 ECU_ADDRESS 0xFFFF44CF /begin FUNCTION_LIST /end FUNCTION_LIST /end MEASUREMENT
/begin MEASUREMENT tTCDY1 "Region judgement NG delay counter" UBYTE COMP_0202_S 1 100 0 255 ECU_ADDRESS 0xFFFF44D0 /begin FUNCTION_LIST /end FUNCTION_LIST /end MEASUREMENT
/begin MEASUREMENT tTCLTNG "Clutch on sticking diagnosis NG judgement timer" UBYTE COMP_0202_S 1 100 0 255 ECU_ADDRESS 0xFFFF44D2 /begin FUNCTION_LIST /end FUNCTION_LIST /end MEASUREMENT
/begin MEASUREMENT tTCLTOK "Clutch on sticking diagnosis OK judgement timer" UBYTE COMP_0202_S 1 100 0 255 ECU_ADDRESS 0xFFFF44D3 /begin FUNCTION_LIST /end FUNCTION_LIST /end MEASUREMENT
/begin MEASUREMENT tTCLUDL "Cut-in delay switching delay after Clutched" UBYTE COMP_0202_S 1 100 0 255 ECU_ADDRESS 0xFFFF44D4 /begin FUNCTION_LIST /end FUNCTION_LIST /end MEASUREMENT
/begin MEASUREMENT tTCSNGB "REF breakage diagnosis NG judgement delay" UBYTE COMP_0202_S 1 100 0 255 ECU_ADDRESS 0xFFFF44D5 /begin FUNCTION_LIST /end FUNCTION_LIST /end MEASUREMENT
/begin MEASUREMENT tTCSNGNO "REF/POS unusual time NG judgement timer" UBYTE COMP_0202_S 1 100 0 255 ECU_ADDRESS 0xFFFF44D6 /begin FUNCTION_LIST /end FUNCTION_LIST /end MEASUREMENT
/begin MEASUREMENT tTCSNGOSP "POS breakage judgement timer" UBYTE COMP_0202_S 1 100 0 255 ECU_ADDRESS 0xFFFF44D7 /begin FUNCTION_LIST /end FUNCTION_LIST /end MEASUREMENT
/begin MEASUREMENT tTCSNGOSR "REF breakage judgement timer" UBYTE COMP_0202_S 1 100 0 255 ECU_ADDRESS 0xFFFF44D8 /begin FUNCTION_LIST /end FUNCTION_LIST /end MEASUREMENT
/begin MEASUREMENT tTCSNGP "START SW After on, breakage judgement delay POS" UBYTE COMP_0202_S 1 100 0 255 ECU_ADDRESS 0xFFFF44D9 /begin FUNCTION_LIST /end FUNCTION_LIST /end MEASUREMENT
/begin MEASUREMENT tTCSNGR "START SW After on, breakage judgement delay PHASE" UBYTE COMP_0202_S 1 100 0 255 ECU_ADDRESS 0xFFFF44DA /begin FUNCTION_LIST /end FUNCTION_LIST /end MEASUREMENT
/begin MEASUREMENT tTCSNGST "At the time of the start, crank angle sensor diagnosis NG judgement timer" UBYTE COMP_0202_S 1 100 0 255 ECU_ADDRESS 0xFFFF44DB /begin FUNCTION_LIST /end FUNCTION_LIST /end MEASUREMENT
/begin MEASUREMENT tTCTD11 "Diagnosis permission delay counter" UBYTE COMP_0202_S 1 100 0 255 ECU_ADDRESS 0xFFFF44DC /begin FUNCTION_LIST /end FUNCTION_LIST /end MEASUREMENT
/begin MEASUREMENT tTCVBNG "Check valve bypass valve NG judgement timer" UBYTE COMP_0202_S 1 100 0 255 ECU_ADDRESS 0xFFFF44E0 /begin FUNCTION_LIST /end FUNCTION_LIST /end MEASUREMENT
/begin MEASUREMENT tTCVBNG2 "Check valve bypass valve NG judgement timer 2" UBYTE COMP_0202_S 1 100 0 255 ECU_ADDRESS 0xFFFF44E1 /begin FUNCTION_LIST /end FUNCTION_LIST /end MEASUREMENT
/begin MEASUREMENT tTDIRE11 "After the CVBV open, stage 1 judgement delay" UBYTE COMP_0202_S 1 100 0 255 ECU_ADDRESS 0xFFFF44E2 /begin FUNCTION_LIST /end FUNCTION_LIST /end MEASUREMENT
/begin MEASUREMENT tTDIRE14 "Vapor monitor control completion delay" UBYTE COMP_0202_S 1 100 0 255 ECU_ADDRESS 0xFFFF44E3 /begin FUNCTION_LIST /end FUNCTION_LIST /end MEASUREMENT
/begin MEASUREMENT tTDIRE15 "DVP4 measuring delay" UBYTE COMP_0202_S 1 100 0 255 ECU_ADDRESS 0xFFFF44E4 /begin FUNCTION_LIST /end FUNCTION_LIST /end MEASUREMENT
/begin MEASUREMENT tTDIRE15B "At the time of the 0.02inch leak-down, a delay timer for the diagnosis" UBYTE COMP_0202_S 1 100 0 255 ECU_ADDRESS 0xFFFF44E5 /begin FUNCTION_LIST /end FUNCTION_LIST /end MEASUREMENT
/begin MEASUREMENT tTDIRE16 "Leak-down switchover cancellation time" UBYTE COMP_0202_S 1 100 0 255 ECU_ADDRESS 0xFFFF44E6 /begin FUNCTION_LIST /end FUNCTION_LIST /end MEASUREMENT
/begin MEASUREMENT tTDIRE18 "Reference voltage BASVP1 renewal continuation time" UBYTE COMP_0202_S 1 100 0 255 ECU_ADDRESS 0xFFFF44E7 /begin FUNCTION_LIST /end FUNCTION_LIST /end MEASUREMENT
/begin MEASUREMENT tTDIREDC "Drain-cut valve close delay" UBYTE COMP_0202_S 1 100 0 255 ECU_ADDRESS 0xFFFF44E8 /begin FUNCTION_LIST /end FUNCTION_LIST /end MEASUREMENT
/begin MEASUREMENT tTDIREI5 "After the purge cut, measuring delay" UBYTE COMP_0202_S 1 100 0 255 ECU_ADDRESS 0xFFFF44E9 /begin FUNCTION_LIST /end FUNCTION_LIST /end MEASUREMENT
/begin MEASUREMENT tTDIREI5H "After the purge cut, measuring delay (a high vehicle speed region)" UBYTE COMP_0202_S 1 100 0 255 ECU_ADDRESS 0xFFFF44EA /begin FUNCTION_LIST /end FUNCTION_LIST /end MEASUREMENT
/begin MEASUREMENT tTDUETNG "DUET diagnosis" UBYTE COMP_0202_S 1 100 0 255 ECU_ADDRESS 0xFFFF44EB /begin FUNCTION_LIST /end FUNCTION_LIST /end MEASUREMENT
/begin MEASUREMENT tTECSNG "Drain-cut solenoid NG judgement timer" UBYTE COMP_0202_S 1 100 0 255 ECU_ADDRESS 0xFFFF44EC /begin FUNCTION_LIST /end FUNCTION_LIST /end MEASUREMENT
/begin MEASUREMENT tTECSNG2 "Drain-cut solenoid NG judgement timer 2" UBYTE COMP_0202_S 1 100 0 255 ECU_ADDRESS 0xFFFF44ED /begin FUNCTION_LIST /end FUNCTION_LIST /end MEASUREMENT
/begin MEASUREMENT tTECSNG21 "Drain-cut solenoid NG judgement timer 21" UBYTE COMP_0202_S 1 100 0 255 ECU_ADDRESS 0xFFFF44EE /begin FUNCTION_LIST /end FUNCTION_LIST /end MEASUREMENT
/begin MEASUREMENT tTECSNG22 "Drain-cut solenoid NG judgement timer 22" UBYTE COMP_0202_S 1 100 0 255 ECU_ADDRESS 0xFFFF44EF /begin FUNCTION_LIST /end FUNCTION_LIST /end MEASUREMENT
/begin MEASUREMENT tTEGCNG "EGR cut solenoid breakage NG judgement timer" UBYTE COMP_0202_S 1 100 0 255 ECU_ADDRESS 0xFFFF44F0 /begin FUNCTION_LIST /end FUNCTION_LIST /end MEASUREMENT
/begin MEASUREMENT tTEGCNG2 "EGR cut solenoid breakage NG judgement timer 2" UBYTE COMP_0202_S 1 100 0 255 ECU_ADDRESS 0xFFFF44F1 /begin FUNCTION_LIST /end FUNCTION_LIST /end MEASUREMENT
/begin MEASUREMENT tTEGRA "EGR diagnosis region formation time" UBYTE COMP_0202_S 1 100 0 255 ECU_ADDRESS 0xFFFF44F2 /begin FUNCTION_LIST /end FUNCTION_LIST /end MEASUREMENT
/begin MEASUREMENT tTENSTB "START SW After on, breakage judgement delay REF" UBYTE COMP_0202_S 1 100 0 255 ECU_ADDRESS 0xFFFF44F3 /begin FUNCTION_LIST /end FUNCTION_LIST /end MEASUREMENT
/begin MEASUREMENT tTETLCNT "EGR temperature sensor LowInput diagnosis complete delay timer (RATE law)" UBYTE COMP_0202_S 1 100 0 255 ECU_ADDRESS 0xFFFF44F5 /begin FUNCTION_LIST /end FUNCTION_LIST /end MEASUREMENT
/begin MEASUREMENT tTEVSTRY "A low vehicle speed judgement delay" UBYTE COMP_0202_S 1 100 0 255 ECU_ADDRESS 0xFFFF44F6 /begin FUNCTION_LIST /end FUNCTION_LIST /end MEASUREMENT
/begin MEASUREMENT tTFGMNG "Fuel level gauge ground breakage diagnosis NG delay" UBYTE COMP_0202_S 1 100 0 255 ECU_ADDRESS 0xFFFF44F7 /begin FUNCTION_LIST /end FUNCTION_LIST /end MEASUREMENT
/begin MEASUREMENT tTFGPNG1 "Fuel level gauge breakage diagnosis NG delay" UBYTE COMP_0202_S 1 100 0 255 ECU_ADDRESS 0xFFFF44F8 /begin FUNCTION_LIST /end FUNCTION_LIST /end MEASUREMENT
/begin MEASUREMENT tTFGPNG1O "Fuel level gauge breakage diagnosis NG delay" UBYTE COMP_0202_S 1 100 0 255 ECU_ADDRESS 0xFFFF44F9 /begin FUNCTION_LIST /end FUNCTION_LIST /end MEASUREMENT
/begin MEASUREMENT tTFGPNG1S "Fuel level gauge breakage diagnosis NG delay" UBYTE COMP_0202_S 1 100 0 255 ECU_ADDRESS 0xFFFF44FA /begin FUNCTION_LIST /end FUNCTION_LIST /end MEASUREMENT
/begin MEASUREMENT tTFGTP1 "Slosh judgement delay" UBYTE COMP_0202_S 1 100 0 255 ECU_ADDRESS 0xFFFF44FB /begin FUNCTION_LIST /end FUNCTION_LIST /end MEASUREMENT
/begin MEASUREMENT tTFPSNG1 "Fuel pressure sensor diagnosis NG judgement delay 1" UBYTE COMP_0202_S 1 100 0 255 ECU_ADDRESS 0xFFFF44FC /begin FUNCTION_LIST /end FUNCTION_LIST /end MEASUREMENT
/begin MEASUREMENT tTFPSNG2 "Fuel pressure sensor diagnosis NG judgement delay 2" UBYTE COMP_0202_S 1 100 0 255 ECU_ADDRESS 0xFFFF44FD /begin FUNCTION_LIST /end FUNCTION_LIST /end MEASUREMENT
/begin MEASUREMENT tTFTIME1 "Slosh judgement delay" UBYTE COMP_0202_S 1 100 0 255 ECU_ADDRESS 0xFFFF44FE /begin FUNCTION_LIST /end FUNCTION_LIST /end MEASUREMENT
/begin MEASUREMENT tTFTIME2 "Slope judgement delay" UBYTE COMP_0202_S 1 100 0 255 ECU_ADDRESS 0xFFFF44FF /begin FUNCTION_LIST /end FUNCTION_LIST /end MEASUREMENT
/begin MEASUREMENT tTFTIME3 "Slope judgement release delay" UBYTE COMP_0202_S 1 100 0 255 ECU_ADDRESS 0xFFFF4500 /begin FUNCTION_LIST /end FUNCTION_LIST /end MEASUREMENT
/begin MEASUREMENT tTHOTM "Opening/short circuit NG judgement delay timer" UBYTE COMP_0202_S 1 100 0 255 ECU_ADDRESS 0xFFFF4501 /begin FUNCTION_LIST /end FUNCTION_LIST /end MEASUREMENT
/begin MEASUREMENT tTHVO2T "The judgement 2 delay timer whose O2 sensor diagnosis rich output is unusual" UBYTE COMP_0202_S 1 100 0 255 ECU_ADDRESS 0xFFFF4502 /begin FUNCTION_LIST /end FUNCTION_LIST /end MEASUREMENT
/begin MEASUREMENT tTKNKNG "Knock sensor diagnosis NG delay timer" UBYTE COMP_0202_S 1 100 0 255 ECU_ADDRESS 0xFFFF4504 /begin FUNCTION_LIST /end FUNCTION_LIST /end MEASUREMENT
/begin MEASUREMENT tTKNKNG1 "Knock sensor diagnosis OK delay timer" UBYTE COMP_0202_S 1 100 0 255 ECU_ADDRESS 0xFFFF4505 /begin FUNCTION_LIST /end FUNCTION_LIST /end MEASUREMENT
/begin MEASUREMENT tTKNKNG2 "Knock sensor diagnosis NG delay timer" UBYTE COMP_0202_S 1 100 0 255 ECU_ADDRESS 0xFFFF4506 /begin FUNCTION_LIST /end FUNCTION_LIST /end MEASUREMENT
/begin MEASUREMENT tTKNKNG2O "Knock sensor diagnosis opening NG delay timer (subdivision for, Bank2)" UBYTE COMP_0202_S 1 100 0 255 ECU_ADDRESS 0xFFFF4507 /begin FUNCTION_LIST /end FUNCTION_LIST /end MEASUREMENT
/begin MEASUREMENT tTKNKNG2S "Knock sensor diagnosis short circuit NG delay timer (subdivision for, Bank2)" UBYTE COMP_0202_S 1 100 0 255 ECU_ADDRESS 0xFFFF4508 /begin FUNCTION_LIST /end FUNCTION_LIST /end MEASUREMENT
/begin MEASUREMENT tTKNKNG3 "Knock sensor diagnosis OK delay timer" UBYTE COMP_0202_S 1 100 0 255 ECU_ADDRESS 0xFFFF4509 /begin FUNCTION_LIST /end FUNCTION_LIST /end MEASUREMENT
/begin MEASUREMENT tTKNKNGO "Knock sensor diagnosis opening NG delay timer (for the subdivision)" UBYTE COMP_0202_S 1 100 0 255 ECU_ADDRESS 0xFFFF450A /begin FUNCTION_LIST /end FUNCTION_LIST /end MEASUREMENT
/begin MEASUREMENT tTKNKNGS "Knock sensor diagnosis short circuit NG delay timer (for the subdivision)" UBYTE COMP_0202_S 1 100 0 255 ECU_ADDRESS 0xFFFF450B /begin FUNCTION_LIST /end FUNCTION_LIST /end MEASUREMENT
/begin MEASUREMENT tTKNKOK2O "Knock sensor diagnosis open OK delay timer (subdivision for, Bank2)" UBYTE COMP_0202_S 1 100 0 255 ECU_ADDRESS 0xFFFF450C /begin FUNCTION_LIST /end FUNCTION_LIST /end MEASUREMENT
/begin MEASUREMENT tTKNKOK2S "Knock sensor diagnosis short OK delay timer (subdivision for, Bank2)" UBYTE COMP_0202_S 1 100 0 255 ECU_ADDRESS 0xFFFF450D /begin FUNCTION_LIST /end FUNCTION_LIST /end MEASUREMENT
/begin MEASUREMENT tTKNKOKO "Knock sensor diagnosis open OK delay timer (for the subdivision)" UBYTE COMP_0202_S 1 100 0 255 ECU_ADDRESS 0xFFFF450E /begin FUNCTION_LIST /end FUNCTION_LIST /end MEASUREMENT
/begin MEASUREMENT tTKNKOKS "Knock sensor diagnosis short OK delay timer (for the subdivision)" UBYTE COMP_0202_S 1 100 0 255 ECU_ADDRESS 0xFFFF450F /begin FUNCTION_LIST /end FUNCTION_LIST /end MEASUREMENT
/begin MEASUREMENT tTLUPNG "Lockup release solenoid NG judgement timer" UBYTE COMP_0202_S 1 100 0 255 ECU_ADDRESS 0xFFFF4510 /begin FUNCTION_LIST /end FUNCTION_LIST /end MEASUREMENT
/begin MEASUREMENT tTLUPNG2 "Lockup release solenoid NG judgement timer 2" UBYTE COMP_0202_S 1 100 0 255 ECU_ADDRESS 0xFFFF4511 /begin FUNCTION_LIST /end FUNCTION_LIST /end MEASUREMENT
/begin MEASUREMENT tTMABCS1 "Intake manifold pressure/atomospheric pressure switching solenoid breakage judgement delay" UBYTE COMP_0202_S 1 100 0 255 ECU_ADDRESS 0xFFFF4512 /begin FUNCTION_LIST /end FUNCTION_LIST /end MEASUREMENT
/begin MEASUREMENT tTMAFAC "A/F activated judgment timer" UBYTE COMP_0202_S 1 100 0 255 ECU_ADDRESS 0xFFFF4513 /begin FUNCTION_LIST /end FUNCTION_LIST /end MEASUREMENT
/begin MEASUREMENT tTMAFAC1 "A/F activated judgment timer 1 (for LMD)" UBYTE COMP_0202_S 1 100 0 255 ECU_ADDRESS 0xFFFF4514 /begin FUNCTION_LIST /end FUNCTION_LIST /end MEASUREMENT
/begin MEASUREMENT tTMAPS "APS open trouble reversion delay timer" UBYTE COMP_0202_S 1 100 0 255 ECU_ADDRESS 0xFFFF4516 /begin FUNCTION_LIST /end FUNCTION_LIST /end MEASUREMENT
/begin MEASUREMENT tTMAPSO "APS open trouble diagnosis judgement timer" UBYTE COMP_0202_S 1 100 0 255 ECU_ADDRESS 0xFFFF4517 /begin FUNCTION_LIST /end FUNCTION_LIST /end MEASUREMENT
/begin MEASUREMENT tTMCHOI "At the time of the PHASE trouble, control (parameter monitor) brief starting judgement engine speed delay" UBYTE COMP_0202_S 1 100 0 255 ECU_ADDRESS 0xFFFF4518 /begin FUNCTION_LIST /end FUNCTION_LIST /end MEASUREMENT
/begin MEASUREMENT tTMCSEN "Engine stall delay timer (for the crank angle sensor diagnosis)" UBYTE COMP_0202_S 1 100 0 255 ECU_ADDRESS 0xFFFF4519 /begin FUNCTION_LIST /end FUNCTION_LIST /end MEASUREMENT
/begin MEASUREMENT tTMDIREI1 "A timer for DIRE1# measuring" UBYTE COMP_0202_S 1 100 0 255 ECU_ADDRESS 0xFFFF451B /begin FUNCTION_LIST /end FUNCTION_LIST /end MEASUREMENT
/begin MEASUREMENT tTMEVCD "A low vehicle speed pull-down region condition failure judgement delay" UBYTE COMP_0202_S 1 100 0 255 ECU_ADDRESS 0xFFFF451C /begin FUNCTION_LIST /end FUNCTION_LIST /end MEASUREMENT
/begin MEASUREMENT tTMGRCGE "Timer for AC wait shift in progress" UBYTE COMP_0202_S 1 100 0 255 ECU_ADDRESS 0xFFFF451E /begin FUNCTION_LIST /end FUNCTION_LIST /end MEASUREMENT
/begin MEASUREMENT tTMIDL "Idle clamp start condition continuation time timer" UBYTE COMP_0202_S 1 100 0 255 ECU_ADDRESS 0xFFFF4523 /begin FUNCTION_LIST /end FUNCTION_LIST /end MEASUREMENT
/begin MEASUREMENT tTMILDS "After the monitor clamp, CLOSE control prohibition time timer" UBYTE COMP_0202_S 1 100 0 255 ECU_ADDRESS 0xFFFF4524 /begin FUNCTION_LIST /end FUNCTION_LIST /end MEASUREMENT
/begin MEASUREMENT tTMINGE "TH/S NG judgement completion timer" UBYTE COMP_0202_S 1 100 0 255 ECU_ADDRESS 0xFFFF4525 /begin FUNCTION_LIST /end FUNCTION_LIST /end MEASUREMENT
/begin MEASUREMENT tTMINGS "TH/S NG judgement start timer" UBYTE COMP_0202_S 1 100 0 255 ECU_ADDRESS 0xFFFF4526 /begin FUNCTION_LIST /end FUNCTION_LIST /end MEASUREMENT
/begin MEASUREMENT tTMPATSCA "response to the challeng" UBYTE COMP_0202_S 1 100 0 255 ECU_ADDRESS 0xFFFF452A /begin FUNCTION_LIST /end FUNCTION_LIST /end MEASUREMENT
/begin MEASUREMENT tTMPCNX "delay for connection detsction autthrization" UBYTE COMP_0202_S 1 100 0 255 ECU_ADDRESS 0xFFFF452B /begin FUNCTION_LIST /end FUNCTION_LIST /end MEASUREMENT
/begin MEASUREMENT tTMPRMT "Timer for AC prolonged inhibition" UBYTE COMP_0202_S 1 100 0 255 ECU_ADDRESS 0xFFFF452C /begin FUNCTION_LIST /end FUNCTION_LIST /end MEASUREMENT
/begin MEASUREMENT tTMPRSH "Timer for AC high pressure inhibition" UBYTE COMP_0202_S 1 100 0 255 ECU_ADDRESS 0xFFFF452D /begin FUNCTION_LIST /end FUNCTION_LIST /end MEASUREMENT
/begin MEASUREMENT tTMPTEST "Validation frame transmission time-out" UBYTE COMP_0202_S 1 100 0 255 ECU_ADDRESS 0xFFFF452E /begin FUNCTION_LIST /end FUNCTION_LIST /end MEASUREMENT
/begin MEASUREMENT tTMPWLVL "response to the challeng" UBYTE COMP_0202_S 1 100 0 255 ECU_ADDRESS 0xFFFF452F /begin FUNCTION_LIST /end FUNCTION_LIST /end MEASUREMENT
/begin MEASUREMENT tTMPWLVL3 "response to the challeng" UBYTE COMP_0202_S 1 100 0 255 ECU_ADDRESS 0xFFFF4530 /begin FUNCTION_LIST /end FUNCTION_LIST /end MEASUREMENT
/begin MEASUREMENT tTMSCSW "A negative pressure SW diagnosis NG judgement timer for the SCV diagnosis" UBYTE COMP_0202_S 1 100 0 255 ECU_ADDRESS 0xFFFF4531 /begin FUNCTION_LIST /end FUNCTION_LIST /end MEASUREMENT
/begin COMPU_METHOD COMP_0283 "1flag" RAT_FUNC "%8.2" "flag" COEFFS 0 1 0 0 0 1 /end COMPU_METHOD
/begin COMPU_METHOD COMP_0201_S "1s1s" RAT_FUNC "%8.2" "1s" COEFFS 0 1 0 0 0 1 /end COMPU_METHOD
/begin COMPU_METHOD COMP_0202_S "100ms100ms" RAT_FUNC "%8.2" "100ms" COEFFS 0 1 0 0 0 1 /end COMPU_METHOD
/end MODULE
/end PROJECT
