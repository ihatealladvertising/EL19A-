ASAP2_VERSION 1 3_BETA
/begin PROJECT TK_X91_EUR_VC ""
/begin HEADER "" /* key HEADER ++ "comment" Ç… Par.scomment */ PROJECT_NO TK_X91_EUR_VC /* key PROJECT_NO ++ project number Ç… car_eng_desti_lot */ VERSION "7V4YHZEB2" /* key VERSION ++ version number Ç… mProgver */ /end HEADER
/begin MODULE DIM ""
/begin MOD_COMMON "" DEPOSIT ABSOLUTE BYTE_ORDER MSB_FIRST /* ﬁ≤ƒµ∞¿ﬁ∞Ç™ÿÃﬂ⁄∞ΩÇ≥ÇÍÇÈ */ /end MOD_COMMON
/begin FUNCTION KF7-580.1[8] "Diagnostics on CAN" /end FUNCTION
/begin FUNCTION R000.1.RS_Integ_1_10_2 "Integration information for RENAULT SPEC" /end FUNCTION
/begin FUNCTION R000.2.RS_ROMflags_1_10_3 "ROM flag allocation for RENAULT SPEC" /end FUNCTION
/begin FUNCTION R000.3.RS_SelfDiagflags_1_1_2 "Self-Diagnosis Selection Flag Allocation for Renault Specific Functions" /end FUNCTION
/begin FUNCTION R000.4.EepAlloc_1_2_2 "EEPROM Allocation for X91" /end FUNCTION
/begin FUNCTION R000.5.DataCompSpec_1_0_2 "Data compression specifications for Freeze Frame Data Control" /end FUNCTION
/begin FUNCTION R101.1M.aps_pedin_1_2_2 "Accelerator pedal sensor - Interface (main)" /end FUNCTION
/begin FUNCTION R101.1P.aps_pedin_1_1_2 "Accelerator pedal sensor - Interface (sub)" /end FUNCTION
/begin FUNCTION R101.2.aps_pedxx_1_1_3 "Pedal safety diagnosis" /end FUNCTION
/begin FUNCTION R101.3.aps_sftpd_1_1_4 "Accelerator Pedal Safety Case" /end FUNCTION
/begin FUNCTION R102.1M.PEDFM_1_0_9 "PEDFM - Ergonomic formatting of accelerator pedal (main)" /end FUNCTION
/begin FUNCTION R102.1P.PEDFM_1_0_2 "PEDFM - Ergonomic formatting of accelerator pedal (sub)" /end FUNCTION
/begin FUNCTION R102.2M.DRARB_1_1_4 "DRARB - Arbitration of real and virtual drivers requests (main)" /end FUNCTION
/begin FUNCTION R102.2P.DRARB_1_0_2 "DRARB - Arbitration of real and virtual drivers requests (sub)" /end FUNCTION
/begin FUNCTION R102.3M.DRTQE_1_1_0 "DRTQE - Driver engine torque setpoint (main)" /end FUNCTION
/begin FUNCTION R102.3P.DRTQE_1_0_2 "DRTQE - Driver engine torque setpoint (sub)" /end FUNCTION
/begin FUNCTION R102.4M.DRLIM_1_1_0 "DRLIM - Driver set point and target torque elaboration (main)" /end FUNCTION
/begin FUNCTION R102.4P.DRLIM_1_0_2 "DRLIM - Driver set point and target torque elaboration (sub)" /end FUNCTION
/begin FUNCTION R102.5M.ARBIT_1_1_0 "ARBIT - Overall arbitration of torque setting (main)" /end FUNCTION
/begin FUNCTION R102.5P.ARBIT_1_0_2 "ARBIT - Overall arbitration of torque setting (sub)" /end FUNCTION
/begin FUNCTION R102.6.drv_pedlh_1_0_3 "Failsafe mode: Accelerator Pedal Limp Home" /end FUNCTION
/begin FUNCTION R103.1.lim_statl_1_0_1 "Static limitations" /end FUNCTION
/begin FUNCTION R103.2.lim_gbxli_1_0_2 "Gearbox torque limitation" /end FUNCTION
/begin FUNCTION R104.1.brk_absct_1_2_2 "Operating Safety of ESP/Engine Exchange" /end FUNCTION
/begin FUNCTION R105.1.tra_atsip_1_0_1 "Elaboration of AT Torque Control Type" /end FUNCTION
/begin CHARACTERISTIC mIMRID "IMR distinction flag" CURVE 0x0000CA29 REC_UBYTE_C 0 COMP_0004 0 255
 /begin AXIS_DESCR FIX_AXIS NO_INPUT_QUANTITY COMP_0205_S 2 0 1 FIX_AXIS_PAR_DIST 0 1 2 /end AXIS_DESCR
 /begin FUNCTION_LIST KF7-580.1[8] /end FUNCTION_LIST
/end CHARACTERISTIC
/begin CHARACTERISTIC mAPPID "SystemIdentification" CURVE 0x0000C89A REC_UBYTE_C 0 COMP_0004 0 255
 /begin AXIS_DESCR FIX_AXIS NO_INPUT_QUANTITY COMP_0205_S 24 0 23 FIX_AXIS_PAR_DIST 0 1 24 /end AXIS_DESCR
 /begin FUNCTION_LIST KF7-580.1[8] R206.2.ECU_Repro_1_0_3 R901.1.Diag_on_can_app_1_6_2 /end FUNCTION_LIST
/end CHARACTERISTIC
/begin CHARACTERISTIC mSPWDLID0 "DiagOnCAN WDBLID distinction flag 01H-20H" CURVE 0x0000CD75 REC_UBYTE_C 0 COMP_0004 0 255
 /begin AXIS_DESCR FIX_AXIS NO_INPUT_QUANTITY COMP_0205_S 4 0 3 FIX_AXIS_PAR_DIST 0 1 4 /end AXIS_DESCR
 /begin FUNCTION_LIST KF7-580.1[8] /end FUNCTION_LIST
/end CHARACTERISTIC
/begin CHARACTERISTIC mSSRLID0 "SRLTBL distinction flag 01H-20H" CURVE 0x0000CD79 REC_UBYTE_C 0 COMP_0004 0 255
 /begin AXIS_DESCR FIX_AXIS NO_INPUT_QUANTITY COMP_0205_S 4 0 3 FIX_AXIS_PAR_DIST 0 1 4 /end AXIS_DESCR
 /begin FUNCTION_LIST KF7-580.1[8] /end FUNCTION_LIST
/end CHARACTERISTIC
/begin CHARACTERISTIC mSWID "SWMONT distinction flag" CURVE 0x0000CD81 REC_UBYTE_C 0 COMP_0004 0 255
 /begin AXIS_DESCR FIX_AXIS NO_INPUT_QUANTITY COMP_0205_S 5 0 4 FIX_AXIS_PAR_DIST 0 1 5 /end AXIS_DESCR
 /begin FUNCTION_LIST KF7-580.1[8] /end FUNCTION_LIST
/end CHARACTERISTIC
/begin CHARACTERISTIC mFSRTEND "SRTEND distinction flag" CURVE 0x0000C972 REC_UBYTE_C 0 COMP_0004 0 255
 /begin AXIS_DESCR FIX_AXIS NO_INPUT_QUANTITY COMP_0205_S 6 0 5 FIX_AXIS_PAR_DIST 0 1 6 /end AXIS_DESCR
 /begin FUNCTION_LIST KF7-580.1[8] /end FUNCTION_LIST
/end CHARACTERISTIC
/begin CHARACTERISTIC mFSRTRSL "SRTRSL distinction flag" CURVE 0x0000C978 REC_UBYTE_C 0 COMP_0004 0 255
 /begin AXIS_DESCR FIX_AXIS NO_INPUT_QUANTITY COMP_0205_S 6 0 5 FIX_AXIS_PAR_DIST 0 1 6 /end AXIS_DESCR
 /begin FUNCTION_LIST KF7-580.1[8] /end FUNCTION_LIST
/end CHARACTERISTIC
/begin CHARACTERISTIC mFSRTTST "SRTTST distinction flag" CURVE 0x0000C97E REC_UBYTE_C 0 COMP_0004 0 255
 /begin AXIS_DESCR FIX_AXIS NO_INPUT_QUANTITY COMP_0205_S 6 0 5 FIX_AXIS_PAR_DIST 0 1 6 /end AXIS_DESCR
 /begin FUNCTION_LIST KF7-580.1[8] /end FUNCTION_LIST
/end CHARACTERISTIC
/begin CHARACTERISTIC mDOID "DOMON distinction flag" CURVE 0x0000C92E REC_UBYTE_C 0 COMP_0004 0 255
 /begin AXIS_DESCR FIX_AXIS NO_INPUT_QUANTITY COMP_0205_S 8 0 7 FIX_AXIS_PAR_DIST 0 1 8 /end AXIS_DESCR
 /begin FUNCTION_LIST KF7-580.1[8] /end FUNCTION_LIST
/end CHARACTERISTIC
/begin CHARACTERISTIC mACLDDFT "Default calibration in case of no request" VALUE 0x00008F9C REC_UWORD_C 0 COMP_0196 0 6553.5 /begin FUNCTION_LIST R000.1.RS_Integ_1_10_2 R301.6.IscAirflow_1_4_5 /end FUNCTION_LIST /end CHARACTERISTIC
/begin CHARACTERISTIC mACPWFIL "Calibration power consumed by air conditioning" VALUE 0x000081DE REC_UBYTE_C 0 COMP_0338_S 0 6375 /begin FUNCTION_LIST R000.1.RS_Integ_1_10_2 /end FUNCTION_LIST /end CHARACTERISTIC
/begin CHARACTERISTIC mADJDLY "After the adjustment control start, delay condition" VALUE 0x000081F2 REC_UBYTE_C 0 COMP_0008 0 25500 /begin FUNCTION_LIST KF7-580.1[8] /end FUNCTION_LIST /end CHARACTERISTIC
/begin CHARACTERISTIC mALHHYSNL "Low engine speed threshold for the hysteresis on max engine speed in accelerator pedal limp home" VALUE 0x00009004 REC_UWORD_C 0 COMP_0337_S 0 65535 DISPLAY_IDENTIFIER Cxx_acel_pdl_lih_hys_n_l /begin FUNCTION_LIST R102.6.drv_pedlh_1_0_3 /end FUNCTION_LIST /end CHARACTERISTIC
/begin CHARACTERISTIC mALHHYSVH "High vehicle speed threshold for the hysteresis on the regulators switch in pedal limp home" VALUE 0x00008254 REC_UBYTE_C 0 COMP_0429 0 255 DISPLAY_IDENTIFIER Cxx_acel_pdl_lih_hys_vs_h /begin FUNCTION_LIST R102.6.drv_pedlh_1_0_3 /end FUNCTION_LIST /end CHARACTERISTIC
/begin CHARACTERISTIC mALHHYSVL "Low vehicle speed threshold for the hysteresis on the regulators switch in pedal limp home" VALUE 0x00008255 REC_UBYTE_C 0 COMP_0429 0 255 DISPLAY_IDENTIFIER Cxx_acel_pdl_lih_hys_vs_l /begin FUNCTION_LIST R102.6.drv_pedlh_1_0_3 /end FUNCTION_LIST /end CHARACTERISTIC
/begin CHARACTERISTIC mALHMNSPL "Decreasing slope during the application of the foot-up accelerator pedal" VALUE 0x00008256 REC_UBYTE_C 0 COMP_0350_S 0 31.875 DISPLAY_IDENTIFIER Cxx_acel_pdl_lih_min_l /begin FUNCTION_LIST R102.6.drv_pedlh_1_0_3 /end FUNCTION_LIST /end CHARACTERISTIC
/begin CHARACTERISTIC mALHMXPOW "Max power for accelerator pedal limp home powertrain setpoint" VALUE 0x00008257 REC_UBYTE_C 0 COMP_0351_S 0 510000 DISPLAY_IDENTIFIER Cxx_max_pow /begin FUNCTION_LIST R102.6.drv_pedlh_1_0_3 /end FUNCTION_LIST /end CHARACTERISTIC
/begin CHARACTERISTIC mALHMXV "Maximum vehicle speed allowed in pedal limp home" VALUE 0x00008258 REC_UBYTE_C 0 COMP_0429 0 255 DISPLAY_IDENTIFIER Cxx_acel_pdl_lih_max_vs /begin FUNCTION_LIST R102.6.drv_pedlh_1_0_3 /end FUNCTION_LIST /end CHARACTERISTIC
/begin CHARACTERISTIC mALHNIG "Integrate factor of pedal limp home engine speed regulator" VALUE 0x00008259 REC_UBYTE_C 0 COMP_0352_S 0 24.9023565 DISPLAY_IDENTIFIER Cxx_acel_pdl_lih_n_ig /begin FUNCTION_LIST R102.6.drv_pedlh_1_0_3 /end FUNCTION_LIST /end CHARACTERISTIC
/begin CHARACTERISTIC mALHNPG "Proportional factor of pedal limp home engine speed regulator" VALUE 0x0000825A REC_UBYTE_C 0 COMP_0353_S 0 0.99609375 DISPLAY_IDENTIFIER Cxx_acel_pdl_lih_n_pg /begin FUNCTION_LIST R102.6.drv_pedlh_1_0_3 /end FUNCTION_LIST /end CHARACTERISTIC
/begin CHARACTERISTIC mALHNSPVF "Pedal limp home engine speed setpoint if vehicle speed failure (safety setpoint)" VALUE 0x00009006 REC_UWORD_C 0 COMP_0337_S 0 65535 DISPLAY_IDENTIFIER Cxx_acel_pdl_lih_n_sp_srs /begin FUNCTION_LIST R102.6.drv_pedlh_1_0_3 /end FUNCTION_LIST /end CHARACTERISTIC
/begin CHARACTERISTIC mALHNTQHC "Maximum torque setpoint allowed for the pedal limp home engine speed regulator" VALUE 0x0000825B REC_UBYTE_C 0 COMP_0354_S -400 1640 DISPLAY_IDENTIFIER Cxx_acel_pdl_lih_n_tqe_h /begin FUNCTION_LIST R102.6.drv_pedlh_1_0_3 /end FUNCTION_LIST /end CHARACTERISTIC
/begin CHARACTERISTIC mALHSLPH1 "Slope for the low vehicle speed and for the increasing vehicle speed setpoint in pedal limp home" VALUE 0x0000825C REC_UBYTE_C 0 COMP_0355_S 0 255 DISPLAY_IDENTIFIER Cxx_acel_pdl_lih_slop_h1 /begin FUNCTION_LIST R102.6.drv_pedlh_1_0_3 /end FUNCTION_LIST /end CHARACTERISTIC
/begin CHARACTERISTIC mALHSLPH2 "Slope for the high vehicle speed and for the increasing vehicle speed setpoint in pedal limp home" VALUE 0x0000825D REC_UBYTE_C 0 COMP_0355_S 0 255 DISPLAY_IDENTIFIER Cxx_acel_pdl_lih_slop_h2 /begin FUNCTION_LIST R102.6.drv_pedlh_1_0_3 /end FUNCTION_LIST /end CHARACTERISTIC
/begin CHARACTERISTIC mALHSLPNH "Slope for the increasing engine speed setpoint in pedal limp home" VALUE 0x0000825E REC_UBYTE_C 0 COMP_0356_S 0 25500 DISPLAY_IDENTIFIER Cxx_acel_pdl_lih_slop_n_h /begin FUNCTION_LIST R102.6.drv_pedlh_1_0_3 /end FUNCTION_LIST /end CHARACTERISTIC
/begin CHARACTERISTIC mALHSLPV "Vehicle speed threshold for the change of the vehicle speed setpoint slope" VALUE 0x0000825F REC_UBYTE_C 0 COMP_0429 0 255 DISPLAY_IDENTIFIER Cxx_acel_pdl_lih_slop_vs /begin FUNCTION_LIST R102.6.drv_pedlh_1_0_3 /end FUNCTION_LIST /end CHARACTERISTIC
/begin CHARACTERISTIC mALHVIG "Integrate factor of pedal limp home vehicle speed regulator" VALUE 0x00008260 REC_UBYTE_C 0 COMP_0352_S 0 24.9023565 DISPLAY_IDENTIFIER Cxx_acel_pdl_lih_vs_ig /begin FUNCTION_LIST R102.6.drv_pedlh_1_0_3 /end FUNCTION_LIST /end CHARACTERISTIC
/begin CHARACTERISTIC mALHVPG "Proportional factor of pedal limp home vehicle speed regulator" VALUE 0x00008261 REC_UBYTE_C 0 COMP_0357_S 0 24.9023565 DISPLAY_IDENTIFIER Cxx_acel_pdl_lih_vs_pg /begin FUNCTION_LIST R102.6.drv_pedlh_1_0_3 /end FUNCTION_LIST /end CHARACTERISTIC
/begin CHARACTERISTIC mALHVSPC "Pedal limp home vehicle speed setpoint" VALUE 0x00008262 REC_UBYTE_C 0 COMP_0358_S 0 255 DISPLAY_IDENTIFIER Cxx_acel_pdl_lih_vs_sp /begin FUNCTION_LIST R102.6.drv_pedlh_1_0_3 /end FUNCTION_LIST /end CHARACTERISTIC
/begin CHARACTERISTIC mALHVSPRV "Pedal limp home vehicle speed setpoint in reverse gear" VALUE 0x00008263 REC_UBYTE_C 0 COMP_0429 0 255 DISPLAY_IDENTIFIER Cxx_acel_pdl_lih_vs_rvr /begin FUNCTION_LIST R102.6.drv_pedlh_1_0_3 /end FUNCTION_LIST /end CHARACTERISTIC
/begin CHARACTERISTIC mALHVTQHC "Maximum torque setpoint allowed for the pedal limp home vehicle speed regulator" VALUE 0x00008264 REC_UBYTE_C 0 COMP_0354_S -400 1640 DISPLAY_IDENTIFIER Cxx_acel_pdl_lih_vs_tqe_h /begin FUNCTION_LIST R102.6.drv_pedlh_1_0_3 /end FUNCTION_LIST /end CHARACTERISTIC
/begin CHARACTERISTIC mAP0RTK_S "pedal sensor is in nominal operation (track 1) (Sub)" VALUE 0x0000F6CC REC_UWORD_C 0 COMP_0359_S 0 63.999056205 /begin FUNCTION_LIST R101.1P.aps_pedin_1_1_2 R301.21.SafetyLevel2_1_0_2 /end FUNCTION_LIST /end CHARACTERISTIC
/begin CHARACTERISTIC mAP0RTN_S "0 pedal ratio position in pedal failure (track 1 or 2) (Sub)" VALUE 0x0000F6CE REC_UWORD_C 0 COMP_0359_S 0 63.999056205 /begin FUNCTION_LIST R101.1P.aps_pedin_1_1_2 R301.21.SafetyLevel2_1_0_2 /end FUNCTION_LIST /end CHARACTERISTIC
/begin CHARACTERISTIC mAP1RTK_S "pedal sensor is in nominal operation (track 1) (Sub)" VALUE 0x0000F6D0 REC_UWORD_C 0 COMP_0359_S 0 63.999056205 /begin FUNCTION_LIST R101.1P.aps_pedin_1_1_2 R301.21.SafetyLevel2_1_0_2 /end FUNCTION_LIST /end CHARACTERISTIC
/begin CHARACTERISTIC mAP1RTN_S "pedal ratio position in pedal failure (track 1 or 2) (Sub)" VALUE 0x0000F6D2 REC_UWORD_C 0 COMP_0359_S 0 63.999056205 /begin FUNCTION_LIST R101.1P.aps_pedin_1_1_2 R301.21.SafetyLevel2_1_0_2 /end FUNCTION_LIST /end CHARACTERISTIC
/begin CHARACTERISTIC mAPFLOUT "A full judgement release per cent" VALUE 0x00009022 REC_UWORD_C 0 COMP_0362_S 0 8191.875 /begin FUNCTION_LIST R000.1.RS_Integ_1_10_2 /end FUNCTION_LIST /end CHARACTERISTIC
/begin CHARACTERISTIC mAPKDHY_S "Uref ratio hysteresis linked with kick-down flag (Sub)" VALUE 0x0000F6D4 REC_UWORD_C 0 COMP_0359_S 0 63.999056205 /begin FUNCTION_LIST R101.1P.aps_pedin_1_1_2 /end FUNCTION_LIST /end CHARACTERISTIC
/begin CHARACTERISTIC mAPKDIK_S "pedal sensor is in nominal operation (track 1) (Sub)" VALUE 0x0000F6D6 REC_UWORD_C 0 COMP_0359_S 0 63.999056205 /begin FUNCTION_LIST R101.1P.aps_pedin_1_1_2 R301.21.SafetyLevel2_1_0_2 /end FUNCTION_LIST /end CHARACTERISTIC
/begin CHARACTERISTIC mAPKDIN_S "KD detection  in pedal failure (track 1 or 2) (Sub)" VALUE 0x0000F6D8 REC_UWORD_C 0 COMP_0359_S 0 63.999056205 /begin FUNCTION_LIST R101.1P.aps_pedin_1_1_2 R301.21.SafetyLevel2_1_0_2 /end FUNCTION_LIST /end CHARACTERISTIC
/begin CHARACTERISTIC mAPLVLTQ "Imposed torque setpoint to help to the calibration of the accelerator pedal limp home regulators" VALUE 0x0000902E REC_UWORD_C 0 COMP_0345_S -400 1647.96875 DISPLAY_IDENTIFIER Cxx_acel_pdl_lvl_tqe_thd /begin FUNCTION_LIST R102.6.drv_pedlh_1_0_3 /end FUNCTION_LIST /end CHARACTERISTIC
/begin CHARACTERISTIC mAPOSPN_S "Accelerator open-degree (for full-close position per cent -> deg conversion) (vice-operation part)" VALUE 0x0000F6E0 REC_UWORD_C 0 COMP_0005 0 7208.85 /begin FUNCTION_LIST R000.1.RS_Integ_1_10_2 /end FUNCTION_LIST /end CHARACTERISTIC
/begin CHARACTERISTIC mAPS0RATK "Uref ratio value defining 0 pedal ratio position when pedal sensor is in nominal operation (track 1)" VALUE 0x00009050 REC_UWORD_C 0 COMP_0359_S 0 63.999056205 DISPLAY_IDENTIFIER Cxx_acel_pdl_0_rat_v_ok
 /begin FUNCTION_LIST R000.1.RS_Integ_1_10_2 R101.1M.aps_pedin_1_2_2 R301.21.SafetyLevel2_1_0_2 /end FUNCTION_LIST
/end CHARACTERISTIC
/begin CHARACTERISTIC mAPS0RATN "Uref ratio value defining 0 pedal ratio position in pedal failure (track 1 or 2)" VALUE 0x00009052 REC_UWORD_C 0 COMP_0359_S 0 63.999056205 DISPLAY_IDENTIFIER Cxx_acel_pdl_0_rat_v_nok
 /begin FUNCTION_LIST R000.1.RS_Integ_1_10_2 R101.1M.aps_pedin_1_2_2 R301.21.SafetyLevel2_1_0_2 /end FUNCTION_LIST
/end CHARACTERISTIC
/begin CHARACTERISTIC mAPS12FAC "Factor between accelerator pedal track 1 and track 2 voltages" VALUE 0x00008281 REC_UBYTE_C 0 COMP_0068 0 255 DISPLAY_IDENTIFIER Cxx_acel_pdl_v1_v2_fac /begin FUNCTION_LIST R101.2.aps_pedxx_1_1_3 /end FUNCTION_LIST /end CHARACTERISTIC
/begin CHARACTERISTIC mAPS1RATK "Uref ratio value defining 1 pedal ratio position when pedal sensor is in nominal operation (track 1)" VALUE 0x00009054 REC_UWORD_C 0 COMP_0359_S 0 63.999056205 DISPLAY_IDENTIFIER Cxx_acel_pdl_100_rat_v_ok
 /begin FUNCTION_LIST R000.1.RS_Integ_1_10_2 R101.1M.aps_pedin_1_2_2 R301.21.SafetyLevel2_1_0_2 /end FUNCTION_LIST
/end CHARACTERISTIC
/begin CHARACTERISTIC mAPS1RATN "Uref ratio value defining 1 pedal ratio position in pedal failure (track 1 or 2)" VALUE 0x00009056 REC_UWORD_C 0 COMP_0359_S 0 63.999056205 DISPLAY_IDENTIFIER Cxx_acel_pdl_100_rat_v_nok /begin FUNCTION_LIST R101.1M.aps_pedin_1_2_2 R301.21.SafetyLevel2_1_0_2 /end FUNCTION_LIST /end CHARACTERISTIC
/begin CHARACTERISTIC mAPS1ULVO "Threshold to detect an open circuit on accelerator pedal track 1" VALUE 0x00009058 REC_UWORD_C 0 COMP_0359_S 0 63.999056205 DISPLAY_IDENTIFIER Cxx_acel_pdl_oc_v1_thd /begin FUNCTION_LIST R000.1.RS_Integ_1_10_2 R101.2.aps_pedxx_1_1_3 /end FUNCTION_LIST /end CHARACTERISTIC
/begin CHARACTERISTIC mAPS1ULVS "Threshold to detect a short circuit on accelerator pedal track 1" VALUE 0x0000905A REC_UWORD_C 0 COMP_0359_S 0 63.999056205 DISPLAY_IDENTIFIER Cxx_acel_pdl_sc_v1_thd /begin FUNCTION_LIST R000.1.RS_Integ_1_10_2 R101.2.aps_pedxx_1_1_3 /end FUNCTION_LIST /end CHARACTERISTIC
/begin CHARACTERISTIC mAPS2ULVO "Threshold to detect an open circuit on accelerator pedal track 2" VALUE 0x0000905C REC_UWORD_C 0 COMP_0359_S 0 63.999056205 DISPLAY_IDENTIFIER Cxx_acel_pdl_oc_v2_thd /begin FUNCTION_LIST R000.1.RS_Integ_1_10_2 R101.2.aps_pedxx_1_1_3 /end FUNCTION_LIST /end CHARACTERISTIC
/begin CHARACTERISTIC mAPS2ULVS "Threshold to detect a short circuit on accelerator pedal track 2" VALUE 0x0000905E REC_UWORD_C 0 COMP_0359_S 0 63.999056205 DISPLAY_IDENTIFIER Cxx_acel_pdl_sc_v2_thd /begin FUNCTION_LIST R000.1.RS_Integ_1_10_2 R101.2.aps_pedxx_1_1_3 /end FUNCTION_LIST /end CHARACTERISTIC
/begin CHARACTERISTIC mAPSKDHYS "Uref ratio hysteresis linked with kick-down flag" VALUE 0x00009062 REC_UWORD_C 0 COMP_0359_S 0 63.999056205 DISPLAY_IDENTIFIER Cxx_acel_pdl_kd_hys /begin FUNCTION_LIST R101.1M.aps_pedin_1_2_2 /end FUNCTION_LIST /end CHARACTERISTIC
/begin CHARACTERISTIC mAPSKDIK "Uref ratio entry threshold for accelerator pedal KD detection when pedal sensor is in nominal operation (track 1)" VALUE 0x00009064 REC_UWORD_C 0 COMP_0359_S 0 63.999056205 DISPLAY_IDENTIFIER Cxx_acel_pdl_kd_in_thd_ok /begin FUNCTION_LIST R101.1M.aps_pedin_1_2_2 R301.21.SafetyLevel2_1_0_2 /end FUNCTION_LIST /end CHARACTERISTIC
/begin CHARACTERISTIC mAPSKDIN "Uref ratio entry threshold for accelerator pedal KD detection    in pedal failure (track 1 or 2)" VALUE 0x00009066 REC_UWORD_C 0 COMP_0359_S 0 63.999056205 DISPLAY_IDENTIFIER Cxx_acel_pdl_kd_in_thd_nok /begin FUNCTION_LIST R101.1M.aps_pedin_1_2_2 R301.21.SafetyLevel2_1_0_2 /end FUNCTION_LIST /end CHARACTERISTIC
/begin CHARACTERISTIC mAPSLHSV "Accelerator pedal voltage (= safety replacement value) if accelerator pedal limp home activated" VALUE 0x00009068 REC_UWORD_C 0 COMP_0359_S 0 63.999056205 DISPLAY_IDENTIFIER Cxx_acel_pdl_lih_sub_v /begin FUNCTION_LIST R101.2.aps_pedxx_1_1_3 /end FUNCTION_LIST /end CHARACTERISTIC
/begin CHARACTERISTIC mAPSLPNEG "Pedal slope during the decreasing transitions : normal mode = accelerator pedal limp home" VALUE 0x00008283 REC_UBYTE_C 0 COMP_0350_S 0 31.875 DISPLAY_IDENTIFIER Cxx_acel_pdl_trs_slop_neg /begin FUNCTION_LIST R102.6.drv_pedlh_1_0_3 /end FUNCTION_LIST /end CHARACTERISTIC
/begin CHARACTERISTIC mAPSLPPOS "Pedal slope during the increasing transitions : normal mode = accelerator pedal limp home" VALUE 0x00008284 REC_UBYTE_C 0 COMP_0350_S 0 31.875 DISPLAY_IDENTIFIER Cxx_acel_pdl_trs_slop_pos /begin FUNCTION_LIST R102.6.drv_pedlh_1_0_3 /end FUNCTION_LIST /end CHARACTERISTIC
/begin CHARACTERISTIC mASCDLY1 "Tempo 1 (before braking) to validate the conditions of accelerator pedal safety case" VALUE 0x00008288 REC_UBYTE_C 0 COMP_0366_S 0 5.1 DISPLAY_IDENTIFIER Cxx_acel_pdl_secu_dly1 /begin FUNCTION_LIST R101.3.aps_sftpd_1_1_4 /end FUNCTION_LIST /end CHARACTERISTIC
/begin CHARACTERISTIC mASCDLY2 "Tempo 2 (after braking) to detect the failure of accelerator pedal safety case N Åã 1" VALUE 0x00008289 REC_UBYTE_C 0 COMP_0366_S 0 5.1 DISPLAY_IDENTIFIER Cxx_acel_pdl_secu_dly2 /begin FUNCTION_LIST R101.3.aps_sftpd_1_1_4 /end FUNCTION_LIST /end CHARACTERISTIC
/begin CHARACTERISTIC mASCDLY3 "Tempo 3 to detect the failure of accelerator pedal safety case N Åã 2" VALUE 0x0000828A REC_UBYTE_C 0 COMP_0367_S 0 510 DISPLAY_IDENTIFIER Cxx_acel_pdl_secu_dly3 /begin FUNCTION_LIST R101.3.aps_sftpd_1_1_4 /end FUNCTION_LIST /end CHARACTERISTIC
/begin CHARACTERISTIC mASCNTHD "Engine speed threshold to allow the detection of accelerator pedal safety case" VALUE 0x0000828C REC_UBYTE_C 0 COMP_0368_S 0 8160 DISPLAY_IDENTIFIER Cxx_acel_pdl_secu_n_thd /begin FUNCTION_LIST R101.3.aps_sftpd_1_1_4 /end FUNCTION_LIST /end CHARACTERISTIC
/begin CHARACTERISTIC mASCSFTHD "Pedal variation threshold to allow the detection of accelerator pedal safety case" VALUE 0x00009078 REC_UWORD_C 0 COMP_0359_S 0 63.999056205 DISPLAY_IDENTIFIER Cxx_acel_pdl_secu_flu_thd /begin FUNCTION_LIST R101.3.aps_sftpd_1_1_4 /end FUNCTION_LIST /end CHARACTERISTIC
/begin CHARACTERISTIC mASCSTHD "Pedal threshold to allow the detection of accelerator pedal safety case" VALUE 0x0000907A REC_UWORD_C 0 COMP_0359_S 0 63.999056205 DISPLAY_IDENTIFIER Cxx_acel_pdl_secu_thd /begin FUNCTION_LIST R101.3.aps_sftpd_1_1_4 /end FUNCTION_LIST /end CHARACTERISTIC
/begin CHARACTERISTIC mASCVTHD "Vehicle speed threshold to allow the detection of accelerator pedal safety case" VALUE 0x0000828D REC_UBYTE_C 0 COMP_0429 0 255 DISPLAY_IDENTIFIER Cxx_acel_pdl_secu_vs_thd /begin FUNCTION_LIST R101.3.aps_sftpd_1_1_4 /end FUNCTION_LIST /end CHARACTERISTIC
/begin CHARACTERISTIC mASRSLNEG "ASR slew rate negative curve in case of protocol error" VALUE 0x00009080 REC_UWORD_C 0 COMP_0369_S -327675 0 DISPLAY_IDENTIFIER Cxx_asr_slwr_neg
 /begin FUNCTION_LIST R104.1.brk_absct_1_2_2 R105.1.tra_atsip_1_0_1 R105.2.tra_sdfta_1_1_2 /end FUNCTION_LIST
/end CHARACTERISTIC
/begin CHARACTERISTIC mASRSLPOS "ASR slew rate positive curve in case of protocol error" VALUE 0x00009082 REC_UWORD_C 0 COMP_0347_S 0 327675 DISPLAY_IDENTIFIER Cxx_asr_slwr_pos /begin FUNCTION_LIST R104.1.brk_absct_1_2_2 R105.1.tra_atsip_1_0_1 /end FUNCTION_LIST /end CHARACTERISTIC
/begin CHARACTERISTIC mASRTQDSB "Unscaled (raw) value of ASR torque setpoint sent during MSR requests." VALUE 0x00009084 REC_UWORD_C 0 COMP_0068 0 65535 DISPLAY_IDENTIFIER Cxx_asr_tqe_sp_msr_raw
 /begin FUNCTION_LIST R104.1.brk_absct_1_2_2 R105.1.tra_atsip_1_0_1 R105.2.tra_sdfta_1_1_2 /end FUNCTION_LIST
/end CHARACTERISTIC
/begin CHARACTERISTIC mBNCSWON "BNC SW judgement voltage" VALUE 0x000082C1 REC_UBYTE_C 0 COMP_0054 0 5100 /begin FUNCTION_LIST R000.1.RS_Integ_1_10_2 /end FUNCTION_LIST /end CHARACTERISTIC
/begin CHARACTERISTIC mCCSLVBF "VB filter coefficient for CC/SL" VALUE 0x000082FA REC_UBYTE_C 0 COMP_0063 0 0.99609375 /begin FUNCTION_LIST R000.1.RS_Integ_1_10_2 /end FUNCTION_LIST /end CHARACTERISTIC
/begin CHARACTERISTIC mDOWNBKP "Down breakpoint on vehicle speed in order to detect a vehicle stop" VALUE 0x000084A0 REC_UBYTE_C 0 COMP_0436 0 25.5 DISPLAY_IDENTIFIER Cxx_down_bkp_vs_neut /begin FUNCTION_LIST R000.1.RS_Integ_1_10_2 /end FUNCTION_LIST /end CHARACTERISTIC
/begin CHARACTERISTIC mESPCTRNG "This is a failure counter threshold. It authorize N successive failure before downgraded mode" VALUE 0x00008558 REC_UBYTE_C 0 COMP_0068 0 255 DISPLAY_IDENTIFIER Cxx_asr_msr_ctr_thd
 /begin FUNCTION_LIST R104.1.brk_absct_1_2_2 R105.1.tra_atsip_1_0_1 R105.2.tra_sdfta_1_1_2 /end FUNCTION_LIST
/end CHARACTERISTIC
/begin CHARACTERISTIC mESPFRMNG "Calibration time to detect a lost frame" VALUE 0x0000855B REC_UBYTE_C 0 COMP_0344_S 0 2.55 DISPLAY_IDENTIFIER Cxx_asr_msr_abst_dly /begin FUNCTION_LIST R104.1.brk_absct_1_2_2 R105.1.tra_atsip_1_0_1 /end FUNCTION_LIST /end CHARACTERISTIC
/begin CHARACTERISTIC mESPMXTRQ "Maximum allowable ASR/MSR torque request" VALUE 0x0000917E REC_UWORD_C 0 COMP_0345_S -400 1647.96875 DISPLAY_IDENTIFIER Cxx_asr_msr_max_tqe /begin FUNCTION_LIST R104.1.brk_absct_1_2_2 /end FUNCTION_LIST /end CHARACTERISTIC
/begin CHARACTERISTIC mESPNOKTQ "Unscaled (raw) invalid value of ASR and MSR torque requests" VALUE 0x00009184 REC_UWORD_C 0 COMP_0068 0 65535 DISPLAY_IDENTIFIER Cxx_mux_asr_msr_tqe_nok_raw /begin FUNCTION_LIST R104.1.brk_absct_1_2_2 /end FUNCTION_LIST /end CHARACTERISTIC
/begin CHARACTERISTIC mESPTQSUM "Sum of raw ASR target and raw MSR setpoint" VALUE 0x00009186 REC_UWORD_C 0 COMP_0068 0 65535 DISPLAY_IDENTIFIER Cxx_asr_msr_raw_sum
 /begin FUNCTION_LIST R104.1.brk_absct_1_2_2 R105.1.tra_atsip_1_0_1 R105.2.tra_sdfta_1_1_2 /end FUNCTION_LIST
/end CHARACTERISTIC
/begin CHARACTERISTIC mEVSPH5 "Pull-down start vehicle speed upper limit" VALUE 0x000085A8 REC_UBYTE_C 0 COMP_0007 0 510 /begin FUNCTION_LIST KF7-580.1[8] /end FUNCTION_LIST /end CHARACTERISTIC
/begin CHARACTERISTIC mEVSPL2 "Vehicle speed condition lower limit 2" VALUE 0x000085AA REC_UBYTE_C 0 COMP_0007 0 510 /begin FUNCTION_LIST KF7-580.1[8] /end FUNCTION_LIST /end CHARACTERISTIC
/begin CHARACTERISTIC mEVSPL3 "At the time of the positive pressure, leak-down control vehicle speed condition lower limit" VALUE 0x000085AB REC_UBYTE_C 0 COMP_0007 0 510 /begin FUNCTION_LIST KF7-580.1[8] /end FUNCTION_LIST /end CHARACTERISTIC
/begin CHARACTERISTIC mEVSPL5 "Pull-down start vehicle speed lower limit" VALUE 0x000085AD REC_UBYTE_C 0 COMP_0007 0 510 /begin FUNCTION_LIST KF7-580.1[8] /end FUNCTION_LIST /end CHARACTERISTIC
/begin CHARACTERISTIC mEVTNH3 "At least, intake air temperature condition upper limit" VALUE 0x000085B9 REC_UBYTE_C 0 COMP_0035 -50 205 /begin FUNCTION_LIST KF7-580.1[8] /end FUNCTION_LIST /end CHARACTERISTIC
/begin CHARACTERISTIC mEVTNH4 "At least, intake air temperature condition upper limit 2" VALUE 0x000085BA REC_UBYTE_C 0 COMP_0035 -50 205 /begin FUNCTION_LIST KF7-580.1[8] /end FUNCTION_LIST /end CHARACTERISTIC
/begin CHARACTERISTIC mEVTNL3 "At least, intake air temperature condition lower limit" VALUE 0x000085BC REC_UBYTE_C 0 COMP_0035 -50 205 /begin FUNCTION_LIST KF7-580.1[8] /end FUNCTION_LIST /end CHARACTERISTIC
/begin CHARACTERISTIC mEVTNL4 "At least, intake air temperature condition lower limit 2" VALUE 0x000085BD REC_UBYTE_C 0 COMP_0035 -50 205 /begin FUNCTION_LIST KF7-580.1[8] /end FUNCTION_LIST /end CHARACTERISTIC
/begin CHARACTERISTIC mEVTPH2 "TP condition upper limit 2" VALUE 0x000085C0 REC_UBYTE_C 0 COMP_0001 0 31.875 /begin FUNCTION_LIST KF7-580.1[8] /end FUNCTION_LIST /end CHARACTERISTIC
/begin CHARACTERISTIC mEVTPH3 "Pull-down start TP upper limit" VALUE 0x000085C1 REC_UBYTE_C 0 COMP_0001 0 31.875 /begin FUNCTION_LIST KF7-580.1[8] /end FUNCTION_LIST /end CHARACTERISTIC
/begin CHARACTERISTIC mEVTPL2 "TP condition lower limit 2" VALUE 0x000085C4 REC_UBYTE_C 0 COMP_0001 0 31.875 /begin FUNCTION_LIST KF7-580.1[8] /end FUNCTION_LIST /end CHARACTERISTIC
/begin CHARACTERISTIC mEVTPL3 "Pull-down start TP lower limit" VALUE 0x000085C5 REC_UBYTE_C 0 COMP_0001 0 31.875 /begin FUNCTION_LIST KF7-580.1[8] /end FUNCTION_LIST /end CHARACTERISTIC
/begin CHARACTERISTIC mHSEPL5 "Pull-down start vehicle speed condition lower limit hysteresis" VALUE 0x000086A3 REC_UBYTE_C 0 COMP_0007 0 510 /begin FUNCTION_LIST KF7-580.1[8] /end FUNCTION_LIST /end CHARACTERISTIC
/begin CHARACTERISTIC mHSEVQM "Inhalation air quantity condition hysteresis" VALUE 0x00009246 REC_UWORD_C 0 COMP_0068 0 65535 /begin FUNCTION_LIST KF7-580.1[8] /end FUNCTION_LIST /end CHARACTERISTIC
/begin CHARACTERISTIC mIOLVTCD1 "IOCVTC target angle lower limit value" VALUE 0x0000874C REC_UBYTE_C 0 COMP_0048 0 127.5 /begin FUNCTION_LIST KF7-580.1[8] /end FUNCTION_LIST /end CHARACTERISTIC
/begin CHARACTERISTIC mIOLVTCD2 "IOCVTC target angle upper limit value" VALUE 0x0000874D REC_UBYTE_C 0 COMP_0048 0 127.5 /begin FUNCTION_LIST KF7-580.1[8] /end FUNCTION_LIST /end CHARACTERISTIC
/begin CHARACTERISTIC mIOLVTCF1 "IOCVTC target angle lower limit value" VALUE 0x0000874E REC_UBYTE_C 0 COMP_0019 0 255 /begin FUNCTION_LIST KF7-580.1[8] /end FUNCTION_LIST /end CHARACTERISTIC
/begin CHARACTERISTIC mIOLVTCF2 "IOCVTC target angle upper limit value" VALUE 0x0000874F REC_UBYTE_C 0 COMP_0019 0 255 /begin FUNCTION_LIST KF7-580.1[8] /end FUNCTION_LIST /end CHARACTERISTIC
/begin CHARACTERISTIC mMNAVLM_S "High limit of minimum available engine torque (sub)" VALUE 0x0000F6C2 REC_SWORD_C 0 COMP_0228 -3276.8 3276.7 /begin FUNCTION_LIST R000.1.RS_Integ_1_10_2 /end FUNCTION_LIST /end CHARACTERISTIC
/begin CHARACTERISTIC mMNAVTF_S "Second corrective factor of minimum available engine torque (sub)" VALUE 0x0000F6F4 REC_UWORD_C 0 COMP_0395 0 15.999780435 /begin FUNCTION_LIST R000.1.RS_Integ_1_10_2 /end FUNCTION_LIST /end CHARACTERISTIC
/begin CHARACTERISTIC mMXPWGER "Maximum power for power limitation" VALUE 0x00008879 REC_UBYTE_C 0 COMP_0351_S 0 510000 DISPLAY_IDENTIFIER Cxx_maw_pow_gear /begin FUNCTION_LIST R103.1.lim_statl_1_0_1 /end FUNCTION_LIST /end CHARACTERISTIC
/begin CHARACTERISTIC mMXPWRPM "Engine speed threshold for activating power limitation" VALUE 0x000093C0 REC_UWORD_C 0 COMP_0443 0 65535 DISPLAY_IDENTIFIER Cxx_max_pow_n_thd /begin FUNCTION_LIST R103.1.lim_statl_1_0_1 /end FUNCTION_LIST /end CHARACTERISTIC
/begin CHARACTERISTIC mNORQMNTQ "Torque value to be sent to torque arbitration when there isn't any request for a minimum torque" VALUE 0x000093D6 REC_UWORD_C 0 COMP_0345_S -400 1647.96875 DISPLAY_IDENTIFIER Cxx_min_tqe_dsb
 /begin FUNCTION_LIST R104.1.brk_absct_1_2_2 R105.1.tra_atsip_1_0_1 R105.2.tra_sdfta_1_1_2 /end FUNCTION_LIST
/end CHARACTERISTIC
/begin CHARACTERISTIC mPDPMEV1 "Pull-down permission EVPCNT" VALUE 0x00009416 REC_UWORD_C 0 COMP_0152 0 131070 /begin FUNCTION_LIST KF7-580.1[8] /end FUNCTION_LIST /end CHARACTERISTIC
/begin CHARACTERISTIC mPDPMEV2 "Pull-down permission EVPCNT" VALUE 0x00009418 REC_UWORD_C 0 COMP_0152 0 131070 /begin FUNCTION_LIST KF7-580.1[8] /end FUNCTION_LIST /end CHARACTERISTIC
/begin CHARACTERISTIC mPFTISSC "Particle filter idle speed setpoint" VALUE 0x0000942C REC_UWORD_C 0 COMP_0337_S 0 65535 DISPLAY_IDENTIFIER Cxx_pft_min_is_n /begin FUNCTION_LIST R000.1.RS_Integ_1_10_2 /end FUNCTION_LIST /end CHARACTERISTIC
/begin CHARACTERISTIC mPSVSPSLB "PS stratified lean fixed permission vehicle speed" VALUE 0x000089E6 REC_UBYTE_C 0 COMP_0007 0 510 /begin FUNCTION_LIST KF7-580.1[8] /end FUNCTION_LIST /end CHARACTERISTIC
/begin CHARACTERISTIC mPSVTCTWH "The test permission coolant temperature upper limit value that C-VTC is active" VALUE 0x000089E7 REC_UBYTE_C 0 COMP_0035 -50 205 /begin FUNCTION_LIST KF7-580.1[8] /end FUNCTION_LIST /end CHARACTERISTIC
/begin CHARACTERISTIC mPSVTCTWL "The test permission coolant temperature lower limit value that C-VTC is active" VALUE 0x000089E8 REC_UBYTE_C 0 COMP_0035 -50 205 /begin FUNCTION_LIST KF7-580.1[8] /end FUNCTION_LIST /end CHARACTERISTIC
/begin CHARACTERISTIC mRAPLCA_S "Accelerator open limiter (CA) (Sub)" VALUE 0x0000F6F8 REC_UWORD_C 0 COMP_0359_S 0 63.999056205 /begin FUNCTION_LIST R000.1.RS_Integ_1_10_2 R301.21.SafetyLevel2_1_0_2 /end FUNCTION_LIST /end CHARACTERISTIC
/begin CHARACTERISTIC mRAPLMT_S "Accelerator open limiter (Sub)" VALUE 0x0000F6FA REC_UWORD_C 0 COMP_0359_S 0 63.999056205 /begin FUNCTION_LIST R000.1.RS_Integ_1_10_2 R301.21.SafetyLevel2_1_0_2 /end FUNCTION_LIST /end CHARACTERISTIC
/begin CHARACTERISTIC mRAPOLMCA "Accelerator open limiter (CA)" VALUE 0x0000947E REC_UWORD_C 0 COMP_0359_S 0 63.999056205 /begin FUNCTION_LIST R000.1.RS_Integ_1_10_2 R301.21.SafetyLevel2_1_0_2 /end FUNCTION_LIST /end CHARACTERISTIC
/begin CHARACTERISTIC mRAPOLMT "Accelerator open limiter" VALUE 0x00009480 REC_UWORD_C 0 COMP_0359_S 0 63.999056205 /begin FUNCTION_LIST R000.1.RS_Integ_1_10_2 R301.21.SafetyLevel2_1_0_2 /end FUNCTION_LIST /end CHARACTERISTIC
/begin CHARACTERISTIC mRDAPL2_S "Calibration for decreasing slope limitation (Sub)" VALUE 0x0000F6FC REC_UWORD_C 0 COMP_0359_S 0 63.999056205 /begin FUNCTION_LIST R000.1.RS_Integ_1_10_2 R301.21.SafetyLevel2_1_0_2 /end FUNCTION_LIST /end CHARACTERISTIC
/begin CHARACTERISTIC mRDAPLT_S "Calibration for increasing slope limitation (Sub)" VALUE 0x0000F6FE REC_UWORD_C 0 COMP_0359_S 0 63.999056205 /begin FUNCTION_LIST R000.1.RS_Integ_1_10_2 R301.21.SafetyLevel2_1_0_2 /end FUNCTION_LIST /end CHARACTERISTIC
/begin CHARACTERISTIC mRDAPOLMT "Calibration for increasing slope limitation" VALUE 0x0000948E REC_UWORD_C 0 COMP_0359_S 0 63.999056205 /begin FUNCTION_LIST R000.1.RS_Integ_1_10_2 R301.21.SafetyLevel2_1_0_2 /end FUNCTION_LIST /end CHARACTERISTIC
/begin CHARACTERISTIC mRDAPOLT2 "Calibration for decreasing slope limitation" VALUE 0x00009490 REC_UWORD_C 0 COMP_0359_S 0 63.999056205 /begin FUNCTION_LIST R000.1.RS_Integ_1_10_2 R301.21.SafetyLevel2_1_0_2 /end FUNCTION_LIST /end CHARACTERISTIC
/begin CHARACTERISTIC mRDRTSNMN "Minimum engine speed for power => torque conversion of driver setpoint (avoids division by zero)" VALUE 0x00008A2E REC_UBYTE_C 0 COMP_0448_S 0 2550 DISPLAY_IDENTIFIER Cxx_driv_tqe_sp_n_min /begin FUNCTION_LIST R102.3M.DRTQE_1_1_0 R301.21.SafetyLevel2_1_0_2 /end FUNCTION_LIST /end CHARACTERISTIC
/begin CHARACTERISTIC mRDTSNM_S "Minimum engine speed for power => torque conversion (Sub)" VALUE 0x0000F6A7 REC_UBYTE_C 0 COMP_0448_S 0 2550 /begin FUNCTION_LIST R102.3P.DRTQE_1_0_2 R301.21.SafetyLevel2_1_0_2 /end FUNCTION_LIST /end CHARACTERISTIC
/begin CHARACTERISTIC mRLHPDLSP "Accelerator ratio at limphome when pedal safety strategy is not activated." VALUE 0x000094B8 REC_UWORD_C 0 COMP_0451_S 0 81.91875 /begin FUNCTION_LIST R000.1.RS_Integ_1_10_2 R301.21.SafetyLevel2_1_0_2 /end FUNCTION_LIST /end CHARACTERISTIC
/begin CHARACTERISTIC mRLHPSP_S "pedal safety strategy is not activated. (Sub)" VALUE 0x0000F700 REC_UWORD_C 0 COMP_0451_S 0 81.91875 /begin FUNCTION_LIST R000.1.RS_Integ_1_10_2 R301.21.SafetyLevel2_1_0_2 /end FUNCTION_LIST /end CHARACTERISTIC
/begin CHARACTERISTIC mRMNATF_S "Slew-rate on minimum available torque for driver setpoint (Sub)" VALUE 0x0000F6AA REC_UBYTE_C 0 COMP_0456_S 0 510 /begin FUNCTION_LIST R102.3P.DRTQE_1_0_2 R301.21.SafetyLevel2_1_0_2 /end FUNCTION_LIST /end CHARACTERISTIC
/begin CHARACTERISTIC mRMNAVTQF "Slew-rate on minimum available torque for driver setpoint calculation" VALUE 0x00008AAB REC_UBYTE_C 0 COMP_0456_S 0 510 DISPLAY_IDENTIFIER Cxx_driv_min_avl_tqe_fil_fac /begin FUNCTION_LIST R102.3M.DRTQE_1_1_0 R301.21.SafetyLevel2_1_0_2 /end FUNCTION_LIST /end CHARACTERISTIC
/begin CHARACTERISTIC mRNFILFAC "Time constant of engine speed filtering for driver torque setpoint calculation" VALUE 0x00008AAC REC_UBYTE_C 0 COMP_0344_S 0 2.55 DISPLAY_IDENTIFIER Cxx_driv_tqe_sp_n_fil_fac /begin FUNCTION_LIST R102.3M.DRTQE_1_1_0 R301.21.SafetyLevel2_1_0_2 /end FUNCTION_LIST /end CHARACTERISTIC
/begin CHARACTERISTIC mRNFLFC_S "constant of engine speed filtering for driver torque setpoint (Sub)" VALUE 0x0000F6AB REC_UBYTE_C 0 COMP_0344_S 0 2.55 /begin FUNCTION_LIST R102.3P.DRTQE_1_0_2 R301.21.SafetyLevel2_1_0_2 /end FUNCTION_LIST /end CHARACTERISTIC
/begin CHARACTERISTIC mRPDLFMNL "Manual interpolation factor between pedal progressivity maps (for tuning purposes)" VALUE 0x00008ACA REC_UBYTE_C 0 COMP_0460_S 0 1.00000035 DISPLAY_IDENTIFIER Cxx_acel_pdl_fmt_mnl_fac
 /begin FUNCTION_LIST R000.2.RS_ROMflags_1_10_3 R102.1M.PEDFM_1_0_9 R301.21.SafetyLevel2_1_0_2 /end FUNCTION_LIST
/end CHARACTERISTIC
/begin CHARACTERISTIC mRPDLFRVR "Pedal progressivity correction factor for reverse gear" VALUE 0x00008ACB REC_UBYTE_C 0 COMP_0373 0 2.55 DISPLAY_IDENTIFIER Cxx_acel_pdl_fmt_rvr_fac /begin FUNCTION_LIST R102.1M.PEDFM_1_0_9 R301.21.SafetyLevel2_1_0_2 /end FUNCTION_LIST /end CHARACTERISTIC
/begin CHARACTERISTIC mRPFMNL_S "Manual interpolation factor between pedal progressivity maps (Sub)" VALUE 0x0000F6AD REC_UBYTE_C 0 COMP_0460_S 0 1.00000035 /begin FUNCTION_LIST R102.1P.PEDFM_1_0_2 R301.21.SafetyLevel2_1_0_2 /end FUNCTION_LIST /end CHARACTERISTIC
/begin CHARACTERISTIC mRPFRVR_S "Pedal progressivity correction factor for reverse gear (Sub)" VALUE 0x0000F6AE REC_UBYTE_C 0 COMP_0373 0 2.55 /begin FUNCTION_LIST R102.1P.PEDFM_1_0_2 R301.21.SafetyLevel2_1_0_2 /end FUNCTION_LIST /end CHARACTERISTIC
/begin CHARACTERISTIC mRRMAXPOW "Reference max power for powertrain setpoint normalization" VALUE 0x00008AD0 REC_UBYTE_C 0 COMP_0351_S 0 510000 DISPLAY_IDENTIFIER Cxx_ref_max_pow /begin FUNCTION_LIST R102.3M.DRTQE_1_1_0 R301.21.SafetyLevel2_1_0_2 /end FUNCTION_LIST /end CHARACTERISTIC
/begin CHARACTERISTIC mRRMXPW_S "Reference max power for powertrain setpoint normalization (Sub)" VALUE 0x0000F6AF REC_UBYTE_C 0 COMP_0351_S 0 510000 /begin FUNCTION_LIST R102.3P.DRTQE_1_0_2 R301.21.SafetyLevel2_1_0_2 /end FUNCTION_LIST /end CHARACTERISTIC
/begin CHARACTERISTIC mRVMALPL "At the time of the idle, air-fuel ratio compensation reference value lower limit" VALUE 0x00008AE1 REC_UBYTE_C 0 COMP_0027 0 255 /begin FUNCTION_LIST KF7-580.1[8] /end FUNCTION_LIST /end CHARACTERISTIC
/begin CHARACTERISTIC mRVMALPU "At the time of the idle, air-fuel ratio compensation reference value upper limit" VALUE 0x00008AE2 REC_UBYTE_C 0 COMP_0027 0 255 /begin FUNCTION_LIST KF7-580.1[8] /end FUNCTION_LIST /end CHARACTERISTIC
/begin CHARACTERISTIC mTETCCLR "ETC learning clear executive time" VALUE 0x00008BB2 REC_UBYTE_C 0 COMP_0008 0 25500 /begin FUNCTION_LIST KF7-580.1[8] /end FUNCTION_LIST /end CHARACTERISTIC
/begin CHARACTERISTIC mTEVDLY "After the diagnosis permission start, time" VALUE 0x00008BB6 REC_UBYTE_C 0 COMP_0096 0 2550 /begin FUNCTION_LIST KF7-580.1[8] /end FUNCTION_LIST /end CHARACTERISTIC
/begin CHARACTERISTIC mTNZEROR "Elapsed time since KNRPM changed from KNRPM! = 0 to KNRPM = 0" VALUE 0x00008CBD REC_UBYTE_C 0 COMP_0014 0 2550 /begin FUNCTION_LIST R000.1.RS_Integ_1_10_2 /end FUNCTION_LIST /end CHARACTERISTIC
/begin CHARACTERISTIC mTPRVL "At the time of the idle, cylinder air quantity equivalent fuel injection quantity reference value lower limit" VALUE 0x000095F8 REC_UWORD_C 0 COMP_0144 0 31.999495335 /begin FUNCTION_LIST KF7-580.1[8] /end FUNCTION_LIST /end CHARACTERISTIC
/begin CHARACTERISTIC mTPRVU "At the time of the idle, cylinder air quantity equivalent fuel injection quantity reference value upper limit" VALUE 0x000095FA REC_UWORD_C 0 COMP_0144 0 31.999495335 /begin FUNCTION_LIST KF7-580.1[8] /end FUNCTION_LIST /end CHARACTERISTIC
/begin CHARACTERISTIC mTWADJH "Adjustment control permission coolant temperature upper limit" VALUE 0x00008D14 REC_UBYTE_C 0 COMP_0035 -50 205 /begin FUNCTION_LIST KF7-580.1[8] /end FUNCTION_LIST /end CHARACTERISTIC
/begin CHARACTERISTIC mTWADJL "Adjustment control permission coolant temperature lower limit" VALUE 0x00008D15 REC_UBYTE_C 0 COMP_0035 -50 205 /begin FUNCTION_LIST KF7-580.1[8] /end FUNCTION_LIST /end CHARACTERISTIC
/begin CHARACTERISTIC mTWSKCR "Coolant temperature soak judgement criteria" VALUE 0x00008D6D REC_UBYTE_C 0 COMP_0003 0 255 /begin FUNCTION_LIST KF7-580.1[8] /end FUNCTION_LIST /end CHARACTERISTIC
/begin CHARACTERISTIC mUSRVL "At the time of the idle, AFM voltage reference value lower limit" VALUE 0x00009648 REC_UWORD_C 0 COMP_0023 0 327675 /begin FUNCTION_LIST KF7-580.1[8] /end FUNCTION_LIST /end CHARACTERISTIC
/begin CHARACTERISTIC mUSRVU "At the time of the idle, AFM voltage reference value upper limit" VALUE 0x0000964A REC_UWORD_C 0 COMP_0023 0 327675 /begin FUNCTION_LIST KF7-580.1[8] /end FUNCTION_LIST /end CHARACTERISTIC
/begin CHARACTERISTIC mVBELISSF "VB filter coefficient for Idle speed setpoint" VALUE 0x00008D9C REC_UBYTE_C 0 COMP_0063 0 0.99609375 /begin FUNCTION_LIST R000.1.RS_Integ_1_10_2 /end FUNCTION_LIST /end CHARACTERISTIC
/begin CHARACTERISTIC mMRDRTQSP "Map giving effective engine torque setpoint from powertrain setpoint and engine speed" MAP 0x0000B772 REC_UWORD_C 0 COMP_0345_S -400 1647.96875
 /begin AXIS_DESCR COM_AXIS NO_INPUT_QUANTITY COMP_0443 16 0 65535 AXIS_PTS_REF mTRDTQSPN /end AXIS_DESCR
 /begin AXIS_DESCR COM_AXIS NO_INPUT_QUANTITY COMP_0451_S 16 0 81.91875 AXIS_PTS_REF mTRDTQSPA /end AXIS_DESCR
 DISPLAY_IDENTIFIER Cmp_driv_tqe_map /begin FUNCTION_LIST R102.3M.DRTQE_1_1_0 R301.21.SafetyLevel2_1_0_2 /end FUNCTION_LIST /end CHARACTERISTIC
/begin CHARACTERISTIC mMRDTSP_S "powertrain setpoint and engine speed (Sub)" MAP 0x0000F98C REC_UWORD_C 0 COMP_0345_S -400 1647.96875
 /begin AXIS_DESCR COM_AXIS NO_INPUT_QUANTITY COMP_0443 16 0 65535 AXIS_PTS_REF mTRDTSN_S /end AXIS_DESCR
 /begin AXIS_DESCR COM_AXIS NO_INPUT_QUANTITY COMP_0451_S 16 0 81.91875 AXIS_PTS_REF mTRDTSA_S /end AXIS_DESCR
 /begin FUNCTION_LIST R102.3P.DRTQE_1_0_2 R301.21.SafetyLevel2_1_0_2 /end FUNCTION_LIST
/end CHARACTERISTIC
/begin CHARACTERISTIC mMGOVD "MGOV map D range (GOV map D range)" MAP 0x00009D5E REC_UBYTE_C 0 COMP_0314 -128 127
 /begin AXIS_DESCR FIX_AXIS NO_INPUT_QUANTITY COMP_0278_S 8 -40 100 FIX_AXIS_PAR_DIST 0 1 8 /end AXIS_DESCR
 /begin AXIS_DESCR FIX_AXIS NO_INPUT_QUANTITY COMP_0271_S 8 0 2800 FIX_AXIS_PAR_DIST 0 1 8 /end AXIS_DESCR
 /begin FUNCTION_LIST R000.2.RS_ROMflags_1_10_3 R301.25.GOV_idle_1_0_2 /end FUNCTION_LIST
/end CHARACTERISTIC
/begin CHARACTERISTIC mMGOVN "MGOV map N range (GOV map N range)" MAP 0x00009D9E REC_UBYTE_C 0 COMP_0314 -128 127
 /begin AXIS_DESCR FIX_AXIS NO_INPUT_QUANTITY COMP_0278_S 8 -40 100 FIX_AXIS_PAR_DIST 0 1 8 /end AXIS_DESCR
 /begin AXIS_DESCR FIX_AXIS NO_INPUT_QUANTITY COMP_0271_S 8 0 2800 FIX_AXIS_PAR_DIST 0 1 8 /end AXIS_DESCR
 /begin FUNCTION_LIST R000.2.RS_ROMflags_1_10_3 R301.25.GOV_idle_1_0_2 /end FUNCTION_LIST
/end CHARACTERISTIC
/begin CHARACTERISTIC mMGRTQLIM "Gear box torque limitation value" MAP 0x0000B572 REC_UWORD_C 0 COMP_0345_S -400 1647.96875
 /begin AXIS_DESCR COM_AXIS NO_INPUT_QUANTITY COMP_0337_S 8 0 65535 AXIS_PTS_REF mGRTLIMBP /end AXIS_DESCR
 /begin AXIS_DESCR FIX_AXIS NO_INPUT_QUANTITY COMP_0484_S 8 -1 6 FIX_AXIS_PAR_DIST 0 1 8 /end AXIS_DESCR
 DISPLAY_IDENTIFIER Cmp_lim_gear_n_gear /begin FUNCTION_LIST R103.2.lim_gbxli_1_0_2 /end FUNCTION_LIST /end CHARACTERISTIC
/begin CHARACTERISTIC mMRPDLFMF "Vehicle speed and driving style map giving transition factor between 2 progressivity maps" MAP 0x0000B972 REC_UWORD_C 0 COMP_0486_S 0 1.003904451
 /begin AXIS_DESCR COM_AXIS NO_INPUT_QUANTITY COMP_0486_S 8 0 1.003904451 AXIS_PTS_REF mTRPFDMFB /end AXIS_DESCR
 /begin AXIS_DESCR COM_AXIS NO_INPUT_QUANTITY COMP_0375_S 8 0 655.35 AXIS_PTS_REF mTRPFVSPB /end AXIS_DESCR
 DISPLAY_IDENTIFIER Cmp_acel_pdl_fmt_fac /begin FUNCTION_LIST R102.1M.PEDFM_1_0_9 R301.21.SafetyLevel2_1_0_2 /end FUNCTION_LIST /end CHARACTERISTIC
/begin CHARACTERISTIC mMRPFMF_S "transition factor between 2 progressivity maps (Sub)" MAP 0x0000FB8C REC_UWORD_C 0 COMP_0486_S 0 1.003904451
 /begin AXIS_DESCR COM_AXIS NO_INPUT_QUANTITY COMP_0486_S 8 0 1.003904451 AXIS_PTS_REF mTRPDMB_S /end AXIS_DESCR
 /begin AXIS_DESCR COM_AXIS NO_INPUT_QUANTITY COMP_0375_S 8 0 655.35 AXIS_PTS_REF mTRPVSB_S /end AXIS_DESCR
 /begin FUNCTION_LIST R102.1P.PEDFM_1_0_2 R301.21.SafetyLevel2_1_0_2 /end FUNCTION_LIST
/end CHARACTERISTIC
/begin CHARACTERISTIC mAPSCNIPT "Interpolated calibration table to detect an inconsistency on accelerator pedal tracks" CURVE 0x0000DF1A REC_UWORD_C 0 COMP_0359_S 0 63.999056205
 /begin AXIS_DESCR COM_AXIS NO_INPUT_QUANTITY COMP_0359_S 16 0 63.999056205 AXIS_PTS_REF mAPSCNBP /end AXIS_DESCR
 DISPLAY_IDENTIFIER Ctp_acel_pdl_v_max_dif /begin FUNCTION_LIST R101.2.aps_pedxx_1_1_3 /end FUNCTION_LIST /end CHARACTERISTIC
/begin CHARACTERISTIC mTEQMP1 "A high vehicle speed pull-down permission QM lower limit table" CURVE 0x0000E96A REC_UWORD_C 0 COMP_0068 0 65535
 /begin AXIS_DESCR COM_AXIS NO_INPUT_QUANTITY COMP_0152 16 0 131070 AXIS_PTS_REF mTEVQCNT /end AXIS_DESCR
 /begin FUNCTION_LIST KF7-580.1[8] /end FUNCTION_LIST
/end CHARACTERISTIC
/begin CHARACTERISTIC mTRBAP1_S "Pedal progressivity map    n Åã 1 (Sub)" CURVE 0x00010612 REC_UWORD_C 0 COMP_0503_S 0 0.999998565
 /begin AXIS_DESCR COM_AXIS NO_INPUT_QUANTITY COMP_0451_S 16 0 81.91875 AXIS_PTS_REF mTRPAPB_S /end AXIS_DESCR
 /begin FUNCTION_LIST R102.1P.PEDFM_1_0_2 R301.21.SafetyLevel2_1_0_2 /end FUNCTION_LIST
/end CHARACTERISTIC
/begin CHARACTERISTIC mTRBAP2_S "Pedal progressivity map    n Åã 2 (Sub)" CURVE 0x00010632 REC_UWORD_C 0 COMP_0503_S 0 0.999998565
 /begin AXIS_DESCR COM_AXIS NO_INPUT_QUANTITY COMP_0451_S 16 0 81.91875 AXIS_PTS_REF mTRPAPB_S /end AXIS_DESCR
 /begin FUNCTION_LIST R102.1P.PEDFM_1_0_2 R301.21.SafetyLevel2_1_0_2 /end FUNCTION_LIST
/end CHARACTERISTIC
/begin CHARACTERISTIC mTRBASPD1 "Pedal progressivity map    n Åã 1" CURVE 0x0000EEF6 REC_UWORD_C 0 COMP_0503_S 0 0.999998565
 /begin AXIS_DESCR COM_AXIS NO_INPUT_QUANTITY COMP_0451_S 16 0 81.91875 AXIS_PTS_REF mTRPDLAPB /end AXIS_DESCR
 DISPLAY_IDENTIFIER Ctp_acel_pdl_fmt_1 /begin FUNCTION_LIST R102.1M.PEDFM_1_0_9 R301.21.SafetyLevel2_1_0_2 /end FUNCTION_LIST /end CHARACTERISTIC
/begin CHARACTERISTIC mTRBASPD2 "Pedal progressivity map    n Åã 2" CURVE 0x0000EF16 REC_UWORD_C 0 COMP_0503_S 0 0.999998565
 /begin AXIS_DESCR COM_AXIS NO_INPUT_QUANTITY COMP_0451_S 16 0 81.91875 AXIS_PTS_REF mTRPDLAPB /end AXIS_DESCR
 DISPLAY_IDENTIFIER Ctp_acel_pdl_fmt_2 /begin FUNCTION_LIST R102.1M.PEDFM_1_0_9 R301.21.SafetyLevel2_1_0_2 /end FUNCTION_LIST /end CHARACTERISTIC
/begin CHARACTERISTIC mTRTFDMAX "Max force table for force => powertrain setpoint conversion" CURVE 0x0000F0B6 REC_UWORD_C 0 COMP_0374_S -20000 111070
 /begin AXIS_DESCR COM_AXIS NO_INPUT_QUANTITY COMP_0375_S 16 0 655.35 AXIS_PTS_REF mTRFDVSPB /end AXIS_DESCR
 DISPLAY_IDENTIFIER Ctp_max_forc /begin FUNCTION_LIST R102.2M.DRARB_1_1_4 R301.21.SafetyLevel2_1_0_2 /end FUNCTION_LIST /end CHARACTERISTIC
/begin CHARACTERISTIC mTRTFDMIN "Min force table for force => powertrain setpoint conversion" CURVE 0x0000F0D6 REC_UWORD_C 0 COMP_0374_S -20000 111070
 /begin AXIS_DESCR COM_AXIS NO_INPUT_QUANTITY COMP_0375_S 16 0 655.35 AXIS_PTS_REF mTRFDVSPB /end AXIS_DESCR
 DISPLAY_IDENTIFIER Ctp_min_forc /begin FUNCTION_LIST R102.2M.DRARB_1_1_4 R301.21.SafetyLevel2_1_0_2 /end FUNCTION_LIST /end CHARACTERISTIC
/begin CHARACTERISTIC mTRTFMN_S "Min force table for force => powertrain setpoint conversion (Sub)" CURVE 0x000106F2 REC_UWORD_C 0 COMP_0374_S -20000 111070
 /begin AXIS_DESCR COM_AXIS NO_INPUT_QUANTITY COMP_0375_S 16 0 655.35 AXIS_PTS_REF mTRFVSB_S /end AXIS_DESCR
 /begin FUNCTION_LIST R102.2P.DRARB_1_0_2 R301.21.SafetyLevel2_1_0_2 /end FUNCTION_LIST
/end CHARACTERISTIC
/begin CHARACTERISTIC mTRTFMX_S "Max force table for force => powertrain setpoint conversion (Sub)" CURVE 0x00010712 REC_UWORD_C 0 COMP_0374_S -20000 111070
 /begin AXIS_DESCR COM_AXIS NO_INPUT_QUANTITY COMP_0375_S 16 0 655.35 AXIS_PTS_REF mTRFVSB_S /end AXIS_DESCR
 /begin FUNCTION_LIST R102.2P.DRARB_1_0_2 R301.21.SafetyLevel2_1_0_2 /end FUNCTION_LIST
/end CHARACTERISTIC
/begin CHARACTERISTIC mTBALHNH "Pedal limp home max gear ratio" CURVE 0x0000E5FA REC_UWORD_C 0 COMP_0337_S 0 65535
 /begin AXIS_DESCR FIX_AXIS NO_INPUT_QUANTITY COMP_0484_S 8 -1 6 FIX_AXIS_PAR_DIST 0 1 8 /end AXIS_DESCR
 DISPLAY_IDENTIFIER Ctp_acel_pdl_lih_hys_n_h /begin FUNCTION_LIST R102.6.drv_pedlh_1_0_3 /end FUNCTION_LIST /end CHARACTERISTIC
/begin CHARACTERISTIC mTBALHNSP "Pedal limp home gear ratio" CURVE 0x0000E60A REC_UWORD_C 0 COMP_0337_S 0 65535
 /begin AXIS_DESCR FIX_AXIS NO_INPUT_QUANTITY COMP_0484_S 8 -1 6 FIX_AXIS_PAR_DIST 0 1 8 /end AXIS_DESCR
 DISPLAY_IDENTIFIER Ctp_acel_pdl_lih_n_sp /begin FUNCTION_LIST R102.6.drv_pedlh_1_0_3 /end FUNCTION_LIST /end CHARACTERISTIC
/begin CHARACTERISTIC mALHCFB "Accelerator Pedal Limp Home calibration flag byte" VALUE 0x00008253 REC_UBYTE_C 0 COMP_0283 0 255
 /begin FUNCTION_LIST R000.1.RS_Integ_1_10_2 R000.2.RS_ROMflags_1_10_3 R102.6.drv_pedlh_1_0_3 /end FUNCTION_LIST
/end CHARACTERISTIC
/begin CHARACTERISTIC mfAPLVL "torque level to help in the calibration" VALUE 0x00008253 REC_UBYTE_C 0 COMP_0283 0 1 BIT_MASK 0x0080 DISPLAY_IDENTIFIER Cbx_acel_pdl_lvl /begin FUNCTION_LIST R000.2.RS_ROMflags_1_10_3 R102.6.drv_pedlh_1_0_3 /end FUNCTION_LIST /end CHARACTERISTIC
/begin CHARACTERISTIC mfASCLHBRK "all brake diagnosis results" VALUE 0x00008253 REC_UBYTE_C 0 COMP_0283 0 1 BIT_MASK 0x0040 /begin FUNCTION_LIST R000.1.RS_Integ_1_10_2 R000.2.RS_ROMflags_1_10_3 /end FUNCTION_LIST /end CHARACTERISTIC
/begin CHARACTERISTIC mALTPTCF1 "Alternator & PTC calibration flag byte used for general purpose." VALUE 0x00008275 REC_UBYTE_C 0 COMP_0283 0 255
 /begin FUNCTION_LIST R000.2.RS_ROMflags_1_10_3 R106.3.epw_palmx_1_1_0 R106.4.epw_paltx_1_1_0 R106.5.epw_ptcxx_1_1_0 /end FUNCTION_LIST
/end CHARACTERISTIC
/begin CHARACTERISTIC mfUPCRCVDG "USM frame reception configuration" VALUE 0x00008275 REC_UBYTE_C 0 COMP_0283 0 1 BIT_MASK 0x0080 DISPLAY_IDENTIFIER Cbx_usm_lk_stt_conf /begin FUNCTION_LIST R000.2.RS_ROMflags_1_10_3 R106.3.epw_palmx_1_1_0 /end FUNCTION_LIST /end CHARACTERISTIC
/begin CHARACTERISTIC mfENAPCUT "Enable other shut off conditions without idle speed" VALUE 0x00008275 REC_UBYTE_C 0 COMP_0283 0 1 BIT_MASK 0x0040 DISPLAY_IDENTIFIER Cbx_ptc_is_acel /begin FUNCTION_LIST R000.2.RS_ROMflags_1_10_3 R106.5.epw_ptcxx_1_1_0 /end FUNCTION_LIST /end CHARACTERISTIC
/begin CHARACTERISTIC mfENAPLIM "Enable power limitation strategie, in power limitation block" VALUE 0x00008275 REC_UBYTE_C 0 COMP_0283 0 1 BIT_MASK 0x0020 DISPLAY_IDENTIFIER Cbx_ptc_max_pow_ena_lim /begin FUNCTION_LIST R000.2.RS_ROMflags_1_10_3 R106.5.epw_ptcxx_1_1_0 /end FUNCTION_LIST /end CHARACTERISTIC
/begin CHARACTERISTIC mfALTPOWSW "Permits to choose between alternator power calculated through Irotor or alternator power from USM" VALUE 0x00008275 REC_UBYTE_C 0 COMP_0283 0 1 BIT_MASK 0x0010 DISPLAY_IDENTIFIER Cbx_alt_pow_swi /begin FUNCTION_LIST R000.2.RS_ROMflags_1_10_3 R106.4.epw_paltx_1_1_0 /end FUNCTION_LIST /end CHARACTERISTIC
/begin CHARACTERISTIC mALTPTCF2 "Alternator & PTC calibration flag byte used for cut-off conditions." VALUE 0x00008276 REC_UBYTE_C 0 COMP_0283 0 255 /begin FUNCTION_LIST R000.2.RS_ROMflags_1_10_3 R106.5.epw_ptcxx_1_1_0 /end FUNCTION_LIST /end CHARACTERISTIC
/begin CHARACTERISTIC mfHLDNE1 "level 1 of engine speed condition in high load condition block" VALUE 0x00008276 REC_UBYTE_C 0 COMP_0283 0 1 BIT_MASK 0x0080 DISPLAY_IDENTIFIER Cbx_ptc_fl_n_lvl_1 /begin FUNCTION_LIST R000.2.RS_ROMflags_1_10_3 R106.5.epw_ptcxx_1_1_0 /end FUNCTION_LIST /end CHARACTERISTIC
/begin CHARACTERISTIC mfHLDNE2 "level 2 of engine speed condition in high load condition block" VALUE 0x00008276 REC_UBYTE_C 0 COMP_0283 0 1 BIT_MASK 0x0040 DISPLAY_IDENTIFIER Cbx_ptc_fl_n_lvl_2 /begin FUNCTION_LIST R000.2.RS_ROMflags_1_10_3 R106.5.epw_ptcxx_1_1_0 /end FUNCTION_LIST /end CHARACTERISTIC
/begin CHARACTERISTIC mfHLDVSP1 "level 1 of vehicle speed condition in high load condition block" VALUE 0x00008276 REC_UBYTE_C 0 COMP_0283 0 1 BIT_MASK 0x0020 DISPLAY_IDENTIFIER Cbx_ptc_fl_vs_lvl_1 /begin FUNCTION_LIST R000.2.RS_ROMflags_1_10_3 R106.5.epw_ptcxx_1_1_0 /end FUNCTION_LIST /end CHARACTERISTIC
/begin CHARACTERISTIC mfHLDVSP2 "level 2 of vehicle speed condition in high load condition block" VALUE 0x00008276 REC_UBYTE_C 0 COMP_0283 0 1 BIT_MASK 0x0010 DISPLAY_IDENTIFIER Cbx_ptc_fl_vs_lvl_2 /begin FUNCTION_LIST R000.2.RS_ROMflags_1_10_3 R106.5.epw_ptcxx_1_1_0 /end FUNCTION_LIST /end CHARACTERISTIC
/begin CHARACTERISTIC mASCCFB "Accelerator Pedal Safety Case calibration flag byte" VALUE 0x00008286 REC_UBYTE_C 0 COMP_0283 0 255 /begin FUNCTION_LIST R000.2.RS_ROMflags_1_10_3 /end FUNCTION_LIST /end CHARACTERISTIC
/begin CHARACTERISTIC mfASCACCD "condition for accelerator" VALUE 0x00008286 REC_UBYTE_C 0 COMP_0283 0 1 BIT_MASK 0x0080 DISPLAY_IDENTIFIER Cbx_acel_pdl_secu_acc_dsb /begin FUNCTION_LIST R000.2.RS_ROMflags_1_10_3 R101.3.aps_sftpd_1_1_4 /end FUNCTION_LIST /end CHARACTERISTIC
/begin CHARACTERISTIC mfASCESPD "Bit of configuration" VALUE 0x00008286 REC_UBYTE_C 0 COMP_0283 0 1 BIT_MASK 0x0040 DISPLAY_IDENTIFIER Cbx_acel_pdl_secu_esp_dsb /begin FUNCTION_LIST R000.2.RS_ROMflags_1_10_3 R101.3.aps_sftpd_1_1_4 /end FUNCTION_LIST /end CHARACTERISTIC
/begin CHARACTERISTIC mfASCCLDG "Clear diagnostics information request" VALUE 0x00008286 REC_UBYTE_C 0 COMP_0283 0 1 BIT_MASK 0x0020 DISPLAY_IDENTIFIER Cbx_fail_dft_ini_req /begin FUNCTION_LIST R000.2.RS_ROMflags_1_10_3 R101.3.aps_sftpd_1_1_4 /end FUNCTION_LIST /end CHARACTERISTIC
/begin CHARACTERISTIC mATMACQUS "ROM inclusion byte" VALUE 0x00008291 REC_UBYTE_C 0 COMP_0283 0 255 /begin FUNCTION_LIST R000.1.RS_Integ_1_10_2 R000.2.RS_ROMflags_1_10_3 /end FUNCTION_LIST /end CHARACTERISTIC
/begin CHARACTERISTIC mfPRSINTL "Atmospheric sensor source" VALUE 0x00008291 REC_UBYTE_C 0 COMP_0283 0 1 BIT_MASK 0x0080 /begin FUNCTION_LIST R000.1.RS_Integ_1_10_2 R000.2.RS_ROMflags_1_10_3 /end FUNCTION_LIST /end CHARACTERISTIC
/begin CHARACTERISTIC mCCSLCFB2 "The CC/SL failure" VALUE 0x000082F8 REC_UBYTE_C 0 COMP_0283 0 255
 /begin FUNCTION_LIST R000.2.RS_ROMflags_1_10_3 R208.6.SERVO_1_2_2 R208.8.DACAX_1_1_5 R208.10.dgn_ccadd_1_3_2 /end FUNCTION_LIST
/end CHARACTERISTIC
/begin CHARACTERISTIC mfCCADDON "Activate the cruise control diagnostic add-on" VALUE 0x000082F8 REC_UBYTE_C 0 COMP_0283 0 1 BIT_MASK 0x0040 DISPLAY_IDENTIFIER Cbx_cru_diag_add_on /begin FUNCTION_LIST R000.2.RS_ROMflags_1_10_3 R208.10.dgn_ccadd_1_3_2 /end FUNCTION_LIST /end CHARACTERISTIC
/begin CHARACTERISTIC mfSLICMX "Enable (1) or disable (0) the ECE89 strategy" VALUE 0x000082F8 REC_UBYTE_C 0 COMP_0283 0 1 BIT_MASK 0x0020 DISPLAY_IDENTIFIER Cbx_sl_max_i_cor /begin FUNCTION_LIST R000.2.RS_ROMflags_1_10_3 R208.6.SERVO_1_2_2 /end FUNCTION_LIST /end CHARACTERISTIC
/begin CHARACTERISTIC mCOMPENSW "compensation inclusion byte" VALUE 0x00008351 REC_UBYTE_C 0 COMP_0283 0 255 /begin FUNCTION_LIST R000.2.RS_ROMflags_1_10_3 R301.20.AmbientComp_1_0_2 /end FUNCTION_LIST /end CHARACTERISTIC
/begin CHARACTERISTIC mfCOMPTTEP "Ambient temperature and pressure compensation" VALUE 0x00008351 REC_UBYTE_C 0 COMP_0283 0 1 BIT_MASK 0x0001 /begin FUNCTION_LIST R000.2.RS_ROMflags_1_10_3 R301.20.AmbientComp_1_0_2 /end FUNCTION_LIST /end CHARACTERISTIC
/begin CHARACTERISTIC mCRASHR "ROM Flags are included in this ROM for Airbag related control" VALUE 0x00008362 REC_UBYTE_C 0 COMP_0283 0 255 /begin FUNCTION_LIST R000.2.RS_ROMflags_1_10_3 R201.1.stp_mngtx_1_2_2 /end FUNCTION_LIST /end CHARACTERISTIC
/begin CHARACTERISTIC mfDEMAFTCR "Selection of the strategy of restart after a crash" VALUE 0x00008362 REC_UBYTE_C 0 COMP_0283 0 1 BIT_MASK 0x0080 DISPLAY_IDENTIFIER Cbx_rest_aftr_crsh_ena /begin FUNCTION_LIST R000.2.RS_ROMflags_1_10_3 R201.1.stp_mngtx_1_2_2 /end FUNCTION_LIST /end CHARACTERISTIC
/begin CHARACTERISTIC mDFAPSC1C "Configuration of the value sent on CAN" VALUE 0x0000842C REC_UBYTE_C 0 COMP_0283 0 255 /begin FUNCTION_LIST R000.2.RS_ROMflags_1_10_3 R204.1.CanComm_1_9_2 /end FUNCTION_LIST /end CHARACTERISTIC
/begin CHARACTERISTIC mfDFAPSC1C "Configuration of the value sent on" VALUE 0x0000842C REC_UBYTE_C 0 COMP_0283 0 1 BIT_MASK 0x0080 /begin FUNCTION_LIST R000.2.RS_ROMflags_1_10_3 R204.1.CanComm_1_9_2 /end FUNCTION_LIST /end CHARACTERISTIC
/begin CHARACTERISTIC mDRPWTSP "Flags_for_Driver_powertrain_setpoint_setting" VALUE 0x000084BA REC_UBYTE_C 0 COMP_0283 0 255 /begin FUNCTION_LIST R000.2.RS_ROMflags_1_10_3 R204.1.CanComm_1_9_2 /end FUNCTION_LIST /end CHARACTERISTIC
/begin CHARACTERISTIC mfDRPWTSPF "Driver powertrain setpoint unavailable value existence" VALUE 0x000084BA REC_UBYTE_C 0 COMP_0283 0 1 BIT_MASK 0x0080 /begin FUNCTION_LIST R000.2.RS_ROMflags_1_10_3 R204.1.CanComm_1_9_2 /end FUNCTION_LIST /end CHARACTERISTIC
/begin CHARACTERISTIC mFAILLAMP "Inclusion byte" VALUE 0x000085D4 REC_UBYTE_C 0 COMP_0283 0 255
 /begin FUNCTION_LIST R000.2.RS_ROMflags_1_10_3 R902.2.DiagMiscell_1_3_5 R903.1.milmgtx_1_0_2 /end FUNCTION_LIST
/end CHARACTERISTIC
/begin CHARACTERISTIC mfCCDSBLP1 "CC deactivation by engine control on warning lamp level 1 request" VALUE 0x000085D4 REC_UBYTE_C 0 COMP_0283 0 1 BIT_MASK 0x0080 DISPLAY_IDENTIFIER Cbx_cru_eng_dsb_wal_1_req_cfm /begin FUNCTION_LIST R000.2.RS_ROMflags_1_10_3 R902.2.DiagMiscell_1_3_5 /end FUNCTION_LIST /end CHARACTERISTIC
/begin CHARACTERISTIC mfSLDSBLP1 "SL deactivation by engine control on warning lamp level 1 request" VALUE 0x000085D4 REC_UBYTE_C 0 COMP_0283 0 1 BIT_MASK 0x0040 DISPLAY_IDENTIFIER Cbx_sl_eng_dsb_wal_1_req_cfm /begin FUNCTION_LIST R000.2.RS_ROMflags_1_10_3 R902.2.DiagMiscell_1_3_5 /end FUNCTION_LIST /end CHARACTERISTIC
/begin CHARACTERISTIC mGOVCTL "ROM inclusion byte" VALUE 0x00008679 REC_UBYTE_C 0 COMP_0283 0 255 /begin FUNCTION_LIST R000.2.RS_ROMflags_1_10_3 R301.25.GOV_idle_1_0_2 /end FUNCTION_LIST /end CHARACTERISTIC
/begin CHARACTERISTIC mfGOVSW "MGOV Map switch" VALUE 0x00008679 REC_UBYTE_C 0 COMP_0283 0 1 BIT_MASK 0x0001 /begin FUNCTION_LIST R000.2.RS_ROMflags_1_10_3 R301.25.GOV_idle_1_0_2 /end FUNCTION_LIST /end CHARACTERISTIC
/begin CHARACTERISTIC mGPSELM "ROM comprehension byte" VALUE 0x0000867D REC_UBYTE_C 0 COMP_0283 0 255 /begin FUNCTION_LIST R000.2.RS_ROMflags_1_10_3 R301.8.Inverse_filter_1_1_3 /end FUNCTION_LIST /end CHARACTERISTIC
/begin CHARACTERISTIC mfGPSELM "Parameter selection gear position modified" VALUE 0x0000867D REC_UBYTE_C 0 COMP_0283 0 1 BIT_MASK 0x0080 /begin FUNCTION_LIST R000.2.RS_ROMflags_1_10_3 R301.8.Inverse_filter_1_1_3 /end FUNCTION_LIST /end CHARACTERISTIC
/begin CHARACTERISTIC mISSARB "ROM comprehension byte" VALUE 0x0000876F REC_UBYTE_C 0 COMP_0283 0 255
 /begin FUNCTION_LIST R000.1.RS_Integ_1_10_2 R000.2.RS_ROMflags_1_10_3 R107.1.iss_ariss_1_0_4 /end FUNCTION_LIST
/end CHARACTERISTIC
/begin CHARACTERISTIC mfMPLDSACT "Slope strategy number" VALUE 0x0000876F REC_UBYTE_C 0 COMP_0283 0 1 BIT_MASK 0x0080 DISPLAY_IDENTIFIER Cbx_mpl_dec_slop_act /begin FUNCTION_LIST R000.2.RS_ROMflags_1_10_3 R107.1.iss_ariss_1_0_4 /end FUNCTION_LIST /end CHARACTERISTIC
/begin CHARACTERISTIC mfELPWST "Power Steering configuration" VALUE 0x0000876F REC_UBYTE_C 0 COMP_0283 0 1 BIT_MASK 0x0040 DISPLAY_IDENTIFIER Cbx_el_pwst /begin FUNCTION_LIST R000.1.RS_Integ_1_10_2 R000.2.RS_ROMflags_1_10_3 /end FUNCTION_LIST /end CHARACTERISTIC
/begin CHARACTERISTIC mMUXCLUMN "Inclusion byte" VALUE 0x00008875 REC_UBYTE_C 0 COMP_0283 0 255 /begin FUNCTION_LIST R000.2.RS_ROMflags_1_10_3 R204.1.CanComm_1_9_2 /end FUNCTION_LIST /end CHARACTERISTIC
/begin CHARACTERISTIC mfMUXCLUMN "clutch switch state" VALUE 0x00008875 REC_UBYTE_C 0 COMP_0283 0 1 BIT_MASK 0x0080 DISPLAY_IDENTIFIER Cbx_mux_bgin_clu_cnt_cfm /begin FUNCTION_LIST R000.2.RS_ROMflags_1_10_3 R204.1.CanComm_1_9_2 /end FUNCTION_LIST /end CHARACTERISTIC
/begin CHARACTERISTIC mNTARGETM "ROM comprehension byte" VALUE 0x000088FB REC_UBYTE_C 0 COMP_0283 0 255 /begin FUNCTION_LIST R000.2.RS_ROMflags_1_10_3 R301.6.IscAirflow_1_4_5 /end FUNCTION_LIST /end CHARACTERISTIC
/begin CHARACTERISTIC mfNTARGETM "Activation of NETARGET modification" VALUE 0x000088FB REC_UBYTE_C 0 COMP_0283 0 1 BIT_MASK 0x0080 /begin FUNCTION_LIST R000.2.RS_ROMflags_1_10_3 R301.6.IscAirflow_1_4_5 /end FUNCTION_LIST /end CHARACTERISTIC
/begin CHARACTERISTIC mPVCONT "ROM inclusion byte" VALUE 0x000089F6 REC_UBYTE_C 0 COMP_0283 0 255
 /begin FUNCTION_LIST R000.2.RS_ROMflags_1_10_3 R202.2.acx_mdfan_1_2_2 R301.3.FanAftPwl_1_0_4 /end FUNCTION_LIST
/end CHARACTERISTIC
/begin CHARACTERISTIC mfPVCONT "Mailbox ventilation choice flag" VALUE 0x000089F6 REC_UBYTE_C 0 COMP_0283 0 1 BIT_MASK 0x0080
 /begin FUNCTION_LIST R000.2.RS_ROMflags_1_10_3 R202.2.acx_mdfan_1_2_2 R301.3.FanAftPwl_1_0_4 /end FUNCTION_LIST
/end CHARACTERISTIC
/begin CHARACTERISTIC mQFBIRNSW "ROM inclusion byte" VALUE 0x00008A01 REC_UBYTE_C 0 COMP_0283 0 255 /begin FUNCTION_LIST R000.2.RS_ROMflags_1_10_3 R301.19.ISC_PID_cont_1_0_2 /end FUNCTION_LIST /end CHARACTERISTIC
/begin CHARACTERISTIC mfRNISCFB "A QFBI choice flag for Renault" VALUE 0x00008A01 REC_UBYTE_C 0 COMP_0283 0 1 BIT_MASK 0x0001 /begin FUNCTION_LIST R000.2.RS_ROMflags_1_10_3 R301.19.ISC_PID_cont_1_0_2 /end FUNCTION_LIST /end CHARACTERISTIC
/begin CHARACTERISTIC mRG3TRQ "ROM inclusion byte" VALUE 0x00008A8F REC_UBYTE_C 0 COMP_0283 0 255
 /begin FUNCTION_LIST R000.1.RS_Integ_1_10_2 R000.2.RS_ROMflags_1_10_3 R102.1M.PEDFM_1_0_9 R102.1P.PEDFM_1_0_2 R102.3M.DRTQE_1_1_0 R102.3P.DRTQE_1_0_2 R105.1.tra_atsip_1_0_1 R105.2.tra_sdfta_1_1_2 /end FUNCTION_LIST
/end CHARACTERISTIC
/begin CHARACTERISTIC mfRPDLFMNC "Selects a manual interpolation factor" VALUE 0x00008A8F REC_UBYTE_C 0 COMP_0283 0 1 BIT_MASK 0x0080 DISPLAY_IDENTIFIER Cbx_acel_pdl_fmt_mnl_conf
 /begin FUNCTION_LIST R000.2.RS_ROMflags_1_10_3 R102.1M.PEDFM_1_0_9 R102.1P.PEDFM_1_0_2 /end FUNCTION_LIST
/end CHARACTERISTIC
/begin CHARACTERISTIC mfRMAXPOW "Option selecting explicit power calculation of driver torque setpoint" VALUE 0x00008A8F REC_UBYTE_C 0 COMP_0283 0 1 BIT_MASK 0x0040 DISPLAY_IDENTIFIER Cbx_ref_max_pow
 /begin FUNCTION_LIST R000.2.RS_ROMflags_1_10_3 R102.3M.DRTQE_1_1_0 R102.3P.DRTQE_1_0_2 /end FUNCTION_LIST
/end CHARACTERISTIC
/begin CHARACTERISTIC mfENASIPDY "Activation of max gear change delay diagnosis" VALUE 0x00008A8F REC_UBYTE_C 0 COMP_0283 0 1 BIT_MASK 0x0020 DISPLAY_IDENTIFIER Cbx_max_gear_cge_dly_ena /begin FUNCTION_LIST R000.2.RS_ROMflags_1_10_3 /end FUNCTION_LIST /end CHARACTERISTIC
/begin CHARACTERISTIC mfTQCMDTYP "Torque command type : 1" VALUE 0x00008A8F REC_UBYTE_C 0 COMP_0283 0 1 BIT_MASK 0x0010 DISPLAY_IDENTIFIER Cbx_tq_cmd_typ /begin FUNCTION_LIST R000.2.RS_ROMflags_1_10_3 R105.1.tra_atsip_1_0_1 /end FUNCTION_LIST /end CHARACTERISTIC
/begin CHARACTERISTIC mfRSAMAXTQ "Renault specific selection for maximum torque calculation" VALUE 0x00008A8F REC_UBYTE_C 0 COMP_0283 0 1 BIT_MASK 0x0002 /begin FUNCTION_LIST R000.1.RS_Integ_1_10_2 R000.2.RS_ROMflags_1_10_3 /end FUNCTION_LIST /end CHARACTERISTIC
/begin CHARACTERISTIC mfRSAMINTQ "Renault specific selection for minimum torque calculation" VALUE 0x00008A8F REC_UBYTE_C 0 COMP_0283 0 1 BIT_MASK 0x0001 /begin FUNCTION_LIST R000.1.RS_Integ_1_10_2 R000.2.RS_ROMflags_1_10_3 /end FUNCTION_LIST /end CHARACTERISTIC
/begin CHARACTERISTIC mRSADV "Renault specific ADV phase" VALUE 0x00008AD1 REC_UBYTE_C 0 COMP_0283 0 255 /begin FUNCTION_LIST R000.2.RS_ROMflags_1_10_3 R301.23.ADV_calculation_1_1_2 /end FUNCTION_LIST /end CHARACTERISTIC
/begin CHARACTERISTIC mfDLADVRN "Renault specific DLTADV control flag" VALUE 0x00008AD1 REC_UBYTE_C 0 COMP_0283 0 1 BIT_MASK 0x0080 /begin FUNCTION_LIST R000.2.RS_ROMflags_1_10_3 R301.23.ADV_calculation_1_1_2 /end FUNCTION_LIST /end CHARACTERISTIC
/begin CHARACTERISTIC mfDLALWYS "ADV control terminate inhibition flag" VALUE 0x00008AD1 REC_UBYTE_C 0 COMP_0283 0 1 BIT_MASK 0x0040 /begin FUNCTION_LIST R000.2.RS_ROMflags_1_10_3 R301.23.ADV_calculation_1_1_2 /end FUNCTION_LIST /end CHARACTERISTIC
/begin CHARACTERISTIC mRSFCC "romflag inclusion byte" VALUE 0x00008AD7 REC_UBYTE_C 0 COMP_0283 0 255 /begin FUNCTION_LIST R000.2.RS_ROMflags_1_10_3 R301.5.FuelCut_1_2_2 /end FUNCTION_LIST /end CHARACTERISTIC
/begin CHARACTERISTIC mfFCUTRN "CFCD determination" VALUE 0x00008AD7 REC_UBYTE_C 0 COMP_0283 0 1 BIT_MASK 0x0080 /begin FUNCTION_LIST R000.2.RS_ROMflags_1_10_3 R301.5.FuelCut_1_2_2 /end FUNCTION_LIST /end CHARACTERISTIC
/begin CHARACTERISTIC mfCLACTIV "Cut-in delay cancel" VALUE 0x00008AD7 REC_UBYTE_C 0 COMP_0283 0 1 BIT_MASK 0x0040 /begin FUNCTION_LIST R000.2.RS_ROMflags_1_10_3 R301.5.FuelCut_1_2_2 /end FUNCTION_LIST /end CHARACTERISTIC
/begin CHARACTERISTIC mfPFCLUTCH "Activation flag for Cut-in delay when Clutch SW present failure detected" VALUE 0x00008AD7 REC_UBYTE_C 0 COMP_0283 0 1 BIT_MASK 0x0020 /begin FUNCTION_LIST R000.2.RS_ROMflags_1_10_3 R301.5.FuelCut_1_2_2 /end FUNCTION_LIST /end CHARACTERISTIC
/begin CHARACTERISTIC mRSFINJ "ROM flag to enable KHOT calculation" VALUE 0x00008AD8 REC_UBYTE_C 0 COMP_0283 0 255 /begin FUNCTION_LIST R000.2.RS_ROMflags_1_10_3 R301.7.KHOT_1_0_2 /end FUNCTION_LIST /end CHARACTERISTIC
/begin CHARACTERISTIC mfKHOTACT "ROM flag to enable KHOT calculation" VALUE 0x00008AD8 REC_UBYTE_C 0 COMP_0283 0 1 BIT_MASK 0x0080 /begin FUNCTION_LIST R000.2.RS_ROMflags_1_10_3 R301.7.KHOT_1_0_2 /end FUNCTION_LIST /end CHARACTERISTIC
/begin CHARACTERISTIC mSAFETYX "Enabling boolean" VALUE 0x00008AE5 REC_UBYTE_C 0 COMP_0283 0 255 /begin FUNCTION_LIST R000.2.RS_ROMflags_1_10_3 R208.9.SAFETYX_1_3_2 /end FUNCTION_LIST /end CHARACTERISTIC
/begin CHARACTERISTIC mfCLUCPENA "Enabling boolean for ccp clutch coherence" VALUE 0x00008AE5 REC_UBYTE_C 0 COMP_0283 0 1 BIT_MASK 0x0080 DISPLAY_IDENTIFIER Cbx_bgin_clu_fail_ccp_ena /begin FUNCTION_LIST R000.2.RS_ROMflags_1_10_3 R208.9.SAFETYX_1_3_2 /end FUNCTION_LIST /end CHARACTERISTIC
/begin CHARACTERISTIC mfCLUCOENA "Enabling boolean for co clutch coherence" VALUE 0x00008AE5 REC_UBYTE_C 0 COMP_0283 0 1 BIT_MASK 0x0040 DISPLAY_IDENTIFIER Cbx_bgin_clu_fail_co_ena /begin FUNCTION_LIST R000.2.RS_ROMflags_1_10_3 R208.9.SAFETYX_1_3_2 /end FUNCTION_LIST /end CHARACTERISTIC
/begin CHARACTERISTIC mfBRKCPENA "Enabling boolean for ccp brake coherence" VALUE 0x00008AE5 REC_UBYTE_C 0 COMP_0283 0 1 BIT_MASK 0x0020 DISPLAY_IDENTIFIER Cbx_brk_fail_ccp_ena /begin FUNCTION_LIST R000.2.RS_ROMflags_1_10_3 R208.9.SAFETYX_1_3_2 /end FUNCTION_LIST /end CHARACTERISTIC
/begin CHARACTERISTIC mfBRKCOENA "Enabling boolean for co brake coherence" VALUE 0x00008AE5 REC_UBYTE_C 0 COMP_0283 0 1 BIT_MASK 0x0010 DISPLAY_IDENTIFIER Cbx_brk_fail_co_ena /begin FUNCTION_LIST R000.2.RS_ROMflags_1_10_3 R208.9.SAFETYX_1_3_2 /end FUNCTION_LIST /end CHARACTERISTIC
/begin CHARACTERISTIC mfBRKSSENA "Enabling boolean for safety strategy on brake switch" VALUE 0x00008AE5 REC_UBYTE_C 0 COMP_0283 0 1 BIT_MASK 0x0008 DISPLAY_IDENTIFIER Cbx_ena_brk_cru_swi /begin FUNCTION_LIST R000.2.RS_ROMflags_1_10_3 R208.9.SAFETYX_1_3_2 /end FUNCTION_LIST /end CHARACTERISTIC
/begin CHARACTERISTIC mfCLUSSENA "Enabling boolean for safety strategy on clutch switch" VALUE 0x00008AE5 REC_UBYTE_C 0 COMP_0283 0 1 BIT_MASK 0x0004 DISPLAY_IDENTIFIER Cbx_ena_clu_cru_swi /begin FUNCTION_LIST R000.2.RS_ROMflags_1_10_3 R208.9.SAFETYX_1_3_2 /end FUNCTION_LIST /end CHARACTERISTIC
/begin CHARACTERISTIC mVBPROTSW "VB-short protection" VALUE 0x00008DA3 REC_UBYTE_C 0 COMP_0283 0 255 /begin FUNCTION_LIST R000.2.RS_ROMflags_1_10_3 /end FUNCTION_LIST /end CHARACTERISTIC
/begin CHARACTERISTIC mfVBSPROT "VB short protection activation flag" VALUE 0x00008DA3 REC_UBYTE_C 0 COMP_0283 0 1 BIT_MASK 0x0080
 /begin FUNCTION_LIST R000.2.RS_ROMflags_1_10_3 R301.18.VB_short_Protection_1_0_2 /end FUNCTION_LIST
/end CHARACTERISTIC
/begin AXIS_PTS mTRDTQSPN "1rpm" 0x0000EF56 NO_INPUT_QUANTITY REC_AXIS_UWORD 0 COMP_0443 16 0 65535 /end AXIS_PTS
/begin AXIS_PTS mTRDTQSPA "0.00125ratio" 0x0000EF36 NO_INPUT_QUANTITY REC_AXIS_UWORD 0 COMP_0451_S 16 0 81.91875 /end AXIS_PTS
/begin AXIS_PTS mTRDTSN_S "1rpm" 0x00010672 NO_INPUT_QUANTITY REC_AXIS_UWORD 0 COMP_0443 16 0 65535 /end AXIS_PTS
/begin AXIS_PTS mTRDTSA_S "0.00125ratio" 0x00010652 NO_INPUT_QUANTITY REC_AXIS_UWORD 0 COMP_0451_S 16 0 81.91875 /end AXIS_PTS
/begin AXIS_PTS mGRTLIMBP "1r/min" 0x0000E050 NO_INPUT_QUANTITY REC_AXIS_UWORD 0 COMP_0337_S 8 0 65535 /end AXIS_PTS
/begin AXIS_PTS mTRPFDMFB "(1/255)/256ratio" 0x0000F096 NO_INPUT_QUANTITY REC_AXIS_UWORD 0 COMP_0486_S 8 0 1.003904451 /end AXIS_PTS
/begin AXIS_PTS mTRPFVSPB "0.01km/h" 0x0000F0A6 NO_INPUT_QUANTITY REC_AXIS_UWORD 0 COMP_0375_S 8 0 655.35 /end AXIS_PTS
/begin AXIS_PTS mTRPDMB_S "(1/255)/256ratio" 0x000106D2 NO_INPUT_QUANTITY REC_AXIS_UWORD 0 COMP_0486_S 8 0 1.003904451 /end AXIS_PTS
/begin AXIS_PTS mTRPVSB_S "0.01km/h" 0x000106E2 NO_INPUT_QUANTITY REC_AXIS_UWORD 0 COMP_0375_S 8 0 655.35 /end AXIS_PTS
/begin AXIS_PTS mAPSCNBP "1/1024Uref rat" 0x0000DEFA NO_INPUT_QUANTITY REC_AXIS_UWORD 0 COMP_0359_S 16 0 63.999056205 /end AXIS_PTS
/begin AXIS_PTS mTEVQCNT "2L" 0x0000E9CA NO_INPUT_QUANTITY REC_AXIS_UWORD 0 COMP_0152 16 0 131070 /end AXIS_PTS
/begin AXIS_PTS mTRPAPB_S "0.00125ratio" 0x000106B2 NO_INPUT_QUANTITY REC_AXIS_UWORD 0 COMP_0451_S 16 0 81.91875 /end AXIS_PTS
/begin AXIS_PTS mTRPDLAPB "0.00125ratio" 0x0000F076 NO_INPUT_QUANTITY REC_AXIS_UWORD 0 COMP_0451_S 16 0 81.91875 /end AXIS_PTS
/begin AXIS_PTS mTRFDVSPB "0.01km/h" 0x0000EFA6 NO_INPUT_QUANTITY REC_AXIS_UWORD 0 COMP_0375_S 16 0 655.35 /end AXIS_PTS
/begin AXIS_PTS mTRFVSB_S "0.01km/h" 0x00010692 NO_INPUT_QUANTITY REC_AXIS_UWORD 0 COMP_0375_S 16 0 655.35 /end AXIS_PTS
/begin MEASUREMENT fBNCAD "BNC SW analog input flag" UBYTE COMP_0283 1 100 0 1 BIT_MASK 0x0080 ECU_ADDRESS 0xFFFF49C1 /begin FUNCTION_LIST R000.1.RS_Integ_1_10_2 /end FUNCTION_LIST /end MEASUREMENT
/begin MEASUREMENT fEVRABS1 "CAN frame received" UBYTE COMP_0283 1 100 0 1 BIT_MASK 0x0010 ECU_ADDRESS 0xFFFF49C3 DISPLAY_IDENTIFIER Event_asr_msr_frm_absct
 /begin FUNCTION_LIST R104.1.brk_absct_1_2_2 R105.1.tra_atsip_1_0_1 R105.2.tra_sdfta_1_1_2 R204.1.CanComm_1_9_2 /end FUNCTION_LIST
/end MEASUREMENT
/begin MEASUREMENT fASCCLDG "Clear diagnostics information request" UBYTE COMP_0283 1 100 0 1 BIT_MASK 0x0004 ECU_ADDRESS 0xFFFF49D7 DISPLAY_IDENTIFIER Vbx_fail_dft_ini_req /begin FUNCTION_LIST R101.3.aps_sftpd_1_1_4 R901.1.Diag_on_can_app_1_6_2 /end FUNCTION_LIST /end MEASUREMENT
/begin MEASUREMENT fASRPRONG "Protocol error in ASR regulation" UBYTE COMP_0283 1 100 0 1 BIT_MASK 0x0080 ECU_ADDRESS 0xFFFF49D8 DISPLAY_IDENTIFIER Vbx_asr_prot_dft /begin FUNCTION_LIST R104.1.brk_absct_1_2_2 R105.1.tra_atsip_1_0_1 /end FUNCTION_LIST /end MEASUREMENT
/begin MEASUREMENT fASRRQCDN "ASR request condition" UBYTE COMP_0283 1 100 0 1 BIT_MASK 0x0040 ECU_ADDRESS 0xFFFF49D8 DISPLAY_IDENTIFIER Vbx_asr_cdn /begin FUNCTION_LIST R104.1.brk_absct_1_2_2 R105.1.tra_atsip_1_0_1 /end FUNCTION_LIST /end MEASUREMENT
/begin MEASUREMENT fCALAGE "Stall detected" UBYTE COMP_0283 1 100 0 1 BIT_MASK 0x0001 ECU_ADDRESS 0xFFFF49D8 DISPLAY_IDENTIFIER Calage
 /begin FUNCTION_LIST R000.1.RS_Integ_1_10_2 R203.1.crk_mngtx_1_2_1 R203.2.crk_restx_1_0_8 /end FUNCTION_LIST
/end MEASUREMENT
/begin MEASUREMENT fCLRDIAG "CLRDiag service applicative flag" UBYTE COMP_0283 1 100 0 1 BIT_MASK 0x0002 ECU_ADDRESS 0xFFFF49D9 DISPLAY_IDENTIFIER Event_diag_tool_cdi
 /begin FUNCTION_LIST R101.3.aps_sftpd_1_1_4 R201.1.stp_mngtx_1_2_2 R204.1.CanComm_1_9_2 R208.1.SWTCH_1_1_7 R208.4.STFLW_1_2_2 R208.8.DACAX_1_1_5 R208.9.SAFETYX_1_3_2 R301.12.ClutchSwDiag_1_0_1 R901.1.Diag_on_can_app_1_6_2 R902.1.SafetyDiagManager_1_3_6 R902.2.DiagMiscell_1_3_5 /end FUNCTION_LIST
/end MEASUREMENT
/begin MEASUREMENT fCLURNSW "State of the begin stroke clutch pedal  Physical input" UBYTE COMP_0283 1 100 0 1 BIT_MASK 0x0001 ECU_ADDRESS 0xFFFF49D9 DISPLAY_IDENTIFIER Vbx_wf_bgin_clu_swi
 /begin FUNCTION_LIST R000.1.RS_Integ_1_10_2 R204.1.CanComm_1_9_2 R208.9.SAFETYX_1_3_2 R301.12.ClutchSwDiag_1_0_1 R301.26.Dashpot_DandN_1_0_2 R901.1.Diag_on_can_app_1_6_2 /end FUNCTION_LIST
/end MEASUREMENT
/begin MEASUREMENT fDFAP12 "Detected failure of accelerator pedal" UBYTE COMP_0283 1 100 0 1 BIT_MASK 0x0010 ECU_ADDRESS 0xFFFF49DB DISPLAY_IDENTIFIER Vbx_df_acel_pdl_tot
 /begin FUNCTION_LIST R101.2.aps_pedxx_1_1_3 R101.3.aps_sftpd_1_1_4 R902.1.SafetyDiagManager_1_3_6 /end FUNCTION_LIST
/end MEASUREMENT
/begin MEASUREMENT fDFAPCHR "Detected failure of accelerator pedal consistency" UBYTE COMP_0283 1 100 0 1 BIT_MASK 0x0008 ECU_ADDRESS 0xFFFF49DB DISPLAY_IDENTIFIER Vbx_df_acel_pdl_chr
 /begin FUNCTION_LIST R000.1.RS_Integ_1_10_2 R101.2.aps_pedxx_1_1_3 R902.1.SafetyDiagManager_1_3_6 /end FUNCTION_LIST
/end MEASUREMENT
/begin MEASUREMENT fDFAPSOC1 "Detected failure of accelerator pedal track 1 open circuit" UBYTE COMP_0283 1 100 0 1 BIT_MASK 0x0004 ECU_ADDRESS 0xFFFF49DB DISPLAY_IDENTIFIER Vbx_df_acel_pdl_oc_v1 /begin FUNCTION_LIST R101.2.aps_pedxx_1_1_3 R902.1.SafetyDiagManager_1_3_6 /end FUNCTION_LIST /end MEASUREMENT
/begin MEASUREMENT fDFAPSOC2 "Detected failure of accelerator pedal track 2 open circuit" UBYTE COMP_0283 1 100 0 1 BIT_MASK 0x0002 ECU_ADDRESS 0xFFFF49DB DISPLAY_IDENTIFIER Vbx_df_acel_pdl_oc_v2 /begin FUNCTION_LIST R101.2.aps_pedxx_1_1_3 R902.1.SafetyDiagManager_1_3_6 /end FUNCTION_LIST /end MEASUREMENT
/begin MEASUREMENT fDFAPSSC1 "Detected failure of accelerator pedal track 1 short circuit" UBYTE COMP_0283 1 100 0 1 BIT_MASK 0x0001 ECU_ADDRESS 0xFFFF49DB DISPLAY_IDENTIFIER Vbx_df_acel_pdl_sc_v1 /begin FUNCTION_LIST R101.2.aps_pedxx_1_1_3 R902.1.SafetyDiagManager_1_3_6 /end FUNCTION_LIST /end MEASUREMENT
/begin MEASUREMENT fDFAPSSC2 "Detected failure of accelerator pedal track 2 short circuit" UBYTE COMP_0283 1 100 0 1 BIT_MASK 0x0080 ECU_ADDRESS 0xFFFF49DC DISPLAY_IDENTIFIER Vbx_df_acel_pdl_sc_v2 /begin FUNCTION_LIST R101.2.aps_pedxx_1_1_3 R902.1.SafetyDiagManager_1_3_6 /end FUNCTION_LIST /end MEASUREMENT
/begin MEASUREMENT fDFAVCC1 "Detected failure of power supply 1 (accelerator pedal track 1)" UBYTE COMP_0283 1 100 0 1 BIT_MASK 0x0040 ECU_ADDRESS 0xFFFF49DC DISPLAY_IDENTIFIER Vbx_df_pws_1
 /begin FUNCTION_LIST R000.1.RS_Integ_1_10_2 R101.2.aps_pedxx_1_1_3 R902.1.SafetyDiagManager_1_3_6 /end FUNCTION_LIST
/end MEASUREMENT
/begin MEASUREMENT fDFAVCC2 "Detected failure of power supply 2 (accelerator pedal track 2)" UBYTE COMP_0283 1 100 0 1 BIT_MASK 0x0020 ECU_ADDRESS 0xFFFF49DC DISPLAY_IDENTIFIER Vbx_df_pws_2
 /begin FUNCTION_LIST R000.1.RS_Integ_1_10_2 R101.2.aps_pedxx_1_1_3 R902.1.SafetyDiagManager_1_3_6 /end FUNCTION_LIST
/end MEASUREMENT
/begin MEASUREMENT fDFESPCPL "ESP complement error detected between ASR and MSR data" UBYTE COMP_0283 1 100 0 1 BIT_MASK 0x0010 ECU_ADDRESS 0xFFFF49DC DISPLAY_IDENTIFIER Vbx_df_asr_msr_cpl
 /begin FUNCTION_LIST R104.1.brk_absct_1_2_2 R105.1.tra_atsip_1_0_1 R902.1.SafetyDiagManager_1_3_6 /end FUNCTION_LIST
/end MEASUREMENT
/begin MEASUREMENT fDIAGONGE "uthorize the diagnostic on CAN" UBYTE COMP_0283 1 100 0 1 BIT_MASK 0x0008 ECU_ADDRESS 0xFFFF49DC DISPLAY_IDENTIFIER Diagongen
 /begin FUNCTION_LIST R104.1.brk_absct_1_2_2 R106.3.epw_palmx_1_1_0 R204.1.CanComm_1_9_2 R208.2.VSINT_1_1_2 R208.7.OUTMX_1_1_3 R208.8.DACAX_1_1_5 R208.9.SAFETYX_1_3_2 R208.10.dgn_ccadd_1_3_2 /end FUNCTION_LIST
/end MEASUREMENT
/begin MEASUREMENT fEGBNEUT "Electronic GearBox is in a configuration equivalent to Neutral for a manual gearbox" UBYTE COMP_0283 1 100 0 1 BIT_MASK 0x0001 ECU_ADDRESS 0xFFFF49DC DISPLAY_IDENTIFIER Vbx_egb_neut /begin FUNCTION_LIST R000.1.RS_Integ_1_10_2 R204.1.CanComm_1_9_2 /end FUNCTION_LIST /end MEASUREMENT
/begin MEASUREMENT fESPLK "This boolean is memorized when the first ESP frame is received." UBYTE COMP_0283 1 100 0 1 BIT_MASK 0x0080 ECU_ADDRESS 0xFFFF49DD DISPLAY_IDENTIFIER Vbx_asr_msr_lk
 /begin FUNCTION_LIST R104.1.brk_absct_1_2_2 R105.1.tra_atsip_1_0_1 R105.2.tra_sdfta_1_1_2 /end FUNCTION_LIST
/end MEASUREMENT
/begin MEASUREMENT fESPRQCDN "ESP request condition" UBYTE COMP_0283 1 100 0 1 BIT_MASK 0x0020 ECU_ADDRESS 0xFFFF49DD DISPLAY_IDENTIFIER Vbx_asr_msr_cdn /begin FUNCTION_LIST R104.1.brk_absct_1_2_2 R105.1.tra_atsip_1_0_1 /end FUNCTION_LIST /end MEASUREMENT
/begin MEASUREMENT fFPT1VSP "Vehicle speed is not relevant" UBYTE COMP_0283 1 100 0 1 BIT_MASK 0x0080 ECU_ADDRESS 0xFFFF49DF DISPLAY_IDENTIFIER Vbx_abs_vs_nok
 /begin FUNCTION_LIST R102.6.drv_pedlh_1_0_3 R108.1.dls_gbrat_vmm_1_1_5 R204.1.CanComm_1_9_2 R301.6.IscAirflow_1_4_5 R301.12.ClutchSwDiag_1_0_1 R301.23.ADV_calculation_1_1_2 R901.1.Diag_on_can_app_1_6_2 /end FUNCTION_LIST
/end MEASUREMENT
/begin MEASUREMENT fLVON "Input of the speed limiter main switch" UBYTE COMP_0283 1 100 0 1 BIT_MASK 0x0002 ECU_ADDRESS 0xFFFF49E1 DISPLAY_IDENTIFIER Lvon
 /begin FUNCTION_LIST R000.1.RS_Integ_1_10_2 R208.1.SWTCH_1_1_7 R901.1.Diag_on_can_app_1_6_2 /end FUNCTION_LIST
/end MEASUREMENT
/begin MEASUREMENT fMSRRQCDN "MSR request condition" UBYTE COMP_0283 1 100 0 1 BIT_MASK 0x0080 ECU_ADDRESS 0xFFFF49E2 DISPLAY_IDENTIFIER Vbx_msr_cdn /begin FUNCTION_LIST R104.1.brk_absct_1_2_2 R105.1.tra_atsip_1_0_1 /end FUNCTION_LIST /end MEASUREMENT
/begin MEASUREMENT fRVON "Input of the cruise control main switch" UBYTE COMP_0283 1 100 0 1 BIT_MASK 0x0020 ECU_ADDRESS 0xFFFF49E3 DISPLAY_IDENTIFIER Rvon
 /begin FUNCTION_LIST R000.1.RS_Integ_1_10_2 R208.1.SWTCH_1_1_7 R901.1.Diag_on_can_app_1_6_2 /end FUNCTION_LIST
/end MEASUREMENT
/begin MEASUREMENT fSDON "Sawtooth signal in progress" UBYTE COMP_0283 1 100 0 1 BIT_MASK 0x0010 ECU_ADDRESS 0xFFFF49E3 DISPLAY_IDENTIFIER Sdon
 /begin FUNCTION_LIST R000.1.RS_Integ_1_10_2 R203.1.crk_mngtx_1_2_1 R203.2.crk_restx_1_0_8 /end FUNCTION_LIST
/end MEASUREMENT
/begin MEASUREMENT fVDCREGMX "AYC in regulation acquired on CAN" UBYTE COMP_0283 1 100 0 1 BIT_MASK 0x0020 ECU_ADDRESS 0xFFFF49E5 DISPLAY_IDENTIFIER Vbx_mux_ayc_reg
 /begin FUNCTION_LIST R101.3.aps_sftpd_1_1_4 R102.6.drv_pedlh_1_0_3 R204.1.CanComm_1_9_2 /end FUNCTION_LIST
/end MEASUREMENT
/begin MEASUREMENT fCMDMDF1 "Low speed engine fan command" UBYTE COMP_0283 1 100 0 1 BIT_MASK 0x0040 ECU_ADDRESS 0xFFFF4277 DISPLAY_IDENTIFIER Vbx_mdf1_cmd
 /begin FUNCTION_LIST R000.1.RS_Integ_1_10_2 R202.2.acx_mdfan_1_2_2 R204.1.CanComm_1_9_2 R301.3.FanAftPwl_1_0_4 /end FUNCTION_LIST
/end MEASUREMENT
/begin MEASUREMENT fCMDMDF2 "High speed engine fan command" UBYTE COMP_0283 1 100 0 1 BIT_MASK 0x0020 ECU_ADDRESS 0xFFFF4277 DISPLAY_IDENTIFIER Vbx_mdf2_cmd
 /begin FUNCTION_LIST R000.1.RS_Integ_1_10_2 R202.2.acx_mdfan_1_2_2 R301.3.FanAftPwl_1_0_4 /end FUNCTION_LIST
/end MEASUREMENT
/begin MEASUREMENT fAGBGEROK "Boolean indicating that the AGB requests are authorized" UBYTE COMP_0283 1 100 0 1 BIT_MASK 0x0001 ECU_ADDRESS 0xFFFF427E DISPLAY_IDENTIFIER Vbx_agb_gear_mod_ok
 /begin FUNCTION_LIST R102.6.drv_pedlh_1_0_3 R105.2.tra_sdfta_1_1_2 R106.1.epw_altxx_1_1_0 R106.2.epw_mxalt_1_1_0 R106.3.epw_palmx_1_1_0 R106.4.epw_paltx_1_1_0 R106.5.epw_ptcxx_1_1_0 R106.6.epw_slope_1_1_0 R106.7.epw_tqalt_1_1_0 /end FUNCTION_LIST
/end MEASUREMENT
/begin MEASUREMENT fALHDFTA "Activation of the accelerator pedal limp home strategy" UBYTE COMP_0283 1 100 0 1 BIT_MASK 0x0001 ECU_ADDRESS 0xFFFF427F DISPLAY_IDENTIFIER Vbx_acel_pdl_lih_dft_act /begin FUNCTION_LIST R102.6.drv_pedlh_1_0_3 /end FUNCTION_LIST /end MEASUREMENT
/begin MEASUREMENT fALHIRST "Conditions to reset integral term of pedal limp home regulators" UBYTE COMP_0283 1 100 0 1 BIT_MASK 0x0080 ECU_ADDRESS 0xFFFF4280 DISPLAY_IDENTIFIER Vbx_acel_pdl_lih_i_rst /begin FUNCTION_LIST R102.6.drv_pedlh_1_0_3 /end FUNCTION_LIST /end MEASUREMENT
/begin MEASUREMENT fALHMIN "Conditions to apply the minimum available engine torque in pedal limp home" UBYTE COMP_0283 1 100 0 1 BIT_MASK 0x0040 ECU_ADDRESS 0xFFFF4280 DISPLAY_IDENTIFIER Vbx_acel_pdl_lih_min_cdn /begin FUNCTION_LIST R102.6.drv_pedlh_1_0_3 /end FUNCTION_LIST /end MEASUREMENT
/begin MEASUREMENT fALHNIFRZ "Conditions to freeze the integral term of the engine speed regulator in pedal limp home" UBYTE COMP_0283 1 100 0 1 BIT_MASK 0x0020 ECU_ADDRESS 0xFFFF4280 DISPLAY_IDENTIFIER Vbx_acel_pdl_lih_n_i_frz /begin FUNCTION_LIST R102.6.drv_pedlh_1_0_3 /end FUNCTION_LIST /end MEASUREMENT
/begin MEASUREMENT fALHNTQH "The maximum torque allowed by the engine speed regulator in pedal limp home is reached" UBYTE COMP_0283 1 100 0 1 BIT_MASK 0x0010 ECU_ADDRESS 0xFFFF4280 DISPLAY_IDENTIFIER Vbx_acel_pdl_lih_n_tqe_h /begin FUNCTION_LIST R102.6.drv_pedlh_1_0_3 /end FUNCTION_LIST /end MEASUREMENT
/begin MEASUREMENT fALHNTQL "The minimum torque allowed by the engine speed regulator in pedal limp home is reached" UBYTE COMP_0283 1 100 0 1 BIT_MASK 0x0008 ECU_ADDRESS 0xFFFF4280 DISPLAY_IDENTIFIER Vbx_acel_pdl_lih_n_tqe_l /begin FUNCTION_LIST R102.6.drv_pedlh_1_0_3 /end FUNCTION_LIST /end MEASUREMENT
/begin MEASUREMENT fALHRGSW "(1) vehicle speed regulator activated. (0) engine speed regulator activated in pedal limp home." UBYTE COMP_0283 1 100 0 1 BIT_MASK 0x0004 ECU_ADDRESS 0xFFFF4280 DISPLAY_IDENTIFIER Vbx_acel_pdl_lih_reg_swi /begin FUNCTION_LIST R102.6.drv_pedlh_1_0_3 /end FUNCTION_LIST /end MEASUREMENT
/begin MEASUREMENT fALHSPINI "Conditions to initialize the engine and vehicle speed setpoints to their current value" UBYTE COMP_0283 1 100 0 1 BIT_MASK 0x0002 ECU_ADDRESS 0xFFFF4280 DISPLAY_IDENTIFIER Vbx_acel_pdl_lih_sp_cdn /begin FUNCTION_LIST R102.6.drv_pedlh_1_0_3 /end FUNCTION_LIST /end MEASUREMENT
/begin MEASUREMENT fALHVIFRZ "Conditions to freeze the integral term of vehicle speed regulator" UBYTE COMP_0283 1 100 0 1 BIT_MASK 0x0001 ECU_ADDRESS 0xFFFF4280 DISPLAY_IDENTIFIER Vbx_acel_pdl_lih_vs_i_frz /begin FUNCTION_LIST R102.6.drv_pedlh_1_0_3 /end FUNCTION_LIST /end MEASUREMENT
/begin MEASUREMENT fALHVPRST "Conditions to reset proportionnal term of vehicle speed pedal limp home regulator" UBYTE COMP_0283 1 100 0 1 BIT_MASK 0x0080 ECU_ADDRESS 0xFFFF4281 DISPLAY_IDENTIFIER Vbx_acel_pdl_lih_vs_p_rst /begin FUNCTION_LIST R102.6.drv_pedlh_1_0_3 /end FUNCTION_LIST /end MEASUREMENT
/begin MEASUREMENT fALHVTQH "The maximum torque allowed by the vehicle speed regulator in pedal limp home is reached" UBYTE COMP_0283 1 100 0 1 BIT_MASK 0x0040 ECU_ADDRESS 0xFFFF4281 DISPLAY_IDENTIFIER Vbx_acel_pdl_lih_vs_tqe_h /begin FUNCTION_LIST R102.6.drv_pedlh_1_0_3 /end FUNCTION_LIST /end MEASUREMENT
/begin MEASUREMENT fALHVTQL "The minimum torque allowed by the vehicle speed regulator in pedal limp home is reached" UBYTE COMP_0283 1 100 0 1 BIT_MASK 0x0020 ECU_ADDRESS 0xFFFF4281 DISPLAY_IDENTIFIER Vbx_acel_pdl_lih_vs_tqe_l /begin FUNCTION_LIST R102.6.drv_pedlh_1_0_3 /end FUNCTION_LIST /end MEASUREMENT
/begin MEASUREMENT fAPLHACTT "Accelerator pedal safety strategy activated (From Renault strategy)" UBYTE COMP_0283 1 100 0 1 BIT_MASK 0x0002 ECU_ADDRESS 0xFFFF4281
 /begin FUNCTION_LIST R000.1.RS_Integ_1_10_2 R102.2M.DRARB_1_1_4 R102.2P.DRARB_1_0_2 R102.6.drv_pedlh_1_0_3 R901.1.Diag_on_can_app_1_6_2 /end FUNCTION_LIST
/end MEASUREMENT
/begin MEASUREMENT fASCBRK "Brake pedal pressed for the detection of pedal safety case (secure information)" UBYTE COMP_0283 1 100 0 1 BIT_MASK 0x0010 ECU_ADDRESS 0xFFFF4282 /begin FUNCTION_LIST R101.3.aps_sftpd_1_1_4 /end FUNCTION_LIST /end MEASUREMENT
/begin MEASUREMENT fASCCDN1 "Conditions 1 for activation of pedal safety case (used for the exit of emergency mode too)" UBYTE COMP_0283 1 100 0 1 BIT_MASK 0x0008 ECU_ADDRESS 0xFFFF4282 DISPLAY_IDENTIFIER Vbx_acel_pdl_secu_cdn_1 /begin FUNCTION_LIST R101.3.aps_sftpd_1_1_4 /end FUNCTION_LIST /end MEASUREMENT
/begin MEASUREMENT fASCCDN2 "Conditions 2 for activation of pedal safety case (not used for the exit of emergency mode)" UBYTE COMP_0283 1 100 0 1 BIT_MASK 0x0004 ECU_ADDRESS 0xFFFF4282 DISPLAY_IDENTIFIER Vbx_acel_pdl_secu_cdn_2 /begin FUNCTION_LIST R101.3.aps_sftpd_1_1_4 /end FUNCTION_LIST /end MEASUREMENT
/begin MEASUREMENT fASCDET "Detection of the conditions of accelerator pedal safety case (before braking)" UBYTE COMP_0283 1 100 0 1 BIT_MASK 0x0001 ECU_ADDRESS 0xFFFF4282 DISPLAY_IDENTIFIER Vbx_acel_pdl_secu_det /begin FUNCTION_LIST R101.3.aps_sftpd_1_1_4 /end FUNCTION_LIST /end MEASUREMENT
/begin MEASUREMENT fASCMSWCN "The main thing SW input flag for the CONSULT" UBYTE COMP_0283 1 100 0 1 BIT_MASK 0x0020 ECU_ADDRESS 0xFFFF4283 /begin FUNCTION_LIST KF7-580.1[8] /end FUNCTION_LIST /end MEASUREMENT
/begin MEASUREMENT fASCVDCUT "Vehicle speed difference cut flag" UBYTE COMP_0283 1 100 0 1 BIT_MASK 0x0004 ECU_ADDRESS 0xFFFF4283 /begin FUNCTION_LIST KF7-580.1[8] /end FUNCTION_LIST /end MEASUREMENT
/begin MEASUREMENT fASCVLCUT "A low vehicle speed cut flag" UBYTE COMP_0283 1 100 0 1 BIT_MASK 0x0002 ECU_ADDRESS 0xFFFF4283 /begin FUNCTION_LIST KF7-580.1[8] /end FUNCTION_LIST /end MEASUREMENT
/begin MEASUREMENT fATODMONI "A/T OD monitor" UBYTE COMP_0283 1 100 0 1 BIT_MASK 0x0040 ECU_ADDRESS 0xFFFF4284 /begin FUNCTION_LIST KF7-580.1[8] /end FUNCTION_LIST /end MEASUREMENT
/begin MEASUREMENT fBRKDIAG "Brake failure is detected through a specific diagnosis" UBYTE COMP_0283 1 100 0 1 BIT_MASK 0x0008 ECU_ADDRESS 0xFFFF4285
 /begin FUNCTION_LIST R000.1.RS_Integ_1_10_2 R101.3.aps_sftpd_1_1_4 R102.6.drv_pedlh_1_0_3 /end FUNCTION_LIST
/end MEASUREMENT
/begin MEASUREMENT fCCREG "Cruise control in regulation" UBYTE COMP_0283 1 100 0 1 BIT_MASK 0x0040 ECU_ADDRESS 0xFFFF4288 DISPLAY_IDENTIFIER Vbx_cru_reg /begin FUNCTION_LIST R000.1.RS_Integ_1_10_2 /end FUNCTION_LIST /end MEASUREMENT
/begin MEASUREMENT fDFESPLNK "ASR/MSR link detected failure" UBYTE COMP_0283 1 100 0 1 BIT_MASK 0x0020 ECU_ADDRESS 0xFFFF4294 DISPLAY_IDENTIFIER Vbx_df_asr_msr_lk
 /begin FUNCTION_LIST R104.1.brk_absct_1_2_2 R105.1.tra_atsip_1_0_1 R902.1.SafetyDiagManager_1_3_6 /end FUNCTION_LIST
/end MEASUREMENT
/begin MEASUREMENT fEGBNEUTD "Neutral switch with delay for electric gearbox" UBYTE COMP_0283 1 100 0 1 BIT_MASK 0x0002 ECU_ADDRESS 0xFFFF4298
 /begin FUNCTION_LIST R000.1.RS_Integ_1_10_2 R107.2.iss_atiss_1_0_2 R107.4.iss_mciss_1_0_2 /end FUNCTION_LIST
/end MEASUREMENT
/begin MEASUREMENT fESPLKFL "The engine control has lost communication with ESP" UBYTE COMP_0283 1 100 0 1 BIT_MASK 0x0080 ECU_ADDRESS 0xFFFF42A0 DISPLAY_IDENTIFIER Vbx_asr_msr_lk_fail /begin FUNCTION_LIST R104.1.brk_absct_1_2_2 /end FUNCTION_LIST /end MEASUREMENT
/begin MEASUREMENT fEVECUINI "ECU initialization event" UBYTE COMP_0283 1 100 0 1 BIT_MASK 0x0020 ECU_ADDRESS 0xFFFF42A5 DISPLAY_IDENTIFIER Event_sta_pws /begin FUNCTION_LIST R000.1.RS_Integ_1_10_2 R106.1.epw_altxx_1_1_0 /end FUNCTION_LIST /end MEASUREMENT
/begin MEASUREMENT fMSRVALID "MSR Effective flag" UBYTE COMP_0283 1 100 0 1 BIT_MASK 0x0080 ECU_ADDRESS 0xFFFF42D7 DISPLAY_IDENTIFIER Vbx_msr_sp_vld
 /begin FUNCTION_LIST R104.1.brk_absct_1_2_2 R105.1.tra_atsip_1_0_1 R105.2.tra_sdfta_1_1_2 R106.5.epw_ptcxx_1_1_0 /end FUNCTION_LIST
/end MEASUREMENT
/begin MEASUREMENT fODCANASC "ASCD OD cancellation flag" UBYTE COMP_0283 1 100 0 1 BIT_MASK 0x0001 ECU_ADDRESS 0xFFFF42DA /begin FUNCTION_LIST KF7-580.1[8] /end FUNCTION_LIST /end MEASUREMENT
/begin MEASUREMENT fPDPMEV1 "Accumulation purge quantity condition flag" UBYTE COMP_0283 1 100 0 1 BIT_MASK 0x0001 ECU_ADDRESS 0xFFFF42DD /begin FUNCTION_LIST KF7-580.1[8] /end FUNCTION_LIST /end MEASUREMENT
/begin MEASUREMENT fPWSTACT "Power steering manostat activation" UBYTE COMP_0283 1 100 0 1 BIT_MASK 0x0008 ECU_ADDRESS 0xFFFF42E6 DISPLAY_IDENTIFIER Vbx_pwst_prs_stt /begin FUNCTION_LIST R000.1.RS_Integ_1_10_2 R107.4.iss_mciss_1_0_2 /end FUNCTION_LIST /end MEASUREMENT
/begin MEASUREMENT fRESSW "Resume SW flag" UBYTE COMP_0283 1 100 0 1 BIT_MASK 0x0002 ECU_ADDRESS 0xFFFF42E8 /begin FUNCTION_LIST KF7-580.1[8] /end FUNCTION_LIST /end MEASUREMENT
/begin MEASUREMENT fRRO2AC "The RrO2/S diagnosis PS command actual behavior voice" UBYTE COMP_0283 1 100 0 1 BIT_MASK 0x0001 ECU_ADDRESS 0xFFFF42EA /begin FUNCTION_LIST KF7-580.1[8] /end FUNCTION_LIST /end MEASUREMENT
/begin MEASUREMENT fRTQAGBON "flag set when torque setpoints are modified by AGB requests in the torque arbitration process" UBYTE COMP_0283 1 100 0 1 BIT_MASK 0x0001 ECU_ADDRESS 0xFFFF42EB DISPLAY_IDENTIFIER Vbx_agb_tq_arb_act /begin FUNCTION_LIST R102.5M.ARBIT_1_1_0 /end FUNCTION_LIST /end MEASUREMENT
/begin MEASUREMENT fRTQESPON "flag set when torque setpoints are modified by ESP requests in the torque arbitration process" UBYTE COMP_0283 1 100 0 1 BIT_MASK 0x0080 ECU_ADDRESS 0xFFFF42EC DISPLAY_IDENTIFIER Vbx_esp_tq_arb_act /begin FUNCTION_LIST R102.5M.ARBIT_1_1_0 /end FUNCTION_LIST /end MEASUREMENT
/begin MEASUREMENT fSETSW "Set SW flag" UBYTE COMP_0283 1 100 0 1 BIT_MASK 0x0001 ECU_ADDRESS 0xFFFF42EC /begin FUNCTION_LIST KF7-580.1[8] /end FUNCTION_LIST /end MEASUREMENT
/begin MEASUREMENT fTHPLSR "Thermoplunger idle speed setpoint acceleration request" UBYTE COMP_0283 1 100 0 1 BIT_MASK 0x0001 ECU_ADDRESS 0xFFFF42F3 DISPLAY_IDENTIFIER Vbx_thpl_is_acel /begin FUNCTION_LIST R000.1.RS_Integ_1_10_2 R107.3.iss_eliss_1_0_4 /end FUNCTION_LIST /end MEASUREMENT
/begin MEASUREMENT fTHRLHDF "corresponds to the loss of the electronic throttle control" UBYTE COMP_0283 1 100 0 1 BIT_MASK 0x0080 ECU_ADDRESS 0xFFFF42F4 DISPLAY_IDENTIFIER Vbx_thr_lih_dft
 /begin FUNCTION_LIST R000.1.RS_Integ_1_10_2 R102.6.drv_pedlh_1_0_3 R902.2.DiagMiscell_1_3_5 /end FUNCTION_LIST
/end MEASUREMENT
/begin MEASUREMENT fTWSKCR "Cold start judgement condition flag" UBYTE COMP_0283 1 100 0 1 BIT_MASK 0x0040 ECU_ADDRESS 0xFFFF42F7 /begin FUNCTION_LIST KF7-580.1[8] /end FUNCTION_LIST /end MEASUREMENT
/begin MEASUREMENT fVHSTOP "Vehicle stop detected" UBYTE COMP_0283 1 100 0 1 BIT_MASK 0x0001 ECU_ADDRESS 0xFFFF42F8 DISPLAY_IDENTIFIER Vbx_vh_stop
 /begin FUNCTION_LIST R000.1.RS_Integ_1_10_2 R107.1.iss_ariss_1_0_4 R301.19.ISC_PID_cont_1_0_2 /end FUNCTION_LIST
/end MEASUREMENT
/begin MEASUREMENT fAPLHAT_S "Accelerator pedal safety strategy activated (Sub)" UBYTE COMP_0283 1 100 0 1 BIT_MASK 0x0010 ECU_ADDRESS 0xFFFF42FF /begin FUNCTION_LIST R000.1.RS_Integ_1_10_2 R102.2P.DRARB_1_0_2 /end FUNCTION_LIST /end MEASUREMENT
/begin MEASUREMENT fAPS1OK "Accelerator pedal sensor track 1 without default" UBYTE COMP_0283 1 100 0 1 BIT_MASK 0x0008 ECU_ADDRESS 0xFFFF430F DISPLAY_IDENTIFIER Vbx_acel_pdl_sens1_ok
 /begin FUNCTION_LIST R000.1.RS_Integ_1_10_2 R101.1M.aps_pedin_1_2_2 R101.1P.aps_pedin_1_1_2 R101.2.aps_pedxx_1_1_3 /end FUNCTION_LIST
/end MEASUREMENT
/begin MEASUREMENT fAPSFULL "Accelerator full-open judgement" UBYTE COMP_0283 1 100 0 1 BIT_MASK 0x0040 ECU_ADDRESS 0xFFFF4310 /begin FUNCTION_LIST R000.1.RS_Integ_1_10_2 /end FUNCTION_LIST /end MEASUREMENT
/begin MEASUREMENT fCSONVSC "Crank angle sensor signal detection for VSC" UBYTE COMP_0283 1 100 0 1 BIT_MASK 0x0008 ECU_ADDRESS 0xFFFF4318 /begin FUNCTION_LIST R000.1.RS_Integ_1_10_2 /end FUNCTION_LIST /end MEASUREMENT
/begin MEASUREMENT fDFESPCLK "ESP clock error detected" UBYTE COMP_0283 1 100 0 1 BIT_MASK 0x0008 ECU_ADDRESS 0xFFFF431A DISPLAY_IDENTIFIER Vbx_df_asr_msr_clck
 /begin FUNCTION_LIST R104.1.brk_absct_1_2_2 R105.1.tra_atsip_1_0_1 R902.1.SafetyDiagManager_1_3_6 /end FUNCTION_LIST
/end MEASUREMENT
/begin MEASUREMENT fDMDSPEC "Starter forbidden by specific engine request (serious system faillure for example)" UBYTE COMP_0283 1 100 0 1 BIT_MASK 0x0040 ECU_ADDRESS 0xFFFF431C DISPLAY_IDENTIFIER Dmdspec
 /begin FUNCTION_LIST R000.1.RS_Integ_1_10_2 R203.1.crk_mngtx_1_2_1 R901.1.Diag_on_can_app_1_6_2 /end FUNCTION_LIST
/end MEASUREMENT
/begin MEASUREMENT fESPCLKDT "Counter error" UBYTE COMP_0283 1 100 0 1 BIT_MASK 0x0002 ECU_ADDRESS 0xFFFF4320 DISPLAY_IDENTIFIER Vbx_asr_msr_clck_dft /begin FUNCTION_LIST R104.1.brk_absct_1_2_2 R105.1.tra_atsip_1_0_1 /end FUNCTION_LIST /end MEASUREMENT
/begin MEASUREMENT fESPCLKFL "Boolean indicating if some successive clock errors." UBYTE COMP_0283 1 100 0 1 BIT_MASK 0x0001 ECU_ADDRESS 0xFFFF4320 DISPLAY_IDENTIFIER Vbx_asr_msr_clck_fil_dft /begin FUNCTION_LIST R104.1.brk_absct_1_2_2 R105.1.tra_atsip_1_0_1 /end FUNCTION_LIST /end MEASUREMENT
/begin MEASUREMENT fESPCPLDT "Counter error" UBYTE COMP_0283 1 100 0 1 BIT_MASK 0x0040 ECU_ADDRESS 0xFFFF4321 DISPLAY_IDENTIFIER Vbx_asr_msr_cpl_dft /begin FUNCTION_LIST R104.1.brk_absct_1_2_2 R105.1.tra_atsip_1_0_1 /end FUNCTION_LIST /end MEASUREMENT
/begin MEASUREMENT fESPCPLFL "Boolean indicating if some successive clock errors." UBYTE COMP_0283 1 100 0 1 BIT_MASK 0x0020 ECU_ADDRESS 0xFFFF4321 DISPLAY_IDENTIFIER Vbx_asr_msr_cpl_fil_dft /begin FUNCTION_LIST R104.1.brk_absct_1_2_2 R105.1.tra_atsip_1_0_1 /end FUNCTION_LIST /end MEASUREMENT
/begin MEASUREMENT fIDLEVAPO "VAPO IDLE judgement" UBYTE COMP_0283 1 100 0 1 BIT_MASK 0x0002 ECU_ADDRESS 0xFFFF432B /begin FUNCTION_LIST R000.1.RS_Integ_1_10_2 /end FUNCTION_LIST /end MEASUREMENT
/begin MEASUREMENT fPRECHASK "Preheating diesel to be done (diesel engine only)" UBYTE COMP_0283 1 100 0 1 BIT_MASK 0x0080 ECU_ADDRESS 0xFFFF4334 DISPLAY_IDENTIFIER Prechask
 /begin FUNCTION_LIST R000.1.RS_Integ_1_10_2 R203.1.crk_mngtx_1_2_1 R901.1.Diag_on_can_app_1_6_2 /end FUNCTION_LIST
/end MEASUREMENT
/begin MEASUREMENT fPRECHOUT "Preheating lamp illumination command (diesel engine only)" UBYTE COMP_0283 1 100 0 1 BIT_MASK 0x0040 ECU_ADDRESS 0xFFFF4334 DISPLAY_IDENTIFIER Prechout
 /begin FUNCTION_LIST R000.1.RS_Integ_1_10_2 R203.1.crk_mngtx_1_2_1 R901.1.Diag_on_can_app_1_6_2 /end FUNCTION_LIST
/end MEASUREMENT
/begin MEASUREMENT fAPSKD_S "Accel pedal depressed beyond mechanical hard point (Sub)" UBYTE COMP_0283 1 100 0 1 BIT_MASK 0x0002 ECU_ADDRESS 0xFFFF4342 /begin FUNCTION_LIST R101.1P.aps_pedin_1_1_2 /end FUNCTION_LIST /end MEASUREMENT
/begin MEASUREMENT afBNCSW "BNC SW flag" UBYTE COMP_0283 1 100 0 1 BIT_MASK 0x0080 ECU_ADDRESS 0xFFFF434C /begin FUNCTION_LIST KF7-580.1[8] /end FUNCTION_LIST /end MEASUREMENT
/begin MEASUREMENT afBNOSW "BNO SW flag" UBYTE COMP_0283 1 100 0 1 BIT_MASK 0x0040 ECU_ADDRESS 0xFFFF434C /begin FUNCTION_LIST KF7-580.1[8] /end FUNCTION_LIST /end MEASUREMENT
/begin MEASUREMENT afMAINSW "The main thing SW flag" UBYTE COMP_0283 1 100 0 1 BIT_MASK 0x0020 ECU_ADDRESS 0xFFFF4356 /begin FUNCTION_LIST KF7-580.1[8] /end FUNCTION_LIST /end MEASUREMENT
/begin MEASUREMENT afSETLMP "Set lamp ON/ off flag" UBYTE COMP_0283 1 100 0 1 BIT_MASK 0x0002 ECU_ADDRESS 0xFFFF4357 /begin FUNCTION_LIST KF7-580.1[8] /end FUNCTION_LIST /end MEASUREMENT
/begin MEASUREMENT fAPLHACT "Accelerator pedal safety strategy activated" UBYTE COMP_0283 1 100 0 1 BIT_MASK 0x0004 ECU_ADDRESS 0xFFFF435B DISPLAY_IDENTIFIER Vbx_acel_pdl_lih_act
 /begin FUNCTION_LIST R000.1.RS_Integ_1_10_2 R102.2M.DRARB_1_1_4 R102.6.drv_pedlh_1_0_3 R901.1.Diag_on_can_app_1_6_2 /end FUNCTION_LIST
/end MEASUREMENT
/begin MEASUREMENT fAPLHDFT "Downgraded mode : accelerator pedal limp home => corresponds to the loss of the driver 's will" UBYTE COMP_0283 1 100 0 1 BIT_MASK 0x0002 ECU_ADDRESS 0xFFFF435B DISPLAY_IDENTIFIER Vbx_acel_pdl_lih_dft
 /begin FUNCTION_LIST R101.2.aps_pedxx_1_1_3 R101.3.aps_sftpd_1_1_4 R102.6.drv_pedlh_1_0_3 R204.1.CanComm_1_9_2 R901.1.Diag_on_can_app_1_6_2 R902.2.DiagMiscell_1_3_5 /end FUNCTION_LIST
/end MEASUREMENT
/begin MEASUREMENT fBNCSW "BNC SW flag" UBYTE COMP_0283 1 100 0 1 BIT_MASK 0x0080 ECU_ADDRESS 0xFFFF435D /begin FUNCTION_LIST KF7-580.1[8] /end FUNCTION_LIST /end MEASUREMENT
/begin MEASUREMENT fBNOSW "BNO SW flag" UBYTE COMP_0283 1 100 0 1 BIT_MASK 0x0040 ECU_ADDRESS 0xFFFF435D /begin FUNCTION_LIST KF7-580.1[8] /end FUNCTION_LIST /end MEASUREMENT
/begin MEASUREMENT fBRKNCSW "Wire connection opened brake switch input" UBYTE COMP_0283 1 100 0 1 BIT_MASK 0x0008 ECU_ADDRESS 0xFFFF435D DISPLAY_IDENTIFIER Vbx_open_brk_swi
 /begin FUNCTION_LIST R000.1.RS_Integ_1_10_2 R208.9.SAFETYX_1_3_2 R901.1.Diag_on_can_app_1_6_2 /end FUNCTION_LIST
/end MEASUREMENT
/begin MEASUREMENT fCRUMSTR "Arbitrated powertrain setpoint equal to Cruise Control setpoint" UBYTE COMP_0283 1 100 0 1 BIT_MASK 0x0002 ECU_ADDRESS 0xFFFF4361 DISPLAY_IDENTIFIER Rvmaitre
 /begin FUNCTION_LIST R000.1.RS_Integ_1_10_2 R208.4.STFLW_1_2_2 R208.6.SERVO_1_2_2 R208.7.OUTMX_1_1_3 /end FUNCTION_LIST
/end MEASUREMENT
/begin MEASUREMENT fDFAPSC1 "Detected failure of accelerator pedal safety case" UBYTE COMP_0283 1 100 0 1 BIT_MASK 0x0004 ECU_ADDRESS 0xFFFF4362 DISPLAY_IDENTIFIER Vbx_df_acel_pdl_secu_1
 /begin FUNCTION_LIST R101.3.aps_sftpd_1_1_4 R204.1.CanComm_1_9_2 R902.1.SafetyDiagManager_1_3_6 R902.2.DiagMiscell_1_3_5 /end FUNCTION_LIST
/end MEASUREMENT
/begin MEASUREMENT fDFAPSC2 "Detected failure of accelerator pedal safety case N Åã 2 (activates irreversible downgraded mode)" UBYTE COMP_0283 1 100 0 1 BIT_MASK 0x0002 ECU_ADDRESS 0xFFFF4362 DISPLAY_IDENTIFIER Vbx_df_acel_pdl_secu /begin FUNCTION_LIST R101.3.aps_sftpd_1_1_4 R902.1.SafetyDiagManager_1_3_6 /end FUNCTION_LIST /end MEASUREMENT
/begin MEASUREMENT fDRARBTON "Accelerator pedal request overrun by a virtual driver (CC/SL/ACC)" UBYTE COMP_0283 1 100 0 1 BIT_MASK 0x0010 ECU_ADDRESS 0xFFFF4363 DISPLAY_IDENTIFIER Vbx_virt_driv_on
 /begin FUNCTION_LIST R000.1.RS_Integ_1_10_2 R102.2M.DRARB_1_1_4 Rxxx.1.Diagnostic_cycle_1_0_1 /end FUNCTION_LIST
/end MEASUREMENT
/begin MEASUREMENT fESPACK "ESP acknowledgement flag" UBYTE COMP_0283 1 100 0 1 BIT_MASK 0x0080 ECU_ADDRESS 0xFFFF4364 DISPLAY_IDENTIFIER Vbx_mux_asr_msr_ack
 /begin FUNCTION_LIST R104.1.brk_absct_1_2_2 R105.1.tra_atsip_1_0_1 R105.2.tra_sdfta_1_1_2 R204.1.CanComm_1_9_2 /end FUNCTION_LIST
/end MEASUREMENT
/begin MEASUREMENT fGMVOUT1 "Fan1 activation request from water temperature" UBYTE COMP_0283 1 100 0 1 BIT_MASK 0x0010 ECU_ADDRESS 0xFFFF4366 DISPLAY_IDENTIFIER Vbx_eng_mdf1_req
 /begin FUNCTION_LIST R000.1.RS_Integ_1_10_2 R202.2.acx_mdfan_1_2_2 R901.1.Diag_on_can_app_1_6_2 /end FUNCTION_LIST
/end MEASUREMENT
/begin MEASUREMENT fGMVOUT2 "Fan2 activation request from water temperature" UBYTE COMP_0283 1 100 0 1 BIT_MASK 0x0008 ECU_ADDRESS 0xFFFF4366 DISPLAY_IDENTIFIER Vbx_eng_mdf2_req
 /begin FUNCTION_LIST R000.1.RS_Integ_1_10_2 R202.2.acx_mdfan_1_2_2 R901.1.Diag_on_can_app_1_6_2 /end FUNCTION_LIST
/end MEASUREMENT
/begin MEASUREMENT fMAINSW "The main thing SW flag" UBYTE COMP_0283 1 100 0 1 BIT_MASK 0x0020 ECU_ADDRESS 0xFFFF4367 /begin FUNCTION_LIST KF7-580.1[8] /end FUNCTION_LIST /end MEASUREMENT
/begin MEASUREMENT fPPXCFRE "Braking detected for cruise control" UBYTE COMP_0283 1 100 0 1 BIT_MASK 0x0010 ECU_ADDRESS 0xFFFF4368 DISPLAY_IDENTIFIER Vbx_cru_brk_det
 /begin FUNCTION_LIST R000.1.RS_Integ_1_10_2 R208.8.DACAX_1_1_5 R208.10.dgn_ccadd_1_3_2 R901.1.Diag_on_can_app_1_6_2 /end FUNCTION_LIST
/end MEASUREMENT
/begin MEASUREMENT fPPXCFRES "Sudden braking detected for cruise control" UBYTE COMP_0283 1 100 0 1 BIT_MASK 0x0008 ECU_ADDRESS 0xFFFF4368 DISPLAY_IDENTIFIER Vbx_cru_brk_det_sudn
 /begin FUNCTION_LIST R000.1.RS_Integ_1_10_2 R208.8.DACAX_1_1_5 R208.10.dgn_ccadd_1_3_2 R901.1.Diag_on_can_app_1_6_2 /end FUNCTION_LIST
/end MEASUREMENT
/begin MEASUREMENT fSETLMP "Set lamp ON/ off flag" UBYTE COMP_0283 1 100 0 1 BIT_MASK 0x0002 ECU_ADDRESS 0xFFFF4368 /begin FUNCTION_LIST KF7-580.1[8] /end FUNCTION_LIST /end MEASUREMENT
/begin MEASUREMENT fDARBON_S "During virtual driver operation, flag (vice-operation part)" UBYTE COMP_0283 1 100 0 1 BIT_MASK 0x0002 ECU_ADDRESS 0xFFFF436A /begin FUNCTION_LIST R000.1.RS_Integ_1_10_2 R102.2P.DRARB_1_0_2 /end FUNCTION_LIST /end MEASUREMENT
/begin MEASUREMENT fVTERI "A VTC operation permission flag for VTC operation angle deviation quantity integral value learning" UBYTE COMP_0283 1 100 0 1 BIT_MASK 0x0080 ECU_ADDRESS 0xFFFF245B /begin FUNCTION_LIST KF7-580.1[8] /end FUNCTION_LIST /end MEASUREMENT
/begin MEASUREMENT fACSTT "Air conditioning compressor output synchronized with compressor state" UBYTE COMP_0283 1 100 0 1 BIT_MASK 0x0008 ECU_ADDRESS 0xFFFF2463 /begin FUNCTION_LIST R000.1.RS_Integ_1_10_2 R301.6.IscAirflow_1_4_5 /end FUNCTION_LIST /end MEASUREMENT
/begin MEASUREMENT fCHTGI "A VTC operation permission condition formation judgement for VTC operation angle deviation quantity integral value learning" UBYTE COMP_0283 1 100 0 1 BIT_MASK 0x0001 ECU_ADDRESS 0xFFFF2469 /begin FUNCTION_LIST KF7-580.1[8] /end FUNCTION_LIST /end MEASUREMENT
/begin MEASUREMENT fTFINT "TFINT value renewal condition judgement" UBYTE COMP_0283 1 100 0 1 BIT_MASK 0x0020 ECU_ADDRESS 0xFFFF24BE /begin FUNCTION_LIST KF7-580.1[8] /end FUNCTION_LIST /end MEASUREMENT
/begin MEASUREMENT afFPC "FPC terminal output flag" UBYTE COMP_0283 1 100 0 1 BIT_MASK 0x0001 ECU_ADDRESS 0xFFFF24CF /begin FUNCTION_LIST KF7-580.1[8] /end FUNCTION_LIST /end MEASUREMENT
/begin MEASUREMENT fFPC "FPC terminal output flag" UBYTE COMP_0283 1 100 0 1 BIT_MASK 0x0001 ECU_ADDRESS 0xFFFF24D6 /begin FUNCTION_LIST KF7-580.1[8] /end FUNCTION_LIST /end MEASUREMENT
/begin MEASUREMENT fCCEPMINH "Boolean that indicates the write-on-the-flight on cruise control activation and deactivation strategy is inhibited" UBYTE COMP_0283 1 100 0 1 BIT_MASK 0x0080 ECU_ADDRESS 0xFFFFB7DA DISPLAY_IDENTIFIER Vbx_cru_dgn_eprm_imd_writ_off /begin FUNCTION_LIST R000.4.EepAlloc_1_2_2 R208.10.dgn_ccadd_1_3_2 /end FUNCTION_LIST /end MEASUREMENT
/begin MEASUREMENT fCCSLIBFS "cruise control activation and shut-off" UBYTE COMP_0283 1 100 0 1 BIT_MASK 0x0040 ECU_ADDRESS 0xFFFFB7DA DISPLAY_IDENTIFIER Vbx_sli_buf_sf /begin FUNCTION_LIST R000.4.EepAlloc_1_2_2 R208.10.dgn_ccadd_1_3_2 /end FUNCTION_LIST /end MEASUREMENT
/begin MEASUREMENT fFAAREA "Misfire judgement region data A memory" UBYTE COMP_0283 1 100 0 1 BIT_MASK 0x0020 ECU_ADDRESS 0xFFFFB7DD /begin FUNCTION_LIST R000.4.EepAlloc_1_2_2 /end FUNCTION_LIST /end MEASUREMENT
/begin MEASUREMENT fFBAREA "Misfire judgement region data B memory" UBYTE COMP_0283 1 100 0 1 BIT_MASK 0x0008 ECU_ADDRESS 0xFFFFB7DD /begin FUNCTION_LIST R000.4.EepAlloc_1_2_2 /end FUNCTION_LIST /end MEASUREMENT
/begin MEASUREMENT fFCAREA "Misfire judgement region data C memory" UBYTE COMP_0283 1 100 0 1 BIT_MASK 0x0004 ECU_ADDRESS 0xFFFFB7DD /begin FUNCTION_LIST R000.4.EepAlloc_1_2_2 /end FUNCTION_LIST /end MEASUREMENT
/begin MEASUREMENT fFPRI2MIL "2 level diagnosis F.F. memory (NG decision) time MIL condition" UBYTE COMP_0283 1 100 0 1 BIT_MASK 0x0040 ECU_ADDRESS 0xFFFFB7DF /begin FUNCTION_LIST R000.4.EepAlloc_1_2_2 /end FUNCTION_LIST /end MEASUREMENT
/begin MEASUREMENT fMFMLON "MIL lighting due to the misfire" UBYTE COMP_0283 1 100 0 1 BIT_MASK 0x0010 ECU_ADDRESS 0xFFFFB7E1 /begin FUNCTION_LIST R000.4.EepAlloc_1_2_2 /end FUNCTION_LIST /end MEASUREMENT
/begin MEASUREMENT fMILWRM "Trouble code clear condition formation flag" UBYTE COMP_0283 1 100 0 1 BIT_MASK 0x0004 ECU_ADDRESS 0xFFFFB7E1 /begin FUNCTION_LIST R000.4.EepAlloc_1_2_2 /end FUNCTION_LIST /end MEASUREMENT
/begin MEASUREMENT fMILWRMZ "Trouble code clear condition formation flag (previous value)" UBYTE COMP_0283 1 100 0 1 BIT_MASK 0x0002 ECU_ADDRESS 0xFFFFB7E1 /begin FUNCTION_LIST R000.4.EepAlloc_1_2_2 /end FUNCTION_LIST /end MEASUREMENT
/begin MEASUREMENT fRESTCDN "Indicator of restart condition" UBYTE COMP_0283 1 100 0 1 BIT_MASK 0x0040 ECU_ADDRESS 0xFFFFB7E3 DISPLAY_IDENTIFIER Vbx_rest_cdn /begin FUNCTION_LIST R000.4.EepAlloc_1_2_2 R203.2.crk_restx_1_0_8 /end FUNCTION_LIST /end MEASUREMENT
/begin MEASUREMENT fRESTSTL "Restart after engine stall detected." UBYTE COMP_0283 1 100 0 1 BIT_MASK 0x0020 ECU_ADDRESS 0xFFFFB7E3 DISPLAY_IDENTIFIER Vbx_rest_stal /begin FUNCTION_LIST R000.4.EepAlloc_1_2_2 R203.2.crk_restx_1_0_8 /end FUNCTION_LIST /end MEASUREMENT
/begin MEASUREMENT fSTALCLU "Boolean for clutch engine stalling detection (engine stalling in gear)." UBYTE COMP_0283 1 100 0 1 BIT_MASK 0x0010 ECU_ADDRESS 0xFFFFB7E3 DISPLAY_IDENTIFIER Vbx_clu_stal /begin FUNCTION_LIST R000.4.EepAlloc_1_2_2 R203.2.crk_restx_1_0_8 /end FUNCTION_LIST /end MEASUREMENT
/begin MEASUREMENT afVTREXI "VTC operation angle deviation quantity integral value rapid learning experience flag" UBYTE COMP_0283 1 100 0 1 BIT_MASK 0x0001 ECU_ADDRESS 0xFFFFB7EA /begin FUNCTION_LIST KF7-580.1[8] /end FUNCTION_LIST /end MEASUREMENT
/begin MEASUREMENT fCRUSWI "Switch order memorized boolean" UBYTE COMP_0283 1 100 0 1 BIT_MASK 0x0001 ECU_ADDRESS 0xFFFFB7EB DISPLAY_IDENTIFIER Vbx_cru_swi
 /begin FUNCTION_LIST R000.4.EepAlloc_1_2_2 R208.9.SAFETYX_1_3_2 R208.10.dgn_ccadd_1_3_2 /end FUNCTION_LIST
/end MEASUREMENT
/begin MEASUREMENT fVTREXI "VTC operation angle deviation quantity integral value rapid learning experience flag" UBYTE COMP_0283 1 100 0 1 BIT_MASK 0x0001 ECU_ADDRESS 0xFFFFB7EC /begin FUNCTION_LIST KF7-580.1[8] /end FUNCTION_LIST /end MEASUREMENT
/begin MEASUREMENT tADJDLY "After the adjustment control start, time" UBYTE COMP_0202_S 1 100 0 255 ECU_ADDRESS 0xFFFF4446 /begin FUNCTION_LIST KF7-580.1[8] /end FUNCTION_LIST /end MEASUREMENT
/begin MEASUREMENT tROJFCTT "Diagnosis permission judgement fuel cut continuation time" UBYTE COMP_0202_S 1 100 0 255 ECU_ADDRESS 0xFFFF44B5 /begin FUNCTION_LIST KF7-580.1[8] /end FUNCTION_LIST /end MEASUREMENT
/begin MEASUREMENT tTETCCLR "ETC learning clear executive time" UBYTE COMP_0202_S 1 100 0 255 ECU_ADDRESS 0xFFFF44F4 /begin FUNCTION_LIST KF7-580.1[8] /end FUNCTION_LIST /end MEASUREMENT
/begin MEASUREMENT tTNZEROR "Timer for TNZEROR#" UBYTE COMP_0203_S 1 100 0 255 ECU_ADDRESS 0xFFFF466E /begin FUNCTION_LIST R000.1.RS_Integ_1_10_2 /end FUNCTION_LIST /end MEASUREMENT
/begin MEASUREMENT tEMNTTM "Idle/shake characteristic switching timer" UBYTE COMP_0202_S 1 100 0 255 ECU_ADDRESS 0xFFFF253F /begin FUNCTION_LIST KF7-580.1[8] /end FUNCTION_LIST /end MEASUREMENT
/begin MEASUREMENT avALTDUTY "Alternator DUTY order value" UBYTE COMP_0047 1 100 0 127.5 ECU_ADDRESS 0xFFFF22FA /begin FUNCTION_LIST KF7-580.1[8] /end FUNCTION_LIST /end MEASUREMENT
/begin MEASUREMENT vACCSB2CN "Outside war estimated value for the CONSULT" SWORD COMP_0010_S 1 100 -7.99997952 7.99973538 ECU_ADDRESS 0xFFFF276C /begin FUNCTION_LIST KF7-580.1[8] /end FUNCTION_LIST /end MEASUREMENT
/begin MEASUREMENT vACPOW "ACCompPowerUsed" UBYTE COMP_0338_S 1 100 0 6375 ECU_ADDRESS 0xFFFF3887 DISPLAY_IDENTIFIER Vxx_ac_pow /begin FUNCTION_LIST R000.1.RS_Integ_1_10_2 R204.1.CanComm_1_9_2 /end FUNCTION_LIST /end MEASUREMENT
/begin MEASUREMENT vACPOWFIL "Filtered power consumed by air conditioning" UBYTE COMP_0338_S 1 100 0 6375 ECU_ADDRESS 0xFFFF26E4 /begin FUNCTION_LIST R000.1.RS_Integ_1_10_2 /end FUNCTION_LIST /end MEASUREMENT
/begin MEASUREMENT vACTRQ "Torque consumed by air conditioning" UWORD COMP_0196 1 100 0 6553.5 ECU_ADDRESS 0xFFFF2782 /begin FUNCTION_LIST R000.1.RS_Integ_1_10_2 /end FUNCTION_LIST /end MEASUREMENT
/begin MEASUREMENT vADSTRSW "Input of the cruise control and speed limiter steering wheel push buttons" UWORD COMP_0023 1 100 0 327675 ECU_ADDRESS 0xFFFF48A8 DISPLAY_IDENTIFIER Vxx_cru_sl_whl_cmd_in
 /begin FUNCTION_LIST R000.1.RS_Integ_1_10_2 R208.1.SWTCH_1_1_7 R301.13.FFDforDiagOnCAN_1_1_3 R901.1.Diag_on_can_app_1_6_2 /end FUNCTION_LIST
/end MEASUREMENT
/begin MEASUREMENT vAFSHDTY1 "A/F sensor heater duty output (for the monitor)" UBYTE COMP_0547_S 1 100 0 102 ECU_ADDRESS 0xFFFF38D2 /begin FUNCTION_LIST KF7-580.1[8] /end FUNCTION_LIST /end MEASUREMENT
/begin MEASUREMENT vAGBMNTQF "setpoint request which will be sent to torque arbitration in max bloc" UWORD COMP_0345_S 1 100 -400 1647.96875 ECU_ADDRESS 0xFFFF27E6 DISPLAY_IDENTIFIER Vxx_agb_max_tqe_sp /begin FUNCTION_LIST R102.5M.ARBIT_1_1_0 /end FUNCTION_LIST /end MEASUREMENT
/begin MEASUREMENT vAGBMNTQS "Slow request which will be sent to torque arbitration in max bloc" UWORD COMP_0345_S 1 100 -400 1647.96875 ECU_ADDRESS 0xFFFF27E8 DISPLAY_IDENTIFIER Vxx_agb_max_tqe_tgt /begin FUNCTION_LIST R102.5M.ARBIT_1_1_0 R102.5P.ARBIT_1_0_2 /end FUNCTION_LIST /end MEASUREMENT
/begin MEASUREMENT vAGBMXTQF "Setpoint request which will be sent to torque arbitration in max bloc" UWORD COMP_0345_S 1 100 -400 1647.96875 ECU_ADDRESS 0xFFFF27EA DISPLAY_IDENTIFIER Vxx_agb_min_tqe_sp /begin FUNCTION_LIST R102.5M.ARBIT_1_1_0 /end FUNCTION_LIST /end MEASUREMENT
/begin MEASUREMENT vAGBMXTQS "Slow request which will be sent to torque arbitration in min bloc" UWORD COMP_0345_S 1 100 -400 1647.96875 ECU_ADDRESS 0xFFFF27EC DISPLAY_IDENTIFIER Vxx_agb_min_tqe_tgt /begin FUNCTION_LIST R102.5M.ARBIT_1_1_0 R102.5P.ARBIT_1_0_2 /end FUNCTION_LIST /end MEASUREMENT
/begin MEASUREMENT vAGBTQLIM "AGB engine torque limitation" UWORD COMP_0345_S 1 100 -400 1647.96875 ECU_ADDRESS 0xFFFF48B6 DISPLAY_IDENTIFIER Vxx_agb_lim_tqe /begin FUNCTION_LIST R103.2.lim_gbxli_1_0_2 R105.2.tra_sdfta_1_1_2 /end FUNCTION_LIST /end MEASUREMENT
/begin MEASUREMENT vALHNDIFF "Difference between engine speed setpoint and measured engine speed in pedal limp home" SWORD COMP_0551_S 1 100 -32768 32767 ECU_ADDRESS 0xFFFF2806 DISPLAY_IDENTIFIER Vxx_acel_pdl_lih_n_dif /begin FUNCTION_LIST R102.6.drv_pedlh_1_0_3 /end FUNCTION_LIST /end MEASUREMENT
/begin MEASUREMENT vALHNI "Integrate term of engine speed regulator in pedal limp home" UWORD COMP_0345_S 1 100 -400 1647.96875 ECU_ADDRESS 0xFFFF2808 DISPLAY_IDENTIFIER Vxx_acel_pdl_lih_n_i /begin FUNCTION_LIST R102.6.drv_pedlh_1_0_3 /end FUNCTION_LIST /end MEASUREMENT
/begin MEASUREMENT vALHNSP "Engine speed setpoint in pedal limp home (after slope)" UWORD COMP_0337_S 1 100 0 65535 ECU_ADDRESS 0xFFFF280A DISPLAY_IDENTIFIER Vxx_acel_pdl_lih_n_sp /begin FUNCTION_LIST R102.6.drv_pedlh_1_0_3 /end FUNCTION_LIST /end MEASUREMENT
/begin MEASUREMENT vALHNTQ "Pedal limp home engine torque from the engine speed regulator" UWORD COMP_0345_S 1 100 -400 1647.96875 ECU_ADDRESS 0xFFFF280C DISPLAY_IDENTIFIER Vxx_acel_pdl_lih_n_tqe /begin FUNCTION_LIST R102.6.drv_pedlh_1_0_3 /end FUNCTION_LIST /end MEASUREMENT
/begin MEASUREMENT vALHPTSPL "Powertrain setpoint calculated by the regulators (transition with normal mode and pedal level)" UWORD COMP_0451_S 1 100 0 81.91875 ECU_ADDRESS 0xFFFF280E DISPLAY_IDENTIFIER Vxx_acel_pdl_lih_pwt_load /begin FUNCTION_LIST R102.6.drv_pedlh_1_0_3 /end FUNCTION_LIST /end MEASUREMENT
/begin MEASUREMENT vALHPTSPR "Powertrain setpoint calculated by the regulators (before the application of the foot-up)" UWORD COMP_0451_S 1 100 0 81.91875 ECU_ADDRESS 0xFFFF2810 DISPLAY_IDENTIFIER Vxx_acel_pdl_lih_pwt /begin FUNCTION_LIST R102.6.drv_pedlh_1_0_3 /end FUNCTION_LIST /end MEASUREMENT
/begin MEASUREMENT vALHTQSP "Accelerator pedal limp home engine torque" UWORD COMP_0345_S 1 100 -400 1647.96875 ECU_ADDRESS 0xFFFF2812 DISPLAY_IDENTIFIER Vxx_acel_pdl_lih_tqe_sp /begin FUNCTION_LIST R102.6.drv_pedlh_1_0_3 /end FUNCTION_LIST /end MEASUREMENT
/begin MEASUREMENT vALHVDIFF "Difference between vehicle speed setpoint and measured vehicle speed in pedal limp home" SWORD COMP_0552_S 1 100 -327.68 327.67 ECU_ADDRESS 0xFFFF2814 DISPLAY_IDENTIFIER Vxx_acel_pdl_lih_vs_dif /begin FUNCTION_LIST R102.6.drv_pedlh_1_0_3 /end FUNCTION_LIST /end MEASUREMENT
/begin MEASUREMENT vALHVI "Integrate term of vehicle speed regulator in pedal limp home" UWORD COMP_0345_S 1 100 -400 1647.96875 ECU_ADDRESS 0xFFFF2816 DISPLAY_IDENTIFIER Vxx_acel_pdl_lih_vs_i /begin FUNCTION_LIST R102.6.drv_pedlh_1_0_3 /end FUNCTION_LIST /end MEASUREMENT
/begin MEASUREMENT vALHVSP "Vehicle speed setpoint in pedal limp home (after slope)" UWORD COMP_0375_S 1 100 0 655.35 ECU_ADDRESS 0xFFFF2818 DISPLAY_IDENTIFIER Vxx_acel_pdl_lih_vs_sp /begin FUNCTION_LIST R102.6.drv_pedlh_1_0_3 /end FUNCTION_LIST /end MEASUREMENT
/begin MEASUREMENT vALHVTQ "Pedal limp home engine torque from the vehicle speed regulator" UWORD COMP_0345_S 1 100 -400 1647.96875 ECU_ADDRESS 0xFFFF281A DISPLAY_IDENTIFIER Vxx_acel_pdl_lih_vs_tqe /begin FUNCTION_LIST R102.6.drv_pedlh_1_0_3 /end FUNCTION_LIST /end MEASUREMENT
/begin MEASUREMENT vALTDUTY "Alternator DUTY order value" UBYTE COMP_0047 1 100 0 127.5 ECU_ADDRESS 0xFFFF23A8 /begin FUNCTION_LIST KF7-580.1[8] /end FUNCTION_LIST /end MEASUREMENT
/begin MEASUREMENT vALTFTQ "Filtered alternator torque load (Nm)" UWORD COMP_0196 1 100 0 6553.5 ECU_ADDRESS 0xFFFF1154 DISPLAY_IDENTIFIER Vxx_fil_alt_tq /begin FUNCTION_LIST R000.1.RS_Integ_1_10_2 R106.7.epw_tqalt_1_1_0 /end FUNCTION_LIST /end MEASUREMENT
/begin MEASUREMENT vAP0RAT_S "Uref ratio value defining 0 pedal ratio position (Sub)" UWORD COMP_0359_S 1 100 0 63.999056205 ECU_ADDRESS 0xFFFF4022 /begin FUNCTION_LIST R101.1P.aps_pedin_1_1_2 /end FUNCTION_LIST /end MEASUREMENT
/begin MEASUREMENT vAP1RAT_S "Uref ratio value defining 1 pedal ratio position (Sub)" UWORD COMP_0359_S 1 100 0 63.999056205 ECU_ADDRESS 0xFFFF4024 /begin FUNCTION_LIST R101.1P.aps_pedin_1_1_2 /end FUNCTION_LIST /end MEASUREMENT
/begin MEASUREMENT vAPLHPTSP "Powertrain setpoint (per cent) requested by accelerator pedal safety strategy (From Renault strategy)" UWORD COMP_0451_S 1 100 0 81.91875 ECU_ADDRESS 0xFFFF2868 /begin FUNCTION_LIST R000.1.RS_Integ_1_10_2 R102.6.drv_pedlh_1_0_3 /end FUNCTION_LIST /end MEASUREMENT
/begin MEASUREMENT vAPS0RAT "Uref ratio value defining 0 pedal ratio position" UWORD COMP_0359_S 1 100 0 63.999056205 ECU_ADDRESS 0xFFFF38FA DISPLAY_IDENTIFIER Vxx_acel_pdl_0_rat_v /begin FUNCTION_LIST R101.1M.aps_pedin_1_2_2 /end FUNCTION_LIST /end MEASUREMENT
/begin MEASUREMENT vAPS1RAT "Uref ratio value defining 1 pedal ratio position" UWORD COMP_0359_S 1 100 0 63.999056205 ECU_ADDRESS 0xFFFF3900 DISPLAY_IDENTIFIER Vxx_acel_pdl_100_rat_v /begin FUNCTION_LIST R101.1M.aps_pedin_1_2_2 /end FUNCTION_LIST /end MEASUREMENT
/begin MEASUREMENT vAPS1UR "Filtered accelerator pedal sensor output voltage : track 1" UWORD COMP_0450 1 100 0 63.999056205 ECU_ADDRESS 0xFFFF3908 DISPLAY_IDENTIFIER Vxx_acel_pdl_fil_sens_v1 /begin FUNCTION_LIST R000.1.RS_Integ_1_10_2 R101.2.aps_pedxx_1_1_3 /end FUNCTION_LIST /end MEASUREMENT
/begin MEASUREMENT vAPS2UR "Filtered accelerator pedal sensor output voltage : track 2" UWORD COMP_0450 1 100 0 63.999056205 ECU_ADDRESS 0xFFFF3914 DISPLAY_IDENTIFIER Vxx_acel_pdl_fil_sens_v2 /begin FUNCTION_LIST R000.1.RS_Integ_1_10_2 R101.2.aps_pedxx_1_1_3 /end FUNCTION_LIST /end MEASUREMENT
/begin MEASUREMENT vAPSCCTR "Counter of accelerator pedal safety case detected failure N Åã 1 (memorized)" UBYTE COMP_0068 1 100 0 255 ECU_ADDRESS 0xFFFFB729 DISPLAY_IDENTIFIER Vxx_acel_pdl_secu_ctr /begin FUNCTION_LIST R101.3.aps_sftpd_1_1_4 R901.1.Diag_on_can_app_1_6_2 /end FUNCTION_LIST /end MEASUREMENT
/begin MEASUREMENT vAPSENSV "Accelerator pedal sensor output voltage (= Upot1 or Upot2)" UWORD COMP_0450 1 100 0 63.999056205 ECU_ADDRESS 0xFFFF48D6 DISPLAY_IDENTIFIER Vxx_acel_pdl_sens_v /begin FUNCTION_LIST R101.2.aps_pedxx_1_1_3 R101.3.aps_sftpd_1_1_4 /end FUNCTION_LIST /end MEASUREMENT
/begin MEASUREMENT vAPSKDI "Uref ratio entry threshold for accelerator pedal Kick-Down detection" UWORD COMP_0359_S 1 100 0 63.999056205 ECU_ADDRESS 0xFFFF391A DISPLAY_IDENTIFIER Vxx_acel_pdl_kd_in_thd /begin FUNCTION_LIST R101.1M.aps_pedin_1_2_2 /end FUNCTION_LIST /end MEASUREMENT
/begin MEASUREMENT vAPSKDI_S "threshold for accelerator pedal Kick-Down detection (Sub)" UWORD COMP_0359_S 1 100 0 63.999056205 ECU_ADDRESS 0xFFFF402C /begin FUNCTION_LIST R101.1P.aps_pedin_1_1_2 /end FUNCTION_LIST /end MEASUREMENT
/begin MEASUREMENT vAPSSFV "Accelerator pedal sensor output voltage (= Upot1 or Upot2 or safety replacement value)" UWORD COMP_0450 1 100 0 63.999056205 ECU_ADDRESS 0xFFFF391C DISPLAY_IDENTIFIER Vxx_acel_pdl_v
 /begin FUNCTION_LIST R000.1.RS_Integ_1_10_2 R101.1M.aps_pedin_1_2_2 R101.2.aps_pedxx_1_1_3 /end FUNCTION_LIST
/end MEASUREMENT
/begin MEASUREMENT vAPSSFV0 "Accelerator pedal sensor output voltage    (for the connection with integration of APS slope limitation)" UWORD COMP_0359_S 1 100 0 63.999056205 ECU_ADDRESS 0xFFFF48D8 /begin FUNCTION_LIST R000.1.RS_Integ_1_10_2 R101.2.aps_pedxx_1_1_3 /end FUNCTION_LIST /end MEASUREMENT
/begin MEASUREMENT vAPSSFV_S "Accelerator pedal sensor output voltage (Sub)" UWORD COMP_0359_S 1 100 0 63.999056205 ECU_ADDRESS 0xFFFF402E /begin FUNCTION_LIST R000.1.RS_Integ_1_10_2 R101.1P.aps_pedin_1_1_2 /end FUNCTION_LIST /end MEASUREMENT
/begin MEASUREMENT vARBISS "Arbitrated and limited idle speed setpoint" UWORD COMP_0337_S 1 100 0 65535 ECU_ADDRESS 0xFFFF2880 DISPLAY_IDENTIFIER Vxx_arb_lim_is /begin FUNCTION_LIST R000.1.RS_Integ_1_10_2 R107.1.iss_ariss_1_0_4 /end FUNCTION_LIST /end MEASUREMENT
/begin MEASUREMENT vASCDID1 "ASCD CONSULT monitor permission inclusion RAM1" UBYTE COMP_0283 1 100 0 255 ECU_ADDRESS 0xFFFF2883 /begin FUNCTION_LIST KF7-580.1[8] /end FUNCTION_LIST /end MEASUREMENT
/begin MEASUREMENT vASCDID2 "ASCD CONSULT monitor permission inclusion RAM2" UBYTE COMP_0283 1 100 0 255 ECU_ADDRESS 0xFFFF2884 /begin FUNCTION_LIST KF7-580.1[8] /end FUNCTION_LIST /end MEASUREMENT
/begin MEASUREMENT vASCDMON1 "Inclusion RAM1 for the ASCD CONSULT monitor" UBYTE COMP_0283 1 100 0 255 ECU_ADDRESS 0xFFFF2885 /begin FUNCTION_LIST KF7-580.1[8] /end FUNCTION_LIST /end MEASUREMENT
/begin MEASUREMENT vASCDMON2 "Inclusion RAM2 for the ASCD CONSULT monitor" UBYTE COMP_0283 1 100 0 255 ECU_ADDRESS 0xFFFF2886 /begin FUNCTION_LIST KF7-580.1[8] /end FUNCTION_LIST /end MEASUREMENT
/begin MEASUREMENT vASRTQF "ASR setpoint torque sent to torque arbitration" UWORD COMP_0345_S 1 100 -400 1647.96875 ECU_ADDRESS 0xFFFF288E DISPLAY_IDENTIFIER Vxx_asr_tqe_sp
 /begin FUNCTION_LIST R102.5M.ARBIT_1_1_0 R104.1.brk_absct_1_2_2 R105.1.tra_atsip_1_0_1 R105.2.tra_sdfta_1_1_2 /end FUNCTION_LIST
/end MEASUREMENT
/begin MEASUREMENT vASRTQS "ASR target torque sent to torque arbitration" UWORD COMP_0345_S 1 100 -400 1647.96875 ECU_ADDRESS 0xFFFF2890 DISPLAY_IDENTIFIER Vxx_asr_tqe_tgt
 /begin FUNCTION_LIST R102.5M.ARBIT_1_1_0 R102.5P.ARBIT_1_0_2 R104.1.brk_absct_1_2_2 R105.1.tra_atsip_1_0_1 R105.2.tra_sdfta_1_1_2 /end FUNCTION_LIST
/end MEASUREMENT
/begin MEASUREMENT vASRTRQF "ASR setpoint torque acquired on the MUX" UWORD COMP_0345_S 1 100 -400 1647.96875 ECU_ADDRESS 0xFFFF48DC DISPLAY_IDENTIFIER Vxx_mux_asr_tqe_sp
 /begin FUNCTION_LIST R104.1.brk_absct_1_2_2 R105.2.tra_sdfta_1_1_2 R204.1.CanComm_1_9_2 /end FUNCTION_LIST
/end MEASUREMENT
/begin MEASUREMENT vASRTRQFR "ASR setpoint torque acquired on the MUX (unscaled)" UWORD COMP_0068 1 100 0 65535 ECU_ADDRESS 0xFFFF48DE DISPLAY_IDENTIFIER Vxx_mux_asr_tqe_sp_raw /begin FUNCTION_LIST R104.1.brk_absct_1_2_2 R204.1.CanComm_1_9_2 /end FUNCTION_LIST /end MEASUREMENT
/begin MEASUREMENT vASRTRQS "ASR target torque acquired on the MUX" UWORD COMP_0345_S 1 100 -400 1647.96875 ECU_ADDRESS 0xFFFF48E0 DISPLAY_IDENTIFIER Vxx_mux_asr_tqe_tgt /begin FUNCTION_LIST R104.1.brk_absct_1_2_2 R204.1.CanComm_1_9_2 /end FUNCTION_LIST /end MEASUREMENT
/begin MEASUREMENT vASRTRQSR "ASR target torque acquired on the MUX" UWORD COMP_0068 1 100 0 65535 ECU_ADDRESS 0xFFFF48E2 DISPLAY_IDENTIFIER Vxx_mux_asr_tqe_tgt_raw /begin FUNCTION_LIST R104.1.brk_absct_1_2_2 R204.1.CanComm_1_9_2 /end FUNCTION_LIST /end MEASUREMENT
/begin MEASUREMENT vAVEPF "Fuel pressure weighted average value" UWORD COMP_0164 1 100 0 19.988175 ECU_ADDRESS 0xFFFF885A /begin FUNCTION_LIST KF7-580.1[8] /end FUNCTION_LIST /end MEASUREMENT
/begin MEASUREMENT vBASVP1 "Reference line pressure" UWORD COMP_0050 1 100 0 5119.921875 ECU_ADDRESS 0xFFFF28C0 /begin FUNCTION_LIST KF7-580.1[8] /end FUNCTION_LIST /end MEASUREMENT
/begin MEASUREMENT vBASVP2 "Stage 1 judgement line pressure" UWORD COMP_0050 1 100 0 5119.921875 ECU_ADDRESS 0xFFFF28C2 /begin FUNCTION_LIST KF7-580.1[8] /end FUNCTION_LIST /end MEASUREMENT
/begin MEASUREMENT vBATSEN "Battery electric current sensor output voltage" UWORD COMP_0023 1 100 0 327675 ECU_ADDRESS 0xFFFF897A /begin FUNCTION_LIST KF7-580.1[8] /end FUNCTION_LIST /end MEASUREMENT
/begin MEASUREMENT vBEIT1CL "At the time of the ETC learning clear, once, taking shelter TPS1CL-EEP reversal" UWORD COMP_0061 1 100 0 327675 ECU_ADDRESS 0xFFFF28C8 /begin FUNCTION_LIST KF7-580.1[8] /end FUNCTION_LIST /end MEASUREMENT
/begin MEASUREMENT vBEIT2CL "At the time of the ETC learning clear, once, taking shelter TPS2CL-EEP reversal" UWORD COMP_0061 1 100 0 327675 ECU_ADDRESS 0xFFFF28CA /begin FUNCTION_LIST KF7-580.1[8] /end FUNCTION_LIST /end MEASUREMENT
/begin MEASUREMENT vBEIT4BCL "At the time of the ETC learning clear, once, taking shelter TPS4BCL-EEP reversal" UWORD COMP_0061 1 100 0 327675 ECU_ADDRESS 0xFFFF28CC /begin FUNCTION_LIST KF7-580.1[8] /end FUNCTION_LIST /end MEASUREMENT
/begin MEASUREMENT vBET1CL "At the time of the ETC learning clear, once, taking shelter TPS1CL-EEP" UWORD COMP_0061 1 100 0 327675 ECU_ADDRESS 0xFFFF28CE /begin FUNCTION_LIST KF7-580.1[8] /end FUNCTION_LIST /end MEASUREMENT
/begin MEASUREMENT vBET2CL "At the time of the ETC learning clear, once, taking shelter TPS2CL-EEP" UWORD COMP_0061 1 100 0 327675 ECU_ADDRESS 0xFFFF28D0 /begin FUNCTION_LIST KF7-580.1[8] /end FUNCTION_LIST /end MEASUREMENT
/begin MEASUREMENT vBET4BCL "At the time of the ETC learning clear, once, taking shelter TPS4BCL-EEP" UWORD COMP_0061 1 100 0 327675 ECU_ADDRESS 0xFFFF28D2 /begin FUNCTION_LIST KF7-580.1[8] /end FUNCTION_LIST /end MEASUREMENT
/begin MEASUREMENT vBIT1CL "At the time of the ETC learning clear, once, taking shelter TPS1CL reversal" UWORD COMP_0061 1 100 0 327675 ECU_ADDRESS 0xFFFF28E8 /begin FUNCTION_LIST KF7-580.1[8] /end FUNCTION_LIST /end MEASUREMENT
/begin MEASUREMENT vBIT2CL "At the time of the ETC learning clear, once, taking shelter TPS2CL reversal" UWORD COMP_0061 1 100 0 327675 ECU_ADDRESS 0xFFFF28EA /begin FUNCTION_LIST KF7-580.1[8] /end FUNCTION_LIST /end MEASUREMENT
/begin MEASUREMENT vBIT4BCL "At the time of the ETC learning clear, once, taking shelter TPS4BCL reversal" UWORD COMP_0061 1 100 0 327675 ECU_ADDRESS 0xFFFF28EC /begin FUNCTION_LIST KF7-580.1[8] /end FUNCTION_LIST /end MEASUREMENT
/begin MEASUREMENT vBNCADV "BNC SW A/D conversion voltage value" UBYTE COMP_0054 1 100 0 5100 ECU_ADDRESS 0xFFFF361B /begin FUNCTION_LIST R000.1.RS_Integ_1_10_2 /end FUNCTION_LIST /end MEASUREMENT
/begin MEASUREMENT vBRKPDMX "Brake pedal states" UBYTE COMP_0068 1 100 0 255 ECU_ADDRESS 0xFFFF48F4 DISPLAY_IDENTIFIER Vsx_brk_pdl
 /begin FUNCTION_LIST R000.1.RS_Integ_1_10_2 R101.3.aps_sftpd_1_1_4 R102.6.drv_pedlh_1_0_3 R204.1.CanComm_1_9_2 R901.1.Diag_on_can_app_1_6_2 /end FUNCTION_LIST
/end MEASUREMENT
/begin MEASUREMENT vBTPS1CL "At the time of the ETC learning clear, once, taking shelter TPS1CL" UWORD COMP_0061 1 100 0 327675 ECU_ADDRESS 0xFFFF2932 /begin FUNCTION_LIST KF7-580.1[8] /end FUNCTION_LIST /end MEASUREMENT
/begin MEASUREMENT vBTPS2CL "At the time of the ETC learning clear, once, taking shelter TPS2CL" UWORD COMP_0061 1 100 0 327675 ECU_ADDRESS 0xFFFF2934 /begin FUNCTION_LIST KF7-580.1[8] /end FUNCTION_LIST /end MEASUREMENT
/begin MEASUREMENT vBTPS4BCL "At the time of the ETC learning clear, once, taking shelter TPS4BCL" UWORD COMP_0061 1 100 0 327675 ECU_ADDRESS 0xFFFF2936 /begin FUNCTION_LIST KF7-580.1[8] /end FUNCTION_LIST /end MEASUREMENT
/begin MEASUREMENT vCATTS "Catalyst temperature sensor voltage" UBYTE COMP_0054 1 100 0 5100 ECU_ADDRESS 0xFFFF1E64 /begin FUNCTION_LIST KF7-580.1[8] /end FUNCTION_LIST /end MEASUREMENT
/begin MEASUREMENT vCATTS_R#1 "Catalyst temperature sensor voltage" UBYTE COMP_0054 1 100 0 5100 ECU_ADDRESS 0xFFFF1E64 /begin FUNCTION_LIST KF7-580.1[8] /end FUNCTION_LIST /end MEASUREMENT
/begin MEASUREMENT vCATTS_R#2 "Catalyst temperature sensor voltage" UBYTE COMP_0054 1 100 0 5100 ECU_ADDRESS 0xFFFF1E65 /begin FUNCTION_LIST KF7-580.1[8] /end FUNCTION_LIST /end MEASUREMENT
/begin MEASUREMENT vCCEPMCTR "Counter of root cause and mileage EEPROM write-on-the-flight" ULONG COMP_0068 1 100 0 4294967295 ECU_ADDRESS 0xFFFF9FF0 DISPLAY_IDENTIFIER Sxx_cru_dgn_eprm_imd_writ_ctr /begin FUNCTION_LIST R000.4.EepAlloc_1_2_2 R208.10.dgn_ccadd_1_3_2 /end FUNCTION_LIST /end MEASUREMENT
/begin MEASUREMENT vCCSLVB "Filtered VB for CC/SL" UBYTE COMP_0033 1 100 0 20400 ECU_ADDRESS 0xFFFF296B DISPLAY_IDENTIFIER Vxx_fil_vb
 /begin FUNCTION_LIST R000.1.RS_Integ_1_10_2 R208.1.SWTCH_1_1_7 R208.9.SAFETYX_1_3_2 /end FUNCTION_LIST
/end MEASUREMENT
/begin MEASUREMENT vCOUPST "Coupler state (1 : closed ; 2 : sliding ; 8 : open)" UBYTE COMP_0068 1 100 0 255 ECU_ADDRESS 0xFFFF49B8 DISPLAY_IDENTIFIER Vxx_coup /begin FUNCTION_LIST R102.6.drv_pedlh_1_0_3 R204.1.CanComm_1_9_2 /end FUNCTION_LIST /end MEASUREMENT
/begin MEASUREMENT vCRASHMEM "Diagnostic byte stored upon reception of a coherent AIRBAG frame" UBYTE COMP_0068 1 100 0 255 ECU_ADDRESS 0xFFFFB66C DISPLAY_IDENTIFIER CRASHMEM
 /begin FUNCTION_LIST R000.1.RS_Integ_1_10_2 R000.4.EepAlloc_1_2_2 R201.1.stp_mngtx_1_2_2 R208.10.dgn_ccadd_1_3_2 R901.1.Diag_on_can_app_1_6_2 /end FUNCTION_LIST
/end MEASUREMENT
/begin MEASUREMENT vCRASHVU "Byte upon reception of AIRBAG_Crash frame coherent" UBYTE COMP_0068 1 100 0 255 ECU_ADDRESS 0xFFFFB66D DISPLAY_IDENTIFIER CRASHVU
 /begin FUNCTION_LIST R000.1.RS_Integ_1_10_2 R000.4.EepAlloc_1_2_2 R201.1.stp_mngtx_1_2_2 R208.10.dgn_ccadd_1_3_2 R901.1.Diag_on_can_app_1_6_2 /end FUNCTION_LIST
/end MEASUREMENT
/begin MEASUREMENT vCRTLOPT1 "I/O Local ID condition data" UBYTE COMP_0004 1 100 0 255 ECU_ADDRESS 0xFFFF29CC /begin FUNCTION_LIST KF7-580.1[8] /end FUNCTION_LIST /end MEASUREMENT
/begin MEASUREMENT vCRTLOPT2 "I/O Local ID executive data" UBYTE COMP_0004 1 100 0 255 ECU_ADDRESS 0xFFFF29CD /begin FUNCTION_LIST KF7-580.1[8] /end FUNCTION_LIST /end MEASUREMENT
/begin MEASUREMENT vCRTLOPT3 "I/O Local ID executive data" UBYTE COMP_0004 1 100 0 255 ECU_ADDRESS 0xFFFF29CF /begin FUNCTION_LIST KF7-580.1[8] /end FUNCTION_LIST /end MEASUREMENT
/begin MEASUREMENT vCRUCMPDG "Carrier for safety failure diagnosis" UBYTE COMP_0068 1 100 0 255 ECU_ADDRESS 0xFFFFB73A DISPLAY_IDENTIFIER Vxx_cru_cmp_diag
 /begin FUNCTION_LIST R000.4.EepAlloc_1_2_2 R208.9.SAFETYX_1_3_2 R208.10.dgn_ccadd_1_3_2 R301.13.FFDforDiagOnCAN_1_1_3 R901.1.Diag_on_can_app_1_6_2 /end FUNCTION_LIST
/end MEASUREMENT
/begin MEASUREMENT vCSMACC "CSMACC Initial diagnosis flag/counter" UBYTE COMP_0016 1 100 0 255 ECU_ADDRESS 0xFFFFB5D9 /begin FUNCTION_LIST KF7-580.1[8] /end FUNCTION_LIST /end MEASUREMENT
/begin MEASUREMENT vCSMAT "CSMAT Initial diagnosis flag/counter" UBYTE COMP_0016 1 100 0 255 ECU_ADDRESS 0xFFFFB5DA /begin FUNCTION_LIST KF7-580.1[8] /end FUNCTION_LIST /end MEASUREMENT
/begin MEASUREMENT vCSMBCM "CSMBCM Initial diagnosis flag/counter" UBYTE COMP_0016 1 100 0 255 ECU_ADDRESS 0xFFFFB5DB /begin FUNCTION_LIST KF7-580.1[8] /end FUNCTION_LIST /end MEASUREMENT
/begin MEASUREMENT vCSMEPS "CSMEPS Initial diagnosis flag/counter" UBYTE COMP_0016 1 100 0 255 ECU_ADDRESS 0xFFFFB5DC /begin FUNCTION_LIST KF7-580.1[8] /end FUNCTION_LIST /end MEASUREMENT
/begin MEASUREMENT vCSMETS "CSMETS Initial diagnosis flag/counter" UBYTE COMP_0016 1 100 0 255 ECU_ADDRESS 0xFFFFB5DD /begin FUNCTION_LIST KF7-580.1[8] /end FUNCTION_LIST /end MEASUREMENT
/begin MEASUREMENT vCSMHVAC "CSMHVAC Initial diagnosis flag/counter" UBYTE COMP_0016 1 100 0 255 ECU_ADDRESS 0xFFFFB5DE /begin FUNCTION_LIST KF7-580.1[8] /end FUNCTION_LIST /end MEASUREMENT
/begin MEASUREMENT vCSMM4WD "CSMM4WD Initial diagnosis flag/counter" UBYTE COMP_0016 1 100 0 255 ECU_ADDRESS 0xFFFFB5DF /begin FUNCTION_LIST KF7-580.1[8] /end FUNCTION_LIST /end MEASUREMENT
/begin MEASUREMENT vCSMMET "CSMMET Initial diagnosis flag/counter" UBYTE COMP_0016 1 100 0 255 ECU_ADDRESS 0xFFFFB5E0 /begin FUNCTION_LIST KF7-580.1[8] /end FUNCTION_LIST /end MEASUREMENT
/begin MEASUREMENT vCSMMUTE "CSMMUTE Initial diagnosis flag/counter" UBYTE COMP_0016 1 100 0 255 ECU_ADDRESS 0xFFFFB5E1 /begin FUNCTION_LIST KF7-580.1[8] /end FUNCTION_LIST /end MEASUREMENT
/begin MEASUREMENT vCSMUSM "CSMUSM Initial diagnosis flag/counter" UBYTE COMP_0016 1 100 0 255 ECU_ADDRESS 0xFFFFB5E2 /begin FUNCTION_LIST KF7-580.1[8] /end FUNCTION_LIST /end MEASUREMENT
/begin MEASUREMENT vCSMVDC "CSMVDC Initial diagnosis flag/counter" UBYTE COMP_0016 1 100 0 255 ECU_ADDRESS 0xFFFFB5E3 /begin FUNCTION_LIST KF7-580.1[8] /end FUNCTION_LIST /end MEASUREMENT
/begin MEASUREMENT vCURGPINV "Current gear position for Inverse filter" UBYTE COMP_0068 1 100 0 255 ECU_ADDRESS 0xFFFF120D
 /begin FUNCTION_LIST R000.1.RS_Integ_1_10_2 R204.1.CanComm_1_9_2 R301.8.Inverse_filter_1_1_3 /end FUNCTION_LIST
/end MEASUREMENT
/begin MEASUREMENT vDCATSP "Diagnostic cycle setpoint" UWORD COMP_0451_S 1 100 0 81.91875 ECU_ADDRESS 0xFFFF2A1C
 /begin FUNCTION_LIST R102.2M.DRARB_1_1_4 R102.2P.DRARB_1_0_2 Rxxx.1.Diagnostic_cycle_1_0_1 /end FUNCTION_LIST
/end MEASUREMENT
/begin MEASUREMENT vDEFMODE "A local ID mode data" UBYTE COMP_0004 1 100 0 255 ECU_ADDRESS 0xFFFF2A28 /begin FUNCTION_LIST KF7-580.1[8] /end FUNCTION_LIST /end MEASUREMENT
/begin MEASUREMENT vDIAGISSO "After sale idle speed setpoint offset" UWORD COMP_0337_S 1 100 0 65535 ECU_ADDRESS 0xFFFFA2E0 DISPLAY_IDENTIFIER Vxx_diag_is_n_ofs
 /begin FUNCTION_LIST R000.1.RS_Integ_1_10_2 R107.1.iss_ariss_1_0_4 R901.1.Diag_on_can_app_1_6_2 /end FUNCTION_LIST
/end MEASUREMENT
/begin MEASUREMENT vDLINCONF "State data of driveline configuration (Transmission type)." UBYTE COMP_0068 1 100 0 255 ECU_ADDRESS 0xFFFF41EB DISPLAY_IDENTIFIER Vsx_dlin_conf
 /begin FUNCTION_LIST R000.1.RS_Integ_1_10_2 R102.6.drv_pedlh_1_0_3 R103.2.lim_gbxli_1_0_2 R107.2.iss_atiss_1_0_2 R108.1.dls_gbrat_vmm_1_1_5 R204.1.CanComm_1_9_2 R902.2.DiagMiscell_1_3_5 /end FUNCTION_LIST
/end MEASUREMENT
/begin MEASUREMENT vDOMON "DO monitor" UBYTE COMP_0004 1 100 0 255 ECU_ADDRESS 0xFFFF2A82 /begin FUNCTION_LIST KF7-580.1[8] /end FUNCTION_LIST /end MEASUREMENT
/begin MEASUREMENT vDOMON_R#1 "DO monitor" UBYTE COMP_0004 1 100 0 255 ECU_ADDRESS 0xFFFF2A82 /begin FUNCTION_LIST KF7-580.1[8] /end FUNCTION_LIST /end MEASUREMENT
/begin MEASUREMENT vDOMON_R#2 "DO monitor" UBYTE COMP_0004 1 100 0 255 ECU_ADDRESS 0xFFFF2A83 /begin FUNCTION_LIST KF7-580.1[8] /end FUNCTION_LIST /end MEASUREMENT
/begin MEASUREMENT vDOMON_R#3 "DO monitor" UBYTE COMP_0004 1 100 0 255 ECU_ADDRESS 0xFFFF2A84 /begin FUNCTION_LIST KF7-580.1[8] /end FUNCTION_LIST /end MEASUREMENT
/begin MEASUREMENT vDOMON_R#4 "DO monitor" UBYTE COMP_0004 1 100 0 255 ECU_ADDRESS 0xFFFF2A85 /begin FUNCTION_LIST KF7-580.1[8] /end FUNCTION_LIST /end MEASUREMENT
/begin MEASUREMENT vDOMON_R#5 "DO monitor" UBYTE COMP_0004 1 100 0 255 ECU_ADDRESS 0xFFFF2A86 /begin FUNCTION_LIST KF7-580.1[8] /end FUNCTION_LIST /end MEASUREMENT
/begin MEASUREMENT vDOMON_R#6 "DO monitor" UBYTE COMP_0004 1 100 0 255 ECU_ADDRESS 0xFFFF2A87 /begin FUNCTION_LIST KF7-580.1[8] /end FUNCTION_LIST /end MEASUREMENT
/begin MEASUREMENT vDOMON_R#7 "DO monitor" UBYTE COMP_0004 1 100 0 255 ECU_ADDRESS 0xFFFF2A88 /begin FUNCTION_LIST KF7-580.1[8] /end FUNCTION_LIST /end MEASUREMENT
/begin MEASUREMENT vDOMON_R#8 "DO monitor" UBYTE COMP_0004 1 100 0 255 ECU_ADDRESS 0xFFFF2A89 /begin FUNCTION_LIST KF7-580.1[8] /end FUNCTION_LIST /end MEASUREMENT
/begin MEASUREMENT vDRV "FRCM D/R voltage" UBYTE COMP_0118 1 100 0 10200 ECU_ADDRESS 0xFFFF8984 /begin FUNCTION_LIST KF7-580.1[8] /end FUNCTION_LIST /end MEASUREMENT
/begin MEASUREMENT vDRVSPTFC "Driver sportivity factor, including 'slow' and 'fast' adaptation algorithms" UBYTE COMP_0460_S 1 100 0 1.00000035 ECU_ADDRESS 0xFFFF2AA8 DISPLAY_IDENTIFIER Vxx_driv_spt_fac
 /begin FUNCTION_LIST R000.1.RS_Integ_1_10_2 R102.1M.PEDFM_1_0_9 R102.1P.PEDFM_1_0_2 /end FUNCTION_LIST
/end MEASUREMENT
/begin MEASUREMENT vERRLRNI "VTC operation angle deviation quantity integral value learning value" ULONG COMP_0064_S 1 100 -10737418.24 10737418.235 ECU_ADDRESS 0xFFFFA324 /begin FUNCTION_LIST KF7-580.1[8] /end FUNCTION_LIST /end MEASUREMENT
/begin MEASUREMENT vERRLRNI_R#1 "VTC operation angle deviation quantity integral value learning value" ULONG COMP_0064_S 1 100 -10737418.24 10737418.235 ECU_ADDRESS 0xFFFFA324 /begin FUNCTION_LIST KF7-580.1[8] /end FUNCTION_LIST /end MEASUREMENT
/begin MEASUREMENT vERRLRNI_R#2 "VTC operation angle deviation quantity integral value learning value" ULONG COMP_0064_S 1 100 -10737418.24 10737418.235 ECU_ADDRESS 0xFFFFA328 /begin FUNCTION_LIST KF7-580.1[8] /end FUNCTION_LIST /end MEASUREMENT
/begin MEASUREMENT vESPCLOCK "ESP clock" UBYTE COMP_0068 1 100 0 255 ECU_ADDRESS 0xFFFF4782 DISPLAY_IDENTIFIER Vxx_mux_asr_msr_clck
 /begin FUNCTION_LIST R104.1.brk_absct_1_2_2 R105.1.tra_atsip_1_0_1 R105.2.tra_sdfta_1_1_2 R204.1.CanComm_1_9_2 /end FUNCTION_LIST
/end MEASUREMENT
/begin MEASUREMENT vESPTQTYP "Type ESP torque control" UBYTE COMP_0068 1 100 0 255 ECU_ADDRESS 0xFFFF492A DISPLAY_IDENTIFIER Vsx_mux_asr_msr_typ
 /begin FUNCTION_LIST R101.3.aps_sftpd_1_1_4 R102.6.drv_pedlh_1_0_3 R104.1.brk_absct_1_2_2 R105.1.tra_atsip_1_0_1 R105.2.tra_sdfta_1_1_2 R204.1.CanComm_1_9_2 /end FUNCTION_LIST
/end MEASUREMENT
/begin MEASUREMENT vETAMOTMX "Engine states" UBYTE COMP_0068 1 100 0 255 ECU_ADDRESS 0xFFFF492B DISPLAY_IDENTIFIER Vsx_eng
 /begin FUNCTION_LIST R102.6.drv_pedlh_1_0_3 R106.2.epw_mxalt_1_1_0 R106.5.epw_ptcxx_1_1_0 R106.7.epw_tqalt_1_1_0 R107.3.iss_eliss_1_0_4 R201.1.stp_mngtx_1_2_2 R202.2.acx_mdfan_1_2_2 R203.1.crk_mngtx_1_2_1 R203.2.crk_restx_1_0_8 R204.1.CanComm_1_9_2 R301.13.FFDforDiagOnCAN_1_1_3 R901.1.Diag_on_can_app_1_6_2 R903.1.milmgtx_1_0_2 /end FUNCTION_LIST
/end MEASUREMENT
/begin MEASUREMENT vETAMXCLM "ABS ECU status for CAN" UBYTE COMP_0068 1 100 0 255 ECU_ADDRESS 0xFFFF492E DISPLAY_IDENTIFIER Vxx_ac_ecu_stt
 /begin FUNCTION_LIST R000.1.RS_Integ_1_10_2 R107.4.iss_mciss_1_0_2 R202.2.acx_mdfan_1_2_2 R204.1.CanComm_1_9_2 R301.6.IscAirflow_1_4_5 /end FUNCTION_LIST
/end MEASUREMENT
/begin MEASUREMENT vETHCNT "HighInput diagnosis complete counter" UWORD COMP_0016 1 100 0 65535 ECU_ADDRESS 0xFFFFA39A /begin FUNCTION_LIST KF7-580.1[8] /end FUNCTION_LIST /end MEASUREMENT
/begin MEASUREMENT vETLCNT "LowInput diagnosis complete counter" UWORD COMP_0016 1 100 0 65535 ECU_ADDRESS 0xFFFFA39C /begin FUNCTION_LIST KF7-580.1[8] /end FUNCTION_LIST /end MEASUREMENT
/begin MEASUREMENT vEVPMON "Evapo leak diagnosis monitor" UBYTE COMP_0004 1 100 0 255 ECU_ADDRESS 0xFFFF2CD2 /begin FUNCTION_LIST KF7-580.1[8] /end FUNCTION_LIST /end MEASUREMENT
/begin MEASUREMENT vEVPMON2 "Evapo leak diagnosis monitor" UBYTE COMP_0004 1 100 0 255 ECU_ADDRESS 0xFFFF2CD3 /begin FUNCTION_LIST KF7-580.1[8] /end FUNCTION_LIST /end MEASUREMENT
/begin MEASUREMENT vEVPMON3 "Evapo leak diagnosis monitor" UBYTE COMP_0068 1 100 0 255 ECU_ADDRESS 0xFFFF2CD4 /begin FUNCTION_LIST KF7-580.1[8] /end FUNCTION_LIST /end MEASUREMENT
/begin MEASUREMENT vEVQMP1 "A high vehicle speed pull-down permission QM lower limit" UWORD COMP_0068 1 100 0 65535 ECU_ADDRESS 0xFFFF1350 /begin FUNCTION_LIST KF7-580.1[8] /end FUNCTION_LIST /end MEASUREMENT
/begin MEASUREMENT vEVQMP2 "A low vehicle speed pull-down permission QM lower limit" UWORD COMP_0068 1 100 0 65535 ECU_ADDRESS 0xFFFF1352 /begin FUNCTION_LIST KF7-580.1[8] /end FUNCTION_LIST /end MEASUREMENT
/begin MEASUREMENT vEVTFNL "Fuel temperature condition upper limit" UBYTE COMP_0035 1 100 -50 205 ECU_ADDRESS 0xFFFF2CDE /begin FUNCTION_LIST KF7-580.1[8] /end FUNCTION_LIST /end MEASUREMENT
/begin MEASUREMENT vFINLISS "Final idle speed setpoint" UWORD COMP_0337_S 1 100 0 65535 ECU_ADDRESS 0xFFFF41F2 DISPLAY_IDENTIFIER Vxx_is_n_sp
 /begin FUNCTION_LIST R000.1.RS_Integ_1_10_2 R107.1.iss_ariss_1_0_4 R204.1.CanComm_1_9_2 /end FUNCTION_LIST
/end MEASUREMENT
/begin MEASUREMENT vFINLISSF "Final idle speed setpoint with Diag offset" UWORD COMP_0337_S 1 100 0 65535 ECU_ADDRESS 0xFFFF41F4 DISPLAY_IDENTIFIER Vxx_fin_is_n_sp /begin FUNCTION_LIST R000.1.RS_Integ_1_10_2 R901.1.Diag_on_can_app_1_6_2 /end FUNCTION_LIST /end MEASUREMENT
/begin MEASUREMENT vFLGCNT "Fuel level gauge function diagnosis RATE counter" UWORD COMP_0016 1 100 0 65535 ECU_ADDRESS 0xFFFFA420 /begin FUNCTION_LIST KF7-580.1[8] /end FUNCTION_LIST /end MEASUREMENT
/begin MEASUREMENT vGSM8RE "Mode 8 response code (DDL2)" UBYTE COMP_0068 1 100 0 255 ECU_ADDRESS 0xFFFF2E11 /begin FUNCTION_LIST KF7-580.1[8] /end FUNCTION_LIST /end MEASUREMENT
/begin MEASUREMENT vHCSENRF "Final FAN speed" UWORD COMP_0093_S 1 100 0 3276.75 ECU_ADDRESS 0xFFFF2E14 /begin FUNCTION_LIST KF7-580.1[8] /end FUNCTION_LIST /end MEASUREMENT
/begin MEASUREMENT vLEKCNTS "0.04-inch leak diagnosis frequency measuring counter" UWORD COMP_0016 1 100 0 65535 ECU_ADDRESS 0xFFFFA4CA /begin FUNCTION_LIST KF7-580.1[8] /end FUNCTION_LIST /end MEASUREMENT
/begin MEASUREMENT vLSENCNT "Line pressure sensor function diagnosis frequency measuring counter" UWORD COMP_0016 1 100 0 65535 ECU_ADDRESS 0xFFFFA4D4 /begin FUNCTION_LIST KF7-580.1[8] /end FUNCTION_LIST /end MEASUREMENT
/begin MEASUREMENT vMANGTM "Injection start timing" UBYTE COMP_0017 1 100 0 255 ECU_ADDRESS 0xFFFF155C /begin FUNCTION_LIST KF7-580.1[8] /end FUNCTION_LIST /end MEASUREMENT
/begin MEASUREMENT vMAXDAVTQ "Maximum available torque with dynamic limitation" UWORD COMP_0345_S 1 100 -400 1647.96875 ECU_ADDRESS 0xFFFF4204 DISPLAY_IDENTIFIER Vxx_max_dyn_avl_tqe
 /begin FUNCTION_LIST R000.1.RS_Integ_1_10_2 R102.4M.DRLIM_1_1_0 R102.4P.DRLIM_1_0_2 R102.5M.ARBIT_1_1_0 R102.5P.ARBIT_1_0_2 R901.1.Diag_on_can_app_1_6_2 /end FUNCTION_LIST
/end MEASUREMENT
/begin MEASUREMENT vMAXSAVTQ "Maximum absolute effective torque" UWORD COMP_0345_S 1 100 -400 1647.96875 ECU_ADDRESS 0xFFFF4206 DISPLAY_IDENTIFIER Vxx_max_stat_avl_tqe
 /begin FUNCTION_LIST R102.4M.DRLIM_1_1_0 R102.4P.DRLIM_1_0_2 R102.5M.ARBIT_1_1_0 R102.5P.ARBIT_1_0_2 R102.6.drv_pedlh_1_0_3 R103.1.lim_statl_1_0_1 R204.1.CanComm_1_9_2 Rxxx.1.Diagnostic_cycle_1_0_1 /end FUNCTION_LIST
/end MEASUREMENT
/begin MEASUREMENT vMEMHH "RMBA service reading address extreme upper byte" UBYTE COMP_0004 1 100 0 255 ECU_ADDRESS 0xFFFF3810 /begin FUNCTION_LIST KF7-580.1[8] /end FUNCTION_LIST /end MEASUREMENT
/begin MEASUREMENT vMEMHL "In the RMBA service reading address, upper byte" UBYTE COMP_0004 1 100 0 255 ECU_ADDRESS 0xFFFF3811 /begin FUNCTION_LIST KF7-580.1[8] /end FUNCTION_LIST /end MEASUREMENT
/begin MEASUREMENT vMEMLH "In the RMBA service reading address, lower byte" UBYTE COMP_0004 1 100 0 255 ECU_ADDRESS 0xFFFF3812 /begin FUNCTION_LIST KF7-580.1[8] /end FUNCTION_LIST /end MEASUREMENT
/begin MEASUREMENT vMEMLL "RMBA service reading address lowest rank byte" UBYTE COMP_0004 1 100 0 255 ECU_ADDRESS 0xFFFF3813 /begin FUNCTION_LIST KF7-580.1[8] /end FUNCTION_LIST /end MEASUREMENT
/begin MEASUREMENT vMEMSIZE "RMBA service EEPROM reading requirement memory size" UWORD COMP_0004 1 100 0 65535 ECU_ADDRESS 0xFFFF3814 /begin FUNCTION_LIST KF7-580.1[8] /end FUNCTION_LIST /end MEASUREMENT
/begin MEASUREMENT vMSPRSCLI "Raw AC pressure voltsge for AC cold loop" UWORD COMP_0411_S 1 100 0 5.119921875 ECU_ADDRESS 0xFFFF15B4 DISPLAY_IDENTIFIER MSPRSCLI /begin FUNCTION_LIST R000.1.RS_Integ_1_10_2 R202.1.acx_acprs_1_2_3 /end FUNCTION_LIST /end MEASUREMENT
/begin MEASUREMENT vMSRTQ "MSR torque setting sent to torque arbitration" UWORD COMP_0345_S 1 100 -400 1647.96875 ECU_ADDRESS 0xFFFF2FF0 DISPLAY_IDENTIFIER Vxx_msr_tqe_sp
 /begin FUNCTION_LIST R102.5M.ARBIT_1_1_0 R102.5P.ARBIT_1_0_2 R104.1.brk_absct_1_2_2 /end FUNCTION_LIST
/end MEASUREMENT
/begin MEASUREMENT vMSRTRQ "MSR torque setting acquired on the MUX" UWORD COMP_0345_S 1 100 -400 1647.96875 ECU_ADDRESS 0xFFFF494E DISPLAY_IDENTIFIER Vxx_mux_msr_tqe_sp /begin FUNCTION_LIST R104.1.brk_absct_1_2_2 R204.1.CanComm_1_9_2 /end FUNCTION_LIST /end MEASUREMENT
/begin MEASUREMENT vMSRTRQR "MSR torque setting" UWORD COMP_0068 1 100 0 65535 ECU_ADDRESS 0xFFFF4950 DISPLAY_IDENTIFIER Vxx_mux_msr_tqe_sp_raw /begin FUNCTION_LIST R104.1.brk_absct_1_2_2 R204.1.CanComm_1_9_2 /end FUNCTION_LIST /end MEASUREMENT
/begin MEASUREMENT vMXAGBTQ "Maximum ÉIÅ[ÉgÉ} ÅE gear box torque" UWORD COMP_0345_S 1 100 -400 1647.96875 ECU_ADDRESS 0xFFFF2FF6 DISPLAY_IDENTIFIER Vxx_max_agb_tqe /begin FUNCTION_LIST R103.2.lim_gbxli_1_0_2 /end FUNCTION_LIST /end MEASUREMENT
/begin MEASUREMENT vMXGBXTQ "Maximum torque to protect gearbox from mechanical overload" UWORD COMP_0345_S 1 100 -400 1647.96875 ECU_ADDRESS 0xFFFF2FF8 DISPLAY_IDENTIFIER Vxx_max_gbx_tqe
 /begin FUNCTION_LIST R000.1.RS_Integ_1_10_2 R103.1.lim_statl_1_0_1 R103.2.lim_gbxli_1_0_2 /end FUNCTION_LIST
/end MEASUREMENT
/begin MEASUREMENT vMXMGBTQ "A maximum gear box allowable torque (for the MGB gear box)" UWORD COMP_0345_S 1 100 -400 1647.96875 ECU_ADDRESS 0xFFFF2FFA DISPLAY_IDENTIFIER Vxx_max_mgb_tqe /begin FUNCTION_LIST R103.2.lim_gbxli_1_0_2 /end FUNCTION_LIST /end MEASUREMENT
/begin MEASUREMENT vMXPWTQ "Limitation effective torque for power limitation" UWORD COMP_0345_S 1 100 -400 1647.96875 ECU_ADDRESS 0xFFFF2FFE DISPLAY_IDENTIFIER Vxx_max_pow_tqe /begin FUNCTION_LIST R103.1.lim_statl_1_0_1 /end FUNCTION_LIST /end MEASUREMENT
/begin MEASUREMENT vMXRSPW "Maximum power allowed by the safety converted in torque" UWORD COMP_0345_S 1 100 -400 1647.96875 ECU_ADDRESS 0xFFFF3000 DISPLAY_IDENTIFIER Vxx_max_rams_pow /begin FUNCTION_LIST R000.1.RS_Integ_1_10_2 R103.1.lim_statl_1_0_1 /end FUNCTION_LIST /end MEASUREMENT
/begin MEASUREMENT vMXRSTQ "Maximum torque allowed by the safety" UWORD COMP_0345_S 1 100 -400 1647.96875 ECU_ADDRESS 0xFFFF3002 DISPLAY_IDENTIFIER Vxx_max_rams_tqe /begin FUNCTION_LIST R000.1.RS_Integ_1_10_2 R103.1.lim_statl_1_0_1 /end FUNCTION_LIST /end MEASUREMENT
/begin MEASUREMENT vMXVHTQ "Maximum torque without safety torque limitation" UWORD COMP_0345_S 1 100 -400 1647.96875 ECU_ADDRESS 0xFFFF3004 DISPLAY_IDENTIFIER Vxx_max_vh_tqe /begin FUNCTION_LIST R103.1.lim_statl_1_0_1 /end FUNCTION_LIST /end MEASUREMENT
/begin MEASUREMENT vNOAGBTRQ "torque request without agb request sent for AGB on CAN" UWORD COMP_0345_S 1 100 -400 1647.96875 ECU_ADDRESS 0xFFFF420E DISPLAY_IDENTIFIER Vxx_mux_arb_no_agb_tqe
 /begin FUNCTION_LIST R102.5M.ARBIT_1_1_0 R105.2.tra_sdfta_1_1_2 R204.1.CanComm_1_9_2 R901.1.Diag_on_can_app_1_6_2 /end FUNCTION_LIST
/end MEASUREMENT
/begin MEASUREMENT vNOAGBTRR "target torque request without agb request sent for AGB on CAN" UWORD COMP_0345_S 1 100 -400 1647.96875 ECU_ADDRESS 0xFFFF4210 DISPLAY_IDENTIFIER Vxx_mux_raw_arb_no_agb_tqe /begin FUNCTION_LIST R102.5M.ARBIT_1_1_0 R204.1.CanComm_1_9_2 /end FUNCTION_LIST /end MEASUREMENT
/begin MEASUREMENT vNRPMPS "Engine speed (POS)" UWORD COMP_0006 1 100 0 819187.5 ECU_ADDRESS 0xFFFF1EE2 /begin FUNCTION_LIST KF7-580.1[8] /end FUNCTION_LIST /end MEASUREMENT
/begin MEASUREMENT vNSETDDL "NSET lower limit adjustment value (DDL receiving value)" UBYTE COMP_0006 1 100 0 3187.5 ECU_ADDRESS 0xFFFF3024 /begin FUNCTION_LIST R000.4.EepAlloc_1_2_2 /end FUNCTION_LIST /end MEASUREMENT
/begin MEASUREMENT vO2HDTYMON "O2 heater duty output monitor" UBYTE COMP_0132_S 1 100 0 2550 ECU_ADDRESS 0xFFFF15FE /begin FUNCTION_LIST KF7-580.1[8] /end FUNCTION_LIST /end MEASUREMENT
/begin MEASUREMENT vOPFFD "Option F.F. data buffer" UBYTE COMP_0068 1 100 0 255 ECU_ADDRESS 0xFFFFAE80 /begin FUNCTION_LIST KF7-580.1[8] /end FUNCTION_LIST /end MEASUREMENT
/begin MEASUREMENT vOPFFD_R#1 "Option F.F. data buffer" UBYTE COMP_0068 1 100 0 255 ECU_ADDRESS 0xFFFFAE80 /begin FUNCTION_LIST KF7-580.1[8] /end FUNCTION_LIST /end MEASUREMENT
/begin MEASUREMENT vOPFFD_R#2 "Option F.F. data buffer" UBYTE COMP_0068 1 100 0 255 ECU_ADDRESS 0xFFFFAE81 /begin FUNCTION_LIST KF7-580.1[8] /end FUNCTION_LIST /end MEASUREMENT
/begin MEASUREMENT vOPFFD_R#3 "Option F.F. data buffer" UBYTE COMP_0068 1 100 0 255 ECU_ADDRESS 0xFFFFAE82 /begin FUNCTION_LIST KF7-580.1[8] /end FUNCTION_LIST /end MEASUREMENT
/begin MEASUREMENT vOPFFD_R#4 "Option F.F. data buffer" UBYTE COMP_0068 1 100 0 255 ECU_ADDRESS 0xFFFFAE83 /begin FUNCTION_LIST KF7-580.1[8] /end FUNCTION_LIST /end MEASUREMENT
/begin MEASUREMENT vOPFFD_R#5 "Option F.F. data buffer" UBYTE COMP_0068 1 100 0 255 ECU_ADDRESS 0xFFFFAE84 /begin FUNCTION_LIST KF7-580.1[8] /end FUNCTION_LIST /end MEASUREMENT
/begin MEASUREMENT vOPFFD_R#6 "Option F.F. data buffer" UBYTE COMP_0068 1 100 0 255 ECU_ADDRESS 0xFFFFAE85 /begin FUNCTION_LIST KF7-580.1[8] /end FUNCTION_LIST /end MEASUREMENT
/begin MEASUREMENT vOPFFD_R#7 "Option F.F. data buffer" UBYTE COMP_0068 1 100 0 255 ECU_ADDRESS 0xFFFFAE86 /begin FUNCTION_LIST KF7-580.1[8] /end FUNCTION_LIST /end MEASUREMENT
/begin MEASUREMENT vOPFFD_R#8 "Option F.F. data buffer" UBYTE COMP_0068 1 100 0 255 ECU_ADDRESS 0xFFFFAE87 /begin FUNCTION_LIST KF7-580.1[8] /end FUNCTION_LIST /end MEASUREMENT
/begin MEASUREMENT vOPFFD_R#9 "Option F.F. data buffer" UBYTE COMP_0068 1 100 0 255 ECU_ADDRESS 0xFFFFAE88 /begin FUNCTION_LIST KF7-580.1[8] /end FUNCTION_LIST /end MEASUREMENT
/begin MEASUREMENT vOPFFD_R#10 "Option F.F. data buffer" UBYTE COMP_0068 1 100 0 255 ECU_ADDRESS 0xFFFFAE89 /begin FUNCTION_LIST KF7-580.1[8] /end FUNCTION_LIST /end MEASUREMENT
/begin MEASUREMENT vOVHPROTQ "Maximum indicated torque for overheat protection" UWORD COMP_0345_S 1 100 -400 1647.96875 ECU_ADDRESS 0xFFFF3058 DISPLAY_IDENTIFIER Vxx_ovh_prot_tqi /begin FUNCTION_LIST R000.1.RS_Integ_1_10_2 R103.1.lim_statl_1_0_1 /end FUNCTION_LIST /end MEASUREMENT
/begin MEASUREMENT vOVNTQCOR "Final corrective factor applied on maximum torque in case of overspeed" UBYTE COMP_0460_S 1 100 0 1.00000035 ECU_ADDRESS 0xFFFF305C DISPLAY_IDENTIFIER Vxx_ovn_tq_cor_fil /begin FUNCTION_LIST R000.1.RS_Integ_1_10_2 R103.1.lim_statl_1_0_1 /end FUNCTION_LIST /end MEASUREMENT
/begin MEASUREMENT vPBS "Supercharge pressure sensor value" UBYTE COMP_0054 1 100 0 5100 ECU_ADDRESS 0xFFFF1EF1 /begin FUNCTION_LIST KF7-580.1[8] /end FUNCTION_LIST /end MEASUREMENT
/begin MEASUREMENT vPFTISS "Particle filter idle speed setpoint" UWORD COMP_0337_S 1 100 0 65535 ECU_ADDRESS 0xFFFF307E DISPLAY_IDENTIFIER Vxx_pft_min_is_n /begin FUNCTION_LIST R000.1.RS_Integ_1_10_2 R107.1.iss_ariss_1_0_4 /end FUNCTION_LIST /end MEASUREMENT
/begin MEASUREMENT vPOSC "Between REFs, the number of POSs" UBYTE COMP_0004 1 100 0 255 ECU_ADDRESS 0xFFFF21ED /begin FUNCTION_LIST KF7-580.1[8] /end FUNCTION_LIST /end MEASUREMENT
/begin MEASUREMENT vPSYSCNT "A counter for purge system diagnosis frequency measuring" UWORD COMP_0016 1 100 0 65535 ECU_ADDRESS 0xFFFFAEEE /begin FUNCTION_LIST KF7-580.1[8] /end FUNCTION_LIST /end MEASUREMENT
/begin MEASUREMENT vQAI "DDL2 monitor inhalation air quantity index number" UWORD COMP_0004 1 100 0 65535 ECU_ADDRESS 0xFFFF3728 /begin FUNCTION_LIST KF7-580.1[8] /end FUNCTION_LIST /end MEASUREMENT
/begin MEASUREMENT vRAPFRC_S "the driver via the accelerator pedal (Sub)" UWORD COMP_0374_S 1 100 -20000 111070 ECU_ADDRESS 0xFFFF34FE /begin FUNCTION_LIST R102.2P.DRARB_1_0_2 /end FUNCTION_LIST /end MEASUREMENT
/begin MEASUREMENT vRAPFSR_S "Normalized accelerator pedal position (Sub)" UWORD COMP_0451_S 1 100 0 81.91875 ECU_ADDRESS 0xFFFF49A4 /begin FUNCTION_LIST R101.1P.aps_pedin_1_1_2 R301.21.SafetyLevel2_1_0_2 /end FUNCTION_LIST /end MEASUREMENT
/begin MEASUREMENT vRAPOFORC "Driving force requested by the driver via the accelerator pedal" UWORD COMP_0374_S 1 100 -20000 111070 ECU_ADDRESS 0xFFFF30EA DISPLAY_IDENTIFIER Vxx_acel_pdl_forc_sp /begin FUNCTION_LIST R102.2M.DRARB_1_1_4 R208.5.SETPT_1_1_0 R208.6.SERVO_1_2_2 /end FUNCTION_LIST /end MEASUREMENT
/begin MEASUREMENT vRAPOFSR "Sportivity factor sent by AT on CAN" UWORD COMP_0451_S 1 100 0 81.91875 ECU_ADDRESS 0xFFFF495E DISPLAY_IDENTIFIER vAPO
 /begin FUNCTION_LIST R000.1.RS_Integ_1_10_2 R101.1M.aps_pedin_1_2_2 R102.1M.PEDFM_1_0_9 R102.1P.PEDFM_1_0_2 R106.5.epw_ptcxx_1_1_0 R204.1.CanComm_1_9_2 R301.13.FFDforDiagOnCAN_1_1_3 R301.21.SafetyLevel2_1_0_2 R901.1.Diag_on_can_app_1_6_2 /end FUNCTION_LIST
/end MEASUREMENT
/begin MEASUREMENT vRAPOSTR "Powertrain setpoint (per cent) requested by the driver via the accelerator pedal" UWORD COMP_0451_S 1 100 0 81.91875 ECU_ADDRESS 0xFFFF30EC DISPLAY_IDENTIFIER Vxx_acel_pdl_pwt_sp
 /begin FUNCTION_LIST R000.1.RS_Integ_1_10_2 R102.1M.PEDFM_1_0_9 R102.2M.DRARB_1_1_4 R102.2P.DRARB_1_0_2 R102.6.drv_pedlh_1_0_3 R301.21.SafetyLevel2_1_0_2 /end FUNCTION_LIST
/end MEASUREMENT
/begin MEASUREMENT vRAPSTR_S "the driver via the accelerator pedal (Sub)" UWORD COMP_0451_S 1 100 0 81.91875 ECU_ADDRESS 0xFFFF3500 /begin FUNCTION_LIST R102.1P.PEDFM_1_0_2 R301.21.SafetyLevel2_1_0_2 /end FUNCTION_LIST /end MEASUREMENT
/begin MEASUREMENT vRBFAP1_S "Accelerator pedal slope limitation 1 (Sub)" UWORD COMP_0359_S 1 100 0 63.999056205 ECU_ADDRESS 0xFFFF4032 /begin FUNCTION_LIST R000.1.RS_Integ_1_10_2 /end FUNCTION_LIST /end MEASUREMENT
/begin MEASUREMENT vRBFAPO "Accelerator pedal slope limitation" UWORD COMP_0359_S 1 100 0 63.999056205 ECU_ADDRESS 0xFFFF1DE8 /begin FUNCTION_LIST R000.1.RS_Integ_1_10_2 /end FUNCTION_LIST /end MEASUREMENT
/begin MEASUREMENT vRBFAPO1 "Accelerator pedal slope limitation 1" UWORD COMP_0359_S 1 100 0 63.999056205 ECU_ADDRESS 0xFFFF3E40 /begin FUNCTION_LIST R000.1.RS_Integ_1_10_2 /end FUNCTION_LIST /end MEASUREMENT
/begin MEASUREMENT vRBFAPO_S "Accelerator pedal slope limitation (Sub)" UWORD COMP_0359_S 1 100 0 63.999056205 ECU_ADDRESS 0xFFFF1F68 /begin FUNCTION_LIST R000.1.RS_Integ_1_10_2 /end FUNCTION_LIST /end MEASUREMENT
/begin MEASUREMENT vRCIDHB "CID upper byte" UBYTE COMP_0004 1 100 0 255 ECU_ADDRESS 0xFFFF30F4 /begin FUNCTION_LIST KF7-580.1[8] /end FUNCTION_LIST /end MEASUREMENT
/begin MEASUREMENT vRCIDLB "CID lower byte" UBYTE COMP_0004 1 100 0 255 ECU_ADDRESS 0xFFFF30F5 /begin FUNCTION_LIST KF7-580.1[8] /end FUNCTION_LIST /end MEASUREMENT
/begin MEASUREMENT vRDMNFL_S "minimum available engine torque for driver setpoint (Sub)" UWORD COMP_0345_S 1 100 -400 1647.96875 ECU_ADDRESS 0xFFFF3502 /begin FUNCTION_LIST R102.3P.DRTQE_1_0_2 /end FUNCTION_LIST /end MEASUREMENT
/begin MEASUREMENT vRDPTSP_S "real (pedal) and virtual (ACC/CC/SL) drivers Sub" UWORD COMP_0451_S 1 100 0 81.91875 ECU_ADDRESS 0xFFFF3504 /begin FUNCTION_LIST R102.2P.DRARB_1_0_2 R102.3P.DRTQE_1_0_2 /end FUNCTION_LIST /end MEASUREMENT
/begin MEASUREMENT vRDRMNFIL "Filtered minimum available engine torque, for driver setpoint calculation" UWORD COMP_0345_S 1 100 -400 1647.96875 ECU_ADDRESS 0xFFFF3102 DISPLAY_IDENTIFIER Vxx_driv_min_avl_tqe /begin FUNCTION_LIST R102.3M.DRTQE_1_1_0 /end FUNCTION_LIST /end MEASUREMENT
/begin MEASUREMENT vRDRPWTSP "Powertrain setpoint (per cent) requested by real (pedal) and virtual (ACC/CC/SL) drivers" UWORD COMP_0451_S 1 100 0 81.91875 ECU_ADDRESS 0xFFFF4216 DISPLAY_IDENTIFIER Vxx_driv_pwt_sp
 /begin FUNCTION_LIST R000.1.RS_Integ_1_10_2 R102.2M.DRARB_1_1_4 R102.3M.DRTQE_1_1_0 R204.1.CanComm_1_9_2 R901.1.Diag_on_can_app_1_6_2 /end FUNCTION_LIST
/end MEASUREMENT
/begin MEASUREMENT vRDRTNFIL "Filtered engine speed for driver torque setpoint calculation" UWORD COMP_0443 1 100 0 65535 ECU_ADDRESS 0xFFFF3104 DISPLAY_IDENTIFIER Vxx_driv_tqe_sp_n_fil /begin FUNCTION_LIST R102.3M.DRTQE_1_1_0 /end FUNCTION_LIST /end MEASUREMENT
/begin MEASUREMENT vRDRTQSP "Effective engine torque requested by real (pedal) and virtual (ACC/CC/SL) drivers" UWORD COMP_0345_S 1 100 -400 1647.96875 ECU_ADDRESS 0xFFFF3106 DISPLAY_IDENTIFIER Vxx_driv_tqe_sp
 /begin FUNCTION_LIST R000.1.RS_Integ_1_10_2 R102.3M.DRTQE_1_1_0 R102.4M.DRLIM_1_1_0 R102.4P.DRLIM_1_0_2 R301.21.SafetyLevel2_1_0_2 /end FUNCTION_LIST
/end MEASUREMENT
/begin MEASUREMENT vRDRTQSP0 "Driver engine torque setpoint without engine brake part (output of torque setpoint map)" UWORD COMP_0345_S 1 100 -400 1647.96875 ECU_ADDRESS 0xFFFF3108 DISPLAY_IDENTIFIER Vxx_main_driv_tqe_sp /begin FUNCTION_LIST R102.3M.DRTQE_1_1_0 /end FUNCTION_LIST /end MEASUREMENT
/begin MEASUREMENT vRDTNFL_S "engine speed for driver torque setpoint calculation (Sub)" UWORD COMP_0443 1 100 0 65535 ECU_ADDRESS 0xFFFF3506 /begin FUNCTION_LIST R102.3P.DRTQE_1_0_2 /end FUNCTION_LIST /end MEASUREMENT
/begin MEASUREMENT vRDTQSP_S "real (pedal) and virtual (ACC/CC/SL) drivers Sub" UWORD COMP_0345_S 1 100 -400 1647.96875 ECU_ADDRESS 0xFFFF3508 /begin FUNCTION_LIST R102.3P.DRTQE_1_0_2 R301.21.SafetyLevel2_1_0_2 /end FUNCTION_LIST /end MEASUREMENT
/begin MEASUREMENT vRDTSP0_S "Driver engine torque setpoint without engine brake part (Sub)" UWORD COMP_0345_S 1 100 -400 1647.96875 ECU_ADDRESS 0xFFFF350A /begin FUNCTION_LIST R102.3P.DRTQE_1_0_2 /end FUNCTION_LIST /end MEASUREMENT
/begin MEASUREMENT vRECAMID "Access mode" UBYTE COMP_0004 1 100 0 255 ECU_ADDRESS 0xFFFF3E42 /begin FUNCTION_LIST KF7-580.1[8] /end FUNCTION_LIST /end MEASUREMENT
/begin MEASUREMENT vRECLID "RecordLocalIdentifier" UBYTE COMP_0068 1 100 0 255 ECU_ADDRESS 0xFFFF3E43 /begin FUNCTION_LIST KF7-580.1[8] /end FUNCTION_LIST /end MEASUREMENT
/begin MEASUREMENT vRECVAL "RecordValue" UBYTE COMP_0068 1 100 0 255 ECU_ADDRESS 0xFFFF3E44 /begin FUNCTION_LIST KF7-580.1[8] /end FUNCTION_LIST /end MEASUREMENT
/begin MEASUREMENT vREG01 "Engine speed" UWORD COMP_0443 1 100 0 65535 ECU_ADDRESS 0xFFFF8A52 DISPLAY_IDENTIFIER Vxx_n01
 /begin FUNCTION_LIST R000.1.RS_Integ_1_10_2 R101.3.aps_sftpd_1_1_4 R102.3M.DRTQE_1_1_0 R102.3P.DRTQE_1_0_2 R102.6.drv_pedlh_1_0_3 R103.1.lim_statl_1_0_1 R103.2.lim_gbxli_1_0_2 R106.2.epw_mxalt_1_1_0 R106.3.epw_palmx_1_1_0 R106.5.epw_ptcxx_1_1_0 R106.6.epw_slope_1_1_0 R106.7.epw_tqalt_1_1_0 R108.1.dls_gbrat_vmm_1_1_5 R203.1.crk_mngtx_1_2_1 R203.2.crk_restx_1_0_8 R901.1.Diag_on_can_app_1_6_2 Rxxx.1.Diagnostic_cycle_1_0_1 Rxxx.2.Integration_Diagnostic_cycle_1_1_1 /end FUNCTION_LIST
/end MEASUREMENT
/begin MEASUREMENT vREGRALOF "Idle Speed tuning target from Diagnostic tool" SBYTE COMP_0263 1 100 -128 127 ECU_ADDRESS 0xFFFF4964 /begin FUNCTION_LIST R000.1.RS_Integ_1_10_2 R901.1.Diag_on_can_app_1_6_2 /end FUNCTION_LIST /end MEASUREMENT
/begin MEASUREMENT vRENSTAT1 "RoutineEntryStatus" UBYTE COMP_0004 1 100 0 255 ECU_ADDRESS 0xFFFF3E45 /begin FUNCTION_LIST KF7-580.1[8] /end FUNCTION_LIST /end MEASUREMENT
/begin MEASUREMENT vRENTOPT1 "The indication of the control condition" UBYTE COMP_0004 1 100 0 255 ECU_ADDRESS 0xFFFF3E46 /begin FUNCTION_LIST KF7-580.1[8] /end FUNCTION_LIST /end MEASUREMENT
/begin MEASUREMENT vRENTOPT2 "Direction for the control practice" UBYTE COMP_0004 1 100 0 255 ECU_ADDRESS 0xFFFF3E47 /begin FUNCTION_LIST KF7-580.1[8] /end FUNCTION_LIST /end MEASUREMENT
/begin MEASUREMENT vRENTOPT3 "Direction for the control practice" UBYTE COMP_0004 1 100 0 255 ECU_ADDRESS 0xFFFF3E48 /begin FUNCTION_LIST KF7-580.1[8] /end FUNCTION_LIST /end MEASUREMENT
/begin MEASUREMENT vRESTCORM "Memorized fuel Injection Mass correction factor for Re-Start" UBYTE COMP_0068 1 100 0 255 ECU_ADDRESS 0xFFFFAF06 DISPLAY_IDENTIFIER Vxx_mem_rest_cor /begin FUNCTION_LIST R000.4.EepAlloc_1_2_2 R203.2.crk_restx_1_0_8 /end FUNCTION_LIST /end MEASUREMENT
/begin MEASUREMENT vRESTTWKM "Memorized engine coolant temperature" UBYTE COMP_0356 1 100 -40 119.375 ECU_ADDRESS 0xFFFFAF07 DISPLAY_IDENTIFIER Vxx_mem_rest_tco /begin FUNCTION_LIST R000.4.EepAlloc_1_2_2 R203.2.crk_restx_1_0_8 /end FUNCTION_LIST /end MEASUREMENT
/begin MEASUREMENT vRESTUFLC "Engine unflooding counter (engine stopped or running)" UBYTE COMP_0068 1 100 0 255 ECU_ADDRESS 0xFFFFAF08 DISPLAY_IDENTIFIER Vxx_rest_ufld_dly /begin FUNCTION_LIST R000.4.EepAlloc_1_2_2 R203.2.crk_restx_1_0_8 /end FUNCTION_LIST /end MEASUREMENT
/begin MEASUREMENT vRLHPDLSP "Powertrain setpoint (per cent) requested by accelerator pedal safety strategy" UWORD COMP_0451_S 1 100 0 81.91875 ECU_ADDRESS 0xFFFF3152 DISPLAY_IDENTIFIER Vxx_acel_pdl_lih_pwt_sp
 /begin FUNCTION_LIST R000.1.RS_Integ_1_10_2 R102.2M.DRARB_1_1_4 R102.6.drv_pedlh_1_0_3 /end FUNCTION_LIST
/end MEASUREMENT
/begin MEASUREMENT vRLHPSP_S "accelerator pedal safety strategy (Sub)" UWORD COMP_0451_S 1 100 0 81.91875 ECU_ADDRESS 0xFFFF350C /begin FUNCTION_LIST R000.1.RS_Integ_1_10_2 R102.2P.DRARB_1_0_2 /end FUNCTION_LIST /end MEASUREMENT
/begin MEASUREMENT vRLOCID "Local ID" UBYTE COMP_0004 1 100 0 255 ECU_ADDRESS 0xFFFF3156 /begin FUNCTION_LIST KF7-580.1[8] /end FUNCTION_LIST /end MEASUREMENT
/begin MEASUREMENT vRMAXAVTQ "Maximum effective engine torque" UWORD COMP_0345_S 1 100 -400 1647.96875 ECU_ADDRESS 0xFFFF421A DISPLAY_IDENTIFIER Vxx_max_avl_tqe
 /begin FUNCTION_LIST R000.1.RS_Integ_1_10_2 R103.1.lim_statl_1_0_1 R106.2.epw_mxalt_1_1_0 R106.5.epw_ptcxx_1_1_0 R901.1.Diag_on_can_app_1_6_2 /end FUNCTION_LIST
/end MEASUREMENT
/begin MEASUREMENT vRMAXFORC "Longitudinal force equivalent to a 100% accelerator pedal demand" UWORD COMP_0374_S 1 100 -20000 111070 ECU_ADDRESS 0xFFFF315C DISPLAY_IDENTIFIER Vxx_max_forc /begin FUNCTION_LIST R102.2M.DRARB_1_1_4 R208.6.SERVO_1_2_2 /end FUNCTION_LIST /end MEASUREMENT
/begin MEASUREMENT vRMINAVTQ "minimum available engine torque" UWORD COMP_0345_S 1 100 -400 1647.96875 ECU_ADDRESS 0xFFFF421C DISPLAY_IDENTIFIER Vxx_min_avl_tqe
 /begin FUNCTION_LIST R000.1.RS_Integ_1_10_2 R102.3M.DRTQE_1_1_0 R102.4M.DRLIM_1_1_0 R102.5M.ARBIT_1_1_0 R102.6.drv_pedlh_1_0_3 R103.1.lim_statl_1_0_1 R901.1.Diag_on_can_app_1_6_2 Rxxx.1.Diagnostic_cycle_1_0_1 /end FUNCTION_LIST
/end MEASUREMENT
/begin MEASUREMENT vRMINFORC "Longitudinal force equivalent to a 0% accelerator pedal demand" UWORD COMP_0374_S 1 100 -20000 111070 ECU_ADDRESS 0xFFFF315E DISPLAY_IDENTIFIER Vxx_min_forc /begin FUNCTION_LIST R102.2M.DRARB_1_1_4 R208.5.SETPT_1_1_0 R208.6.SERVO_1_2_2 /end FUNCTION_LIST /end MEASUREMENT
/begin MEASUREMENT vRMNATQ_S "minimum available engine torque (Sub)" UWORD COMP_0345_S 1 100 -400 1647.96875 ECU_ADDRESS 0xFFFF350E
 /begin FUNCTION_LIST R000.1.RS_Integ_1_10_2 R102.3P.DRTQE_1_0_2 R102.4P.DRLIM_1_0_2 R102.5P.ARBIT_1_0_2 /end FUNCTION_LIST
/end MEASUREMENT
/begin MEASUREMENT vRMNFRC_S "0% accelerator pedal demand (Sub)" UWORD COMP_0374_S 1 100 -20000 111070 ECU_ADDRESS 0xFFFF3510 /begin FUNCTION_LIST R102.2P.DRARB_1_0_2 /end FUNCTION_LIST /end MEASUREMENT
/begin MEASUREMENT vRMXFRC_S "100% accelerator pedal demand (Sub)" UWORD COMP_0374_S 1 100 -20000 111070 ECU_ADDRESS 0xFFFF3512 /begin FUNCTION_LIST R102.2P.DRARB_1_0_2 /end FUNCTION_LIST /end MEASUREMENT
/begin MEASUREMENT vRNPSFAIL "Idle speed setpoint for  Power-steering oil pressure sensor fail-safe " UBYTE COMP_0621_S 1 100 0 3187.5 ECU_ADDRESS 0xFFFF3160 /begin FUNCTION_LIST R000.1.RS_Integ_1_10_2 R107.1.iss_ariss_1_0_4 /end FUNCTION_LIST /end MEASUREMENT
/begin MEASUREMENT vRNSETB "Idle speed setpoint for  Brake Off at D range " UBYTE COMP_0621_S 1 100 0 3187.5 ECU_ADDRESS 0xFFFF3161 /begin FUNCTION_LIST R000.1.RS_Integ_1_10_2 R107.1.iss_ariss_1_0_4 /end FUNCTION_LIST /end MEASUREMENT
/begin MEASUREMENT vRNSETFS "Idle speed setpoint for  Failures " UBYTE COMP_0621_S 1 100 0 3187.5 ECU_ADDRESS 0xFFFF3162 /begin FUNCTION_LIST R000.1.RS_Integ_1_10_2 R107.1.iss_ariss_1_0_4 /end FUNCTION_LIST /end MEASUREMENT
/begin MEASUREMENT vRNSETH "Idle speed setpoint for  DIG homogeneous combustion mode " UBYTE COMP_0006 1 100 0 3187.5 ECU_ADDRESS 0xFFFF3163 /begin FUNCTION_LIST R000.1.RS_Integ_1_10_2 R107.1.iss_ariss_1_0_4 /end FUNCTION_LIST /end MEASUREMENT
/begin MEASUREMENT vRNSETHEA "Idle speed setpoint for  Engine Start at very hot condition " UBYTE COMP_0621_S 1 100 0 3187.5 ECU_ADDRESS 0xFFFF3164 /begin FUNCTION_LIST R000.1.RS_Integ_1_10_2 R107.1.iss_ariss_1_0_4 /end FUNCTION_LIST /end MEASUREMENT
/begin MEASUREMENT vRPDLFMFC "Interpolation factor between pedal progressivity maps (0 = map1, 1 = map2)" UBYTE COMP_0460_S 1 100 0 1.00000035 ECU_ADDRESS 0xFFFF3184 DISPLAY_IDENTIFIER Vxx_acel_pdl_fmt_fac /begin FUNCTION_LIST R102.1M.PEDFM_1_0_9 /end FUNCTION_LIST /end MEASUREMENT
/begin MEASUREMENT vRPFMFC_S "Interpolation factor between pedal progressivity maps (Sub)" UBYTE COMP_0460_S 1 100 0 1.00000035 ECU_ADDRESS 0xFFFF3514 /begin FUNCTION_LIST R102.1P.PEDFM_1_0_2 /end FUNCTION_LIST /end MEASUREMENT
/begin MEASUREMENT vRPIGREG "Idle speed setpoint for  Hot water and air temperature " UBYTE COMP_0621_S 1 100 0 3187.5 ECU_ADDRESS 0xFFFF318A /begin FUNCTION_LIST R000.1.RS_Integ_1_10_2 R107.1.iss_ariss_1_0_4 /end FUNCTION_LIST /end MEASUREMENT
/begin MEASUREMENT vRTEFRIC "engine torque losses (pumping and rubbing)" UWORD COMP_0345_S 1 100 -400 1647.96875 ECU_ADDRESS 0xFFFF319E DISPLAY_IDENTIFIER Vxx_raw_eng_tql /begin FUNCTION_LIST R000.1.RS_Integ_1_10_2 /end FUNCTION_LIST /end MEASUREMENT
/begin MEASUREMENT vRTENG "Estimated effective engine torque" UWORD COMP_0345_S 1 100 -400 1647.96875 ECU_ADDRESS 0xFFFF4220 DISPLAY_IDENTIFIER Vxx_esti_tqe
 /begin FUNCTION_LIST R000.1.RS_Integ_1_10_2 R204.1.CanComm_1_9_2 R301.13.FFDforDiagOnCAN_1_1_3 R901.1.Diag_on_can_app_1_6_2 /end FUNCTION_LIST
/end MEASUREMENT
/begin MEASUREMENT vRTFDACC "Driving force requested by Active Cruise Control" UWORD COMP_0374_S 1 100 -20000 111070 ECU_ADDRESS 0xFFFF31A0 DISPLAY_IDENTIFIER Vxx_acc_forc_sp
 /begin FUNCTION_LIST R000.1.RS_Integ_1_10_2 R102.2M.DRARB_1_1_4 R102.2P.DRARB_1_0_2 /end FUNCTION_LIST
/end MEASUREMENT
/begin MEASUREMENT vRTFDCC "Driving force requested by Cruise Control" UWORD COMP_0374_S 1 100 -20000 111070 ECU_ADDRESS 0xFFFF31A2 DISPLAY_IDENTIFIER Vxx_cru_forc_sp
 /begin FUNCTION_LIST R000.1.RS_Integ_1_10_2 R102.2M.DRARB_1_1_4 R102.2P.DRARB_1_0_2 R208.6.SERVO_1_2_2 R208.9.SAFETYX_1_3_2 /end FUNCTION_LIST
/end MEASUREMENT
/begin MEASUREMENT vRTFDSDL "Force value which is sent to driver force arbitration for SDL function" UWORD COMP_0374_S 1 100 -20000 111070 ECU_ADDRESS 0xFFFF31A6 DISPLAY_IDENTIFIER Vxx_sdl_forc_sp
 /begin FUNCTION_LIST R000.1.RS_Integ_1_10_2 R102.2M.DRARB_1_1_4 R102.2P.DRARB_1_0_2 /end FUNCTION_LIST
/end MEASUREMENT
/begin MEASUREMENT vRTFDSL "Driving force requested by Speed Limiter" UWORD COMP_0374_S 1 100 -20000 111070 ECU_ADDRESS 0xFFFF31A8 DISPLAY_IDENTIFIER Vxx_sl_forc_sp
 /begin FUNCTION_LIST R000.1.RS_Integ_1_10_2 R102.2M.DRARB_1_1_4 R102.2P.DRARB_1_0_2 R208.6.SERVO_1_2_2 R208.9.SAFETYX_1_3_2 /end FUNCTION_LIST
/end MEASUREMENT
/begin MEASUREMENT vRTFRIC "engine torque losses" UWORD COMP_0345_S 1 100 -400 1647.96875 ECU_ADDRESS 0xFFFF4222 DISPLAY_IDENTIFIER Vxx_eng_tql
 /begin FUNCTION_LIST R000.1.RS_Integ_1_10_2 R204.1.CanComm_1_9_2 R901.1.Diag_on_can_app_1_6_2 /end FUNCTION_LIST
/end MEASUREMENT
/begin MEASUREMENT vRTHOKI "Torque losses due to accessories" UWORD COMP_0345_S 1 100 -400 1647.96875 ECU_ADDRESS 0xFFFF31AC DISPLAY_IDENTIFIER Vxx_aux_tql_sp /begin FUNCTION_LIST R000.1.RS_Integ_1_10_2 /end FUNCTION_LIST /end MEASUREMENT
/begin MEASUREMENT vRTPACC_S "Powertrain setpoint (per cent) requested by ACC (Sub)" UWORD COMP_0451_S 1 100 0 81.91875 ECU_ADDRESS 0xFFFF3516 /begin FUNCTION_LIST R102.2P.DRARB_1_0_2 /end FUNCTION_LIST /end MEASUREMENT
/begin MEASUREMENT vRTPCC_S "Powertrain setpoint (per cent) requested by Cruise Control (Sub)" UWORD COMP_0451_S 1 100 0 81.91875 ECU_ADDRESS 0xFFFF3518 /begin FUNCTION_LIST R102.2P.DRARB_1_0_2 /end FUNCTION_LIST /end MEASUREMENT
/begin MEASUREMENT vRTPSDL_S "Powertrain setpoint (per cent) requested by SDL (Sub)" UWORD COMP_0451_S 1 100 0 81.91875 ECU_ADDRESS 0xFFFF351A /begin FUNCTION_LIST R102.2P.DRARB_1_0_2 /end FUNCTION_LIST /end MEASUREMENT
/begin MEASUREMENT vRTPSL_S "Powertrain setpoint (per cent) requested by Speed Limiter (Sub)" UWORD COMP_0451_S 1 100 0 81.91875 ECU_ADDRESS 0xFFFF351C /begin FUNCTION_LIST R102.2P.DRARB_1_0_2 /end FUNCTION_LIST /end MEASUREMENT
/begin MEASUREMENT vRTPWACC "Powertrain setpoint (per cent) requested by ACC" UWORD COMP_0451_S 1 100 0 81.91875 ECU_ADDRESS 0xFFFF31AE DISPLAY_IDENTIFIER Vxx_acc_pwt_sp /begin FUNCTION_LIST R102.2M.DRARB_1_1_4 /end FUNCTION_LIST /end MEASUREMENT
/begin MEASUREMENT vRTPWCC "Powertrain setpoint (per cent) requested by Cruise Control" UWORD COMP_0451_S 1 100 0 81.91875 ECU_ADDRESS 0xFFFF31B0 DISPLAY_IDENTIFIER Vxx_cru_pwt_sp /begin FUNCTION_LIST R102.2M.DRARB_1_1_4 /end FUNCTION_LIST /end MEASUREMENT
/begin MEASUREMENT vRTPWSDL "Powertrain setpoint (per cent) requested by SDL (Speed and distance limiter function located in ACC)" UWORD COMP_0451_S 1 100 0 81.91875 ECU_ADDRESS 0xFFFF31B2 DISPLAY_IDENTIFIER Vxx_sdl_pwt_sp /begin FUNCTION_LIST R102.2M.DRARB_1_1_4 /end FUNCTION_LIST /end MEASUREMENT
/begin MEASUREMENT vRTPWSL "Powertrain setpoint (per cent) requested by Speed Limiter" UWORD COMP_0451_S 1 100 0 81.91875 ECU_ADDRESS 0xFFFF31B4 DISPLAY_IDENTIFIER Vxx_sl_pwt_sp /begin FUNCTION_LIST R102.2M.DRARB_1_1_4 /end FUNCTION_LIST /end MEASUREMENT
/begin MEASUREMENT vRTTEP "Torque Target (SLOW torque)" UWORD COMP_0345_S 1 100 -400 1647.96875 ECU_ADDRESS 0xFFFF4226 DISPLAY_IDENTIFIER Vxx_arb_tqe_tgt
 /begin FUNCTION_LIST R000.1.RS_Integ_1_10_2 R102.5M.ARBIT_1_1_0 R301.13.FFDforDiagOnCAN_1_1_3 R301.21.SafetyLevel2_1_0_2 R901.1.Diag_on_can_app_1_6_2 /end FUNCTION_LIST
/end MEASUREMENT
/begin MEASUREMENT vRTTEPFST "Torque Setpoint (FAST torque)" UWORD COMP_0345_S 1 100 -400 1647.96875 ECU_ADDRESS 0xFFFF4228 DISPLAY_IDENTIFIER Vxx_arb_tqe_sp
 /begin FUNCTION_LIST R000.1.RS_Integ_1_10_2 R102.5M.ARBIT_1_1_0 R901.1.Diag_on_can_app_1_6_2 /end FUNCTION_LIST
/end MEASUREMENT
/begin MEASUREMENT vRTTEPRAW "Slow torque without AT request and without anti-jerk." UWORD COMP_0345_S 1 100 -400 1647.96875 ECU_ADDRESS 0xFFFF422A DISPLAY_IDENTIFIER Vxx_arb_tqe_raw /begin FUNCTION_LIST R102.5M.ARBIT_1_1_0 R901.1.Diag_on_can_app_1_6_2 /end FUNCTION_LIST /end MEASUREMENT
/begin MEASUREMENT vRTTEP_S "Torque Target (SLOW torque) (Sub)" UWORD COMP_0345_S 1 100 -400 1647.96875 ECU_ADDRESS 0xFFFF351E /begin FUNCTION_LIST R102.5P.ARBIT_1_0_2 R301.21.SafetyLevel2_1_0_2 /end FUNCTION_LIST /end MEASUREMENT
/begin MEASUREMENT vSCVSTPDL "SCV target open-degree (the left bank)" UWORD COMP_0140 1 100 0 32767.5 ECU_ADDRESS 0xFFFF31C4 /begin FUNCTION_LIST KF7-580.1[8] /end FUNCTION_LIST /end MEASUREMENT
/begin MEASUREMENT vSDLCTYP "ACC control type Acquired on CAN" UBYTE COMP_0068 1 100 0 255 ECU_ADDRESS 0xFFFF496C DISPLAY_IDENTIFIER Vsx_mux_acc_sdl_ctl_typ /begin FUNCTION_LIST R101.3.aps_sftpd_1_1_4 R204.1.CanComm_1_9_2 /end FUNCTION_LIST /end MEASUREMENT
/begin MEASUREMENT vSTAGE "FFD reading and writing stage" UBYTE COMP_0004 1 100 0 255 ECU_ADDRESS 0xFFFF3202 /begin FUNCTION_LIST KF7-580.1[8] /end FUNCTION_LIST /end MEASUREMENT
/begin MEASUREMENT vSWMONT "SW monitor" UBYTE COMP_0004 1 100 0 255 ECU_ADDRESS 0xFFFF326A /begin FUNCTION_LIST KF7-580.1[8] /end FUNCTION_LIST /end MEASUREMENT
/begin MEASUREMENT vSWMONT_R#1 "SW monitor" UBYTE COMP_0004 1 100 0 255 ECU_ADDRESS 0xFFFF326A /begin FUNCTION_LIST KF7-580.1[8] /end FUNCTION_LIST /end MEASUREMENT
/begin MEASUREMENT vSWMONT_R#2 "SW monitor" UBYTE COMP_0004 1 100 0 255 ECU_ADDRESS 0xFFFF326B /begin FUNCTION_LIST KF7-580.1[8] /end FUNCTION_LIST /end MEASUREMENT
/begin MEASUREMENT vSWMONT_R#3 "SW monitor" UBYTE COMP_0004 1 100 0 255 ECU_ADDRESS 0xFFFF326C /begin FUNCTION_LIST KF7-580.1[8] /end FUNCTION_LIST /end MEASUREMENT
/begin MEASUREMENT vSWMONT_R#4 "SW monitor" UBYTE COMP_0004 1 100 0 255 ECU_ADDRESS 0xFFFF326D /begin FUNCTION_LIST KF7-580.1[8] /end FUNCTION_LIST /end MEASUREMENT
/begin MEASUREMENT vSWMONT_R#5 "SW monitor" UBYTE COMP_0004 1 100 0 255 ECU_ADDRESS 0xFFFF326E /begin FUNCTION_LIST KF7-580.1[8] /end FUNCTION_LIST /end MEASUREMENT
/begin MEASUREMENT vTEGR "EGR temperature" UBYTE COMP_0035 1 100 -50 205 ECU_ADDRESS 0xFFFF497B /begin FUNCTION_LIST KF7-580.1[8] /end FUNCTION_LIST /end MEASUREMENT
/begin MEASUREMENT vTFCNT "Fuel temperature sensor diagnosis diagnosis complete counter" UWORD COMP_0016 1 100 0 65535 ECU_ADDRESS 0xFFFFB242 /begin FUNCTION_LIST KF7-580.1[8] /end FUNCTION_LIST /end MEASUREMENT
/begin MEASUREMENT vTFINT "At the time of the start, fuel temperature" UBYTE COMP_0035 1 100 -50 205 ECU_ADDRESS 0xFFFF88A7 /begin FUNCTION_LIST KF7-580.1[8] /end FUNCTION_LIST /end MEASUREMENT
/begin MEASUREMENT vTFN "Fuel temperature" UBYTE COMP_0035 1 100 -50 205 ECU_ADDRESS 0xFFFF88A8 /begin FUNCTION_LIST KF7-580.1[8] /end FUNCTION_LIST /end MEASUREMENT
/begin MEASUREMENT vTMEVCN "Diagnosis prohibition timer" UWORD COMP_0013 1 100 0 65535 ECU_ADDRESS 0xFFFF3344 /begin FUNCTION_LIST KF7-580.1[8] /end FUNCTION_LIST /end MEASUREMENT
/begin MEASUREMENT vTMEVP1 "After the start, diagnosis prohibition timer" UBYTE COMP_0096 1 100 0 2550 ECU_ADDRESS 0xFFFF1946 /begin FUNCTION_LIST KF7-580.1[8] /end FUNCTION_LIST /end MEASUREMENT
/begin MEASUREMENT vTSd "Invalid pulse width" UWORD COMP_0325 1 100 -52428.8 52427.2 ECU_ADDRESS 0xFFFF19CE /begin FUNCTION_LIST KF7-580.1[8] /end FUNCTION_LIST /end MEASUREMENT
/begin MEASUREMENT vTTEDFS_S "Final Torque Target after Inverse filter (Sub)" UWORD COMP_0345_S 1 100 -400 1647.96875 ECU_ADDRESS 0xFFFF352C /begin FUNCTION_LIST R000.1.RS_Integ_1_10_2 R102.5P.ARBIT_1_0_2 /end FUNCTION_LIST /end MEASUREMENT
/begin MEASUREMENT vTTEDIFF "Final torque setpoint after Inverse filter" UWORD COMP_0345_S 1 100 -400 1647.96875 ECU_ADDRESS 0xFFFF3400 DISPLAY_IDENTIFIER Vxx_ajs_modu_tqe_sp /begin FUNCTION_LIST R000.1.RS_Integ_1_10_2 R102.5M.ARBIT_1_1_0 /end FUNCTION_LIST /end MEASUREMENT
/begin MEASUREMENT vTTEDIFS "Final Torque Target after Inverse filter" UWORD COMP_0345_S 1 100 -400 1647.96875 ECU_ADDRESS 0xFFFF3402 DISPLAY_IDENTIFIER Vxx_ajs_modu_tqe_tgt /begin FUNCTION_LIST R000.1.RS_Integ_1_10_2 R102.5M.ARBIT_1_1_0 /end FUNCTION_LIST /end MEASUREMENT
/begin MEASUREMENT vTTEPDF_S "real (pedal) and virtual (ACC/CC/SL) drivers Sub" UWORD COMP_0345_S 1 100 -400 1647.96875 ECU_ADDRESS 0xFFFF3532 /begin FUNCTION_LIST R102.4P.DRLIM_1_0_2 /end FUNCTION_LIST /end MEASUREMENT
/begin MEASUREMENT vTTEPDIFD "Inverse filter input PTD torque (FAST)" SWORD COMP_0228 1 100 -3276.8 3276.7 ECU_ADDRESS 0xFFFF19F0 /begin FUNCTION_LIST R000.1.RS_Integ_1_10_2 /end FUNCTION_LIST /end MEASUREMENT
/begin MEASUREMENT vTTEPDIFF "Effective engine torque setpoint requested by real (pedal) and virtual (ACC/CC/SL) drivers" UWORD COMP_0345_S 1 100 -400 1647.96875 ECU_ADDRESS 0xFFFF4256 DISPLAY_IDENTIFIER Vxx_lim_driv_tqe_sp
 /begin FUNCTION_LIST R000.1.RS_Integ_1_10_2 R102.4M.DRLIM_1_1_0 R901.1.Diag_on_can_app_1_6_2 /end FUNCTION_LIST
/end MEASUREMENT
/begin MEASUREMENT vTTEPDIFS "Effective engine torque target requested by real (pedal) and virtual (ACC/CC/SL) drivers" UWORD COMP_0345_S 1 100 -400 1647.96875 ECU_ADDRESS 0xFFFF4258 DISPLAY_IDENTIFIER Vxx_lim_driv_tqe_tgt
 /begin FUNCTION_LIST R000.1.RS_Integ_1_10_2 R102.4M.DRLIM_1_1_0 R102.5M.ARBIT_1_1_0 R106.2.epw_mxalt_1_1_0 R106.5.epw_ptcxx_1_1_0 R204.1.CanComm_1_9_2 R901.1.Diag_on_can_app_1_6_2 /end FUNCTION_LIST
/end MEASUREMENT
/begin MEASUREMENT vTTEPDS_S "real (pedal) and virtual (ACC/CC/SL) drivers Sub" UWORD COMP_0345_S 1 100 -400 1647.96875 ECU_ADDRESS 0xFFFF3534 /begin FUNCTION_LIST R000.1.RS_Integ_1_10_2 R102.4P.DRLIM_1_0_2 /end FUNCTION_LIST /end MEASUREMENT
/begin MEASUREMENT vTTEVDLY "After the start, time measuring timer" UBYTE COMP_0096 1 100 0 2550 ECU_ADDRESS 0xFFFF3406 /begin FUNCTION_LIST KF7-580.1[8] /end FUNCTION_LIST /end MEASUREMENT
/begin MEASUREMENT vTVOV20M "Throttle sensor voltage" UBYTE COMP_0054 1 100 0 5100 ECU_ADDRESS 0xFFFF1F4E /begin FUNCTION_LIST KF7-580.1[8] /end FUNCTION_LIST /end MEASUREMENT
/begin MEASUREMENT vTVTOIL "Oil temperature" UBYTE COMP_0035 1 100 -50 205 ECU_ADDRESS 0xFFFF89D6 /begin FUNCTION_LIST KF7-580.1[8] /end FUNCTION_LIST /end MEASUREMENT
/begin MEASUREMENT vTWMINISS "Nominal idle speed setpoint" UWORD COMP_0337_S 1 100 0 65535 ECU_ADDRESS 0xFFFF3430 DISPLAY_IDENTIFIER Vxx_tco_min_is_n
 /begin FUNCTION_LIST R000.1.RS_Integ_1_10_2 R107.1.iss_ariss_1_0_4 R107.2.iss_atiss_1_0_2 /end FUNCTION_LIST
/end MEASUREMENT
/begin MEASUREMENT vUID "UID" UWORD COMP_0068 1 100 0 65535 ECU_ADDRESS 0xFFFF3FAC /begin FUNCTION_LIST KF7-580.1[8] /end FUNCTION_LIST /end MEASUREMENT
/begin MEASUREMENT vVBELISS "Filtered battery voltage" UWORD COMP_0492 1 100 0 65535 ECU_ADDRESS 0xFFFF344A DISPLAY_IDENTIFIER Vxx_mv_vb /begin FUNCTION_LIST R000.1.RS_Integ_1_10_2 R107.3.iss_eliss_1_0_4 /end FUNCTION_LIST /end MEASUREMENT
/begin MEASUREMENT vVSPASCCN "An ASCD vehicle speed for the CONSULT" SWORD COMP_0184_S 1 100 -1843.2 1843.14375 ECU_ADDRESS 0xFFFF3464 /begin FUNCTION_LIST KF7-580.1[8] /end FUNCTION_LIST /end MEASUREMENT
/begin MEASUREMENT vVSPCMNCN "Vehicle speed order value for the CONSULT" SWORD COMP_0184_S 1 100 -1843.2 1843.14375 ECU_ADDRESS 0xFFFF3474 /begin FUNCTION_LIST KF7-580.1[8] /end FUNCTION_LIST /end MEASUREMENT
/begin MEASUREMENT vVSSFCHK "Vehicle speed" UWORD COMP_0375_S 1 100 0 655.35 ECU_ADDRESS 0xFFFF89E6 DISPLAY_IDENTIFIER Vxx_vs
 /begin FUNCTION_LIST R000.1.RS_Integ_1_10_2 R101.3.aps_sftpd_1_1_4 R102.1M.PEDFM_1_0_9 R102.1P.PEDFM_1_0_2 R102.2M.DRARB_1_1_4 R102.2P.DRARB_1_0_2 R102.6.drv_pedlh_1_0_3 R106.1.epw_altxx_1_1_0 R106.2.epw_mxalt_1_1_0 R106.3.epw_palmx_1_1_0 R106.4.epw_paltx_1_1_0 R106.5.epw_ptcxx_1_1_0 R106.6.epw_slope_1_1_0 R106.7.epw_tqalt_1_1_0 R108.1.dls_gbrat_vmm_1_1_5 R204.1.CanComm_1_9_2 R301.12.ClutchSwDiag_1_0_1 R301.13.FFDforDiagOnCAN_1_1_3 R901.1.Diag_on_can_app_1_6_2 /end FUNCTION_LIST
/end MEASUREMENT
/begin MEASUREMENT vVTCDUTYE "Clutch solenoid drive DUTY ratio" UWORD COMP_0447 1 100 0 6399.90234375 ECU_ADDRESS 0xFFFF1AF8 /begin FUNCTION_LIST KF7-580.1[8] /end FUNCTION_LIST /end MEASUREMENT
/begin MEASUREMENT vVTCDUTYE_R#1 "Clutch solenoid drive DUTY ratio" UWORD COMP_0447 1 100 0 6399.90234375 ECU_ADDRESS 0xFFFF1AF8 /begin FUNCTION_LIST KF7-580.1[8] /end FUNCTION_LIST /end MEASUREMENT
/begin MEASUREMENT vVTCDUTYE_R#2 "Clutch solenoid drive DUTY ratio" UWORD COMP_0447 1 100 0 6399.90234375 ECU_ADDRESS 0xFFFF1AFA /begin FUNCTION_LIST KF7-580.1[8] /end FUNCTION_LIST /end MEASUREMENT
/begin MEASUREMENT vVTCDUTYI "Clutch solenoid drive DUTY ratio" UWORD COMP_0447 1 100 0 6399.90234375 ECU_ADDRESS 0xFFFF1AFC /begin FUNCTION_LIST KF7-580.1[8] /end FUNCTION_LIST /end MEASUREMENT
/begin MEASUREMENT vVTCDUTYI_R#1 "Clutch solenoid drive DUTY ratio" UWORD COMP_0447 1 100 0 6399.90234375 ECU_ADDRESS 0xFFFF1AFC /begin FUNCTION_LIST KF7-580.1[8] /end FUNCTION_LIST /end MEASUREMENT
/begin MEASUREMENT vVTCDUTYI_R#2 "Clutch solenoid drive DUTY ratio" UWORD COMP_0447 1 100 0 6399.90234375 ECU_ADDRESS 0xFFFF1AFE /begin FUNCTION_LIST KF7-580.1[8] /end FUNCTION_LIST /end MEASUREMENT
/begin MEASUREMENT vVTCNOWE "VTC operation angle (exhaust)" UBYTE COMP_0256 1 100 -64 63.5 ECU_ADDRESS 0xFFFF1044 /begin FUNCTION_LIST KF7-580.1[8] /end FUNCTION_LIST /end MEASUREMENT
/begin MEASUREMENT vVTCNOWE_R#1 "VTC operation angle (exhaust)" UBYTE COMP_0256 1 100 -64 63.5 ECU_ADDRESS 0xFFFF1044 /begin FUNCTION_LIST KF7-580.1[8] /end FUNCTION_LIST /end MEASUREMENT
/begin MEASUREMENT vVTCNOWE_R#2 "VTC operation angle (exhaust)" UBYTE COMP_0256 1 100 -64 63.5 ECU_ADDRESS 0xFFFF1045 /begin FUNCTION_LIST KF7-580.1[8] /end FUNCTION_LIST /end MEASUREMENT
/begin MEASUREMENT vVTCTRGE "VTC target angle (exhaust)" UBYTE COMP_0256 1 100 -64 63.5 ECU_ADDRESS 0xFFFF1049 /begin FUNCTION_LIST KF7-580.1[8] /end FUNCTION_LIST /end MEASUREMENT
/begin MEASUREMENT vVTERI "After VTCTRGI=0degCA, progress timer" UBYTE COMP_0014 1 100 0 2550 ECU_ADDRESS 0xFFFF1BE5 /begin FUNCTION_LIST KF7-580.1[8] /end FUNCTION_LIST /end MEASUREMENT
/begin MEASUREMENT vVXXGEAR "Gear engaged (-1 0 1 2 3 4 5 6)" SBYTE COMP_0263 1 100 -128 127 ECU_ADDRESS 0xFFFF4272 DISPLAY_IDENTIFIER Vsx_gear
 /begin FUNCTION_LIST R000.1.RS_Integ_1_10_2 R102.6.drv_pedlh_1_0_3 R103.2.lim_gbxli_1_0_2 R108.1.dls_gbrat_vmm_1_1_5 R208.3.GRBOX_1_2_2 R301.12.ClutchSwDiag_1_0_1 R301.13.FFDforDiagOnCAN_1_1_3 R901.1.Diag_on_can_app_1_6_2 /end FUNCTION_LIST
/end MEASUREMENT
/begin MEASUREMENT vVXXGEARD "Gear engaged (-1 0 1 2 3 4 5 6) with delay" SBYTE COMP_0263 1 100 -128 127 ECU_ADDRESS 0xFFFF34BE /begin FUNCTION_LIST R000.1.RS_Integ_1_10_2 R107.1.iss_ariss_1_0_4 /end FUNCTION_LIST /end MEASUREMENT
/begin MEASUREMENT vWDLID "Local ID" UBYTE COMP_0004 1 100 0 255 ECU_ADDRESS 0xFFFF400C /begin FUNCTION_LIST KF7-580.1[8] /end FUNCTION_LIST /end MEASUREMENT
/begin MEASUREMENT vfLJUDGEE "Lean judgement flag (0 : It is 1:Lean which is not Lean.)" UBYTE COMP_0283 1 100 0 255 ECU_ADDRESS 0xFFFF41F6 /begin FUNCTION_LIST KF7-580.1[8] /end FUNCTION_LIST /end MEASUREMENT
/begin MEASUREMENT vfLJUDGEE_R#1 "Lean judgement flag (0 : It is 1:Lean which is not Lean.)" UBYTE COMP_0283 1 100 0 255 ECU_ADDRESS 0xFFFF41F6 /begin FUNCTION_LIST KF7-580.1[8] /end FUNCTION_LIST /end MEASUREMENT
/begin MEASUREMENT vfLJUDGEE_R#2 "Lean judgement flag (0 : It is 1:Lean which is not Lean.)" UBYTE COMP_0283 1 100 0 255 ECU_ADDRESS 0xFFFF41F7 /begin FUNCTION_LIST KF7-580.1[8] /end FUNCTION_LIST /end MEASUREMENT
/begin MEASUREMENT vfRJUDGEE "Rich judgement flag (0 : It is 1:Rich which is not Rich.)" UBYTE COMP_0283 1 100 0 255 ECU_ADDRESS 0xFFFF41F8 /begin FUNCTION_LIST KF7-580.1[8] /end FUNCTION_LIST /end MEASUREMENT
/begin MEASUREMENT vfRJUDGEE_R#1 "Rich judgement flag (0 : It is 1:Rich which is not Rich.)" UBYTE COMP_0283 1 100 0 255 ECU_ADDRESS 0xFFFF41F8 /begin FUNCTION_LIST KF7-580.1[8] /end FUNCTION_LIST /end MEASUREMENT
/begin MEASUREMENT vfRJUDGEE_R#2 "Rich judgement flag (0 : It is 1:Rich which is not Rich.)" UBYTE COMP_0283 1 100 0 255 ECU_ADDRESS 0xFFFF41F9 /begin FUNCTION_LIST KF7-580.1[8] /end FUNCTION_LIST /end MEASUREMENT
/begin MEASUREMENT wvAVEPF "Fuel pressure weighted average value" UWORD COMP_0164 1 100 0 19.988175 ECU_ADDRESS 0xFFFF8848 /begin FUNCTION_LIST KF7-580.1[8] /end FUNCTION_LIST /end MEASUREMENT
/begin MEASUREMENT wvBATSEN "Battery electric current sensor output voltage" UWORD COMP_0023 1 100 0 327675 ECU_ADDRESS 0xFFFF88EE /begin FUNCTION_LIST KF7-580.1[8] /end FUNCTION_LIST /end MEASUREMENT
/begin MEASUREMENT wvDRV "FRCM D/R voltage" UBYTE COMP_0118 1 100 0 10200 ECU_ADDRESS 0xFFFF88F8 /begin FUNCTION_LIST KF7-580.1[8] /end FUNCTION_LIST /end MEASUREMENT
/begin MEASUREMENT wvTEGR "EGR temperature" UBYTE COMP_0035 1 100 -50 205 ECU_ADDRESS 0xFFFF4879 /begin FUNCTION_LIST KF7-580.1[8] /end FUNCTION_LIST /end MEASUREMENT
/begin MEASUREMENT wvTFINT "At the time of the start, fuel temperature" UBYTE COMP_0035 1 100 -50 205 ECU_ADDRESS 0xFFFF889B /begin FUNCTION_LIST KF7-580.1[8] /end FUNCTION_LIST /end MEASUREMENT
/begin MEASUREMENT wvTFN "Fuel temperature" UBYTE COMP_0035 1 100 -50 205 ECU_ADDRESS 0xFFFF889C /begin FUNCTION_LIST KF7-580.1[8] /end FUNCTION_LIST /end MEASUREMENT
/begin MEASUREMENT wvTVTOIL "Oil temperature" UBYTE COMP_0035 1 100 -50 205 ECU_ADDRESS 0xFFFF894A /begin FUNCTION_LIST KF7-580.1[8] /end FUNCTION_LIST /end MEASUREMENT
/begin MEASUREMENT APSC "RAM value APSC" UBYTE COMP_0068 1 100 0 255 ECU_ADDRESS 0xFFFF9E07
 /begin FUNCTION_LIST R000.3.RS_SelfDiagflags_1_1_2 R902.1.SafetyDiagManager_1_3_6 /end FUNCTION_LIST
/end MEASUREMENT
/begin MEASUREMENT APSOC1 "RAM value APSOC1" UBYTE COMP_0068 1 100 0 255 ECU_ADDRESS 0xFFFF9E0A
 /begin FUNCTION_LIST R000.1.RS_Integ_1_10_2 R000.3.RS_SelfDiagflags_1_1_2 R000.5.DataCompSpec_1_0_2 R902.1.SafetyDiagManager_1_3_6 /end FUNCTION_LIST
/end MEASUREMENT
/begin MEASUREMENT APSSC1 "RAM value APSSC1" UBYTE COMP_0068 1 100 0 255 ECU_ADDRESS 0xFFFF9E0D
 /begin FUNCTION_LIST R000.1.RS_Integ_1_10_2 R000.3.RS_SelfDiagflags_1_1_2 R000.5.DataCompSpec_1_0_2 R902.1.SafetyDiagManager_1_3_6 /end FUNCTION_LIST
/end MEASUREMENT
/begin MEASUREMENT APSOC2 "RAM value APSOC2" UBYTE COMP_0068 1 100 0 255 ECU_ADDRESS 0xFFFF9E10
 /begin FUNCTION_LIST R000.1.RS_Integ_1_10_2 R000.3.RS_SelfDiagflags_1_1_2 R000.5.DataCompSpec_1_0_2 R902.1.SafetyDiagManager_1_3_6 /end FUNCTION_LIST
/end MEASUREMENT
/begin MEASUREMENT APSSC2 "RAM value APSSC2" UBYTE COMP_0068 1 100 0 255 ECU_ADDRESS 0xFFFF9E13
 /begin FUNCTION_LIST R000.1.RS_Integ_1_10_2 R000.3.RS_SelfDiagflags_1_1_2 R000.5.DataCompSpec_1_0_2 R902.1.SafetyDiagManager_1_3_6 /end FUNCTION_LIST
/end MEASUREMENT
/begin MEASUREMENT AP12 "RAM value AP12" UBYTE COMP_0068 1 100 0 255 ECU_ADDRESS 0xFFFF9E16
 /begin FUNCTION_LIST R000.3.RS_SelfDiagflags_1_1_2 R902.1.SafetyDiagManager_1_3_6 /end FUNCTION_LIST
/end MEASUREMENT
/begin MEASUREMENT APCHR "RAM value APCHR" UBYTE COMP_0068 1 100 0 255 ECU_ADDRESS 0xFFFF9E19
 /begin FUNCTION_LIST R000.1.RS_Integ_1_10_2 R000.3.RS_SelfDiagflags_1_1_2 R000.5.DataCompSpec_1_0_2 R902.1.SafetyDiagManager_1_3_6 /end FUNCTION_LIST
/end MEASUREMENT
/begin MEASUREMENT APSC1 "RAM value APSC1" UBYTE COMP_0068 1 100 0 255 ECU_ADDRESS 0xFFFF9E1C
 /begin FUNCTION_LIST R000.3.RS_SelfDiagflags_1_1_2 R902.1.SafetyDiagManager_1_3_6 /end FUNCTION_LIST
/end MEASUREMENT
/begin MEASUREMENT AVCC1 "RAM value AVCC1" UBYTE COMP_0068 1 100 0 255 ECU_ADDRESS 0xFFFF9E1F
 /begin FUNCTION_LIST R000.1.RS_Integ_1_10_2 R000.3.RS_SelfDiagflags_1_1_2 R902.1.SafetyDiagManager_1_3_6 /end FUNCTION_LIST
/end MEASUREMENT
/begin MEASUREMENT AVCC2 "RAM value AVCC2" UBYTE COMP_0068 1 100 0 255 ECU_ADDRESS 0xFFFF9E22
 /begin FUNCTION_LIST R000.1.RS_Integ_1_10_2 R000.3.RS_SelfDiagflags_1_1_2 R902.1.SafetyDiagManager_1_3_6 /end FUNCTION_LIST
/end MEASUREMENT
/begin MEASUREMENT PRSSC "RAM value PRSSC" UBYTE COMP_0068 1 100 0 255 ECU_ADDRESS 0xFFFF9E25
 /begin FUNCTION_LIST R000.3.RS_SelfDiagflags_1_1_2 R901.1.Diag_on_can_app_1_6_2 R902.1.SafetyDiagManager_1_3_6 /end FUNCTION_LIST
/end MEASUREMENT
/begin MEASUREMENT PRSOC "RAM value PRSOC" UBYTE COMP_0068 1 100 0 255 ECU_ADDRESS 0xFFFF9E28
 /begin FUNCTION_LIST R000.3.RS_SelfDiagflags_1_1_2 R901.1.Diag_on_can_app_1_6_2 R902.1.SafetyDiagManager_1_3_6 /end FUNCTION_LIST
/end MEASUREMENT
/begin MEASUREMENT UPCRCV "RAM value UPCRCV" UBYTE COMP_0068 1 100 0 255 ECU_ADDRESS 0xFFFF9E2B
 /begin FUNCTION_LIST R000.3.RS_SelfDiagflags_1_1_2 R902.1.SafetyDiagManager_1_3_6 /end FUNCTION_LIST
/end MEASUREMENT
/begin MEASUREMENT APMUX "RAM value APMUX" UBYTE COMP_0068 1 100 0 255 ECU_ADDRESS 0xFFFF9E2E
 /begin FUNCTION_LIST R000.3.RS_SelfDiagflags_1_1_2 R902.1.SafetyDiagManager_1_3_6 /end FUNCTION_LIST
/end MEASUREMENT
/begin MEASUREMENT ESPLNK "RAM value ESPLNK" UBYTE COMP_0068 1 100 0 255 ECU_ADDRESS 0xFFFF9E31
 /begin FUNCTION_LIST R000.3.RS_SelfDiagflags_1_1_2 R902.1.SafetyDiagManager_1_3_6 /end FUNCTION_LIST
/end MEASUREMENT
/begin MEASUREMENT AGBLNK "RAM value AGBLNK" UBYTE COMP_0068 1 100 0 255 ECU_ADDRESS 0xFFFF9E34
 /begin FUNCTION_LIST R000.3.RS_SelfDiagflags_1_1_2 R902.1.SafetyDiagManager_1_3_6 /end FUNCTION_LIST
/end MEASUREMENT
/begin MEASUREMENT AGBCLK "RAM value AGBCLK" UBYTE COMP_0068 1 100 0 255 ECU_ADDRESS 0xFFFF9E37
 /begin FUNCTION_LIST R000.3.RS_SelfDiagflags_1_1_2 R902.1.SafetyDiagManager_1_3_6 /end FUNCTION_LIST
/end MEASUREMENT
/begin MEASUREMENT ESPCPL "RAM value ESPCPL" UBYTE COMP_0068 1 100 0 255 ECU_ADDRESS 0xFFFF9E3A
 /begin FUNCTION_LIST R000.3.RS_SelfDiagflags_1_1_2 R902.1.SafetyDiagManager_1_3_6 /end FUNCTION_LIST
/end MEASUREMENT
/begin MEASUREMENT ESPCLK "RAM value ESPCLK" UBYTE COMP_0068 1 100 0 255 ECU_ADDRESS 0xFFFF9E3D
 /begin FUNCTION_LIST R000.3.RS_SelfDiagflags_1_1_2 R902.1.SafetyDiagManager_1_3_6 /end FUNCTION_LIST
/end MEASUREMENT
/begin MEASUREMENT AGBDLY "RAM value AGBDLY" UBYTE COMP_0068 1 100 0 255 ECU_ADDRESS 0xFFFF9E40
 /begin FUNCTION_LIST R000.3.RS_SelfDiagflags_1_1_2 R902.1.SafetyDiagManager_1_3_6 /end FUNCTION_LIST
/end MEASUREMENT
/begin MEASUREMENT AGBINT "RAM value AGBINT" UBYTE COMP_0068 1 100 0 255 ECU_ADDRESS 0xFFFF9E43
 /begin FUNCTION_LIST R000.3.RS_SelfDiagflags_1_1_2 R902.1.SafetyDiagManager_1_3_6 /end FUNCTION_LIST
/end MEASUREMENT
/begin MEASUREMENT CSCHR "RAM value CSCHR" UBYTE COMP_0068 1 100 0 255 ECU_ADDRESS 0xFFFF9E46
 /begin FUNCTION_LIST R000.3.RS_SelfDiagflags_1_1_2 R902.1.SafetyDiagManager_1_3_6 /end FUNCTION_LIST
/end MEASUREMENT
/begin MEASUREMENT CSTOT "RAM value CSTOT" UBYTE COMP_0068 1 100 0 255 ECU_ADDRESS 0xFFFF9E49
 /begin FUNCTION_LIST R000.3.RS_SelfDiagflags_1_1_2 R902.1.SafetyDiagManager_1_3_6 /end FUNCTION_LIST
/end MEASUREMENT
/begin MEASUREMENT VSCMP "RAM value VSCMP" UBYTE COMP_0068 1 100 0 255 ECU_ADDRESS 0xFFFF9E4C
 /begin FUNCTION_LIST R000.3.RS_SelfDiagflags_1_1_2 R208.10.dgn_ccadd_1_3_2 R902.1.SafetyDiagManager_1_3_6 /end FUNCTION_LIST
/end MEASUREMENT
/begin MEASUREMENT CSOOR "RAM value CSOOR" UBYTE COMP_0068 1 100 0 255 ECU_ADDRESS 0xFFFF9E4F
 /begin FUNCTION_LIST R000.3.RS_SelfDiagflags_1_1_2 R902.1.SafetyDiagManager_1_3_6 /end FUNCTION_LIST
/end MEASUREMENT
/begin MEASUREMENT CSOCS "RAM value CSOCS" UBYTE COMP_0068 1 100 0 255 ECU_ADDRESS 0xFFFF9E52
 /begin FUNCTION_LIST R000.3.RS_SelfDiagflags_1_1_2 R902.1.SafetyDiagManager_1_3_6 /end FUNCTION_LIST
/end MEASUREMENT
/begin MEASUREMENT CSNOK "RAM value CSNOK" UBYTE COMP_0068 1 100 0 255 ECU_ADDRESS 0xFFFF9E55
 /begin FUNCTION_LIST R000.3.RS_SelfDiagflags_1_1_2 R902.1.SafetyDiagManager_1_3_6 /end FUNCTION_LIST
/end MEASUREMENT
/begin MEASUREMENT CLUCMP "RAM value CLUCMP" UBYTE COMP_0068 1 100 0 255 ECU_ADDRESS 0xFFFF9E58
 /begin FUNCTION_LIST R000.3.RS_SelfDiagflags_1_1_2 R902.1.SafetyDiagManager_1_3_6 /end FUNCTION_LIST
/end MEASUREMENT
/begin MEASUREMENT BRKCMP "RAM value BRKCMP" UBYTE COMP_0068 1 100 0 255 ECU_ADDRESS 0xFFFF9E5B
 /begin FUNCTION_LIST R000.3.RS_SelfDiagflags_1_1_2 R902.1.SafetyDiagManager_1_3_6 /end FUNCTION_LIST
/end MEASUREMENT
/begin MEASUREMENT CRUCMP "RAM value CRUCMP" UBYTE COMP_0068 1 100 0 255 ECU_ADDRESS 0xFFFF9E5E
 /begin FUNCTION_LIST R000.3.RS_SelfDiagflags_1_1_2 R902.1.SafetyDiagManager_1_3_6 /end FUNCTION_LIST
/end MEASUREMENT
/begin MEASUREMENT CLSW "RAM value CLSW" UBYTE COMP_0068 1 100 0 255 ECU_ADDRESS 0xFFFF9E61
 /begin FUNCTION_LIST R000.3.RS_SelfDiagflags_1_1_2 R902.1.SafetyDiagManager_1_3_6 /end FUNCTION_LIST
/end MEASUREMENT
/begin MEASUREMENT INHNG6 "RAM value INHNG6" UBYTE COMP_0068 1 100 0 255 ECU_ADDRESS 0xFFFF9E64
 /begin FUNCTION_LIST R000.3.RS_SelfDiagflags_1_1_2 R301.11.INJDiag_1_1_2 R301.18.VB_short_Protection_1_0_2 /end FUNCTION_LIST
/end MEASUREMENT
/begin MEASUREMENT INHNG5 "RAM value INHNG5" UBYTE COMP_0068 1 100 0 255 ECU_ADDRESS 0xFFFF9E67
 /begin FUNCTION_LIST R000.3.RS_SelfDiagflags_1_1_2 R301.11.INJDiag_1_1_2 R301.18.VB_short_Protection_1_0_2 /end FUNCTION_LIST
/end MEASUREMENT
/begin MEASUREMENT INHNG4 "RAM value INHNG4" UBYTE COMP_0068 1 100 0 255 ECU_ADDRESS 0xFFFF9E6A
 /begin FUNCTION_LIST R000.3.RS_SelfDiagflags_1_1_2 R301.11.INJDiag_1_1_2 R301.18.VB_short_Protection_1_0_2 /end FUNCTION_LIST
/end MEASUREMENT
/begin MEASUREMENT INHNG3 "RAM value INHNG3" UBYTE COMP_0068 1 100 0 255 ECU_ADDRESS 0xFFFF9E6D
 /begin FUNCTION_LIST R000.3.RS_SelfDiagflags_1_1_2 R301.11.INJDiag_1_1_2 R301.18.VB_short_Protection_1_0_2 /end FUNCTION_LIST
/end MEASUREMENT
/begin MEASUREMENT INHNG2 "RAM value INHNG2" UBYTE COMP_0068 1 100 0 255 ECU_ADDRESS 0xFFFF9E70
 /begin FUNCTION_LIST R000.3.RS_SelfDiagflags_1_1_2 R301.11.INJDiag_1_1_2 R301.18.VB_short_Protection_1_0_2 /end FUNCTION_LIST
/end MEASUREMENT
/begin MEASUREMENT INHNG1 "RAM value INHNG1" UBYTE COMP_0068 1 100 0 255 ECU_ADDRESS 0xFFFF9E73
 /begin FUNCTION_LIST R000.3.RS_SelfDiagflags_1_1_2 R301.11.INJDiag_1_1_2 R301.18.VB_short_Protection_1_0_2 /end FUNCTION_LIST
/end MEASUREMENT
/begin MEASUREMENT INLNG6 "RAM value INLNG6" UBYTE COMP_0068 1 100 0 255 ECU_ADDRESS 0xFFFF9E76 /begin FUNCTION_LIST R000.3.RS_SelfDiagflags_1_1_2 R301.11.INJDiag_1_1_2 /end FUNCTION_LIST /end MEASUREMENT
/begin MEASUREMENT INLNG5 "RAM value INLNG5" UBYTE COMP_0068 1 100 0 255 ECU_ADDRESS 0xFFFF9E79 /begin FUNCTION_LIST R000.3.RS_SelfDiagflags_1_1_2 R301.11.INJDiag_1_1_2 /end FUNCTION_LIST /end MEASUREMENT
/begin MEASUREMENT INLNG4 "RAM value INLNG4" UBYTE COMP_0068 1 100 0 255 ECU_ADDRESS 0xFFFF9E7C /begin FUNCTION_LIST R000.3.RS_SelfDiagflags_1_1_2 R301.11.INJDiag_1_1_2 /end FUNCTION_LIST /end MEASUREMENT
/begin MEASUREMENT INLNG3 "RAM value INLNG3" UBYTE COMP_0068 1 100 0 255 ECU_ADDRESS 0xFFFF9E7F /begin FUNCTION_LIST R000.3.RS_SelfDiagflags_1_1_2 R301.11.INJDiag_1_1_2 /end FUNCTION_LIST /end MEASUREMENT
/begin MEASUREMENT INLNG2 "RAM value INLNG2" UBYTE COMP_0068 1 100 0 255 ECU_ADDRESS 0xFFFF9E82 /begin FUNCTION_LIST R000.3.RS_SelfDiagflags_1_1_2 R301.11.INJDiag_1_1_2 /end FUNCTION_LIST /end MEASUREMENT
/begin MEASUREMENT INLNG1 "RAM value INLNG1" UBYTE COMP_0068 1 100 0 255 ECU_ADDRESS 0xFFFF9E85 /begin FUNCTION_LIST R000.3.RS_SelfDiagflags_1_1_2 R301.11.INJDiag_1_1_2 /end FUNCTION_LIST /end MEASUREMENT
/* COMPU_METHOD --------------------------------------------------------- */
/begin COMPU_METHOD COMP_0017 "1deg" RAT_FUNC "%8.2" "deg" COEFFS 0 1 0 0 0 1 /end COMPU_METHOD
/begin COMPU_METHOD COMP_0205_S "fixed axis Long" RAT_FUNC "%8.2" "Long" COEFFS 0 1 0 0 0 1 /end COMPU_METHOD
/begin COMPU_METHOD COMP_0068 "1-" RAT_FUNC "%8.2" "-" COEFFS 0 1 0 0 0 1 /end COMPU_METHOD
/begin COMPU_METHOD COMP_0004 "1Å|" RAT_FUNC "%8.2" "Å|" COEFFS 0 1 0 0 0 1 /end COMPU_METHOD
/begin COMPU_METHOD COMP_0061 "5mv" RAT_FUNC "%8.2" "mv" COEFFS 0 1 0 0 0 5 /end COMPU_METHOD
/begin COMPU_METHOD COMP_0023 "5mV" RAT_FUNC "%8.2" "mV" COEFFS 0 1 0 0 0 5 /end COMPU_METHOD
/begin COMPU_METHOD COMP_0429 "1km/h" RAT_FUNC "%8.2" "km/h" COEFFS 0 1 0 0 0 1 /end COMPU_METHOD
/begin COMPU_METHOD COMP_0001 "1/8ms" RAT_FUNC "%8.2" "ms" COEFFS 0 1 0 0 0 0.125 /end COMPU_METHOD
/begin COMPU_METHOD COMP_0003 "1Åé" RAT_FUNC "%8.2" "Åé" COEFFS 0 1 0 0 0 1 /end COMPU_METHOD
/begin COMPU_METHOD COMP_0014 "10ms" RAT_FUNC "%8.2" "ms" COEFFS 0 1 0 0 0 10 /end COMPU_METHOD
/begin COMPU_METHOD COMP_0006 "12.5rpm" RAT_FUNC "%8.2" "rpm" COEFFS 0 1 0 0 0 12.5 /end COMPU_METHOD
/begin COMPU_METHOD COMP_0008 "100ms" RAT_FUNC "%8.2" "ms" COEFFS 0 1 0 0 0 100 /end COMPU_METHOD
/begin COMPU_METHOD COMP_0337_S "1r/min" RAT_FUNC "%8.2" "r/min" COEFFS 0 1 0 0 0 1 /end COMPU_METHOD
/begin COMPU_METHOD COMP_0196 "0.1Nm" RAT_FUNC "%8.2" "Nm" COEFFS 0 1 0 0 0 0.1 /end COMPU_METHOD
/begin COMPU_METHOD COMP_0013 "1s" RAT_FUNC "%8.2" "s" COEFFS 0 1 0 0 0 1 /end COMPU_METHOD
/begin COMPU_METHOD COMP_0338_S "25W" RAT_FUNC "%8.2" "W" COEFFS 0 1 0 0 0 25 /end COMPU_METHOD
/begin COMPU_METHOD COMP_0047 "0.5%" RAT_FUNC "%8.2" "%" COEFFS 0 1 0 0 0 0.5 /end COMPU_METHOD
/begin COMPU_METHOD COMP_0436 "0.1km/h" RAT_FUNC "%8.2" "km/h" COEFFS 0 1 0 0 0 0.1 /end COMPU_METHOD
/begin COMPU_METHOD COMP_0019 "1degCA" RAT_FUNC "%8.2" "degCA" COEFFS 0 1 0 0 0 1 /end COMPU_METHOD
/begin COMPU_METHOD COMP_0007 "2km/h" RAT_FUNC "%8.2" "km/h" COEFFS 0 1 0 0 0 2 /end COMPU_METHOD
/begin COMPU_METHOD COMP_0033 "80mV" RAT_FUNC "%8.2" "mV" COEFFS 0 1 0 0 0 80 /end COMPU_METHOD
/begin COMPU_METHOD COMP_0027 "1%" RAT_FUNC "%8.2" "%" COEFFS 0 1 0 0 0 1 /end COMPU_METHOD
/begin COMPU_METHOD COMP_0063 "1/256-" RAT_FUNC "%8.4" "-" COEFFS 0 1 0 0 0 0.00390625 /end COMPU_METHOD
/begin COMPU_METHOD COMP_0344_S "0.01s" RAT_FUNC "%8.3" "s" COEFFS 0 1 0 0 0 0.01 /end COMPU_METHOD
/begin COMPU_METHOD COMP_0443 "1rpm" RAT_FUNC "%8.2" "rpm" COEFFS 0 1 0 0 0 1 /end COMPU_METHOD
/begin COMPU_METHOD COMP_0345_S "1/32Nm" RAT_FUNC "%8.3" "Nm" COEFFS 0 1 400 0 0 0.03125 /end COMPU_METHOD
/begin COMPU_METHOD COMP_0347_S "5Nm/s" RAT_FUNC "%8.2" "Nm/s" COEFFS 0 1 0 0 0 5 /end COMPU_METHOD
/begin COMPU_METHOD COMP_0350_S "0.125ratio/s" RAT_FUNC "%8.2" "ratio/s" COEFFS 0 1 0 0 0 0.125 /end COMPU_METHOD
/begin COMPU_METHOD COMP_0351_S "2000W" RAT_FUNC "%8.2" "W" COEFFS 0 1 0 0 0 2000 /end COMPU_METHOD
/begin COMPU_METHOD COMP_0352_S "25/256s" RAT_FUNC "%8.3" "s" COEFFS 0 1 0 0 0 0.0976563 /end COMPU_METHOD
/begin COMPU_METHOD COMP_0353_S "1/256Nm/r/min" RAT_FUNC "%8.4" "Nm/r/min" COEFFS 0 1 0 0 0 0.00390625 /end COMPU_METHOD
/begin COMPU_METHOD COMP_0354_S "8Nm" RAT_FUNC "%8.2" "Nm" COEFFS 0 1 400 0 0 8 /end COMPU_METHOD
/begin COMPU_METHOD COMP_0355_S "1km/h/s" RAT_FUNC "%8.2" "km/h/s" COEFFS 0 1 0 0 0 1 /end COMPU_METHOD
/begin COMPU_METHOD COMP_0356_S "100r/min/s" RAT_FUNC "%8.2" "r/min/s" COEFFS 0 1 0 0 0 100 /end COMPU_METHOD
/begin COMPU_METHOD COMP_0357_S "25/256Nm/km/h" RAT_FUNC "%8.3" "Nm/km/h" COEFFS 0 1 0 0 0 0.0976563 /end COMPU_METHOD
/begin COMPU_METHOD COMP_0358_S "1ALHVSPC" RAT_FUNC "%8.2" "ALHVSPC" COEFFS 0 1 0 0 0 1 /end COMPU_METHOD
/begin COMPU_METHOD COMP_0359_S "1/1024Uref rat" RAT_FUNC "%8.5" "Uref rat" COEFFS 0 1 0 0 0 0.000976563 /end COMPU_METHOD
/begin COMPU_METHOD COMP_0005 "0.11deg" RAT_FUNC "%8.2" "deg" COEFFS 0 1 0 0 0 0.11 /end COMPU_METHOD
/begin COMPU_METHOD COMP_0362_S "0.125%" RAT_FUNC "%8.2" "%" COEFFS 0 1 0 0 0 0.125 /end COMPU_METHOD
/begin COMPU_METHOD COMP_0366_S "0.02s" RAT_FUNC "%8.3" "s" COEFFS 0 1 0 0 0 0.02 /end COMPU_METHOD
/begin COMPU_METHOD COMP_0367_S "2s" RAT_FUNC "%8.2" "s" COEFFS 0 1 0 0 0 2 /end COMPU_METHOD
/begin COMPU_METHOD COMP_0368_S "32r/min" RAT_FUNC "%8.2" "r/min" COEFFS 0 1 0 0 0 32 /end COMPU_METHOD
/begin COMPU_METHOD COMP_0369_S "5Nm/s" RAT_FUNC "%8.2" "Nm/s" COEFFS 0 1 327675 0 0 5 /end COMPU_METHOD
/begin COMPU_METHOD COMP_0048 "64/128degCA" RAT_FUNC "%8.2" "degCA" COEFFS 0 1 0 0 0 0.5 /end COMPU_METHOD
/begin COMPU_METHOD COMP_0016 "1count" RAT_FUNC "%8.2" "count" COEFFS 0 1 0 0 0 1 /end COMPU_METHOD
/begin COMPU_METHOD COMP_0054 "20mV" RAT_FUNC "%8.2" "mV" COEFFS 0 1 0 0 0 20 /end COMPU_METHOD
/begin COMPU_METHOD COMP_0373 "1/100-" RAT_FUNC "%8.3" "-" COEFFS 0 1 0 0 0 0.01 /end COMPU_METHOD
/begin COMPU_METHOD COMP_0374_S "2N" RAT_FUNC "%8.2" "N" COEFFS 0 1 20000 0 0 2 /end COMPU_METHOD
/begin COMPU_METHOD COMP_0050 "5/64mV" RAT_FUNC "%8.3" "mV" COEFFS 0 1 0 0 0 0.078125 /end COMPU_METHOD
/begin COMPU_METHOD COMP_0035 "X-50Åé" RAT_FUNC "%8.2" "Åé" COEFFS 0 1 50 0 0 1 /end COMPU_METHOD
/begin COMPU_METHOD COMP_0375_S "0.01km/h" RAT_FUNC "%8.3" "km/h" COEFFS 0 1 0 0 0 0.01 /end COMPU_METHOD
/begin COMPU_METHOD COMP_0228 "0.1Nm" RAT_FUNC "%8.2" "Nm" COEFFS 0 1 0 0 0 0.1 /end COMPU_METHOD
/begin COMPU_METHOD COMP_0096 "10s" RAT_FUNC "%8.2" "s" COEFFS 0 1 0 0 0 10 /end COMPU_METHOD
/begin COMPU_METHOD COMP_0256 "64/128degCA" RAT_FUNC "%8.2" "degCA" COEFFS 0 1 64 0 0 0.5 /end COMPU_METHOD
/begin COMPU_METHOD COMP_0450 "1/1024-" RAT_FUNC "%8.5" "-" COEFFS 0 1 0 0 0 0.000976563 /end COMPU_METHOD
/begin COMPU_METHOD COMP_0411_S "5.12/65536V" RAT_FUNC "%8.6" "V" COEFFS 0 1 0 0 0 0.000078125 /end COMPU_METHOD
/begin COMPU_METHOD COMP_0314 "X-128deg" RAT_FUNC "%8.2" "deg" COEFFS 0 1 128 0 0 1 /end COMPU_METHOD
/begin COMPU_METHOD COMP_0395 "1/4096-" RAT_FUNC "%8.5" "-" COEFFS 0 1 0 0 0 0.000244141 /end COMPU_METHOD
/begin COMPU_METHOD COMP_0492 "20/256mV" RAT_FUNC "%8.2" "mV" COEFFS 0 1 0 0 0 1 /end COMPU_METHOD
/begin COMPU_METHOD COMP_0263 "1-" RAT_FUNC "%8.2" "-" COEFFS 0 1 0 0 0 1 /end COMPU_METHOD
/begin COMPU_METHOD COMP_0152 "2L" RAT_FUNC "%8.2" "L" COEFFS 0 1 0 0 0 2 /end COMPU_METHOD
/begin COMPU_METHOD COMP_0448_S "10rpm" RAT_FUNC "%8.2" "rpm" COEFFS 0 1 0 0 0 10 /end COMPU_METHOD
/begin COMPU_METHOD COMP_0132_S "%%" RAT_FUNC "%8.2" "%" COEFFS 0 1 0 0 0 10 /end COMPU_METHOD
/begin COMPU_METHOD COMP_0356 "0.625X-40Åé" RAT_FUNC "%8.2" "Åé" COEFFS 0 1 40 0 0 0.625 /end COMPU_METHOD
/begin COMPU_METHOD COMP_0451_S "0.00125ratio" RAT_FUNC "%8.4" "ratio" COEFFS 0 1 0 0 0 0.00125 /end COMPU_METHOD
/begin COMPU_METHOD COMP_0456_S "2Nm/s" RAT_FUNC "%8.2" "Nm/s" COEFFS 0 1 0 0 0 2 /end COMPU_METHOD
/begin COMPU_METHOD COMP_0460_S "1/255ratio" RAT_FUNC "%8.4" "ratio" COEFFS 0 1 0 0 0 0.00392157 /end COMPU_METHOD
/begin COMPU_METHOD COMP_0144 "1/2048ms" RAT_FUNC "%8.5" "ms" COEFFS 0 1 0 0 0 0.000488281 /end COMPU_METHOD
/begin COMPU_METHOD COMP_0278_S "fixed axis Åé" RAT_FUNC "%8.2" "Åé" COEFFS 0 1 40 0 0 20 /end COMPU_METHOD
/begin COMPU_METHOD COMP_0271_S "fixed axis rpm" RAT_FUNC "%8.2" "rpm" COEFFS 0 1 0 0 0 400 /end COMPU_METHOD
/begin COMPU_METHOD COMP_0484_S "fixed axis -" RAT_FUNC "%8.2" "-" COEFFS 0 1 1 0 0 1 /end COMPU_METHOD
/begin COMPU_METHOD COMP_0486_S "(1/255)/256ratio" RAT_FUNC "%8.6" "ratio" COEFFS 0 1 0 0 0 0.0000153186 /end COMPU_METHOD
/begin COMPU_METHOD COMP_0503_S "1/65535ratio" RAT_FUNC "%8.6" "ratio" COEFFS 0 1 0 0 0 0.000015259 /end COMPU_METHOD
/begin COMPU_METHOD COMP_0283 "1flag" RAT_FUNC "%8.2" "flag" COEFFS 0 1 0 0 0 1 /end COMPU_METHOD
/begin COMPU_METHOD COMP_0202_S "100ms100ms" RAT_FUNC "%8.2" "100ms" COEFFS 0 1 0 0 0 1 /end COMPU_METHOD
/begin COMPU_METHOD COMP_0203_S "10ms10ms" RAT_FUNC "%8.2" "10ms" COEFFS 0 1 0 0 0 1 /end COMPU_METHOD
/begin COMPU_METHOD COMP_0140 "0.5STEP" RAT_FUNC "%8.2" "STEP" COEFFS 0 1 0 0 0 0.5 /end COMPU_METHOD
/begin COMPU_METHOD COMP_0010_S "m/ssm/ss" RAT_FUNC "%8.5" "m/ss" COEFFS 0 1 0 0 0 0.00024414 /end COMPU_METHOD
/begin COMPU_METHOD COMP_0547_S "%%" RAT_FUNC "%8.2" "%" COEFFS 0 1 0 0 0 0.4 /end COMPU_METHOD
/begin COMPU_METHOD COMP_0551_S "r/minr/min" RAT_FUNC "%8.2" "r/min" COEFFS 0 1 0 0 0 1 /end COMPU_METHOD
/begin COMPU_METHOD COMP_0552_S "km/hkm/h" RAT_FUNC "%8.3" "km/h" COEFFS 0 1 0 0 0 0.01 /end COMPU_METHOD
/begin COMPU_METHOD COMP_0118 "40mV" RAT_FUNC "%8.2" "mV" COEFFS 0 1 0 0 0 40 /end COMPU_METHOD
/begin COMPU_METHOD COMP_0164 "0.000305MPa" RAT_FUNC "%8.5" "MPa" COEFFS 0 1 0 0 0 0.000305 /end COMPU_METHOD
/begin COMPU_METHOD COMP_0064_S "degCAsdegCAs" RAT_FUNC "%8.4" "degCAs" COEFFS 0 1 10737418.24 0 0 0.005 /end COMPU_METHOD
/begin COMPU_METHOD COMP_0093_S "rpmrpm" RAT_FUNC "%8.3" "rpm" COEFFS 0 1 0 0 0 0.05 /end COMPU_METHOD
/begin COMPU_METHOD COMP_0621_S "r/minr/min" RAT_FUNC "%8.2" "r/min" COEFFS 0 1 0 0 0 12.5 /end COMPU_METHOD
/begin COMPU_METHOD COMP_0325 "1.6É S" RAT_FUNC "%8.2" "É S" COEFFS 0 1 52428.8 0 0 1.6 /end COMPU_METHOD
/begin COMPU_METHOD COMP_0184_S "km/hkm/h" RAT_FUNC "%8.3" "km/h" COEFFS 0 1 0 0 0 0.05625 /end COMPU_METHOD
/begin COMPU_METHOD COMP_0447 "100/1024%" RAT_FUNC "%8.3" "%" COEFFS 0 1 0 0 0 0.09765625 /end COMPU_METHOD
/* RECORD_LAYOUT ------------------------------------------------------ */
/begin RECORD_LAYOUT REC_UBYTE_C FNC_VALUES 1 UBYTE COLUMN_DIR DIRECT /end RECORD_LAYOUT
/begin RECORD_LAYOUT REC_UWORD_C FNC_VALUES 1 UWORD COLUMN_DIR DIRECT /end RECORD_LAYOUT
/begin RECORD_LAYOUT REC_SWORD_C FNC_VALUES 1 SWORD COLUMN_DIR DIRECT /end RECORD_LAYOUT
/begin RECORD_LAYOUT REC_AXIS_UWORD AXIS_PTS_X 1 UWORD INDEX_INCR DIRECT /end RECORD_LAYOUT
/end MODULE
/end PROJECT
