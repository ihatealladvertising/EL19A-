ASAP2_VERSION 1 3_BETA
/begin PROJECT TK_X91_EUR_VC ""
/begin HEADER "" /* key HEADER ++ "comment" Ç… Par.scomment */ PROJECT_NO TK_X91_EUR_VC /* key PROJECT_NO ++ project number Ç… car_eng_desti_lot */ VERSION "7V4YHZEB2" /* key VERSION ++ version number Ç… mProgver */ /end HEADER
/begin MODULE DIM ""
/begin MOD_COMMON "" DEPOSIT ABSOLUTE BYTE_ORDER MSB_FIRST /* ﬁ≤ƒµ∞¿ﬁ∞Ç™ÿÃﬂ⁄∞ΩÇ≥ÇÍÇÈ */ /end MOD_COMMON
/begin FUNCTION KF7-313C.1[36] "Interface" /end FUNCTION
/begin MEASUREMENT vAFSCNR2_R#2 "Rich side fixed shift renewal number of times counter" UBYTE COMP_0030 1 100 0 255 ECU_ADDRESS 0xFFFF27D2 /begin FUNCTION_LIST KF7-313C.1[36] KF7-500.75[4] /end FUNCTION_LIST /end MEASUREMENT
/begin MEASUREMENT vAFSCNR3 "Rich side moment fixed shift renewal number of times counter" UBYTE COMP_0030 1 100 0 255 ECU_ADDRESS 0xFFFF27D3 /begin FUNCTION_LIST KF7-313C.1[36] KF7-500.75[4] /end FUNCTION_LIST /end MEASUREMENT
/begin MEASUREMENT vAFSCNR3_R#1 "Rich side moment fixed shift renewal number of times counter" UBYTE COMP_0030 1 100 0 255 ECU_ADDRESS 0xFFFF27D3 /begin FUNCTION_LIST KF7-313C.1[36] KF7-500.75[4] /end FUNCTION_LIST /end MEASUREMENT
/begin MEASUREMENT vAFSCNR3_R#2 "Rich side moment fixed shift renewal number of times counter" UBYTE COMP_0030 1 100 0 255 ECU_ADDRESS 0xFFFF27D4 /begin FUNCTION_LIST KF7-313C.1[36] KF7-500.75[4] /end FUNCTION_LIST /end MEASUREMENT
/begin MEASUREMENT vAFSHOS "A/F sensor shift compensation value" SWORD COMP_0341_S 1 100 -65.536 65.534 ECU_ADDRESS 0xFFFFA0B6
 /begin FUNCTION_LIST KF7-313C.1[36] KF7-313C.4[3] KF7-313C.5[3] KF7-314.1F[1] KF7-500.75[4] /end FUNCTION_LIST
/end MEASUREMENT
/begin MEASUREMENT vAFSHOS_R#1 "A/F sensor shift compensation value" SWORD COMP_0341_S 1 100 -65.536 65.534 ECU_ADDRESS 0xFFFFA0B6
 /begin FUNCTION_LIST KF7-313C.1[36] KF7-313C.4[3] KF7-313C.5[3] KF7-314.1F[1] KF7-500.75[4] /end FUNCTION_LIST
/end MEASUREMENT
/begin MEASUREMENT vAFSHOS_R#2 "A/F sensor shift compensation value" SWORD COMP_0341_S 1 100 -65.536 65.534 ECU_ADDRESS 0xFFFFA0B8
 /begin FUNCTION_LIST KF7-313C.1[36] KF7-313C.4[3] KF7-313C.5[3] KF7-314.1F[1] KF7-500.75[4] /end FUNCTION_LIST
/end MEASUREMENT
/begin MEASUREMENT vAFSHOSC "AFSHOS renewal counter" UBYTE COMP_0030 1 100 0 255 ECU_ADDRESS 0xFFFF27D5 /begin FUNCTION_LIST KF7-313C.1[36] KF7-500.75[4] /end FUNCTION_LIST /end MEASUREMENT
/begin MEASUREMENT vAFSHOSC_R#1 "AFSHOS renewal counter" UBYTE COMP_0030 1 100 0 255 ECU_ADDRESS 0xFFFF27D5 /begin FUNCTION_LIST KF7-313C.1[36] KF7-500.75[4] /end FUNCTION_LIST /end MEASUREMENT
/begin MEASUREMENT vAFSHOSC_R#2 "AFSHOS renewal counter" UBYTE COMP_0030 1 100 0 255 ECU_ADDRESS 0xFFFF27D6 /begin FUNCTION_LIST KF7-313C.1[36] KF7-500.75[4] /end FUNCTION_LIST /end MEASUREMENT
/begin MEASUREMENT vALPHA0 "Clamp input ALPHA" UWORD COMP_0031 1 100 0 255.99609375 ECU_ADDRESS 0xFFFF2822 /begin FUNCTION_LIST KF7-313C.1[36] KF7-313C.11B[1] /end FUNCTION_LIST /end MEASUREMENT
/begin MEASUREMENT vALPHA0_R#1 "Clamp input ALPHA" UWORD COMP_0031 1 100 0 255.99609375 ECU_ADDRESS 0xFFFF2822 /begin FUNCTION_LIST KF7-313C.1[36] KF7-313C.11B[1] /end FUNCTION_LIST /end MEASUREMENT
/begin MEASUREMENT vALPHA0_R#2 "Clamp input ALPHA" UWORD COMP_0031 1 100 0 255.99609375 ECU_ADDRESS 0xFFFF2824 /begin FUNCTION_LIST KF7-313C.1[36] KF7-313C.11B[1] /end FUNCTION_LIST /end MEASUREMENT
/begin MEASUREMENT vAVADO2R "Rr O2 sensor weighted average value" UWORD COMP_0061 1 100 0 327675 ECU_ADDRESS 0xFFFF2894 /begin FUNCTION_LIST KF7-313C.1[36] /end FUNCTION_LIST /end MEASUREMENT
/begin MEASUREMENT vAVADO2R_R#1 "Rr O2 sensor weighted average value" UWORD COMP_0061 1 100 0 327675 ECU_ADDRESS 0xFFFF2894 /begin FUNCTION_LIST KF7-313C.1[36] /end FUNCTION_LIST /end MEASUREMENT
/begin MEASUREMENT vAVADO2R_R#2 "Rr O2 sensor weighted average value" UWORD COMP_0061 1 100 0 327675 ECU_ADDRESS 0xFFFF2896 /begin FUNCTION_LIST KF7-313C.1[36] /end FUNCTION_LIST /end MEASUREMENT
/begin MEASUREMENT vAVAFSAF "A/F weighted average value" UWORD COMP_0453 1 100 0 131.07 ECU_ADDRESS 0xFFFF2898 /begin FUNCTION_LIST KF7-313C.1[36] /end FUNCTION_LIST /end MEASUREMENT
/begin MEASUREMENT vAVAFSAF_R#1 "A/F weighted average value" UWORD COMP_0453 1 100 0 131.07 ECU_ADDRESS 0xFFFF2898 /begin FUNCTION_LIST KF7-313C.1[36] /end FUNCTION_LIST /end MEASUREMENT
/begin MEASUREMENT vAVAFSAF_R#2 "A/F weighted average value" UWORD COMP_0453 1 100 0 131.07 ECU_ADDRESS 0xFFFF289A /begin FUNCTION_LIST KF7-313C.1[36] /end FUNCTION_LIST /end MEASUREMENT
/begin MEASUREMENT vAVQAEL "Lean side air quantity mean" UWORD COMP_0068 1 100 0 65535 ECU_ADDRESS 0xFFFF28AC /begin FUNCTION_LIST KF7-313C.1[36] /end FUNCTION_LIST /end MEASUREMENT
/begin MEASUREMENT vAVQAEL_R#1 "Lean side air quantity mean" UWORD COMP_0068 1 100 0 65535 ECU_ADDRESS 0xFFFF28AC /begin FUNCTION_LIST KF7-313C.1[36] /end FUNCTION_LIST /end MEASUREMENT
/begin MEASUREMENT vAVQAEL_R#2 "Lean side air quantity mean" UWORD COMP_0068 1 100 0 65535 ECU_ADDRESS 0xFFFF28AE /begin FUNCTION_LIST KF7-313C.1[36] /end FUNCTION_LIST /end MEASUREMENT
/begin MEASUREMENT vAVQAER "Rich side air quantity mean" UWORD COMP_0068 1 100 0 65535 ECU_ADDRESS 0xFFFF28B0 /begin FUNCTION_LIST KF7-313C.1[36] /end FUNCTION_LIST /end MEASUREMENT
/begin MEASUREMENT vAVQAER_R#1 "Rich side air quantity mean" UWORD COMP_0068 1 100 0 65535 ECU_ADDRESS 0xFFFF28B0 /begin FUNCTION_LIST KF7-313C.1[36] /end FUNCTION_LIST /end MEASUREMENT
/begin MEASUREMENT vAVQAER_R#2 "Rich side air quantity mean" UWORD COMP_0068 1 100 0 65535 ECU_ADDRESS 0xFFFF28B2 /begin FUNCTION_LIST KF7-313C.1[36] /end FUNCTION_LIST /end MEASUREMENT
/begin MEASUREMENT vAVRPML "Lean side speed mean" UWORD COMP_0006 1 100 0 819187.5 ECU_ADDRESS 0xFFFF28B6 /begin FUNCTION_LIST KF7-313C.1[36] /end FUNCTION_LIST /end MEASUREMENT
/begin MEASUREMENT vAVRPML_R#1 "Lean side speed mean" UWORD COMP_0006 1 100 0 819187.5 ECU_ADDRESS 0xFFFF28B6 /begin FUNCTION_LIST KF7-313C.1[36] /end FUNCTION_LIST /end MEASUREMENT
/begin MEASUREMENT vAVRPML_R#2 "Lean side speed mean" UWORD COMP_0006 1 100 0 819187.5 ECU_ADDRESS 0xFFFF28B8 /begin FUNCTION_LIST KF7-313C.1[36] /end FUNCTION_LIST /end MEASUREMENT
/begin MEASUREMENT vAVRPMR "Rich side speed mean" UWORD COMP_0006 1 100 0 819187.5 ECU_ADDRESS 0xFFFF28BA /begin FUNCTION_LIST KF7-313C.1[36] /end FUNCTION_LIST /end MEASUREMENT
/begin MEASUREMENT vAVRPMR_R#1 "Rich side speed mean" UWORD COMP_0006 1 100 0 819187.5 ECU_ADDRESS 0xFFFF28BA /begin FUNCTION_LIST KF7-313C.1[36] /end FUNCTION_LIST /end MEASUREMENT
/begin MEASUREMENT vAVRPMR_R#2 "Rich side speed mean" UWORD COMP_0006 1 100 0 819187.5 ECU_ADDRESS 0xFFFF28BC /begin FUNCTION_LIST KF7-313C.1[36] /end FUNCTION_LIST /end MEASUREMENT
/begin MEASUREMENT vB0MODEL "Input line B0" SWORD COMP_0336_S 1 100 -3.2768 3.2767 ECU_ADDRESS 0xFFFF119C /begin FUNCTION_LIST KF7-313C.1[36] /end FUNCTION_LIST /end MEASUREMENT
/begin MEASUREMENT vB0MODEL_R#1 "Input line B0" SWORD COMP_0336_S 1 100 -3.2768 3.2767 ECU_ADDRESS 0xFFFF119C /begin FUNCTION_LIST KF7-313C.1[36] /end FUNCTION_LIST /end MEASUREMENT
/begin MEASUREMENT vB0MODEL_R#2 "Input line B0" SWORD COMP_0336_S 1 100 -3.2768 3.2767 ECU_ADDRESS 0xFFFF119E /begin FUNCTION_LIST KF7-313C.1[36] /end FUNCTION_LIST /end MEASUREMENT
/begin MEASUREMENT vB1MODEL "Input line B1" SWORD COMP_0336_S 1 100 -3.2768 3.2767 ECU_ADDRESS 0xFFFF11A0 /begin FUNCTION_LIST KF7-313C.1[36] /end FUNCTION_LIST /end MEASUREMENT
/begin MEASUREMENT vB1MODEL_R#1 "Input line B1" SWORD COMP_0336_S 1 100 -3.2768 3.2767 ECU_ADDRESS 0xFFFF11A0 /begin FUNCTION_LIST KF7-313C.1[36] /end FUNCTION_LIST /end MEASUREMENT
/begin MEASUREMENT vB1MODEL_R#2 "Input line B1" SWORD COMP_0336_S 1 100 -3.2768 3.2767 ECU_ADDRESS 0xFFFF11A2 /begin FUNCTION_LIST KF7-313C.1[36] /end FUNCTION_LIST /end MEASUREMENT
/begin MEASUREMENT vCALPCNT "ALPHA integration number of times" UWORD COMP_0016 1 100 0 65535 ECU_ADDRESS 0xFFFF293C /begin FUNCTION_LIST KF7-313C.1[36] /end FUNCTION_LIST /end MEASUREMENT
/begin MEASUREMENT vCALPCNT_R#1 "ALPHA integration number of times" UWORD COMP_0016 1 100 0 65535 ECU_ADDRESS 0xFFFF293C /begin FUNCTION_LIST KF7-313C.1[36] /end FUNCTION_LIST /end MEASUREMENT
/begin MEASUREMENT vCALPCNT_R#2 "ALPHA integration number of times" UWORD COMP_0016 1 100 0 65535 ECU_ADDRESS 0xFFFF293E /begin FUNCTION_LIST KF7-313C.1[36] /end FUNCTION_LIST /end MEASUREMENT
/begin MEASUREMENT vCALPHA "Reference A/F, very, ALPHA" UWORD COMP_0031 1 100 0 255.99609375 ECU_ADDRESS 0xFFFF2940 /begin FUNCTION_LIST KF7-313C.1[36] /end FUNCTION_LIST /end MEASUREMENT
/begin MEASUREMENT vCALPHA_R#1 "Reference A/F, very, ALPHA" UWORD COMP_0031 1 100 0 255.99609375 ECU_ADDRESS 0xFFFF2940 /begin FUNCTION_LIST KF7-313C.1[36] /end FUNCTION_LIST /end MEASUREMENT
/begin MEASUREMENT vCALPHA_R#2 "Reference A/F, very, ALPHA" UWORD COMP_0031 1 100 0 255.99609375 ECU_ADDRESS 0xFFFF2942 /begin FUNCTION_LIST KF7-313C.1[36] /end FUNCTION_LIST /end MEASUREMENT
/begin MEASUREMENT vCATSLSFT "At the time of the control for the catalyst diagnosis, lambda point compensation value" SWORD COMP_0341_S 1 100 -65.536 65.534 ECU_ADDRESS 0xFFFF2952 /begin FUNCTION_LIST KF7-313C.1[36] /end FUNCTION_LIST /end MEASUREMENT
/begin MEASUREMENT vCATSLSFT_R#1 "At the time of the control for the catalyst diagnosis, lambda point compensation value" SWORD COMP_0341_S 1 100 -65.536 65.534 ECU_ADDRESS 0xFFFF2952 /begin FUNCTION_LIST KF7-313C.1[36] /end FUNCTION_LIST /end MEASUREMENT
/begin MEASUREMENT vCATSLSFT_R#2 "At the time of the control for the catalyst diagnosis, lambda point compensation value" SWORD COMP_0341_S 1 100 -65.536 65.534 ECU_ADDRESS 0xFFFF2954 /begin FUNCTION_LIST KF7-313C.1[36] /end FUNCTION_LIST /end MEASUREMENT
/begin MEASUREMENT vCNTL "Lean side parameter integration number of times" UWORD COMP_0016 1 100 0 65535 ECU_ADDRESS 0xFFFF29AA /begin FUNCTION_LIST KF7-313C.1[36] /end FUNCTION_LIST /end MEASUREMENT
/begin MEASUREMENT vCNTL_R#1 "Lean side parameter integration number of times" UWORD COMP_0016 1 100 0 65535 ECU_ADDRESS 0xFFFF29AA /begin FUNCTION_LIST KF7-313C.1[36] /end FUNCTION_LIST /end MEASUREMENT
/begin MEASUREMENT vCNTL_R#2 "Lean side parameter integration number of times" UWORD COMP_0016 1 100 0 65535 ECU_ADDRESS 0xFFFF29AC /begin FUNCTION_LIST KF7-313C.1[36] /end FUNCTION_LIST /end MEASUREMENT
/begin MEASUREMENT vCNTR "Rich side parameter integration number of times" UWORD COMP_0016 1 100 0 65535 ECU_ADDRESS 0xFFFF29AE /begin FUNCTION_LIST KF7-313C.1[36] /end FUNCTION_LIST /end MEASUREMENT
/begin MEASUREMENT vCNTR_R#1 "Rich side parameter integration number of times" UWORD COMP_0016 1 100 0 65535 ECU_ADDRESS 0xFFFF29AE /begin FUNCTION_LIST KF7-313C.1[36] /end FUNCTION_LIST /end MEASUREMENT
/begin MEASUREMENT vCNTR_R#2 "Rich side parameter integration number of times" UWORD COMP_0016 1 100 0 65535 ECU_ADDRESS 0xFFFF29B0 /begin FUNCTION_LIST KF7-313C.1[36] /end FUNCTION_LIST /end MEASUREMENT
/begin MEASUREMENT vCYLAF "Supply A/F" UWORD COMP_0453 1 100 0 131.07 ECU_ADDRESS 0xFFFF1210 /begin FUNCTION_LIST KF7-313C.1[36] /end FUNCTION_LIST /end MEASUREMENT
/begin MEASUREMENT vCYLAF_R#1 "Supply A/F" UWORD COMP_0453 1 100 0 131.07 ECU_ADDRESS 0xFFFF1210 /begin FUNCTION_LIST KF7-313C.1[36] /end FUNCTION_LIST /end MEASUREMENT
/begin MEASUREMENT vCYLAF_R#2 "Supply A/F" UWORD COMP_0453 1 100 0 131.07 ECU_ADDRESS 0xFFFF1212 /begin FUNCTION_LIST KF7-313C.1[36] /end FUNCTION_LIST /end MEASUREMENT
/begin MEASUREMENT vDABFE "A/F deviation" SWORD COMP_0341_S 1 100 -65.536 65.534 ECU_ADDRESS 0xFFFF2A06 /begin FUNCTION_LIST KF7-313C.1[36] KF7-313C.11B[1] /end FUNCTION_LIST /end MEASUREMENT
/begin MEASUREMENT vDABFE_R#1 "A/F deviation" SWORD COMP_0341_S 1 100 -65.536 65.534 ECU_ADDRESS 0xFFFF2A06 /begin FUNCTION_LIST KF7-313C.1[36] KF7-313C.11B[1] /end FUNCTION_LIST /end MEASUREMENT
/begin MEASUREMENT vDABFE_R#2 "A/F deviation" SWORD COMP_0341_S 1 100 -65.536 65.534 ECU_ADDRESS 0xFFFF2A08 /begin FUNCTION_LIST KF7-313C.1[36] KF7-313C.11B[1] /end FUNCTION_LIST /end MEASUREMENT
/begin MEASUREMENT vDCLALP "Slowdown lean clamp rate" UWORD COMP_0031 1 100 0 255.99609375 ECU_ADDRESS 0xFFFF2A22 /begin FUNCTION_LIST KF7-313C.1[36] /end FUNCTION_LIST /end MEASUREMENT
/begin MEASUREMENT vDEADTM "A waste time estimated value" UBYTE COMP_0569_S 1 100 0 255 ECU_ADDRESS 0xFFFF124C /begin FUNCTION_LIST KF7-313C.1[36] /end FUNCTION_LIST /end MEASUREMENT
/begin MEASUREMENT vDEADTM_R#1 "A waste time estimated value" UBYTE COMP_0569_S 1 100 0 255 ECU_ADDRESS 0xFFFF124C /begin FUNCTION_LIST KF7-313C.1[36] /end FUNCTION_LIST /end MEASUREMENT
/begin MEASUREMENT vDEADTM_R#2 "A waste time estimated value" UBYTE COMP_0569_S 1 100 0 255 ECU_ADDRESS 0xFFFF124D /begin FUNCTION_LIST KF7-313C.1[36] /end FUNCTION_LIST /end MEASUREMENT
/begin MEASUREMENT vDGNGRD "Gradual clamp" UBYTE COMP_0068 1 100 0 255 ECU_ADDRESS 0xFFFF2A38 /begin FUNCTION_LIST KF7-313C.1[36] /end FUNCTION_LIST /end MEASUREMENT
/begin MEASUREMENT vDGNGRD_R#1 "Gradual clamp" UBYTE COMP_0068 1 100 0 255 ECU_ADDRESS 0xFFFF2A38 /begin FUNCTION_LIST KF7-313C.1[36] /end FUNCTION_LIST /end MEASUREMENT
/begin MEASUREMENT vDGNGRD_R#2 "Gradual clamp" UBYTE COMP_0068 1 100 0 255 ECU_ADDRESS 0xFFFF2A39 /begin FUNCTION_LIST KF7-313C.1[36] /end FUNCTION_LIST /end MEASUREMENT
/begin MEASUREMENT vDGNIMD "As soon as possible, clamp" UBYTE COMP_0068 1 100 0 255 ECU_ADDRESS 0xFFFF2A3A /begin FUNCTION_LIST KF7-313C.1[36] KF7-580.1[8] R301.11.INJDiag_1_1_2 /end FUNCTION_LIST /end MEASUREMENT
/begin MEASUREMENT vDGNIMD_R#1 "As soon as possible, clamp" UBYTE COMP_0068 1 100 0 255 ECU_ADDRESS 0xFFFF2A3A /begin FUNCTION_LIST KF7-313C.1[36] KF7-580.1[8] R301.11.INJDiag_1_1_2 /end FUNCTION_LIST /end MEASUREMENT
/begin MEASUREMENT vDGNIMD_R#2 "As soon as possible, clamp" UBYTE COMP_0068 1 100 0 255 ECU_ADDRESS 0xFFFF2A3B /begin FUNCTION_LIST KF7-313C.1[36] KF7-580.1[8] R301.11.INJDiag_1_1_2 /end FUNCTION_LIST /end MEASUREMENT
/begin MEASUREMENT vDQMXL "Lean side air change quantity maximum value" UWORD COMP_0068 1 100 0 65535 ECU_ADDRESS 0xFFFF2A94 /begin FUNCTION_LIST KF7-313C.1[36] /end FUNCTION_LIST /end MEASUREMENT
/begin MEASUREMENT vDQMXL_R#1 "Lean side air change quantity maximum value" UWORD COMP_0068 1 100 0 65535 ECU_ADDRESS 0xFFFF2A94 /begin FUNCTION_LIST KF7-313C.1[36] /end FUNCTION_LIST /end MEASUREMENT
/begin MEASUREMENT vDQMXL_R#2 "Lean side air change quantity maximum value" UWORD COMP_0068 1 100 0 65535 ECU_ADDRESS 0xFFFF2A96 /begin FUNCTION_LIST KF7-313C.1[36] /end FUNCTION_LIST /end MEASUREMENT
/begin MEASUREMENT vDQMXR "Rich side air change quantity maximum value" UWORD COMP_0068 1 100 0 65535 ECU_ADDRESS 0xFFFF2A98 /begin FUNCTION_LIST KF7-313C.1[36] /end FUNCTION_LIST /end MEASUREMENT
/begin MEASUREMENT vDQMXR_R#1 "Rich side air change quantity maximum value" UWORD COMP_0068 1 100 0 65535 ECU_ADDRESS 0xFFFF2A98 /begin FUNCTION_LIST KF7-313C.1[36] /end FUNCTION_LIST /end MEASUREMENT
/begin MEASUREMENT vDQMXR_R#2 "Rich side air change quantity maximum value" UWORD COMP_0068 1 100 0 65535 ECU_ADDRESS 0xFFFF2A9A /begin FUNCTION_LIST KF7-313C.1[36] /end FUNCTION_LIST /end MEASUREMENT
/begin MEASUREMENT vDRPMXL "Lean side speed change quantity maximum value" UBYTE COMP_0006 1 100 0 3187.5 ECU_ADDRESS 0xFFFF2A9E /begin FUNCTION_LIST KF7-313C.1[36] /end FUNCTION_LIST /end MEASUREMENT
/begin MEASUREMENT vDRPMXL_R#1 "Lean side speed change quantity maximum value" UBYTE COMP_0006 1 100 0 3187.5 ECU_ADDRESS 0xFFFF2A9E /begin FUNCTION_LIST KF7-313C.1[36] /end FUNCTION_LIST /end MEASUREMENT
/begin MEASUREMENT vDRPMXL_R#2 "Lean side speed change quantity maximum value" UBYTE COMP_0006 1 100 0 3187.5 ECU_ADDRESS 0xFFFF2A9F /begin FUNCTION_LIST KF7-313C.1[36] /end FUNCTION_LIST /end MEASUREMENT
/begin MEASUREMENT vDRPMXR "Rich side speed change quantity maximum value" UBYTE COMP_0006 1 100 0 3187.5 ECU_ADDRESS 0xFFFF2AA0 /begin FUNCTION_LIST KF7-313C.1[36] /end FUNCTION_LIST /end MEASUREMENT
/begin MEASUREMENT vDRPMXR_R#1 "Rich side speed change quantity maximum value" UBYTE COMP_0006 1 100 0 3187.5 ECU_ADDRESS 0xFFFF2AA0 /begin FUNCTION_LIST KF7-313C.1[36] /end FUNCTION_LIST /end MEASUREMENT
/begin MEASUREMENT vDRPMXR_R#2 "Rich side speed change quantity maximum value" UBYTE COMP_0006 1 100 0 3187.5 ECU_ADDRESS 0xFFFF2AA1 /begin FUNCTION_LIST KF7-313C.1[36] /end FUNCTION_LIST /end MEASUREMENT
/begin MEASUREMENT vFAC "Cylinder inhalation fuel pulse width conversion value" UWORD COMP_0593_S 1 100 0 31.999495335 ECU_ADDRESS 0xFFFF1354 /begin FUNCTION_LIST KF7-313C.1[36] KF7-580.1[8] /end FUNCTION_LIST /end MEASUREMENT
/begin MEASUREMENT vFAC_R#1 "Cylinder inhalation fuel pulse width conversion value" UWORD COMP_0593_S 1 100 0 31.999495335 ECU_ADDRESS 0xFFFF1354 /begin FUNCTION_LIST KF7-313C.1[36] KF7-580.1[8] /end FUNCTION_LIST /end MEASUREMENT
/begin MEASUREMENT vFAC_R#2 "Cylinder inhalation fuel pulse width conversion value" UWORD COMP_0593_S 1 100 0 31.999495335 ECU_ADDRESS 0xFFFF1356 /begin FUNCTION_LIST KF7-313C.1[36] KF7-580.1[8] /end FUNCTION_LIST /end MEASUREMENT
/begin MEASUREMENT vFLGRPS0E "-" UBYTE COMP_0068 1 100 0 255 ECU_ADDRESS 0xFFFF2D6C /begin FUNCTION_LIST KF7-313C.1[36] /end FUNCTION_LIST /end MEASUREMENT
/begin MEASUREMENT vFODWN2 "At the time of Rich, AFSHOS renewal permission flag (0: prohibition 1: permission)" UBYTE COMP_0283 1 100 0 255 ECU_ADDRESS 0xFFFF2D8E /begin FUNCTION_LIST KF7-313C.1[36] KF7-313C.4[3] /end FUNCTION_LIST /end MEASUREMENT
/begin MEASUREMENT vFODWN2_R#1 "At the time of Rich, AFSHOS renewal permission flag (0: prohibition 1: permission)" UBYTE COMP_0283 1 100 0 255 ECU_ADDRESS 0xFFFF2D8E /begin FUNCTION_LIST KF7-313C.1[36] KF7-313C.4[3] /end FUNCTION_LIST /end MEASUREMENT
/begin MEASUREMENT vFODWN2_R#2 "At the time of Rich, AFSHOS renewal permission flag (0: prohibition 1: permission)" UBYTE COMP_0283 1 100 0 255 ECU_ADDRESS 0xFFFF2D8F /begin FUNCTION_LIST KF7-313C.1[36] KF7-313C.4[3] /end FUNCTION_LIST /end MEASUREMENT
/begin MEASUREMENT vFROUP2 "At the time of Lean, A/F sensor learning value renewal permission flag" UBYTE COMP_0068 1 100 0 255 ECU_ADDRESS 0xFFFF13A6 /begin FUNCTION_LIST KF7-313C.1[36] KF7-313C.4[3] /end FUNCTION_LIST /end MEASUREMENT
/begin MEASUREMENT vFROUP2_R#1 "At the time of Lean, A/F sensor learning value renewal permission flag" UBYTE COMP_0068 1 100 0 255 ECU_ADDRESS 0xFFFF13A6 /begin FUNCTION_LIST KF7-313C.1[36] KF7-313C.4[3] /end FUNCTION_LIST /end MEASUREMENT
/begin MEASUREMENT vFROUP2_R#2 "At the time of Lean, A/F sensor learning value renewal permission flag" UBYTE COMP_0068 1 100 0 255 ECU_ADDRESS 0xFFFF13A7 /begin FUNCTION_LIST KF7-313C.1[36] KF7-313C.4[3] /end FUNCTION_LIST /end MEASUREMENT
/begin MEASUREMENT vGAC "Cylinder inhalation air quantity equivalent pulse width conversion value" UWORD COMP_0593_S 1 100 0 31.999495335 ECU_ADDRESS 0xFFFF13B4 /begin FUNCTION_LIST KF7-313C.1[36] /end FUNCTION_LIST /end MEASUREMENT
/begin MEASUREMENT vHLRDIFF "After air quantity compensation, lean rich parameter buffer" UWORD COMP_0453 1 100 0 131.07 ECU_ADDRESS 0xFFFF2E18 /begin FUNCTION_LIST KF7-313C.1[36] /end FUNCTION_LIST /end MEASUREMENT
/begin MEASUREMENT vHLRDIFF_R#1 "After air quantity compensation, lean rich parameter buffer" UWORD COMP_0453 1 100 0 131.07 ECU_ADDRESS 0xFFFF2E18 /begin FUNCTION_LIST KF7-313C.1[36] /end FUNCTION_LIST /end MEASUREMENT
/begin MEASUREMENT vHLRDIFF_R#2 "After air quantity compensation, lean rich parameter buffer" UWORD COMP_0453 1 100 0 131.07 ECU_ADDRESS 0xFFFF2E1A /begin FUNCTION_LIST KF7-313C.1[36] /end FUNCTION_LIST /end MEASUREMENT
/begin MEASUREMENT vHODTM "Heater on delay timer" UWORD COMP_0165_S 1 100 0 655.35 ECU_ADDRESS 0xFFFF2E1C /begin FUNCTION_LIST KF7-313C.1[36] /end FUNCTION_LIST /end MEASUREMENT
/begin MEASUREMENT vHODTM_R#1 "Heater on delay timer" UWORD COMP_0165_S 1 100 0 655.35 ECU_ADDRESS 0xFFFF2E1C /begin FUNCTION_LIST KF7-313C.1[36] /end FUNCTION_LIST /end MEASUREMENT
/begin MEASUREMENT vHODTM_R#2 "Heater on delay timer" UWORD COMP_0165_S 1 100 0 655.35 ECU_ADDRESS 0xFFFF2E1E /begin FUNCTION_LIST KF7-313C.1[36] /end FUNCTION_LIST /end MEASUREMENT
/begin MEASUREMENT vHPAMB "Atomospheric pressure compensation coefficient" UBYTE COMP_0045 1 100 0 1.9921875 ECU_ADDRESS 0xFFFF2E2A /begin FUNCTION_LIST KF7-313C.1[36] /end FUNCTION_LIST /end MEASUREMENT
/begin MEASUREMENT vHRLDIFF "After air quantity compensation, rich lean parameter buffer" UWORD COMP_0453 1 100 0 131.07 ECU_ADDRESS 0xFFFF2E2C /begin FUNCTION_LIST KF7-313C.1[36] /end FUNCTION_LIST /end MEASUREMENT
/begin MEASUREMENT vHRLDIFF_R#1 "After air quantity compensation, rich lean parameter buffer" UWORD COMP_0453 1 100 0 131.07 ECU_ADDRESS 0xFFFF2E2C /begin FUNCTION_LIST KF7-313C.1[36] /end FUNCTION_LIST /end MEASUREMENT
/begin MEASUREMENT vHRLDIFF_R#2 "After air quantity compensation, rich lean parameter buffer" UWORD COMP_0453 1 100 0 131.07 ECU_ADDRESS 0xFFFF2E2E /begin FUNCTION_LIST KF7-313C.1[36] /end FUNCTION_LIST /end MEASUREMENT
/begin MEASUREMENT vIOLID "I/O Local ID data" UBYTE COMP_0004 1 100 0 255 ECU_ADDRESS 0xFFFF2E61 /begin FUNCTION_LIST KF7-313C.1[36] KF7-351.1[16] KF7-351.2[17] KF7-580.1[8] /end FUNCTION_LIST /end MEASUREMENT
/begin MEASUREMENT vJGRLD "A diagnosis parameter (rich/lean) for GST" UWORD COMP_0453 1 100 0 131.07 ECU_ADDRESS 0xFFFF2E72 /begin FUNCTION_LIST KF7-313C.1[36] KF7-500.74B[5] /end FUNCTION_LIST /end MEASUREMENT
/begin MEASUREMENT vJGRLD_R#1 "A diagnosis parameter (rich/lean) for GST" UWORD COMP_0453 1 100 0 131.07 ECU_ADDRESS 0xFFFF2E72 /begin FUNCTION_LIST KF7-313C.1[36] KF7-500.74B[5] /end FUNCTION_LIST /end MEASUREMENT
/begin MEASUREMENT vJGRLD_R#2 "A diagnosis parameter (rich/lean) for GST" UWORD COMP_0453 1 100 0 131.07 ECU_ADDRESS 0xFFFF2E74 /begin FUNCTION_LIST KF7-313C.1[36] KF7-500.74B[5] /end FUNCTION_LIST /end MEASUREMENT
/begin MEASUREMENT vLCOUNT "Lean rich number of times" UBYTE COMP_0016 1 100 0 255 ECU_ADDRESS 0xFFFF2E98 /begin FUNCTION_LIST KF7-313C.1[36] /end FUNCTION_LIST /end MEASUREMENT
/begin MEASUREMENT vLCOUNT_R#1 "Lean rich number of times" UBYTE COMP_0016 1 100 0 255 ECU_ADDRESS 0xFFFF2E98 /begin FUNCTION_LIST KF7-313C.1[36] /end FUNCTION_LIST /end MEASUREMENT
/begin MEASUREMENT vLCOUNT_R#2 "Lean rich number of times" UBYTE COMP_0016 1 100 0 255 ECU_ADDRESS 0xFFFF2E99 /begin FUNCTION_LIST KF7-313C.1[36] /end FUNCTION_LIST /end MEASUREMENT
/begin MEASUREMENT vLHOLD "Lean maximum value previous value" UWORD COMP_0453 1 100 0 131.07 ECU_ADDRESS 0xFFFF2EA2 /begin FUNCTION_LIST KF7-313C.1[36] /end FUNCTION_LIST /end MEASUREMENT
/begin MEASUREMENT vLHOLD_R#1 "Lean maximum value previous value" UWORD COMP_0453 1 100 0 131.07 ECU_ADDRESS 0xFFFF2EA2 /begin FUNCTION_LIST KF7-313C.1[36] /end FUNCTION_LIST /end MEASUREMENT
/begin MEASUREMENT vLHOLD_R#2 "Lean maximum value previous value" UWORD COMP_0453 1 100 0 131.07 ECU_ADDRESS 0xFFFF2EA4 /begin FUNCTION_LIST KF7-313C.1[36] /end FUNCTION_LIST /end MEASUREMENT
/begin MEASUREMENT vLINTVL "Lean time timer" UWORD COMP_0165_S 1 100 0 655.35 ECU_ADDRESS 0xFFFF2EA6 /begin FUNCTION_LIST KF7-313C.1[36] /end FUNCTION_LIST /end MEASUREMENT
/begin MEASUREMENT vLINTVL_R#1 "Lean time timer" UWORD COMP_0165_S 1 100 0 655.35 ECU_ADDRESS 0xFFFF2EA6 /begin FUNCTION_LIST KF7-313C.1[36] /end FUNCTION_LIST /end MEASUREMENT
/begin MEASUREMENT vLINTVL_R#2 "Lean time timer" UWORD COMP_0165_S 1 100 0 655.35 ECU_ADDRESS 0xFFFF2EA8 /begin FUNCTION_LIST KF7-313C.1[36] /end FUNCTION_LIST /end MEASUREMENT
/begin MEASUREMENT vLLPEAK "At the time of the lean, RrO2 sensor minimum value" UWORD COMP_0023 1 100 0 327675 ECU_ADDRESS 0xFFFF2EAE /begin FUNCTION_LIST KF7-313C.1[36] /end FUNCTION_LIST /end MEASUREMENT
/begin MEASUREMENT vLLPEAK_R#1 "At the time of the lean, RrO2 sensor minimum value" UWORD COMP_0023 1 100 0 327675 ECU_ADDRESS 0xFFFF2EAE /begin FUNCTION_LIST KF7-313C.1[36] /end FUNCTION_LIST /end MEASUREMENT
/begin MEASUREMENT vLLPEAK_R#2 "At the time of the lean, RrO2 sensor minimum value" UWORD COMP_0023 1 100 0 327675 ECU_ADDRESS 0xFFFF2EB0 /begin FUNCTION_LIST KF7-313C.1[36] /end FUNCTION_LIST /end MEASUREMENT
/begin MEASUREMENT vLMDPMDA "CLOSE control compulsory start delay" UBYTE COMP_0008 1 100 0 25500 ECU_ADDRESS 0xFFFF152F /begin FUNCTION_LIST KF7-313C.1[36] /end FUNCTION_LIST /end MEASUREMENT
/begin MEASUREMENT vLMDPMDA_R#1 "CLOSE control compulsory start delay" UBYTE COMP_0008 1 100 0 25500 ECU_ADDRESS 0xFFFF152F /begin FUNCTION_LIST KF7-313C.1[36] /end FUNCTION_LIST /end MEASUREMENT
/begin MEASUREMENT vLMDPMDA_R#2 "CLOSE control compulsory start delay" UBYTE COMP_0008 1 100 0 25500 ECU_ADDRESS 0xFFFF1530 /begin FUNCTION_LIST KF7-313C.1[36] /end FUNCTION_LIST /end MEASUREMENT
/begin MEASUREMENT vLPEAK "Lean maximum value" UWORD COMP_0453 1 100 0 131.07 ECU_ADDRESS 0xFFFF2EBA /begin FUNCTION_LIST KF7-313C.1[36] /end FUNCTION_LIST /end MEASUREMENT
/begin MEASUREMENT vLPEAK_R#1 "Lean maximum value" UWORD COMP_0453 1 100 0 131.07 ECU_ADDRESS 0xFFFF2EBA /begin FUNCTION_LIST KF7-313C.1[36] /end FUNCTION_LIST /end MEASUREMENT
/begin MEASUREMENT vLPEAK_R#2 "Lean maximum value" UWORD COMP_0453 1 100 0 131.07 ECU_ADDRESS 0xFFFF2EBC /begin FUNCTION_LIST KF7-313C.1[36] /end FUNCTION_LIST /end MEASUREMENT
/begin MEASUREMENT vLRDIFF "Rich lean parameter buffer" UWORD COMP_0453 1 100 0 131.07 ECU_ADDRESS 0xFFFF2EC0 /begin FUNCTION_LIST KF7-313C.1[36] /end FUNCTION_LIST /end MEASUREMENT
/begin MEASUREMENT vLRDIFF_R#1 "Rich lean parameter buffer" UWORD COMP_0453 1 100 0 131.07 ECU_ADDRESS 0xFFFF2EC0 /begin FUNCTION_LIST KF7-313C.1[36] /end FUNCTION_LIST /end MEASUREMENT
/begin MEASUREMENT vLRDIFF_R#2 "Rich lean parameter buffer" UWORD COMP_0453 1 100 0 131.07 ECU_ADDRESS 0xFFFF2EC2 /begin FUNCTION_LIST KF7-313C.1[36] /end FUNCTION_LIST /end MEASUREMENT
/begin MEASUREMENT vLRDSUM "Lean side parameter integration value" ULONG COMP_0453 1 100 0 8589934.59 ECU_ADDRESS 0xFFFF2EC8 /begin FUNCTION_LIST KF7-313C.1[36] /end FUNCTION_LIST /end MEASUREMENT
/begin MEASUREMENT vLRDSUM_R#1 "Lean side parameter integration value" ULONG COMP_0453 1 100 0 8589934.59 ECU_ADDRESS 0xFFFF2EC8 /begin FUNCTION_LIST KF7-313C.1[36] /end FUNCTION_LIST /end MEASUREMENT
/begin MEASUREMENT vLRDSUM_R#2 "Lean side parameter integration value" ULONG COMP_0453 1 100 0 8589934.59 ECU_ADDRESS 0xFFFF2ECC /begin FUNCTION_LIST KF7-313C.1[36] /end FUNCTION_LIST /end MEASUREMENT
/begin MEASUREMENT vLRPEAK "At the time of the lean, RrO2 sensor maximum value" UWORD COMP_0023 1 100 0 327675 ECU_ADDRESS 0xFFFF2ED4 /begin FUNCTION_LIST KF7-313C.1[36] /end FUNCTION_LIST /end MEASUREMENT
/begin MEASUREMENT vLRPEAK_R#1 "At the time of the lean, RrO2 sensor maximum value" UWORD COMP_0023 1 100 0 327675 ECU_ADDRESS 0xFFFF2ED4 /begin FUNCTION_LIST KF7-313C.1[36] /end FUNCTION_LIST /end MEASUREMENT
/begin MEASUREMENT vLRPEAK_R#2 "At the time of the lean, RrO2 sensor maximum value" UWORD COMP_0023 1 100 0 327675 ECU_ADDRESS 0xFFFF2ED6 /begin FUNCTION_LIST KF7-313C.1[36] /end FUNCTION_LIST /end MEASUREMENT
/begin MEASUREMENT vLSLICE "Lean side slice value" UWORD COMP_0023 1 100 0 327675 ECU_ADDRESS 0xFFFF2ED8 /begin FUNCTION_LIST KF7-313C.1[36] /end FUNCTION_LIST /end MEASUREMENT
/begin MEASUREMENT vLSLICE_R#1 "Lean side slice value" UWORD COMP_0023 1 100 0 327675 ECU_ADDRESS 0xFFFF2ED8 /begin FUNCTION_LIST KF7-313C.1[36] /end FUNCTION_LIST /end MEASUREMENT
/begin MEASUREMENT vLSLICE_R#2 "Lean side slice value" UWORD COMP_0023 1 100 0 327675 ECU_ADDRESS 0xFFFF2EDA /begin FUNCTION_LIST KF7-313C.1[36] /end FUNCTION_LIST /end MEASUREMENT
/begin MEASUREMENT vLSOSQ "-" SLONG COMP_0094_S 1 100 -21474836.48 21474836.47 ECU_ADDRESS 0xFFFF2EDC /begin FUNCTION_LIST KF7-313C.1[36] KF7-313C.7[1] /end FUNCTION_LIST /end MEASUREMENT
/begin MEASUREMENT vLSOSQ_R#1 "-" SLONG COMP_0094_S 1 100 -21474836.48 21474836.47 ECU_ADDRESS 0xFFFF2EDC /begin FUNCTION_LIST KF7-313C.1[36] KF7-313C.7[1] /end FUNCTION_LIST /end MEASUREMENT
/begin MEASUREMENT vLSOSQ_R#2 "-" SLONG COMP_0094_S 1 100 -21474836.48 21474836.47 ECU_ADDRESS 0xFFFF2EE0 /begin FUNCTION_LIST KF7-313C.1[36] KF7-313C.7[1] /end FUNCTION_LIST /end MEASUREMENT
/begin MEASUREMENT vMDLWAIT "At the time of switching, a waste time compensation timer" UBYTE COMP_0068 1 100 0 255 ECU_ADDRESS 0xFFFF1565 /begin FUNCTION_LIST KF7-313C.1[36] /end FUNCTION_LIST /end MEASUREMENT
/begin MEASUREMENT vMNALL "At the time of the parameter minimum value renewal, ALPHA (lean rich)" UWORD COMP_0031 1 100 0 255.99609375 ECU_ADDRESS 0xFFFFA744 /begin FUNCTION_LIST KF7-313C.1[36] /end FUNCTION_LIST /end MEASUREMENT
/begin MEASUREMENT vMNALL_R#1 "At the time of the parameter minimum value renewal, ALPHA (lean rich)" UWORD COMP_0031 1 100 0 255.99609375 ECU_ADDRESS 0xFFFFA744 /begin FUNCTION_LIST KF7-313C.1[36] /end FUNCTION_LIST /end MEASUREMENT
/begin MEASUREMENT vMNALL_R#2 "At the time of the parameter minimum value renewal, ALPHA (lean rich)" UWORD COMP_0031 1 100 0 255.99609375 ECU_ADDRESS 0xFFFFA746 /begin FUNCTION_LIST KF7-313C.1[36] /end FUNCTION_LIST /end MEASUREMENT
/begin MEASUREMENT vMNALL_R#3 "At the time of the parameter minimum value renewal, ALPHA (lean rich)" UWORD COMP_0031 1 100 0 255.99609375 ECU_ADDRESS 0xFFFFA748 /begin FUNCTION_LIST KF7-313C.1[36] /end FUNCTION_LIST /end MEASUREMENT
/begin MEASUREMENT vMNALL_R#4 "At the time of the parameter minimum value renewal, ALPHA (lean rich)" UWORD COMP_0031 1 100 0 255.99609375 ECU_ADDRESS 0xFFFFA74A /begin FUNCTION_LIST KF7-313C.1[36] /end FUNCTION_LIST /end MEASUREMENT
/begin MEASUREMENT vMNALL_R#5 "At the time of the parameter minimum value renewal, ALPHA (lean rich)" UWORD COMP_0031 1 100 0 255.99609375 ECU_ADDRESS 0xFFFFA74C /begin FUNCTION_LIST KF7-313C.1[36] /end FUNCTION_LIST /end MEASUREMENT
/begin MEASUREMENT vMNALL_R#6 "At the time of the parameter minimum value renewal, ALPHA (lean rich)" UWORD COMP_0031 1 100 0 255.99609375 ECU_ADDRESS 0xFFFFA74E /begin FUNCTION_LIST KF7-313C.1[36] /end FUNCTION_LIST /end MEASUREMENT
/begin MEASUREMENT vMNALL_R#7 "At the time of the parameter minimum value renewal, ALPHA (lean rich)" UWORD COMP_0031 1 100 0 255.99609375 ECU_ADDRESS 0xFFFFA750 /begin FUNCTION_LIST KF7-313C.1[36] /end FUNCTION_LIST /end MEASUREMENT
/begin MEASUREMENT vMNALL_R#8 "At the time of the parameter minimum value renewal, ALPHA (lean rich)" UWORD COMP_0031 1 100 0 255.99609375 ECU_ADDRESS 0xFFFFA752 /begin FUNCTION_LIST KF7-313C.1[36] /end FUNCTION_LIST /end MEASUREMENT
/begin MEASUREMENT vMNALL_R#9 "At the time of the parameter minimum value renewal, ALPHA (lean rich)" UWORD COMP_0031 1 100 0 255.99609375 ECU_ADDRESS 0xFFFFA754 /begin FUNCTION_LIST KF7-313C.1[36] /end FUNCTION_LIST /end MEASUREMENT
/begin MEASUREMENT vMNALL_R#10 "At the time of the parameter minimum value renewal, ALPHA (lean rich)" UWORD COMP_0031 1 100 0 255.99609375 ECU_ADDRESS 0xFFFFA756 /begin FUNCTION_LIST KF7-313C.1[36] /end FUNCTION_LIST /end MEASUREMENT
/begin MEASUREMENT vMNALL_R#11 "At the time of the parameter minimum value renewal, ALPHA (lean rich)" UWORD COMP_0031 1 100 0 255.99609375 ECU_ADDRESS 0xFFFFA758 /begin FUNCTION_LIST KF7-313C.1[36] /end FUNCTION_LIST /end MEASUREMENT
/begin MEASUREMENT vMNALL_R#12 "At the time of the parameter minimum value renewal, ALPHA (lean rich)" UWORD COMP_0031 1 100 0 255.99609375 ECU_ADDRESS 0xFFFFA75A /begin FUNCTION_LIST KF7-313C.1[36] /end FUNCTION_LIST /end MEASUREMENT
/begin MEASUREMENT vMNALL_R#13 "At the time of the parameter minimum value renewal, ALPHA (lean rich)" UWORD COMP_0031 1 100 0 255.99609375 ECU_ADDRESS 0xFFFFA75C /begin FUNCTION_LIST KF7-313C.1[36] /end FUNCTION_LIST /end MEASUREMENT
/begin MEASUREMENT vMNALL_R#14 "At the time of the parameter minimum value renewal, ALPHA (lean rich)" UWORD COMP_0031 1 100 0 255.99609375 ECU_ADDRESS 0xFFFFA75E /begin FUNCTION_LIST KF7-313C.1[36] /end FUNCTION_LIST /end MEASUREMENT
/begin MEASUREMENT vMNALL_R#15 "At the time of the parameter minimum value renewal, ALPHA (lean rich)" UWORD COMP_0031 1 100 0 255.99609375 ECU_ADDRESS 0xFFFFA760 /begin FUNCTION_LIST KF7-313C.1[36] /end FUNCTION_LIST /end MEASUREMENT
/begin MEASUREMENT vMNALL_R#16 "At the time of the parameter minimum value renewal, ALPHA (lean rich)" UWORD COMP_0031 1 100 0 255.99609375 ECU_ADDRESS 0xFFFFA762 /begin FUNCTION_LIST KF7-313C.1[36] /end FUNCTION_LIST /end MEASUREMENT
/begin MEASUREMENT vMNALR "At the time of the parameter minimum value renewal, ALPHA (rich lean)" UWORD COMP_0031 1 100 0 255.99609375 ECU_ADDRESS 0xFFFFA764 /begin FUNCTION_LIST KF7-313C.1[36] /end FUNCTION_LIST /end MEASUREMENT
/begin MEASUREMENT vMNALR_R#1 "At the time of the parameter minimum value renewal, ALPHA (rich lean)" UWORD COMP_0031 1 100 0 255.99609375 ECU_ADDRESS 0xFFFFA764 /begin FUNCTION_LIST KF7-313C.1[36] /end FUNCTION_LIST /end MEASUREMENT
/begin MEASUREMENT vMNALR_R#2 "At the time of the parameter minimum value renewal, ALPHA (rich lean)" UWORD COMP_0031 1 100 0 255.99609375 ECU_ADDRESS 0xFFFFA766 /begin FUNCTION_LIST KF7-313C.1[36] /end FUNCTION_LIST /end MEASUREMENT
/begin MEASUREMENT vMNALR_R#3 "At the time of the parameter minimum value renewal, ALPHA (rich lean)" UWORD COMP_0031 1 100 0 255.99609375 ECU_ADDRESS 0xFFFFA768 /begin FUNCTION_LIST KF7-313C.1[36] /end FUNCTION_LIST /end MEASUREMENT
/begin MEASUREMENT vMNALR_R#4 "At the time of the parameter minimum value renewal, ALPHA (rich lean)" UWORD COMP_0031 1 100 0 255.99609375 ECU_ADDRESS 0xFFFFA76A /begin FUNCTION_LIST KF7-313C.1[36] /end FUNCTION_LIST /end MEASUREMENT
/begin MEASUREMENT vMNALR_R#5 "At the time of the parameter minimum value renewal, ALPHA (rich lean)" UWORD COMP_0031 1 100 0 255.99609375 ECU_ADDRESS 0xFFFFA76C /begin FUNCTION_LIST KF7-313C.1[36] /end FUNCTION_LIST /end MEASUREMENT
/begin MEASUREMENT vMNALR_R#6 "At the time of the parameter minimum value renewal, ALPHA (rich lean)" UWORD COMP_0031 1 100 0 255.99609375 ECU_ADDRESS 0xFFFFA76E /begin FUNCTION_LIST KF7-313C.1[36] /end FUNCTION_LIST /end MEASUREMENT
/begin MEASUREMENT vMNALR_R#7 "At the time of the parameter minimum value renewal, ALPHA (rich lean)" UWORD COMP_0031 1 100 0 255.99609375 ECU_ADDRESS 0xFFFFA770 /begin FUNCTION_LIST KF7-313C.1[36] /end FUNCTION_LIST /end MEASUREMENT
/begin MEASUREMENT vMNALR_R#8 "At the time of the parameter minimum value renewal, ALPHA (rich lean)" UWORD COMP_0031 1 100 0 255.99609375 ECU_ADDRESS 0xFFFFA772 /begin FUNCTION_LIST KF7-313C.1[36] /end FUNCTION_LIST /end MEASUREMENT
/begin MEASUREMENT vMNALR_R#9 "At the time of the parameter minimum value renewal, ALPHA (rich lean)" UWORD COMP_0031 1 100 0 255.99609375 ECU_ADDRESS 0xFFFFA774 /begin FUNCTION_LIST KF7-313C.1[36] /end FUNCTION_LIST /end MEASUREMENT
/begin MEASUREMENT vMNALR_R#10 "At the time of the parameter minimum value renewal, ALPHA (rich lean)" UWORD COMP_0031 1 100 0 255.99609375 ECU_ADDRESS 0xFFFFA776 /begin FUNCTION_LIST KF7-313C.1[36] /end FUNCTION_LIST /end MEASUREMENT
/begin MEASUREMENT vMNALR_R#11 "At the time of the parameter minimum value renewal, ALPHA (rich lean)" UWORD COMP_0031 1 100 0 255.99609375 ECU_ADDRESS 0xFFFFA778 /begin FUNCTION_LIST KF7-313C.1[36] /end FUNCTION_LIST /end MEASUREMENT
/begin MEASUREMENT vMNALR_R#12 "At the time of the parameter minimum value renewal, ALPHA (rich lean)" UWORD COMP_0031 1 100 0 255.99609375 ECU_ADDRESS 0xFFFFA77A /begin FUNCTION_LIST KF7-313C.1[36] /end FUNCTION_LIST /end MEASUREMENT
/begin MEASUREMENT vMNALR_R#13 "At the time of the parameter minimum value renewal, ALPHA (rich lean)" UWORD COMP_0031 1 100 0 255.99609375 ECU_ADDRESS 0xFFFFA77C /begin FUNCTION_LIST KF7-313C.1[36] /end FUNCTION_LIST /end MEASUREMENT
/begin MEASUREMENT vMNALR_R#14 "At the time of the parameter minimum value renewal, ALPHA (rich lean)" UWORD COMP_0031 1 100 0 255.99609375 ECU_ADDRESS 0xFFFFA77E /begin FUNCTION_LIST KF7-313C.1[36] /end FUNCTION_LIST /end MEASUREMENT
/begin MEASUREMENT vMNALR_R#15 "At the time of the parameter minimum value renewal, ALPHA (rich lean)" UWORD COMP_0031 1 100 0 255.99609375 ECU_ADDRESS 0xFFFFA780 /begin FUNCTION_LIST KF7-313C.1[36] /end FUNCTION_LIST /end MEASUREMENT
/begin MEASUREMENT vMNALR_R#16 "At the time of the parameter minimum value renewal, ALPHA (rich lean)" UWORD COMP_0031 1 100 0 255.99609375 ECU_ADDRESS 0xFFFFA782 /begin FUNCTION_LIST KF7-313C.1[36] /end FUNCTION_LIST /end MEASUREMENT
/begin MEASUREMENT vMNDNL "At the time of the parameter minimum value renewal, rotation change (lean rich)" UBYTE COMP_0006 1 100 0 3187.5 ECU_ADDRESS 0xFFFFA7C4 /begin FUNCTION_LIST KF7-313C.1[36] /end FUNCTION_LIST /end MEASUREMENT
/begin MEASUREMENT vMNDNL_R#1 "At the time of the parameter minimum value renewal, rotation change (lean rich)" UBYTE COMP_0006 1 100 0 3187.5 ECU_ADDRESS 0xFFFFA7C4 /begin FUNCTION_LIST KF7-313C.1[36] /end FUNCTION_LIST /end MEASUREMENT
/begin MEASUREMENT vMNDNL_R#2 "At the time of the parameter minimum value renewal, rotation change (lean rich)" UBYTE COMP_0006 1 100 0 3187.5 ECU_ADDRESS 0xFFFFA7C5 /begin FUNCTION_LIST KF7-313C.1[36] /end FUNCTION_LIST /end MEASUREMENT
/begin MEASUREMENT vMNDNL_R#3 "At the time of the parameter minimum value renewal, rotation change (lean rich)" UBYTE COMP_0006 1 100 0 3187.5 ECU_ADDRESS 0xFFFFA7C6 /begin FUNCTION_LIST KF7-313C.1[36] /end FUNCTION_LIST /end MEASUREMENT
/begin MEASUREMENT vMNDNL_R#4 "At the time of the parameter minimum value renewal, rotation change (lean rich)" UBYTE COMP_0006 1 100 0 3187.5 ECU_ADDRESS 0xFFFFA7C7 /begin FUNCTION_LIST KF7-313C.1[36] /end FUNCTION_LIST /end MEASUREMENT
/begin MEASUREMENT vMNDNL_R#5 "At the time of the parameter minimum value renewal, rotation change (lean rich)" UBYTE COMP_0006 1 100 0 3187.5 ECU_ADDRESS 0xFFFFA7C8 /begin FUNCTION_LIST KF7-313C.1[36] /end FUNCTION_LIST /end MEASUREMENT
/begin MEASUREMENT vMNDNL_R#6 "At the time of the parameter minimum value renewal, rotation change (lean rich)" UBYTE COMP_0006 1 100 0 3187.5 ECU_ADDRESS 0xFFFFA7C9 /begin FUNCTION_LIST KF7-313C.1[36] /end FUNCTION_LIST /end MEASUREMENT
/begin MEASUREMENT vMNDNL_R#7 "At the time of the parameter minimum value renewal, rotation change (lean rich)" UBYTE COMP_0006 1 100 0 3187.5 ECU_ADDRESS 0xFFFFA7CA /begin FUNCTION_LIST KF7-313C.1[36] /end FUNCTION_LIST /end MEASUREMENT
/begin MEASUREMENT vMNDNL_R#8 "At the time of the parameter minimum value renewal, rotation change (lean rich)" UBYTE COMP_0006 1 100 0 3187.5 ECU_ADDRESS 0xFFFFA7CB /begin FUNCTION_LIST KF7-313C.1[36] /end FUNCTION_LIST /end MEASUREMENT
/begin MEASUREMENT vMNDNL_R#9 "At the time of the parameter minimum value renewal, rotation change (lean rich)" UBYTE COMP_0006 1 100 0 3187.5 ECU_ADDRESS 0xFFFFA7CC /begin FUNCTION_LIST KF7-313C.1[36] /end FUNCTION_LIST /end MEASUREMENT
/begin MEASUREMENT vMNDNL_R#10 "At the time of the parameter minimum value renewal, rotation change (lean rich)" UBYTE COMP_0006 1 100 0 3187.5 ECU_ADDRESS 0xFFFFA7CD /begin FUNCTION_LIST KF7-313C.1[36] /end FUNCTION_LIST /end MEASUREMENT
/begin MEASUREMENT vMNDNL_R#11 "At the time of the parameter minimum value renewal, rotation change (lean rich)" UBYTE COMP_0006 1 100 0 3187.5 ECU_ADDRESS 0xFFFFA7CE /begin FUNCTION_LIST KF7-313C.1[36] /end FUNCTION_LIST /end MEASUREMENT
/begin MEASUREMENT vMNDNL_R#12 "At the time of the parameter minimum value renewal, rotation change (lean rich)" UBYTE COMP_0006 1 100 0 3187.5 ECU_ADDRESS 0xFFFFA7CF /begin FUNCTION_LIST KF7-313C.1[36] /end FUNCTION_LIST /end MEASUREMENT
/begin MEASUREMENT vMNDNL_R#13 "At the time of the parameter minimum value renewal, rotation change (lean rich)" UBYTE COMP_0006 1 100 0 3187.5 ECU_ADDRESS 0xFFFFA7D0 /begin FUNCTION_LIST KF7-313C.1[36] /end FUNCTION_LIST /end MEASUREMENT
/begin MEASUREMENT vMNDNL_R#14 "At the time of the parameter minimum value renewal, rotation change (lean rich)" UBYTE COMP_0006 1 100 0 3187.5 ECU_ADDRESS 0xFFFFA7D1 /begin FUNCTION_LIST KF7-313C.1[36] /end FUNCTION_LIST /end MEASUREMENT
/begin MEASUREMENT vMNDNL_R#15 "At the time of the parameter minimum value renewal, rotation change (lean rich)" UBYTE COMP_0006 1 100 0 3187.5 ECU_ADDRESS 0xFFFFA7D2 /begin FUNCTION_LIST KF7-313C.1[36] /end FUNCTION_LIST /end MEASUREMENT
/begin MEASUREMENT vMNDNL_R#16 "At the time of the parameter minimum value renewal, rotation change (lean rich)" UBYTE COMP_0006 1 100 0 3187.5 ECU_ADDRESS 0xFFFFA7D3 /begin FUNCTION_LIST KF7-313C.1[36] /end FUNCTION_LIST /end MEASUREMENT
/begin MEASUREMENT vMNDNR "At the time of the parameter minimum value renewal, rotation change (rich lean)" UBYTE COMP_0006 1 100 0 3187.5 ECU_ADDRESS 0xFFFFA7D4 /begin FUNCTION_LIST KF7-313C.1[36] /end FUNCTION_LIST /end MEASUREMENT
/begin MEASUREMENT vMNDNR_R#1 "At the time of the parameter minimum value renewal, rotation change (rich lean)" UBYTE COMP_0006 1 100 0 3187.5 ECU_ADDRESS 0xFFFFA7D4 /begin FUNCTION_LIST KF7-313C.1[36] /end FUNCTION_LIST /end MEASUREMENT
/begin MEASUREMENT vMNDNR_R#2 "At the time of the parameter minimum value renewal, rotation change (rich lean)" UBYTE COMP_0006 1 100 0 3187.5 ECU_ADDRESS 0xFFFFA7D5 /begin FUNCTION_LIST KF7-313C.1[36] /end FUNCTION_LIST /end MEASUREMENT
/begin MEASUREMENT vMNDNR_R#3 "At the time of the parameter minimum value renewal, rotation change (rich lean)" UBYTE COMP_0006 1 100 0 3187.5 ECU_ADDRESS 0xFFFFA7D6 /begin FUNCTION_LIST KF7-313C.1[36] /end FUNCTION_LIST /end MEASUREMENT
/begin MEASUREMENT vMNDNR_R#4 "At the time of the parameter minimum value renewal, rotation change (rich lean)" UBYTE COMP_0006 1 100 0 3187.5 ECU_ADDRESS 0xFFFFA7D7 /begin FUNCTION_LIST KF7-313C.1[36] /end FUNCTION_LIST /end MEASUREMENT
/begin MEASUREMENT vMNDNR_R#5 "At the time of the parameter minimum value renewal, rotation change (rich lean)" UBYTE COMP_0006 1 100 0 3187.5 ECU_ADDRESS 0xFFFFA7D8 /begin FUNCTION_LIST KF7-313C.1[36] /end FUNCTION_LIST /end MEASUREMENT
/begin MEASUREMENT vMNDNR_R#6 "At the time of the parameter minimum value renewal, rotation change (rich lean)" UBYTE COMP_0006 1 100 0 3187.5 ECU_ADDRESS 0xFFFFA7D9 /begin FUNCTION_LIST KF7-313C.1[36] /end FUNCTION_LIST /end MEASUREMENT
/begin MEASUREMENT vMNDNR_R#7 "At the time of the parameter minimum value renewal, rotation change (rich lean)" UBYTE COMP_0006 1 100 0 3187.5 ECU_ADDRESS 0xFFFFA7DA /begin FUNCTION_LIST KF7-313C.1[36] /end FUNCTION_LIST /end MEASUREMENT
/begin MEASUREMENT vMNDNR_R#8 "At the time of the parameter minimum value renewal, rotation change (rich lean)" UBYTE COMP_0006 1 100 0 3187.5 ECU_ADDRESS 0xFFFFA7DB /begin FUNCTION_LIST KF7-313C.1[36] /end FUNCTION_LIST /end MEASUREMENT
/begin MEASUREMENT vMNDNR_R#9 "At the time of the parameter minimum value renewal, rotation change (rich lean)" UBYTE COMP_0006 1 100 0 3187.5 ECU_ADDRESS 0xFFFFA7DC /begin FUNCTION_LIST KF7-313C.1[36] /end FUNCTION_LIST /end MEASUREMENT
/begin MEASUREMENT vMNDNR_R#10 "At the time of the parameter minimum value renewal, rotation change (rich lean)" UBYTE COMP_0006 1 100 0 3187.5 ECU_ADDRESS 0xFFFFA7DD /begin FUNCTION_LIST KF7-313C.1[36] /end FUNCTION_LIST /end MEASUREMENT
/begin MEASUREMENT vMNDNR_R#11 "At the time of the parameter minimum value renewal, rotation change (rich lean)" UBYTE COMP_0006 1 100 0 3187.5 ECU_ADDRESS 0xFFFFA7DE /begin FUNCTION_LIST KF7-313C.1[36] /end FUNCTION_LIST /end MEASUREMENT
/begin MEASUREMENT vMNDNR_R#12 "At the time of the parameter minimum value renewal, rotation change (rich lean)" UBYTE COMP_0006 1 100 0 3187.5 ECU_ADDRESS 0xFFFFA7DF /begin FUNCTION_LIST KF7-313C.1[36] /end FUNCTION_LIST /end MEASUREMENT
/begin MEASUREMENT vMNDNR_R#13 "At the time of the parameter minimum value renewal, rotation change (rich lean)" UBYTE COMP_0006 1 100 0 3187.5 ECU_ADDRESS 0xFFFFA7E0 /begin FUNCTION_LIST KF7-313C.1[36] /end FUNCTION_LIST /end MEASUREMENT
/begin MEASUREMENT vMNDNR_R#14 "At the time of the parameter minimum value renewal, rotation change (rich lean)" UBYTE COMP_0006 1 100 0 3187.5 ECU_ADDRESS 0xFFFFA7E1 /begin FUNCTION_LIST KF7-313C.1[36] /end FUNCTION_LIST /end MEASUREMENT
/begin MEASUREMENT vMNDNR_R#15 "At the time of the parameter minimum value renewal, rotation change (rich lean)" UBYTE COMP_0006 1 100 0 3187.5 ECU_ADDRESS 0xFFFFA7E2 /begin FUNCTION_LIST KF7-313C.1[36] /end FUNCTION_LIST /end MEASUREMENT
/begin MEASUREMENT vMNDNR_R#16 "At the time of the parameter minimum value renewal, rotation change (rich lean)" UBYTE COMP_0006 1 100 0 3187.5 ECU_ADDRESS 0xFFFFA7E3 /begin FUNCTION_LIST KF7-313C.1[36] /end FUNCTION_LIST /end MEASUREMENT
/begin MEASUREMENT vMNDQL "At the time of the parameter minimum value renewal, air change (lean rich)" UWORD COMP_0068 1 100 0 65535 ECU_ADDRESS 0xFFFFA7E4 /begin FUNCTION_LIST KF7-313C.1[36] /end FUNCTION_LIST /end MEASUREMENT
/begin MEASUREMENT vMNDQL_R#1 "At the time of the parameter minimum value renewal, air change (lean rich)" UWORD COMP_0068 1 100 0 65535 ECU_ADDRESS 0xFFFFA7E4 /begin FUNCTION_LIST KF7-313C.1[36] /end FUNCTION_LIST /end MEASUREMENT
/begin MEASUREMENT vMNDQL_R#2 "At the time of the parameter minimum value renewal, air change (lean rich)" UWORD COMP_0068 1 100 0 65535 ECU_ADDRESS 0xFFFFA7E6 /begin FUNCTION_LIST KF7-313C.1[36] /end FUNCTION_LIST /end MEASUREMENT
/begin MEASUREMENT vMNDQL_R#3 "At the time of the parameter minimum value renewal, air change (lean rich)" UWORD COMP_0068 1 100 0 65535 ECU_ADDRESS 0xFFFFA7E8 /begin FUNCTION_LIST KF7-313C.1[36] /end FUNCTION_LIST /end MEASUREMENT
/begin MEASUREMENT vMNDQL_R#4 "At the time of the parameter minimum value renewal, air change (lean rich)" UWORD COMP_0068 1 100 0 65535 ECU_ADDRESS 0xFFFFA7EA /begin FUNCTION_LIST KF7-313C.1[36] /end FUNCTION_LIST /end MEASUREMENT
/begin MEASUREMENT vMNDQL_R#5 "At the time of the parameter minimum value renewal, air change (lean rich)" UWORD COMP_0068 1 100 0 65535 ECU_ADDRESS 0xFFFFA7EC /begin FUNCTION_LIST KF7-313C.1[36] /end FUNCTION_LIST /end MEASUREMENT
/begin MEASUREMENT vMNDQL_R#6 "At the time of the parameter minimum value renewal, air change (lean rich)" UWORD COMP_0068 1 100 0 65535 ECU_ADDRESS 0xFFFFA7EE /begin FUNCTION_LIST KF7-313C.1[36] /end FUNCTION_LIST /end MEASUREMENT
/begin MEASUREMENT vMNDQL_R#7 "At the time of the parameter minimum value renewal, air change (lean rich)" UWORD COMP_0068 1 100 0 65535 ECU_ADDRESS 0xFFFFA7F0 /begin FUNCTION_LIST KF7-313C.1[36] /end FUNCTION_LIST /end MEASUREMENT
/begin MEASUREMENT vMNDQL_R#8 "At the time of the parameter minimum value renewal, air change (lean rich)" UWORD COMP_0068 1 100 0 65535 ECU_ADDRESS 0xFFFFA7F2 /begin FUNCTION_LIST KF7-313C.1[36] /end FUNCTION_LIST /end MEASUREMENT
/begin MEASUREMENT vMNDQL_R#9 "At the time of the parameter minimum value renewal, air change (lean rich)" UWORD COMP_0068 1 100 0 65535 ECU_ADDRESS 0xFFFFA7F4 /begin FUNCTION_LIST KF7-313C.1[36] /end FUNCTION_LIST /end MEASUREMENT
/begin MEASUREMENT vMNDQL_R#10 "At the time of the parameter minimum value renewal, air change (lean rich)" UWORD COMP_0068 1 100 0 65535 ECU_ADDRESS 0xFFFFA7F6 /begin FUNCTION_LIST KF7-313C.1[36] /end FUNCTION_LIST /end MEASUREMENT
/begin MEASUREMENT vMNDQL_R#11 "At the time of the parameter minimum value renewal, air change (lean rich)" UWORD COMP_0068 1 100 0 65535 ECU_ADDRESS 0xFFFFA7F8 /begin FUNCTION_LIST KF7-313C.1[36] /end FUNCTION_LIST /end MEASUREMENT
/begin MEASUREMENT vMNDQL_R#12 "At the time of the parameter minimum value renewal, air change (lean rich)" UWORD COMP_0068 1 100 0 65535 ECU_ADDRESS 0xFFFFA7FA /begin FUNCTION_LIST KF7-313C.1[36] /end FUNCTION_LIST /end MEASUREMENT
/begin MEASUREMENT vMNDQL_R#13 "At the time of the parameter minimum value renewal, air change (lean rich)" UWORD COMP_0068 1 100 0 65535 ECU_ADDRESS 0xFFFFA7FC /begin FUNCTION_LIST KF7-313C.1[36] /end FUNCTION_LIST /end MEASUREMENT
/begin MEASUREMENT vMNDQL_R#14 "At the time of the parameter minimum value renewal, air change (lean rich)" UWORD COMP_0068 1 100 0 65535 ECU_ADDRESS 0xFFFFA7FE /begin FUNCTION_LIST KF7-313C.1[36] /end FUNCTION_LIST /end MEASUREMENT
/begin MEASUREMENT vMNDQL_R#15 "At the time of the parameter minimum value renewal, air change (lean rich)" UWORD COMP_0068 1 100 0 65535 ECU_ADDRESS 0xFFFFA800 /begin FUNCTION_LIST KF7-313C.1[36] /end FUNCTION_LIST /end MEASUREMENT
/begin MEASUREMENT vMNDQL_R#16 "At the time of the parameter minimum value renewal, air change (lean rich)" UWORD COMP_0068 1 100 0 65535 ECU_ADDRESS 0xFFFFA802 /begin FUNCTION_LIST KF7-313C.1[36] /end FUNCTION_LIST /end MEASUREMENT
/begin MEASUREMENT vMNDQR "At the time of the parameter minimum value renewal, air change (rich lean)" UWORD COMP_0068 1 100 0 65535 ECU_ADDRESS 0xFFFFA804 /begin FUNCTION_LIST KF7-313C.1[36] /end FUNCTION_LIST /end MEASUREMENT
/begin MEASUREMENT vMNDQR_R#1 "At the time of the parameter minimum value renewal, air change (rich lean)" UWORD COMP_0068 1 100 0 65535 ECU_ADDRESS 0xFFFFA804 /begin FUNCTION_LIST KF7-313C.1[36] /end FUNCTION_LIST /end MEASUREMENT
/begin MEASUREMENT vMNDQR_R#2 "At the time of the parameter minimum value renewal, air change (rich lean)" UWORD COMP_0068 1 100 0 65535 ECU_ADDRESS 0xFFFFA806 /begin FUNCTION_LIST KF7-313C.1[36] /end FUNCTION_LIST /end MEASUREMENT
/begin MEASUREMENT vMNDQR_R#3 "At the time of the parameter minimum value renewal, air change (rich lean)" UWORD COMP_0068 1 100 0 65535 ECU_ADDRESS 0xFFFFA808 /begin FUNCTION_LIST KF7-313C.1[36] /end FUNCTION_LIST /end MEASUREMENT
/begin MEASUREMENT vMNDQR_R#4 "At the time of the parameter minimum value renewal, air change (rich lean)" UWORD COMP_0068 1 100 0 65535 ECU_ADDRESS 0xFFFFA80A /begin FUNCTION_LIST KF7-313C.1[36] /end FUNCTION_LIST /end MEASUREMENT
/begin MEASUREMENT vMNDQR_R#5 "At the time of the parameter minimum value renewal, air change (rich lean)" UWORD COMP_0068 1 100 0 65535 ECU_ADDRESS 0xFFFFA80C /begin FUNCTION_LIST KF7-313C.1[36] /end FUNCTION_LIST /end MEASUREMENT
/begin MEASUREMENT vMNDQR_R#6 "At the time of the parameter minimum value renewal, air change (rich lean)" UWORD COMP_0068 1 100 0 65535 ECU_ADDRESS 0xFFFFA80E /begin FUNCTION_LIST KF7-313C.1[36] /end FUNCTION_LIST /end MEASUREMENT
/begin MEASUREMENT vMNDQR_R#7 "At the time of the parameter minimum value renewal, air change (rich lean)" UWORD COMP_0068 1 100 0 65535 ECU_ADDRESS 0xFFFFA810 /begin FUNCTION_LIST KF7-313C.1[36] /end FUNCTION_LIST /end MEASUREMENT
/begin MEASUREMENT vMNDQR_R#8 "At the time of the parameter minimum value renewal, air change (rich lean)" UWORD COMP_0068 1 100 0 65535 ECU_ADDRESS 0xFFFFA812 /begin FUNCTION_LIST KF7-313C.1[36] /end FUNCTION_LIST /end MEASUREMENT
/begin MEASUREMENT vMNDQR_R#9 "At the time of the parameter minimum value renewal, air change (rich lean)" UWORD COMP_0068 1 100 0 65535 ECU_ADDRESS 0xFFFFA814 /begin FUNCTION_LIST KF7-313C.1[36] /end FUNCTION_LIST /end MEASUREMENT
/begin MEASUREMENT vMNDQR_R#10 "At the time of the parameter minimum value renewal, air change (rich lean)" UWORD COMP_0068 1 100 0 65535 ECU_ADDRESS 0xFFFFA816 /begin FUNCTION_LIST KF7-313C.1[36] /end FUNCTION_LIST /end MEASUREMENT
/begin MEASUREMENT vMNDQR_R#11 "At the time of the parameter minimum value renewal, air change (rich lean)" UWORD COMP_0068 1 100 0 65535 ECU_ADDRESS 0xFFFFA818 /begin FUNCTION_LIST KF7-313C.1[36] /end FUNCTION_LIST /end MEASUREMENT
/begin MEASUREMENT vMNDQR_R#12 "At the time of the parameter minimum value renewal, air change (rich lean)" UWORD COMP_0068 1 100 0 65535 ECU_ADDRESS 0xFFFFA81A /begin FUNCTION_LIST KF7-313C.1[36] /end FUNCTION_LIST /end MEASUREMENT
/begin MEASUREMENT vMNDQR_R#13 "At the time of the parameter minimum value renewal, air change (rich lean)" UWORD COMP_0068 1 100 0 65535 ECU_ADDRESS 0xFFFFA81C /begin FUNCTION_LIST KF7-313C.1[36] /end FUNCTION_LIST /end MEASUREMENT
/begin MEASUREMENT vMNDQR_R#14 "At the time of the parameter minimum value renewal, air change (rich lean)" UWORD COMP_0068 1 100 0 65535 ECU_ADDRESS 0xFFFFA81E /begin FUNCTION_LIST KF7-313C.1[36] /end FUNCTION_LIST /end MEASUREMENT
/begin MEASUREMENT vMNDQR_R#15 "At the time of the parameter minimum value renewal, air change (rich lean)" UWORD COMP_0068 1 100 0 65535 ECU_ADDRESS 0xFFFFA820 /begin FUNCTION_LIST KF7-313C.1[36] /end FUNCTION_LIST /end MEASUREMENT
/begin MEASUREMENT vMNDQR_R#16 "At the time of the parameter minimum value renewal, air change (rich lean)" UWORD COMP_0068 1 100 0 65535 ECU_ADDRESS 0xFFFFA822 /begin FUNCTION_LIST KF7-313C.1[36] /end FUNCTION_LIST /end MEASUREMENT
/begin MEASUREMENT vMNFLGL "At the time of the parameter minimum value renewal, flag (lean rich)" UBYTE COMP_0068 1 100 0 255 ECU_ADDRESS 0xFFFFA824 /begin FUNCTION_LIST KF7-313C.1[36] /end FUNCTION_LIST /end MEASUREMENT
/begin MEASUREMENT vMNFLGL_R#1 "At the time of the parameter minimum value renewal, flag (lean rich)" UBYTE COMP_0068 1 100 0 255 ECU_ADDRESS 0xFFFFA824 /begin FUNCTION_LIST KF7-313C.1[36] /end FUNCTION_LIST /end MEASUREMENT
/begin MEASUREMENT vMNFLGL_R#2 "At the time of the parameter minimum value renewal, flag (lean rich)" UBYTE COMP_0068 1 100 0 255 ECU_ADDRESS 0xFFFFA825 /begin FUNCTION_LIST KF7-313C.1[36] /end FUNCTION_LIST /end MEASUREMENT
/begin MEASUREMENT vMNFLGL_R#3 "At the time of the parameter minimum value renewal, flag (lean rich)" UBYTE COMP_0068 1 100 0 255 ECU_ADDRESS 0xFFFFA826 /begin FUNCTION_LIST KF7-313C.1[36] /end FUNCTION_LIST /end MEASUREMENT
/begin MEASUREMENT vMNFLGL_R#4 "At the time of the parameter minimum value renewal, flag (lean rich)" UBYTE COMP_0068 1 100 0 255 ECU_ADDRESS 0xFFFFA827 /begin FUNCTION_LIST KF7-313C.1[36] /end FUNCTION_LIST /end MEASUREMENT
/begin MEASUREMENT vMNFLGL_R#5 "At the time of the parameter minimum value renewal, flag (lean rich)" UBYTE COMP_0068 1 100 0 255 ECU_ADDRESS 0xFFFFA828 /begin FUNCTION_LIST KF7-313C.1[36] /end FUNCTION_LIST /end MEASUREMENT
/begin MEASUREMENT vMNFLGL_R#6 "At the time of the parameter minimum value renewal, flag (lean rich)" UBYTE COMP_0068 1 100 0 255 ECU_ADDRESS 0xFFFFA829 /begin FUNCTION_LIST KF7-313C.1[36] /end FUNCTION_LIST /end MEASUREMENT
/begin MEASUREMENT vMNFLGL_R#7 "At the time of the parameter minimum value renewal, flag (lean rich)" UBYTE COMP_0068 1 100 0 255 ECU_ADDRESS 0xFFFFA82A /begin FUNCTION_LIST KF7-313C.1[36] /end FUNCTION_LIST /end MEASUREMENT
/begin MEASUREMENT vMNFLGL_R#8 "At the time of the parameter minimum value renewal, flag (lean rich)" UBYTE COMP_0068 1 100 0 255 ECU_ADDRESS 0xFFFFA82B /begin FUNCTION_LIST KF7-313C.1[36] /end FUNCTION_LIST /end MEASUREMENT
/begin MEASUREMENT vMNFLGL_R#9 "At the time of the parameter minimum value renewal, flag (lean rich)" UBYTE COMP_0068 1 100 0 255 ECU_ADDRESS 0xFFFFA82C /begin FUNCTION_LIST KF7-313C.1[36] /end FUNCTION_LIST /end MEASUREMENT
/begin MEASUREMENT vMNFLGL_R#10 "At the time of the parameter minimum value renewal, flag (lean rich)" UBYTE COMP_0068 1 100 0 255 ECU_ADDRESS 0xFFFFA82D /begin FUNCTION_LIST KF7-313C.1[36] /end FUNCTION_LIST /end MEASUREMENT
/begin MEASUREMENT vMNFLGL_R#11 "At the time of the parameter minimum value renewal, flag (lean rich)" UBYTE COMP_0068 1 100 0 255 ECU_ADDRESS 0xFFFFA82E /begin FUNCTION_LIST KF7-313C.1[36] /end FUNCTION_LIST /end MEASUREMENT
/begin MEASUREMENT vMNFLGL_R#12 "At the time of the parameter minimum value renewal, flag (lean rich)" UBYTE COMP_0068 1 100 0 255 ECU_ADDRESS 0xFFFFA82F /begin FUNCTION_LIST KF7-313C.1[36] /end FUNCTION_LIST /end MEASUREMENT
/begin MEASUREMENT vMNFLGL_R#13 "At the time of the parameter minimum value renewal, flag (lean rich)" UBYTE COMP_0068 1 100 0 255 ECU_ADDRESS 0xFFFFA830 /begin FUNCTION_LIST KF7-313C.1[36] /end FUNCTION_LIST /end MEASUREMENT
/begin MEASUREMENT vMNFLGL_R#14 "At the time of the parameter minimum value renewal, flag (lean rich)" UBYTE COMP_0068 1 100 0 255 ECU_ADDRESS 0xFFFFA831 /begin FUNCTION_LIST KF7-313C.1[36] /end FUNCTION_LIST /end MEASUREMENT
/begin MEASUREMENT vMNFLGL_R#15 "At the time of the parameter minimum value renewal, flag (lean rich)" UBYTE COMP_0068 1 100 0 255 ECU_ADDRESS 0xFFFFA832 /begin FUNCTION_LIST KF7-313C.1[36] /end FUNCTION_LIST /end MEASUREMENT
/begin MEASUREMENT vMNFLGL_R#16 "At the time of the parameter minimum value renewal, flag (lean rich)" UBYTE COMP_0068 1 100 0 255 ECU_ADDRESS 0xFFFFA833 /begin FUNCTION_LIST KF7-313C.1[36] /end FUNCTION_LIST /end MEASUREMENT
/begin MEASUREMENT vMNFLGR "At the time of the parameter minimum value renewal, flag (rich lean)" UBYTE COMP_0068 1 100 0 255 ECU_ADDRESS 0xFFFFA834 /begin FUNCTION_LIST KF7-313C.1[36] /end FUNCTION_LIST /end MEASUREMENT
/begin MEASUREMENT vMNFLGR_R#1 "At the time of the parameter minimum value renewal, flag (rich lean)" UBYTE COMP_0068 1 100 0 255 ECU_ADDRESS 0xFFFFA834 /begin FUNCTION_LIST KF7-313C.1[36] /end FUNCTION_LIST /end MEASUREMENT
/begin MEASUREMENT vMNFLGR_R#2 "At the time of the parameter minimum value renewal, flag (rich lean)" UBYTE COMP_0068 1 100 0 255 ECU_ADDRESS 0xFFFFA835 /begin FUNCTION_LIST KF7-313C.1[36] /end FUNCTION_LIST /end MEASUREMENT
/begin MEASUREMENT vMNFLGR_R#3 "At the time of the parameter minimum value renewal, flag (rich lean)" UBYTE COMP_0068 1 100 0 255 ECU_ADDRESS 0xFFFFA836 /begin FUNCTION_LIST KF7-313C.1[36] /end FUNCTION_LIST /end MEASUREMENT
/begin MEASUREMENT vMNFLGR_R#4 "At the time of the parameter minimum value renewal, flag (rich lean)" UBYTE COMP_0068 1 100 0 255 ECU_ADDRESS 0xFFFFA837 /begin FUNCTION_LIST KF7-313C.1[36] /end FUNCTION_LIST /end MEASUREMENT
/begin MEASUREMENT vMNFLGR_R#5 "At the time of the parameter minimum value renewal, flag (rich lean)" UBYTE COMP_0068 1 100 0 255 ECU_ADDRESS 0xFFFFA838 /begin FUNCTION_LIST KF7-313C.1[36] /end FUNCTION_LIST /end MEASUREMENT
/begin MEASUREMENT vMNFLGR_R#6 "At the time of the parameter minimum value renewal, flag (rich lean)" UBYTE COMP_0068 1 100 0 255 ECU_ADDRESS 0xFFFFA839 /begin FUNCTION_LIST KF7-313C.1[36] /end FUNCTION_LIST /end MEASUREMENT
/begin MEASUREMENT vMNFLGR_R#7 "At the time of the parameter minimum value renewal, flag (rich lean)" UBYTE COMP_0068 1 100 0 255 ECU_ADDRESS 0xFFFFA83A /begin FUNCTION_LIST KF7-313C.1[36] /end FUNCTION_LIST /end MEASUREMENT
/begin MEASUREMENT vMNFLGR_R#8 "At the time of the parameter minimum value renewal, flag (rich lean)" UBYTE COMP_0068 1 100 0 255 ECU_ADDRESS 0xFFFFA83B /begin FUNCTION_LIST KF7-313C.1[36] /end FUNCTION_LIST /end MEASUREMENT
/begin MEASUREMENT vMNFLGR_R#9 "At the time of the parameter minimum value renewal, flag (rich lean)" UBYTE COMP_0068 1 100 0 255 ECU_ADDRESS 0xFFFFA83C /begin FUNCTION_LIST KF7-313C.1[36] /end FUNCTION_LIST /end MEASUREMENT
/begin MEASUREMENT vMNFLGR_R#10 "At the time of the parameter minimum value renewal, flag (rich lean)" UBYTE COMP_0068 1 100 0 255 ECU_ADDRESS 0xFFFFA83D /begin FUNCTION_LIST KF7-313C.1[36] /end FUNCTION_LIST /end MEASUREMENT
/begin MEASUREMENT vMNFLGR_R#11 "At the time of the parameter minimum value renewal, flag (rich lean)" UBYTE COMP_0068 1 100 0 255 ECU_ADDRESS 0xFFFFA83E /begin FUNCTION_LIST KF7-313C.1[36] /end FUNCTION_LIST /end MEASUREMENT
/begin MEASUREMENT vMNFLGR_R#12 "At the time of the parameter minimum value renewal, flag (rich lean)" UBYTE COMP_0068 1 100 0 255 ECU_ADDRESS 0xFFFFA83F /begin FUNCTION_LIST KF7-313C.1[36] /end FUNCTION_LIST /end MEASUREMENT
/begin MEASUREMENT vMNFLGR_R#13 "At the time of the parameter minimum value renewal, flag (rich lean)" UBYTE COMP_0068 1 100 0 255 ECU_ADDRESS 0xFFFFA840 /begin FUNCTION_LIST KF7-313C.1[36] /end FUNCTION_LIST /end MEASUREMENT
/begin MEASUREMENT vMNFLGR_R#14 "At the time of the parameter minimum value renewal, flag (rich lean)" UBYTE COMP_0068 1 100 0 255 ECU_ADDRESS 0xFFFFA841 /begin FUNCTION_LIST KF7-313C.1[36] /end FUNCTION_LIST /end MEASUREMENT
/begin MEASUREMENT vMNFLGR_R#15 "At the time of the parameter minimum value renewal, flag (rich lean)" UBYTE COMP_0068 1 100 0 255 ECU_ADDRESS 0xFFFFA842 /begin FUNCTION_LIST KF7-313C.1[36] /end FUNCTION_LIST /end MEASUREMENT
/begin MEASUREMENT vMNFLGR_R#16 "At the time of the parameter minimum value renewal, flag (rich lean)" UBYTE COMP_0068 1 100 0 255 ECU_ADDRESS 0xFFFFA843 /begin FUNCTION_LIST KF7-313C.1[36] /end FUNCTION_LIST /end MEASUREMENT
/begin MEASUREMENT vMNHOL "At the time of the parameter minimum value renewal, heater on delay time (lean rich)" UWORD COMP_0165_S 1 100 0 655.35 ECU_ADDRESS 0xFFFFA844 /begin FUNCTION_LIST KF7-313C.1[36] /end FUNCTION_LIST /end MEASUREMENT
/begin MEASUREMENT vMNHOL_R#1 "At the time of the parameter minimum value renewal, heater on delay time (lean rich)" UWORD COMP_0165_S 1 100 0 655.35 ECU_ADDRESS 0xFFFFA844 /begin FUNCTION_LIST KF7-313C.1[36] /end FUNCTION_LIST /end MEASUREMENT
/begin MEASUREMENT vMNHOL_R#2 "At the time of the parameter minimum value renewal, heater on delay time (lean rich)" UWORD COMP_0165_S 1 100 0 655.35 ECU_ADDRESS 0xFFFFA846 /begin FUNCTION_LIST KF7-313C.1[36] /end FUNCTION_LIST /end MEASUREMENT
/begin MEASUREMENT vMNHOL_R#3 "At the time of the parameter minimum value renewal, heater on delay time (lean rich)" UWORD COMP_0165_S 1 100 0 655.35 ECU_ADDRESS 0xFFFFA848 /begin FUNCTION_LIST KF7-313C.1[36] /end FUNCTION_LIST /end MEASUREMENT
/begin MEASUREMENT vMNHOL_R#4 "At the time of the parameter minimum value renewal, heater on delay time (lean rich)" UWORD COMP_0165_S 1 100 0 655.35 ECU_ADDRESS 0xFFFFA84A /begin FUNCTION_LIST KF7-313C.1[36] /end FUNCTION_LIST /end MEASUREMENT
/begin MEASUREMENT vMNHOL_R#5 "At the time of the parameter minimum value renewal, heater on delay time (lean rich)" UWORD COMP_0165_S 1 100 0 655.35 ECU_ADDRESS 0xFFFFA84C /begin FUNCTION_LIST KF7-313C.1[36] /end FUNCTION_LIST /end MEASUREMENT
/begin MEASUREMENT vMNHOL_R#6 "At the time of the parameter minimum value renewal, heater on delay time (lean rich)" UWORD COMP_0165_S 1 100 0 655.35 ECU_ADDRESS 0xFFFFA84E /begin FUNCTION_LIST KF7-313C.1[36] /end FUNCTION_LIST /end MEASUREMENT
/begin MEASUREMENT vMNHOL_R#7 "At the time of the parameter minimum value renewal, heater on delay time (lean rich)" UWORD COMP_0165_S 1 100 0 655.35 ECU_ADDRESS 0xFFFFA850 /begin FUNCTION_LIST KF7-313C.1[36] /end FUNCTION_LIST /end MEASUREMENT
/begin MEASUREMENT vMNHOL_R#8 "At the time of the parameter minimum value renewal, heater on delay time (lean rich)" UWORD COMP_0165_S 1 100 0 655.35 ECU_ADDRESS 0xFFFFA852 /begin FUNCTION_LIST KF7-313C.1[36] /end FUNCTION_LIST /end MEASUREMENT
/begin MEASUREMENT vMNHOL_R#9 "At the time of the parameter minimum value renewal, heater on delay time (lean rich)" UWORD COMP_0165_S 1 100 0 655.35 ECU_ADDRESS 0xFFFFA854 /begin FUNCTION_LIST KF7-313C.1[36] /end FUNCTION_LIST /end MEASUREMENT
/begin MEASUREMENT vMNHOL_R#10 "At the time of the parameter minimum value renewal, heater on delay time (lean rich)" UWORD COMP_0165_S 1 100 0 655.35 ECU_ADDRESS 0xFFFFA856 /begin FUNCTION_LIST KF7-313C.1[36] /end FUNCTION_LIST /end MEASUREMENT
/begin MEASUREMENT vMNHOL_R#11 "At the time of the parameter minimum value renewal, heater on delay time (lean rich)" UWORD COMP_0165_S 1 100 0 655.35 ECU_ADDRESS 0xFFFFA858 /begin FUNCTION_LIST KF7-313C.1[36] /end FUNCTION_LIST /end MEASUREMENT
/begin MEASUREMENT vMNHOL_R#12 "At the time of the parameter minimum value renewal, heater on delay time (lean rich)" UWORD COMP_0165_S 1 100 0 655.35 ECU_ADDRESS 0xFFFFA85A /begin FUNCTION_LIST KF7-313C.1[36] /end FUNCTION_LIST /end MEASUREMENT
/begin MEASUREMENT vMNHOL_R#13 "At the time of the parameter minimum value renewal, heater on delay time (lean rich)" UWORD COMP_0165_S 1 100 0 655.35 ECU_ADDRESS 0xFFFFA85C /begin FUNCTION_LIST KF7-313C.1[36] /end FUNCTION_LIST /end MEASUREMENT
/begin MEASUREMENT vMNHOL_R#14 "At the time of the parameter minimum value renewal, heater on delay time (lean rich)" UWORD COMP_0165_S 1 100 0 655.35 ECU_ADDRESS 0xFFFFA85E /begin FUNCTION_LIST KF7-313C.1[36] /end FUNCTION_LIST /end MEASUREMENT
/begin MEASUREMENT vMNHOL_R#15 "At the time of the parameter minimum value renewal, heater on delay time (lean rich)" UWORD COMP_0165_S 1 100 0 655.35 ECU_ADDRESS 0xFFFFA860 /begin FUNCTION_LIST KF7-313C.1[36] /end FUNCTION_LIST /end MEASUREMENT
/begin MEASUREMENT vMNHOL_R#16 "At the time of the parameter minimum value renewal, heater on delay time (lean rich)" UWORD COMP_0165_S 1 100 0 655.35 ECU_ADDRESS 0xFFFFA862 /begin FUNCTION_LIST KF7-313C.1[36] /end FUNCTION_LIST /end MEASUREMENT
/begin MEASUREMENT vMNHOR "At the time of the parameter minimum value renewal, heater on delay time (rich lean)" UWORD COMP_0165_S 1 100 0 655.35 ECU_ADDRESS 0xFFFFA864 /begin FUNCTION_LIST KF7-313C.1[36] /end FUNCTION_LIST /end MEASUREMENT
/begin MEASUREMENT vMNHOR_R#1 "At the time of the parameter minimum value renewal, heater on delay time (rich lean)" UWORD COMP_0165_S 1 100 0 655.35 ECU_ADDRESS 0xFFFFA864 /begin FUNCTION_LIST KF7-313C.1[36] /end FUNCTION_LIST /end MEASUREMENT
/begin MEASUREMENT vMNHOR_R#2 "At the time of the parameter minimum value renewal, heater on delay time (rich lean)" UWORD COMP_0165_S 1 100 0 655.35 ECU_ADDRESS 0xFFFFA866 /begin FUNCTION_LIST KF7-313C.1[36] /end FUNCTION_LIST /end MEASUREMENT
/begin MEASUREMENT vMNHOR_R#3 "At the time of the parameter minimum value renewal, heater on delay time (rich lean)" UWORD COMP_0165_S 1 100 0 655.35 ECU_ADDRESS 0xFFFFA868 /begin FUNCTION_LIST KF7-313C.1[36] /end FUNCTION_LIST /end MEASUREMENT
/begin MEASUREMENT vMNHOR_R#4 "At the time of the parameter minimum value renewal, heater on delay time (rich lean)" UWORD COMP_0165_S 1 100 0 655.35 ECU_ADDRESS 0xFFFFA86A /begin FUNCTION_LIST KF7-313C.1[36] /end FUNCTION_LIST /end MEASUREMENT
/begin MEASUREMENT vMNHOR_R#5 "At the time of the parameter minimum value renewal, heater on delay time (rich lean)" UWORD COMP_0165_S 1 100 0 655.35 ECU_ADDRESS 0xFFFFA86C /begin FUNCTION_LIST KF7-313C.1[36] /end FUNCTION_LIST /end MEASUREMENT
/begin MEASUREMENT vMNHOR_R#6 "At the time of the parameter minimum value renewal, heater on delay time (rich lean)" UWORD COMP_0165_S 1 100 0 655.35 ECU_ADDRESS 0xFFFFA86E /begin FUNCTION_LIST KF7-313C.1[36] /end FUNCTION_LIST /end MEASUREMENT
/begin MEASUREMENT vMNHOR_R#7 "At the time of the parameter minimum value renewal, heater on delay time (rich lean)" UWORD COMP_0165_S 1 100 0 655.35 ECU_ADDRESS 0xFFFFA870 /begin FUNCTION_LIST KF7-313C.1[36] /end FUNCTION_LIST /end MEASUREMENT
/begin MEASUREMENT vMNHOR_R#8 "At the time of the parameter minimum value renewal, heater on delay time (rich lean)" UWORD COMP_0165_S 1 100 0 655.35 ECU_ADDRESS 0xFFFFA872 /begin FUNCTION_LIST KF7-313C.1[36] /end FUNCTION_LIST /end MEASUREMENT
/begin MEASUREMENT vMNHOR_R#9 "At the time of the parameter minimum value renewal, heater on delay time (rich lean)" UWORD COMP_0165_S 1 100 0 655.35 ECU_ADDRESS 0xFFFFA874 /begin FUNCTION_LIST KF7-313C.1[36] /end FUNCTION_LIST /end MEASUREMENT
/begin MEASUREMENT vMNHOR_R#10 "At the time of the parameter minimum value renewal, heater on delay time (rich lean)" UWORD COMP_0165_S 1 100 0 655.35 ECU_ADDRESS 0xFFFFA876 /begin FUNCTION_LIST KF7-313C.1[36] /end FUNCTION_LIST /end MEASUREMENT
/begin MEASUREMENT vMNHOR_R#11 "At the time of the parameter minimum value renewal, heater on delay time (rich lean)" UWORD COMP_0165_S 1 100 0 655.35 ECU_ADDRESS 0xFFFFA878 /begin FUNCTION_LIST KF7-313C.1[36] /end FUNCTION_LIST /end MEASUREMENT
/begin MEASUREMENT vMNHOR_R#12 "At the time of the parameter minimum value renewal, heater on delay time (rich lean)" UWORD COMP_0165_S 1 100 0 655.35 ECU_ADDRESS 0xFFFFA87A /begin FUNCTION_LIST KF7-313C.1[36] /end FUNCTION_LIST /end MEASUREMENT
/begin MEASUREMENT vMNHOR_R#13 "At the time of the parameter minimum value renewal, heater on delay time (rich lean)" UWORD COMP_0165_S 1 100 0 655.35 ECU_ADDRESS 0xFFFFA87C /begin FUNCTION_LIST KF7-313C.1[36] /end FUNCTION_LIST /end MEASUREMENT
/begin MEASUREMENT vMNHOR_R#14 "At the time of the parameter minimum value renewal, heater on delay time (rich lean)" UWORD COMP_0165_S 1 100 0 655.35 ECU_ADDRESS 0xFFFFA87E /begin FUNCTION_LIST KF7-313C.1[36] /end FUNCTION_LIST /end MEASUREMENT
/begin MEASUREMENT vMNHOR_R#15 "At the time of the parameter minimum value renewal, heater on delay time (rich lean)" UWORD COMP_0165_S 1 100 0 655.35 ECU_ADDRESS 0xFFFFA880 /begin FUNCTION_LIST KF7-313C.1[36] /end FUNCTION_LIST /end MEASUREMENT
/begin MEASUREMENT vMNHOR_R#16 "At the time of the parameter minimum value renewal, heater on delay time (rich lean)" UWORD COMP_0165_S 1 100 0 655.35 ECU_ADDRESS 0xFFFFA882 /begin FUNCTION_LIST KF7-313C.1[36] /end FUNCTION_LIST /end MEASUREMENT
/begin MEASUREMENT vMNLPL "At the time of the parameter minimum value renewal, A/F lean value (lean rich)" UWORD COMP_0453 1 100 0 131.07 ECU_ADDRESS 0xFFFFA884 /begin FUNCTION_LIST KF7-313C.1[36] /end FUNCTION_LIST /end MEASUREMENT
/begin MEASUREMENT vMNLPL_R#1 "At the time of the parameter minimum value renewal, A/F lean value (lean rich)" UWORD COMP_0453 1 100 0 131.07 ECU_ADDRESS 0xFFFFA884 /begin FUNCTION_LIST KF7-313C.1[36] /end FUNCTION_LIST /end MEASUREMENT
/begin MEASUREMENT vMNLPL_R#2 "At the time of the parameter minimum value renewal, A/F lean value (lean rich)" UWORD COMP_0453 1 100 0 131.07 ECU_ADDRESS 0xFFFFA886 /begin FUNCTION_LIST KF7-313C.1[36] /end FUNCTION_LIST /end MEASUREMENT
/begin MEASUREMENT vMNLPL_R#3 "At the time of the parameter minimum value renewal, A/F lean value (lean rich)" UWORD COMP_0453 1 100 0 131.07 ECU_ADDRESS 0xFFFFA888 /begin FUNCTION_LIST KF7-313C.1[36] /end FUNCTION_LIST /end MEASUREMENT
/begin MEASUREMENT vMNLPL_R#4 "At the time of the parameter minimum value renewal, A/F lean value (lean rich)" UWORD COMP_0453 1 100 0 131.07 ECU_ADDRESS 0xFFFFA88A /begin FUNCTION_LIST KF7-313C.1[36] /end FUNCTION_LIST /end MEASUREMENT
/begin MEASUREMENT vMNLPL_R#5 "At the time of the parameter minimum value renewal, A/F lean value (lean rich)" UWORD COMP_0453 1 100 0 131.07 ECU_ADDRESS 0xFFFFA88C /begin FUNCTION_LIST KF7-313C.1[36] /end FUNCTION_LIST /end MEASUREMENT
/begin MEASUREMENT vMNLPL_R#6 "At the time of the parameter minimum value renewal, A/F lean value (lean rich)" UWORD COMP_0453 1 100 0 131.07 ECU_ADDRESS 0xFFFFA88E /begin FUNCTION_LIST KF7-313C.1[36] /end FUNCTION_LIST /end MEASUREMENT
/begin MEASUREMENT vMNLPL_R#7 "At the time of the parameter minimum value renewal, A/F lean value (lean rich)" UWORD COMP_0453 1 100 0 131.07 ECU_ADDRESS 0xFFFFA890 /begin FUNCTION_LIST KF7-313C.1[36] /end FUNCTION_LIST /end MEASUREMENT
/begin MEASUREMENT vMNLPL_R#8 "At the time of the parameter minimum value renewal, A/F lean value (lean rich)" UWORD COMP_0453 1 100 0 131.07 ECU_ADDRESS 0xFFFFA892 /begin FUNCTION_LIST KF7-313C.1[36] /end FUNCTION_LIST /end MEASUREMENT
/begin MEASUREMENT vMNLPL_R#9 "At the time of the parameter minimum value renewal, A/F lean value (lean rich)" UWORD COMP_0453 1 100 0 131.07 ECU_ADDRESS 0xFFFFA894 /begin FUNCTION_LIST KF7-313C.1[36] /end FUNCTION_LIST /end MEASUREMENT
/begin MEASUREMENT vMNLPL_R#10 "At the time of the parameter minimum value renewal, A/F lean value (lean rich)" UWORD COMP_0453 1 100 0 131.07 ECU_ADDRESS 0xFFFFA896 /begin FUNCTION_LIST KF7-313C.1[36] /end FUNCTION_LIST /end MEASUREMENT
/begin MEASUREMENT vMNLPL_R#11 "At the time of the parameter minimum value renewal, A/F lean value (lean rich)" UWORD COMP_0453 1 100 0 131.07 ECU_ADDRESS 0xFFFFA898 /begin FUNCTION_LIST KF7-313C.1[36] /end FUNCTION_LIST /end MEASUREMENT
/begin MEASUREMENT vMNLPL_R#12 "At the time of the parameter minimum value renewal, A/F lean value (lean rich)" UWORD COMP_0453 1 100 0 131.07 ECU_ADDRESS 0xFFFFA89A /begin FUNCTION_LIST KF7-313C.1[36] /end FUNCTION_LIST /end MEASUREMENT
/begin MEASUREMENT vMNLPL_R#13 "At the time of the parameter minimum value renewal, A/F lean value (lean rich)" UWORD COMP_0453 1 100 0 131.07 ECU_ADDRESS 0xFFFFA89C /begin FUNCTION_LIST KF7-313C.1[36] /end FUNCTION_LIST /end MEASUREMENT
/begin MEASUREMENT vMNLPL_R#14 "At the time of the parameter minimum value renewal, A/F lean value (lean rich)" UWORD COMP_0453 1 100 0 131.07 ECU_ADDRESS 0xFFFFA89E /begin FUNCTION_LIST KF7-313C.1[36] /end FUNCTION_LIST /end MEASUREMENT
/begin MEASUREMENT vMNLPL_R#15 "At the time of the parameter minimum value renewal, A/F lean value (lean rich)" UWORD COMP_0453 1 100 0 131.07 ECU_ADDRESS 0xFFFFA8A0 /begin FUNCTION_LIST KF7-313C.1[36] /end FUNCTION_LIST /end MEASUREMENT
/begin MEASUREMENT vMNLPL_R#16 "At the time of the parameter minimum value renewal, A/F lean value (lean rich)" UWORD COMP_0453 1 100 0 131.07 ECU_ADDRESS 0xFFFFA8A2 /begin FUNCTION_LIST KF7-313C.1[36] /end FUNCTION_LIST /end MEASUREMENT
/begin MEASUREMENT vMNLPR "At the time of the parameter minimum value renewal, A/F lean value (rich lean)" UWORD COMP_0453 1 100 0 131.07 ECU_ADDRESS 0xFFFFA8A4 /begin FUNCTION_LIST KF7-313C.1[36] /end FUNCTION_LIST /end MEASUREMENT
/begin MEASUREMENT vMNLPR_R#1 "At the time of the parameter minimum value renewal, A/F lean value (rich lean)" UWORD COMP_0453 1 100 0 131.07 ECU_ADDRESS 0xFFFFA8A4 /begin FUNCTION_LIST KF7-313C.1[36] /end FUNCTION_LIST /end MEASUREMENT
/begin MEASUREMENT vMNLPR_R#2 "At the time of the parameter minimum value renewal, A/F lean value (rich lean)" UWORD COMP_0453 1 100 0 131.07 ECU_ADDRESS 0xFFFFA8A6 /begin FUNCTION_LIST KF7-313C.1[36] /end FUNCTION_LIST /end MEASUREMENT
/begin MEASUREMENT vMNLPR_R#3 "At the time of the parameter minimum value renewal, A/F lean value (rich lean)" UWORD COMP_0453 1 100 0 131.07 ECU_ADDRESS 0xFFFFA8A8 /begin FUNCTION_LIST KF7-313C.1[36] /end FUNCTION_LIST /end MEASUREMENT
/begin MEASUREMENT vMNLPR_R#4 "At the time of the parameter minimum value renewal, A/F lean value (rich lean)" UWORD COMP_0453 1 100 0 131.07 ECU_ADDRESS 0xFFFFA8AA /begin FUNCTION_LIST KF7-313C.1[36] /end FUNCTION_LIST /end MEASUREMENT
/begin MEASUREMENT vMNLPR_R#5 "At the time of the parameter minimum value renewal, A/F lean value (rich lean)" UWORD COMP_0453 1 100 0 131.07 ECU_ADDRESS 0xFFFFA8AC /begin FUNCTION_LIST KF7-313C.1[36] /end FUNCTION_LIST /end MEASUREMENT
/begin MEASUREMENT vMNLPR_R#6 "At the time of the parameter minimum value renewal, A/F lean value (rich lean)" UWORD COMP_0453 1 100 0 131.07 ECU_ADDRESS 0xFFFFA8AE /begin FUNCTION_LIST KF7-313C.1[36] /end FUNCTION_LIST /end MEASUREMENT
/begin MEASUREMENT vMNLPR_R#7 "At the time of the parameter minimum value renewal, A/F lean value (rich lean)" UWORD COMP_0453 1 100 0 131.07 ECU_ADDRESS 0xFFFFA8B0 /begin FUNCTION_LIST KF7-313C.1[36] /end FUNCTION_LIST /end MEASUREMENT
/begin MEASUREMENT vMNLPR_R#8 "At the time of the parameter minimum value renewal, A/F lean value (rich lean)" UWORD COMP_0453 1 100 0 131.07 ECU_ADDRESS 0xFFFFA8B2 /begin FUNCTION_LIST KF7-313C.1[36] /end FUNCTION_LIST /end MEASUREMENT
/begin MEASUREMENT vMNLPR_R#9 "At the time of the parameter minimum value renewal, A/F lean value (rich lean)" UWORD COMP_0453 1 100 0 131.07 ECU_ADDRESS 0xFFFFA8B4 /begin FUNCTION_LIST KF7-313C.1[36] /end FUNCTION_LIST /end MEASUREMENT
/begin MEASUREMENT vMNLPR_R#10 "At the time of the parameter minimum value renewal, A/F lean value (rich lean)" UWORD COMP_0453 1 100 0 131.07 ECU_ADDRESS 0xFFFFA8B6 /begin FUNCTION_LIST KF7-313C.1[36] /end FUNCTION_LIST /end MEASUREMENT
/begin MEASUREMENT vMNLPR_R#11 "At the time of the parameter minimum value renewal, A/F lean value (rich lean)" UWORD COMP_0453 1 100 0 131.07 ECU_ADDRESS 0xFFFFA8B8 /begin FUNCTION_LIST KF7-313C.1[36] /end FUNCTION_LIST /end MEASUREMENT
/begin MEASUREMENT vMNLPR_R#12 "At the time of the parameter minimum value renewal, A/F lean value (rich lean)" UWORD COMP_0453 1 100 0 131.07 ECU_ADDRESS 0xFFFFA8BA /begin FUNCTION_LIST KF7-313C.1[36] /end FUNCTION_LIST /end MEASUREMENT
/begin MEASUREMENT vMNLPR_R#13 "At the time of the parameter minimum value renewal, A/F lean value (rich lean)" UWORD COMP_0453 1 100 0 131.07 ECU_ADDRESS 0xFFFFA8BC /begin FUNCTION_LIST KF7-313C.1[36] /end FUNCTION_LIST /end MEASUREMENT
/begin MEASUREMENT vMNLPR_R#14 "At the time of the parameter minimum value renewal, A/F lean value (rich lean)" UWORD COMP_0453 1 100 0 131.07 ECU_ADDRESS 0xFFFFA8BE /begin FUNCTION_LIST KF7-313C.1[36] /end FUNCTION_LIST /end MEASUREMENT
/begin MEASUREMENT vMNLPR_R#15 "At the time of the parameter minimum value renewal, A/F lean value (rich lean)" UWORD COMP_0453 1 100 0 131.07 ECU_ADDRESS 0xFFFFA8C0 /begin FUNCTION_LIST KF7-313C.1[36] /end FUNCTION_LIST /end MEASUREMENT
/begin MEASUREMENT vMNLPR_R#16 "At the time of the parameter minimum value renewal, A/F lean value (rich lean)" UWORD COMP_0453 1 100 0 131.07 ECU_ADDRESS 0xFFFFA8C2 /begin FUNCTION_LIST KF7-313C.1[36] /end FUNCTION_LIST /end MEASUREMENT
/begin MEASUREMENT vMNLRD "Lean rich parameter minimum value" UWORD COMP_0453 1 100 0 131.07 ECU_ADDRESS 0xFFFFA8C4 /begin FUNCTION_LIST KF7-313C.1[36] /end FUNCTION_LIST /end MEASUREMENT
/begin MEASUREMENT vMNLRD_R#1 "Lean rich parameter minimum value" UWORD COMP_0453 1 100 0 131.07 ECU_ADDRESS 0xFFFFA8C4 /begin FUNCTION_LIST KF7-313C.1[36] /end FUNCTION_LIST /end MEASUREMENT
/begin MEASUREMENT vMNLRD_R#2 "Lean rich parameter minimum value" UWORD COMP_0453 1 100 0 131.07 ECU_ADDRESS 0xFFFFA8C6 /begin FUNCTION_LIST KF7-313C.1[36] /end FUNCTION_LIST /end MEASUREMENT
/begin MEASUREMENT vMNLRD_R#3 "Lean rich parameter minimum value" UWORD COMP_0453 1 100 0 131.07 ECU_ADDRESS 0xFFFFA8C8 /begin FUNCTION_LIST KF7-313C.1[36] /end FUNCTION_LIST /end MEASUREMENT
/begin MEASUREMENT vMNLRD_R#4 "Lean rich parameter minimum value" UWORD COMP_0453 1 100 0 131.07 ECU_ADDRESS 0xFFFFA8CA /begin FUNCTION_LIST KF7-313C.1[36] /end FUNCTION_LIST /end MEASUREMENT
/begin MEASUREMENT vMNLRD_R#5 "Lean rich parameter minimum value" UWORD COMP_0453 1 100 0 131.07 ECU_ADDRESS 0xFFFFA8CC /begin FUNCTION_LIST KF7-313C.1[36] /end FUNCTION_LIST /end MEASUREMENT
/begin MEASUREMENT vMNLRD_R#6 "Lean rich parameter minimum value" UWORD COMP_0453 1 100 0 131.07 ECU_ADDRESS 0xFFFFA8CE /begin FUNCTION_LIST KF7-313C.1[36] /end FUNCTION_LIST /end MEASUREMENT
/begin MEASUREMENT vMNLRD_R#7 "Lean rich parameter minimum value" UWORD COMP_0453 1 100 0 131.07 ECU_ADDRESS 0xFFFFA8D0 /begin FUNCTION_LIST KF7-313C.1[36] /end FUNCTION_LIST /end MEASUREMENT
/begin MEASUREMENT vMNLRD_R#8 "Lean rich parameter minimum value" UWORD COMP_0453 1 100 0 131.07 ECU_ADDRESS 0xFFFFA8D2 /begin FUNCTION_LIST KF7-313C.1[36] /end FUNCTION_LIST /end MEASUREMENT
/begin MEASUREMENT vMNLRD_R#9 "Lean rich parameter minimum value" UWORD COMP_0453 1 100 0 131.07 ECU_ADDRESS 0xFFFFA8D4 /begin FUNCTION_LIST KF7-313C.1[36] /end FUNCTION_LIST /end MEASUREMENT
/begin MEASUREMENT vMNLRD_R#10 "Lean rich parameter minimum value" UWORD COMP_0453 1 100 0 131.07 ECU_ADDRESS 0xFFFFA8D6 /begin FUNCTION_LIST KF7-313C.1[36] /end FUNCTION_LIST /end MEASUREMENT
/begin MEASUREMENT vMNLRD_R#11 "Lean rich parameter minimum value" UWORD COMP_0453 1 100 0 131.07 ECU_ADDRESS 0xFFFFA8D8 /begin FUNCTION_LIST KF7-313C.1[36] /end FUNCTION_LIST /end MEASUREMENT
/begin MEASUREMENT vMNLRD_R#12 "Lean rich parameter minimum value" UWORD COMP_0453 1 100 0 131.07 ECU_ADDRESS 0xFFFFA8DA /begin FUNCTION_LIST KF7-313C.1[36] /end FUNCTION_LIST /end MEASUREMENT
/begin MEASUREMENT vMNLRD_R#13 "Lean rich parameter minimum value" UWORD COMP_0453 1 100 0 131.07 ECU_ADDRESS 0xFFFFA8DC /begin FUNCTION_LIST KF7-313C.1[36] /end FUNCTION_LIST /end MEASUREMENT
/begin MEASUREMENT vMNLRD_R#14 "Lean rich parameter minimum value" UWORD COMP_0453 1 100 0 131.07 ECU_ADDRESS 0xFFFFA8DE /begin FUNCTION_LIST KF7-313C.1[36] /end FUNCTION_LIST /end MEASUREMENT
/begin MEASUREMENT vMNLRD_R#15 "Lean rich parameter minimum value" UWORD COMP_0453 1 100 0 131.07 ECU_ADDRESS 0xFFFFA8E0 /begin FUNCTION_LIST KF7-313C.1[36] /end FUNCTION_LIST /end MEASUREMENT
/begin MEASUREMENT vMNLRD_R#16 "Lean rich parameter minimum value" UWORD COMP_0453 1 100 0 131.07 ECU_ADDRESS 0xFFFFA8E2 /begin FUNCTION_LIST KF7-313C.1[36] /end FUNCTION_LIST /end MEASUREMENT
/begin MEASUREMENT vMNNL "At the time of the parameter minimum value renewal, speed (lean rich)" UWORD COMP_0006 1 100 0 819187.5 ECU_ADDRESS 0xFFFFA8E4 /begin FUNCTION_LIST KF7-313C.1[36] /end FUNCTION_LIST /end MEASUREMENT
/begin MEASUREMENT vMNNL_R#1 "At the time of the parameter minimum value renewal, speed (lean rich)" UWORD COMP_0006 1 100 0 819187.5 ECU_ADDRESS 0xFFFFA8E4 /begin FUNCTION_LIST KF7-313C.1[36] /end FUNCTION_LIST /end MEASUREMENT
/begin MEASUREMENT vMNNL_R#2 "At the time of the parameter minimum value renewal, speed (lean rich)" UWORD COMP_0006 1 100 0 819187.5 ECU_ADDRESS 0xFFFFA8E6 /begin FUNCTION_LIST KF7-313C.1[36] /end FUNCTION_LIST /end MEASUREMENT
/begin MEASUREMENT vMNNL_R#3 "At the time of the parameter minimum value renewal, speed (lean rich)" UWORD COMP_0006 1 100 0 819187.5 ECU_ADDRESS 0xFFFFA8E8 /begin FUNCTION_LIST KF7-313C.1[36] /end FUNCTION_LIST /end MEASUREMENT
/begin MEASUREMENT vMNNL_R#4 "At the time of the parameter minimum value renewal, speed (lean rich)" UWORD COMP_0006 1 100 0 819187.5 ECU_ADDRESS 0xFFFFA8EA /begin FUNCTION_LIST KF7-313C.1[36] /end FUNCTION_LIST /end MEASUREMENT
/begin MEASUREMENT vMNNL_R#5 "At the time of the parameter minimum value renewal, speed (lean rich)" UWORD COMP_0006 1 100 0 819187.5 ECU_ADDRESS 0xFFFFA8EC /begin FUNCTION_LIST KF7-313C.1[36] /end FUNCTION_LIST /end MEASUREMENT
/begin MEASUREMENT vMNNL_R#6 "At the time of the parameter minimum value renewal, speed (lean rich)" UWORD COMP_0006 1 100 0 819187.5 ECU_ADDRESS 0xFFFFA8EE /begin FUNCTION_LIST KF7-313C.1[36] /end FUNCTION_LIST /end MEASUREMENT
/begin MEASUREMENT vMNNL_R#7 "At the time of the parameter minimum value renewal, speed (lean rich)" UWORD COMP_0006 1 100 0 819187.5 ECU_ADDRESS 0xFFFFA8F0 /begin FUNCTION_LIST KF7-313C.1[36] /end FUNCTION_LIST /end MEASUREMENT
/begin MEASUREMENT vMNNL_R#8 "At the time of the parameter minimum value renewal, speed (lean rich)" UWORD COMP_0006 1 100 0 819187.5 ECU_ADDRESS 0xFFFFA8F2 /begin FUNCTION_LIST KF7-313C.1[36] /end FUNCTION_LIST /end MEASUREMENT
/begin MEASUREMENT vMNNL_R#9 "At the time of the parameter minimum value renewal, speed (lean rich)" UWORD COMP_0006 1 100 0 819187.5 ECU_ADDRESS 0xFFFFA8F4 /begin FUNCTION_LIST KF7-313C.1[36] /end FUNCTION_LIST /end MEASUREMENT
/begin MEASUREMENT vMNNL_R#10 "At the time of the parameter minimum value renewal, speed (lean rich)" UWORD COMP_0006 1 100 0 819187.5 ECU_ADDRESS 0xFFFFA8F6 /begin FUNCTION_LIST KF7-313C.1[36] /end FUNCTION_LIST /end MEASUREMENT
/begin MEASUREMENT vMNNL_R#11 "At the time of the parameter minimum value renewal, speed (lean rich)" UWORD COMP_0006 1 100 0 819187.5 ECU_ADDRESS 0xFFFFA8F8 /begin FUNCTION_LIST KF7-313C.1[36] /end FUNCTION_LIST /end MEASUREMENT
/begin MEASUREMENT vMNNL_R#12 "At the time of the parameter minimum value renewal, speed (lean rich)" UWORD COMP_0006 1 100 0 819187.5 ECU_ADDRESS 0xFFFFA8FA /begin FUNCTION_LIST KF7-313C.1[36] /end FUNCTION_LIST /end MEASUREMENT
/begin MEASUREMENT vMNNL_R#13 "At the time of the parameter minimum value renewal, speed (lean rich)" UWORD COMP_0006 1 100 0 819187.5 ECU_ADDRESS 0xFFFFA8FC /begin FUNCTION_LIST KF7-313C.1[36] /end FUNCTION_LIST /end MEASUREMENT
/begin MEASUREMENT vMNNL_R#14 "At the time of the parameter minimum value renewal, speed (lean rich)" UWORD COMP_0006 1 100 0 819187.5 ECU_ADDRESS 0xFFFFA8FE /begin FUNCTION_LIST KF7-313C.1[36] /end FUNCTION_LIST /end MEASUREMENT
/begin MEASUREMENT vMNNL_R#15 "At the time of the parameter minimum value renewal, speed (lean rich)" UWORD COMP_0006 1 100 0 819187.5 ECU_ADDRESS 0xFFFFA900 /begin FUNCTION_LIST KF7-313C.1[36] /end FUNCTION_LIST /end MEASUREMENT
/begin MEASUREMENT vMNNL_R#16 "At the time of the parameter minimum value renewal, speed (lean rich)" UWORD COMP_0006 1 100 0 819187.5 ECU_ADDRESS 0xFFFFA902 /begin FUNCTION_LIST KF7-313C.1[36] /end FUNCTION_LIST /end MEASUREMENT
/begin MEASUREMENT vMNNR "At the time of the parameter minimum value renewal, speed (rich lean)" UWORD COMP_0006 1 100 0 819187.5 ECU_ADDRESS 0xFFFFA904 /begin FUNCTION_LIST KF7-313C.1[36] /end FUNCTION_LIST /end MEASUREMENT
/begin MEASUREMENT vMNNR_R#1 "At the time of the parameter minimum value renewal, speed (rich lean)" UWORD COMP_0006 1 100 0 819187.5 ECU_ADDRESS 0xFFFFA904 /begin FUNCTION_LIST KF7-313C.1[36] /end FUNCTION_LIST /end MEASUREMENT
/begin MEASUREMENT vMNNR_R#2 "At the time of the parameter minimum value renewal, speed (rich lean)" UWORD COMP_0006 1 100 0 819187.5 ECU_ADDRESS 0xFFFFA906 /begin FUNCTION_LIST KF7-313C.1[36] /end FUNCTION_LIST /end MEASUREMENT
/begin MEASUREMENT vMNNR_R#3 "At the time of the parameter minimum value renewal, speed (rich lean)" UWORD COMP_0006 1 100 0 819187.5 ECU_ADDRESS 0xFFFFA908 /begin FUNCTION_LIST KF7-313C.1[36] /end FUNCTION_LIST /end MEASUREMENT
/begin MEASUREMENT vMNNR_R#4 "At the time of the parameter minimum value renewal, speed (rich lean)" UWORD COMP_0006 1 100 0 819187.5 ECU_ADDRESS 0xFFFFA90A /begin FUNCTION_LIST KF7-313C.1[36] /end FUNCTION_LIST /end MEASUREMENT
/begin MEASUREMENT vMNNR_R#5 "At the time of the parameter minimum value renewal, speed (rich lean)" UWORD COMP_0006 1 100 0 819187.5 ECU_ADDRESS 0xFFFFA90C /begin FUNCTION_LIST KF7-313C.1[36] /end FUNCTION_LIST /end MEASUREMENT
/begin MEASUREMENT vMNNR_R#6 "At the time of the parameter minimum value renewal, speed (rich lean)" UWORD COMP_0006 1 100 0 819187.5 ECU_ADDRESS 0xFFFFA90E /begin FUNCTION_LIST KF7-313C.1[36] /end FUNCTION_LIST /end MEASUREMENT
/begin MEASUREMENT vMNNR_R#7 "At the time of the parameter minimum value renewal, speed (rich lean)" UWORD COMP_0006 1 100 0 819187.5 ECU_ADDRESS 0xFFFFA910 /begin FUNCTION_LIST KF7-313C.1[36] /end FUNCTION_LIST /end MEASUREMENT
/begin MEASUREMENT vMNNR_R#8 "At the time of the parameter minimum value renewal, speed (rich lean)" UWORD COMP_0006 1 100 0 819187.5 ECU_ADDRESS 0xFFFFA912 /begin FUNCTION_LIST KF7-313C.1[36] /end FUNCTION_LIST /end MEASUREMENT
/begin MEASUREMENT vMNNR_R#9 "At the time of the parameter minimum value renewal, speed (rich lean)" UWORD COMP_0006 1 100 0 819187.5 ECU_ADDRESS 0xFFFFA914 /begin FUNCTION_LIST KF7-313C.1[36] /end FUNCTION_LIST /end MEASUREMENT
/begin MEASUREMENT vMNNR_R#10 "At the time of the parameter minimum value renewal, speed (rich lean)" UWORD COMP_0006 1 100 0 819187.5 ECU_ADDRESS 0xFFFFA916 /begin FUNCTION_LIST KF7-313C.1[36] /end FUNCTION_LIST /end MEASUREMENT
/begin MEASUREMENT vMNNR_R#11 "At the time of the parameter minimum value renewal, speed (rich lean)" UWORD COMP_0006 1 100 0 819187.5 ECU_ADDRESS 0xFFFFA918 /begin FUNCTION_LIST KF7-313C.1[36] /end FUNCTION_LIST /end MEASUREMENT
/begin MEASUREMENT vMNNR_R#12 "At the time of the parameter minimum value renewal, speed (rich lean)" UWORD COMP_0006 1 100 0 819187.5 ECU_ADDRESS 0xFFFFA91A /begin FUNCTION_LIST KF7-313C.1[36] /end FUNCTION_LIST /end MEASUREMENT
/begin MEASUREMENT vMNNR_R#13 "At the time of the parameter minimum value renewal, speed (rich lean)" UWORD COMP_0006 1 100 0 819187.5 ECU_ADDRESS 0xFFFFA91C /begin FUNCTION_LIST KF7-313C.1[36] /end FUNCTION_LIST /end MEASUREMENT
/begin MEASUREMENT vMNNR_R#14 "At the time of the parameter minimum value renewal, speed (rich lean)" UWORD COMP_0006 1 100 0 819187.5 ECU_ADDRESS 0xFFFFA91E /begin FUNCTION_LIST KF7-313C.1[36] /end FUNCTION_LIST /end MEASUREMENT
/begin MEASUREMENT vMNNR_R#15 "At the time of the parameter minimum value renewal, speed (rich lean)" UWORD COMP_0006 1 100 0 819187.5 ECU_ADDRESS 0xFFFFA920 /begin FUNCTION_LIST KF7-313C.1[36] /end FUNCTION_LIST /end MEASUREMENT
/begin MEASUREMENT vMNNR_R#16 "At the time of the parameter minimum value renewal, speed (rich lean)" UWORD COMP_0006 1 100 0 819187.5 ECU_ADDRESS 0xFFFFA922 /begin FUNCTION_LIST KF7-313C.1[36] /end FUNCTION_LIST /end MEASUREMENT
/begin MEASUREMENT vMNPBSTL "At the time of the parameter minimum value renewal, atomospheric pressure (lean rich)" UWORD COMP_0050 1 100 0 5119.921875 ECU_ADDRESS 0xFFFFA924 /begin FUNCTION_LIST KF7-313C.1[36] /end FUNCTION_LIST /end MEASUREMENT
/begin MEASUREMENT vMNPBSTL_R#1 "At the time of the parameter minimum value renewal, atomospheric pressure (lean rich)" UWORD COMP_0050 1 100 0 5119.921875 ECU_ADDRESS 0xFFFFA924 /begin FUNCTION_LIST KF7-313C.1[36] /end FUNCTION_LIST /end MEASUREMENT
/begin MEASUREMENT vMNPBSTL_R#2 "At the time of the parameter minimum value renewal, atomospheric pressure (lean rich)" UWORD COMP_0050 1 100 0 5119.921875 ECU_ADDRESS 0xFFFFA926 /begin FUNCTION_LIST KF7-313C.1[36] /end FUNCTION_LIST /end MEASUREMENT
/begin MEASUREMENT vMNPBSTL_R#3 "At the time of the parameter minimum value renewal, atomospheric pressure (lean rich)" UWORD COMP_0050 1 100 0 5119.921875 ECU_ADDRESS 0xFFFFA928 /begin FUNCTION_LIST KF7-313C.1[36] /end FUNCTION_LIST /end MEASUREMENT
/begin MEASUREMENT vMNPBSTL_R#4 "At the time of the parameter minimum value renewal, atomospheric pressure (lean rich)" UWORD COMP_0050 1 100 0 5119.921875 ECU_ADDRESS 0xFFFFA92A /begin FUNCTION_LIST KF7-313C.1[36] /end FUNCTION_LIST /end MEASUREMENT
/begin MEASUREMENT vMNPBSTL_R#5 "At the time of the parameter minimum value renewal, atomospheric pressure (lean rich)" UWORD COMP_0050 1 100 0 5119.921875 ECU_ADDRESS 0xFFFFA92C /begin FUNCTION_LIST KF7-313C.1[36] /end FUNCTION_LIST /end MEASUREMENT
/begin MEASUREMENT vMNPBSTL_R#6 "At the time of the parameter minimum value renewal, atomospheric pressure (lean rich)" UWORD COMP_0050 1 100 0 5119.921875 ECU_ADDRESS 0xFFFFA92E /begin FUNCTION_LIST KF7-313C.1[36] /end FUNCTION_LIST /end MEASUREMENT
/begin MEASUREMENT vMNPBSTL_R#7 "At the time of the parameter minimum value renewal, atomospheric pressure (lean rich)" UWORD COMP_0050 1 100 0 5119.921875 ECU_ADDRESS 0xFFFFA930 /begin FUNCTION_LIST KF7-313C.1[36] /end FUNCTION_LIST /end MEASUREMENT
/begin MEASUREMENT vMNPBSTL_R#8 "At the time of the parameter minimum value renewal, atomospheric pressure (lean rich)" UWORD COMP_0050 1 100 0 5119.921875 ECU_ADDRESS 0xFFFFA932 /begin FUNCTION_LIST KF7-313C.1[36] /end FUNCTION_LIST /end MEASUREMENT
/begin MEASUREMENT vMNPBSTL_R#9 "At the time of the parameter minimum value renewal, atomospheric pressure (lean rich)" UWORD COMP_0050 1 100 0 5119.921875 ECU_ADDRESS 0xFFFFA934 /begin FUNCTION_LIST KF7-313C.1[36] /end FUNCTION_LIST /end MEASUREMENT
/begin MEASUREMENT vMNPBSTL_R#10 "At the time of the parameter minimum value renewal, atomospheric pressure (lean rich)" UWORD COMP_0050 1 100 0 5119.921875 ECU_ADDRESS 0xFFFFA936 /begin FUNCTION_LIST KF7-313C.1[36] /end FUNCTION_LIST /end MEASUREMENT
/begin MEASUREMENT vMNPBSTL_R#11 "At the time of the parameter minimum value renewal, atomospheric pressure (lean rich)" UWORD COMP_0050 1 100 0 5119.921875 ECU_ADDRESS 0xFFFFA938 /begin FUNCTION_LIST KF7-313C.1[36] /end FUNCTION_LIST /end MEASUREMENT
/begin MEASUREMENT vMNPBSTL_R#12 "At the time of the parameter minimum value renewal, atomospheric pressure (lean rich)" UWORD COMP_0050 1 100 0 5119.921875 ECU_ADDRESS 0xFFFFA93A /begin FUNCTION_LIST KF7-313C.1[36] /end FUNCTION_LIST /end MEASUREMENT
/begin MEASUREMENT vMNPBSTL_R#13 "At the time of the parameter minimum value renewal, atomospheric pressure (lean rich)" UWORD COMP_0050 1 100 0 5119.921875 ECU_ADDRESS 0xFFFFA93C /begin FUNCTION_LIST KF7-313C.1[36] /end FUNCTION_LIST /end MEASUREMENT
/begin MEASUREMENT vMNPBSTL_R#14 "At the time of the parameter minimum value renewal, atomospheric pressure (lean rich)" UWORD COMP_0050 1 100 0 5119.921875 ECU_ADDRESS 0xFFFFA93E /begin FUNCTION_LIST KF7-313C.1[36] /end FUNCTION_LIST /end MEASUREMENT
/begin MEASUREMENT vMNPBSTL_R#15 "At the time of the parameter minimum value renewal, atomospheric pressure (lean rich)" UWORD COMP_0050 1 100 0 5119.921875 ECU_ADDRESS 0xFFFFA940 /begin FUNCTION_LIST KF7-313C.1[36] /end FUNCTION_LIST /end MEASUREMENT
/begin MEASUREMENT vMNPBSTL_R#16 "At the time of the parameter minimum value renewal, atomospheric pressure (lean rich)" UWORD COMP_0050 1 100 0 5119.921875 ECU_ADDRESS 0xFFFFA942 /begin FUNCTION_LIST KF7-313C.1[36] /end FUNCTION_LIST /end MEASUREMENT
/begin MEASUREMENT vMNPBSTR "At the time of the parameter minimum value renewal, atomospheric pressure (rich lean)" UWORD COMP_0050 1 100 0 5119.921875 ECU_ADDRESS 0xFFFFA944 /begin FUNCTION_LIST KF7-313C.1[36] /end FUNCTION_LIST /end MEASUREMENT
/begin MEASUREMENT vMNPBSTR_R#1 "At the time of the parameter minimum value renewal, atomospheric pressure (rich lean)" UWORD COMP_0050 1 100 0 5119.921875 ECU_ADDRESS 0xFFFFA944 /begin FUNCTION_LIST KF7-313C.1[36] /end FUNCTION_LIST /end MEASUREMENT
/begin MEASUREMENT vMNPBSTR_R#2 "At the time of the parameter minimum value renewal, atomospheric pressure (rich lean)" UWORD COMP_0050 1 100 0 5119.921875 ECU_ADDRESS 0xFFFFA946 /begin FUNCTION_LIST KF7-313C.1[36] /end FUNCTION_LIST /end MEASUREMENT
/begin MEASUREMENT vMNPBSTR_R#3 "At the time of the parameter minimum value renewal, atomospheric pressure (rich lean)" UWORD COMP_0050 1 100 0 5119.921875 ECU_ADDRESS 0xFFFFA948 /begin FUNCTION_LIST KF7-313C.1[36] /end FUNCTION_LIST /end MEASUREMENT
/begin MEASUREMENT vMNPBSTR_R#4 "At the time of the parameter minimum value renewal, atomospheric pressure (rich lean)" UWORD COMP_0050 1 100 0 5119.921875 ECU_ADDRESS 0xFFFFA94A /begin FUNCTION_LIST KF7-313C.1[36] /end FUNCTION_LIST /end MEASUREMENT
/begin MEASUREMENT vMNPBSTR_R#5 "At the time of the parameter minimum value renewal, atomospheric pressure (rich lean)" UWORD COMP_0050 1 100 0 5119.921875 ECU_ADDRESS 0xFFFFA94C /begin FUNCTION_LIST KF7-313C.1[36] /end FUNCTION_LIST /end MEASUREMENT
/begin MEASUREMENT vMNPBSTR_R#6 "At the time of the parameter minimum value renewal, atomospheric pressure (rich lean)" UWORD COMP_0050 1 100 0 5119.921875 ECU_ADDRESS 0xFFFFA94E /begin FUNCTION_LIST KF7-313C.1[36] /end FUNCTION_LIST /end MEASUREMENT
/begin MEASUREMENT vMNPBSTR_R#7 "At the time of the parameter minimum value renewal, atomospheric pressure (rich lean)" UWORD COMP_0050 1 100 0 5119.921875 ECU_ADDRESS 0xFFFFA950 /begin FUNCTION_LIST KF7-313C.1[36] /end FUNCTION_LIST /end MEASUREMENT
/begin MEASUREMENT vMNPBSTR_R#8 "At the time of the parameter minimum value renewal, atomospheric pressure (rich lean)" UWORD COMP_0050 1 100 0 5119.921875 ECU_ADDRESS 0xFFFFA952 /begin FUNCTION_LIST KF7-313C.1[36] /end FUNCTION_LIST /end MEASUREMENT
/begin MEASUREMENT vMNPBSTR_R#9 "At the time of the parameter minimum value renewal, atomospheric pressure (rich lean)" UWORD COMP_0050 1 100 0 5119.921875 ECU_ADDRESS 0xFFFFA954 /begin FUNCTION_LIST KF7-313C.1[36] /end FUNCTION_LIST /end MEASUREMENT
/begin MEASUREMENT vMNPBSTR_R#10 "At the time of the parameter minimum value renewal, atomospheric pressure (rich lean)" UWORD COMP_0050 1 100 0 5119.921875 ECU_ADDRESS 0xFFFFA956 /begin FUNCTION_LIST KF7-313C.1[36] /end FUNCTION_LIST /end MEASUREMENT
/begin MEASUREMENT vMNPBSTR_R#11 "At the time of the parameter minimum value renewal, atomospheric pressure (rich lean)" UWORD COMP_0050 1 100 0 5119.921875 ECU_ADDRESS 0xFFFFA958 /begin FUNCTION_LIST KF7-313C.1[36] /end FUNCTION_LIST /end MEASUREMENT
/begin MEASUREMENT vMNPBSTR_R#12 "At the time of the parameter minimum value renewal, atomospheric pressure (rich lean)" UWORD COMP_0050 1 100 0 5119.921875 ECU_ADDRESS 0xFFFFA95A /begin FUNCTION_LIST KF7-313C.1[36] /end FUNCTION_LIST /end MEASUREMENT
/begin MEASUREMENT vMNPBSTR_R#13 "At the time of the parameter minimum value renewal, atomospheric pressure (rich lean)" UWORD COMP_0050 1 100 0 5119.921875 ECU_ADDRESS 0xFFFFA95C /begin FUNCTION_LIST KF7-313C.1[36] /end FUNCTION_LIST /end MEASUREMENT
/begin MEASUREMENT vMNPBSTR_R#14 "At the time of the parameter minimum value renewal, atomospheric pressure (rich lean)" UWORD COMP_0050 1 100 0 5119.921875 ECU_ADDRESS 0xFFFFA95E /begin FUNCTION_LIST KF7-313C.1[36] /end FUNCTION_LIST /end MEASUREMENT
/begin MEASUREMENT vMNPBSTR_R#15 "At the time of the parameter minimum value renewal, atomospheric pressure (rich lean)" UWORD COMP_0050 1 100 0 5119.921875 ECU_ADDRESS 0xFFFFA960 /begin FUNCTION_LIST KF7-313C.1[36] /end FUNCTION_LIST /end MEASUREMENT
/begin MEASUREMENT vMNPBSTR_R#16 "At the time of the parameter minimum value renewal, atomospheric pressure (rich lean)" UWORD COMP_0050 1 100 0 5119.921875 ECU_ADDRESS 0xFFFFA962 /begin FUNCTION_LIST KF7-313C.1[36] /end FUNCTION_LIST /end MEASUREMENT
/begin MEASUREMENT vMNQL "At the time of the parameter minimum value renewal, air quantity (lean rich)" UWORD COMP_0068 1 100 0 65535 ECU_ADDRESS 0xFFFFA964 /begin FUNCTION_LIST KF7-313C.1[36] /end FUNCTION_LIST /end MEASUREMENT
/begin MEASUREMENT vMNQL_R#1 "At the time of the parameter minimum value renewal, air quantity (lean rich)" UWORD COMP_0068 1 100 0 65535 ECU_ADDRESS 0xFFFFA964 /begin FUNCTION_LIST KF7-313C.1[36] /end FUNCTION_LIST /end MEASUREMENT
/begin MEASUREMENT vMNQL_R#2 "At the time of the parameter minimum value renewal, air quantity (lean rich)" UWORD COMP_0068 1 100 0 65535 ECU_ADDRESS 0xFFFFA966 /begin FUNCTION_LIST KF7-313C.1[36] /end FUNCTION_LIST /end MEASUREMENT
/begin MEASUREMENT vMNQL_R#3 "At the time of the parameter minimum value renewal, air quantity (lean rich)" UWORD COMP_0068 1 100 0 65535 ECU_ADDRESS 0xFFFFA968 /begin FUNCTION_LIST KF7-313C.1[36] /end FUNCTION_LIST /end MEASUREMENT
/begin MEASUREMENT vMNQL_R#4 "At the time of the parameter minimum value renewal, air quantity (lean rich)" UWORD COMP_0068 1 100 0 65535 ECU_ADDRESS 0xFFFFA96A /begin FUNCTION_LIST KF7-313C.1[36] /end FUNCTION_LIST /end MEASUREMENT
/begin MEASUREMENT vMNQL_R#5 "At the time of the parameter minimum value renewal, air quantity (lean rich)" UWORD COMP_0068 1 100 0 65535 ECU_ADDRESS 0xFFFFA96C /begin FUNCTION_LIST KF7-313C.1[36] /end FUNCTION_LIST /end MEASUREMENT
/begin MEASUREMENT vMNQL_R#6 "At the time of the parameter minimum value renewal, air quantity (lean rich)" UWORD COMP_0068 1 100 0 65535 ECU_ADDRESS 0xFFFFA96E /begin FUNCTION_LIST KF7-313C.1[36] /end FUNCTION_LIST /end MEASUREMENT
/begin MEASUREMENT vMNQL_R#7 "At the time of the parameter minimum value renewal, air quantity (lean rich)" UWORD COMP_0068 1 100 0 65535 ECU_ADDRESS 0xFFFFA970 /begin FUNCTION_LIST KF7-313C.1[36] /end FUNCTION_LIST /end MEASUREMENT
/begin MEASUREMENT vMNQL_R#8 "At the time of the parameter minimum value renewal, air quantity (lean rich)" UWORD COMP_0068 1 100 0 65535 ECU_ADDRESS 0xFFFFA972 /begin FUNCTION_LIST KF7-313C.1[36] /end FUNCTION_LIST /end MEASUREMENT
/begin MEASUREMENT vMNQL_R#9 "At the time of the parameter minimum value renewal, air quantity (lean rich)" UWORD COMP_0068 1 100 0 65535 ECU_ADDRESS 0xFFFFA974 /begin FUNCTION_LIST KF7-313C.1[36] /end FUNCTION_LIST /end MEASUREMENT
/begin MEASUREMENT vMNQL_R#10 "At the time of the parameter minimum value renewal, air quantity (lean rich)" UWORD COMP_0068 1 100 0 65535 ECU_ADDRESS 0xFFFFA976 /begin FUNCTION_LIST KF7-313C.1[36] /end FUNCTION_LIST /end MEASUREMENT
/begin MEASUREMENT vMNQL_R#11 "At the time of the parameter minimum value renewal, air quantity (lean rich)" UWORD COMP_0068 1 100 0 65535 ECU_ADDRESS 0xFFFFA978 /begin FUNCTION_LIST KF7-313C.1[36] /end FUNCTION_LIST /end MEASUREMENT
/begin MEASUREMENT vMNQL_R#12 "At the time of the parameter minimum value renewal, air quantity (lean rich)" UWORD COMP_0068 1 100 0 65535 ECU_ADDRESS 0xFFFFA97A /begin FUNCTION_LIST KF7-313C.1[36] /end FUNCTION_LIST /end MEASUREMENT
/begin MEASUREMENT vMNQL_R#13 "At the time of the parameter minimum value renewal, air quantity (lean rich)" UWORD COMP_0068 1 100 0 65535 ECU_ADDRESS 0xFFFFA97C /begin FUNCTION_LIST KF7-313C.1[36] /end FUNCTION_LIST /end MEASUREMENT
/begin MEASUREMENT vMNQL_R#14 "At the time of the parameter minimum value renewal, air quantity (lean rich)" UWORD COMP_0068 1 100 0 65535 ECU_ADDRESS 0xFFFFA97E /begin FUNCTION_LIST KF7-313C.1[36] /end FUNCTION_LIST /end MEASUREMENT
/begin MEASUREMENT vMNQL_R#15 "At the time of the parameter minimum value renewal, air quantity (lean rich)" UWORD COMP_0068 1 100 0 65535 ECU_ADDRESS 0xFFFFA980 /begin FUNCTION_LIST KF7-313C.1[36] /end FUNCTION_LIST /end MEASUREMENT
/begin MEASUREMENT vMNQL_R#16 "At the time of the parameter minimum value renewal, air quantity (lean rich)" UWORD COMP_0068 1 100 0 65535 ECU_ADDRESS 0xFFFFA982 /begin FUNCTION_LIST KF7-313C.1[36] /end FUNCTION_LIST /end MEASUREMENT
/begin MEASUREMENT vMNQR "At the time of the parameter minimum value renewal, air quantity (rich lean)" UWORD COMP_0068 1 100 0 65535 ECU_ADDRESS 0xFFFFA984 /begin FUNCTION_LIST KF7-313C.1[36] /end FUNCTION_LIST /end MEASUREMENT
/begin MEASUREMENT vMNQR_R#1 "At the time of the parameter minimum value renewal, air quantity (rich lean)" UWORD COMP_0068 1 100 0 65535 ECU_ADDRESS 0xFFFFA984 /begin FUNCTION_LIST KF7-313C.1[36] /end FUNCTION_LIST /end MEASUREMENT
/begin MEASUREMENT vMNQR_R#2 "At the time of the parameter minimum value renewal, air quantity (rich lean)" UWORD COMP_0068 1 100 0 65535 ECU_ADDRESS 0xFFFFA986 /begin FUNCTION_LIST KF7-313C.1[36] /end FUNCTION_LIST /end MEASUREMENT
/begin MEASUREMENT vMNQR_R#3 "At the time of the parameter minimum value renewal, air quantity (rich lean)" UWORD COMP_0068 1 100 0 65535 ECU_ADDRESS 0xFFFFA988 /begin FUNCTION_LIST KF7-313C.1[36] /end FUNCTION_LIST /end MEASUREMENT
/begin MEASUREMENT vMNQR_R#4 "At the time of the parameter minimum value renewal, air quantity (rich lean)" UWORD COMP_0068 1 100 0 65535 ECU_ADDRESS 0xFFFFA98A /begin FUNCTION_LIST KF7-313C.1[36] /end FUNCTION_LIST /end MEASUREMENT
/begin MEASUREMENT vMNQR_R#5 "At the time of the parameter minimum value renewal, air quantity (rich lean)" UWORD COMP_0068 1 100 0 65535 ECU_ADDRESS 0xFFFFA98C /begin FUNCTION_LIST KF7-313C.1[36] /end FUNCTION_LIST /end MEASUREMENT
/begin MEASUREMENT vMNQR_R#6 "At the time of the parameter minimum value renewal, air quantity (rich lean)" UWORD COMP_0068 1 100 0 65535 ECU_ADDRESS 0xFFFFA98E /begin FUNCTION_LIST KF7-313C.1[36] /end FUNCTION_LIST /end MEASUREMENT
/begin MEASUREMENT vMNQR_R#7 "At the time of the parameter minimum value renewal, air quantity (rich lean)" UWORD COMP_0068 1 100 0 65535 ECU_ADDRESS 0xFFFFA990 /begin FUNCTION_LIST KF7-313C.1[36] /end FUNCTION_LIST /end MEASUREMENT
/begin MEASUREMENT vMNQR_R#8 "At the time of the parameter minimum value renewal, air quantity (rich lean)" UWORD COMP_0068 1 100 0 65535 ECU_ADDRESS 0xFFFFA992 /begin FUNCTION_LIST KF7-313C.1[36] /end FUNCTION_LIST /end MEASUREMENT
/begin MEASUREMENT vMNQR_R#9 "At the time of the parameter minimum value renewal, air quantity (rich lean)" UWORD COMP_0068 1 100 0 65535 ECU_ADDRESS 0xFFFFA994 /begin FUNCTION_LIST KF7-313C.1[36] /end FUNCTION_LIST /end MEASUREMENT
/begin MEASUREMENT vMNQR_R#10 "At the time of the parameter minimum value renewal, air quantity (rich lean)" UWORD COMP_0068 1 100 0 65535 ECU_ADDRESS 0xFFFFA996 /begin FUNCTION_LIST KF7-313C.1[36] /end FUNCTION_LIST /end MEASUREMENT
/begin MEASUREMENT vMNQR_R#11 "At the time of the parameter minimum value renewal, air quantity (rich lean)" UWORD COMP_0068 1 100 0 65535 ECU_ADDRESS 0xFFFFA998 /begin FUNCTION_LIST KF7-313C.1[36] /end FUNCTION_LIST /end MEASUREMENT
/begin MEASUREMENT vMNQR_R#12 "At the time of the parameter minimum value renewal, air quantity (rich lean)" UWORD COMP_0068 1 100 0 65535 ECU_ADDRESS 0xFFFFA99A /begin FUNCTION_LIST KF7-313C.1[36] /end FUNCTION_LIST /end MEASUREMENT
/begin MEASUREMENT vMNQR_R#13 "At the time of the parameter minimum value renewal, air quantity (rich lean)" UWORD COMP_0068 1 100 0 65535 ECU_ADDRESS 0xFFFFA99C /begin FUNCTION_LIST KF7-313C.1[36] /end FUNCTION_LIST /end MEASUREMENT
/begin MEASUREMENT vMNQR_R#14 "At the time of the parameter minimum value renewal, air quantity (rich lean)" UWORD COMP_0068 1 100 0 65535 ECU_ADDRESS 0xFFFFA99E /begin FUNCTION_LIST KF7-313C.1[36] /end FUNCTION_LIST /end MEASUREMENT
/begin MEASUREMENT vMNQR_R#15 "At the time of the parameter minimum value renewal, air quantity (rich lean)" UWORD COMP_0068 1 100 0 65535 ECU_ADDRESS 0xFFFFA9A0 /begin FUNCTION_LIST KF7-313C.1[36] /end FUNCTION_LIST /end MEASUREMENT
/begin MEASUREMENT vMNQR_R#16 "At the time of the parameter minimum value renewal, air quantity (rich lean)" UWORD COMP_0068 1 100 0 65535 ECU_ADDRESS 0xFFFFA9A2 /begin FUNCTION_LIST KF7-313C.1[36] /end FUNCTION_LIST /end MEASUREMENT
/begin MEASUREMENT vMNRLD "Rich lean parameter minimum value" UWORD COMP_0453 1 100 0 131.07 ECU_ADDRESS 0xFFFFA9A4 /begin FUNCTION_LIST KF7-313C.1[36] /end FUNCTION_LIST /end MEASUREMENT
/begin MEASUREMENT vMNRLD_R#1 "Rich lean parameter minimum value" UWORD COMP_0453 1 100 0 131.07 ECU_ADDRESS 0xFFFFA9A4 /begin FUNCTION_LIST KF7-313C.1[36] /end FUNCTION_LIST /end MEASUREMENT
/begin MEASUREMENT vMNRLD_R#2 "Rich lean parameter minimum value" UWORD COMP_0453 1 100 0 131.07 ECU_ADDRESS 0xFFFFA9A6 /begin FUNCTION_LIST KF7-313C.1[36] /end FUNCTION_LIST /end MEASUREMENT
/begin MEASUREMENT vMNRLD_R#3 "Rich lean parameter minimum value" UWORD COMP_0453 1 100 0 131.07 ECU_ADDRESS 0xFFFFA9A8 /begin FUNCTION_LIST KF7-313C.1[36] /end FUNCTION_LIST /end MEASUREMENT
/begin MEASUREMENT vMNRLD_R#4 "Rich lean parameter minimum value" UWORD COMP_0453 1 100 0 131.07 ECU_ADDRESS 0xFFFFA9AA /begin FUNCTION_LIST KF7-313C.1[36] /end FUNCTION_LIST /end MEASUREMENT
/begin MEASUREMENT vMNRLD_R#5 "Rich lean parameter minimum value" UWORD COMP_0453 1 100 0 131.07 ECU_ADDRESS 0xFFFFA9AC /begin FUNCTION_LIST KF7-313C.1[36] /end FUNCTION_LIST /end MEASUREMENT
/begin MEASUREMENT vMNRLD_R#6 "Rich lean parameter minimum value" UWORD COMP_0453 1 100 0 131.07 ECU_ADDRESS 0xFFFFA9AE /begin FUNCTION_LIST KF7-313C.1[36] /end FUNCTION_LIST /end MEASUREMENT
/begin MEASUREMENT vMNRLD_R#7 "Rich lean parameter minimum value" UWORD COMP_0453 1 100 0 131.07 ECU_ADDRESS 0xFFFFA9B0 /begin FUNCTION_LIST KF7-313C.1[36] /end FUNCTION_LIST /end MEASUREMENT
/begin MEASUREMENT vMNRLD_R#8 "Rich lean parameter minimum value" UWORD COMP_0453 1 100 0 131.07 ECU_ADDRESS 0xFFFFA9B2 /begin FUNCTION_LIST KF7-313C.1[36] /end FUNCTION_LIST /end MEASUREMENT
/begin MEASUREMENT vMNRLD_R#9 "Rich lean parameter minimum value" UWORD COMP_0453 1 100 0 131.07 ECU_ADDRESS 0xFFFFA9B4 /begin FUNCTION_LIST KF7-313C.1[36] /end FUNCTION_LIST /end MEASUREMENT
/begin MEASUREMENT vMNRLD_R#10 "Rich lean parameter minimum value" UWORD COMP_0453 1 100 0 131.07 ECU_ADDRESS 0xFFFFA9B6 /begin FUNCTION_LIST KF7-313C.1[36] /end FUNCTION_LIST /end MEASUREMENT
/begin MEASUREMENT vMNRLD_R#11 "Rich lean parameter minimum value" UWORD COMP_0453 1 100 0 131.07 ECU_ADDRESS 0xFFFFA9B8 /begin FUNCTION_LIST KF7-313C.1[36] /end FUNCTION_LIST /end MEASUREMENT
/begin MEASUREMENT vMNRLD_R#12 "Rich lean parameter minimum value" UWORD COMP_0453 1 100 0 131.07 ECU_ADDRESS 0xFFFFA9BA /begin FUNCTION_LIST KF7-313C.1[36] /end FUNCTION_LIST /end MEASUREMENT
/begin MEASUREMENT vMNRLD_R#13 "Rich lean parameter minimum value" UWORD COMP_0453 1 100 0 131.07 ECU_ADDRESS 0xFFFFA9BC /begin FUNCTION_LIST KF7-313C.1[36] /end FUNCTION_LIST /end MEASUREMENT
/begin MEASUREMENT vMNRLD_R#14 "Rich lean parameter minimum value" UWORD COMP_0453 1 100 0 131.07 ECU_ADDRESS 0xFFFFA9BE /begin FUNCTION_LIST KF7-313C.1[36] /end FUNCTION_LIST /end MEASUREMENT
/begin MEASUREMENT vMNRLD_R#15 "Rich lean parameter minimum value" UWORD COMP_0453 1 100 0 131.07 ECU_ADDRESS 0xFFFFA9C0 /begin FUNCTION_LIST KF7-313C.1[36] /end FUNCTION_LIST /end MEASUREMENT
/begin MEASUREMENT vMNRLD_R#16 "Rich lean parameter minimum value" UWORD COMP_0453 1 100 0 131.07 ECU_ADDRESS 0xFFFFA9C2 /begin FUNCTION_LIST KF7-313C.1[36] /end FUNCTION_LIST /end MEASUREMENT
/begin MEASUREMENT vMNRPL "At the time of the parameter minimum value renewal, A/F lean value (lean rich)" UWORD COMP_0453 1 100 0 131.07 ECU_ADDRESS 0xFFFFA9C4 /begin FUNCTION_LIST KF7-313C.1[36] /end FUNCTION_LIST /end MEASUREMENT
/begin MEASUREMENT vMNRPL_R#1 "At the time of the parameter minimum value renewal, A/F lean value (lean rich)" UWORD COMP_0453 1 100 0 131.07 ECU_ADDRESS 0xFFFFA9C4 /begin FUNCTION_LIST KF7-313C.1[36] /end FUNCTION_LIST /end MEASUREMENT
/begin MEASUREMENT vMNRPL_R#2 "At the time of the parameter minimum value renewal, A/F lean value (lean rich)" UWORD COMP_0453 1 100 0 131.07 ECU_ADDRESS 0xFFFFA9C6 /begin FUNCTION_LIST KF7-313C.1[36] /end FUNCTION_LIST /end MEASUREMENT
/begin MEASUREMENT vMNRPL_R#3 "At the time of the parameter minimum value renewal, A/F lean value (lean rich)" UWORD COMP_0453 1 100 0 131.07 ECU_ADDRESS 0xFFFFA9C8 /begin FUNCTION_LIST KF7-313C.1[36] /end FUNCTION_LIST /end MEASUREMENT
/begin MEASUREMENT vMNRPL_R#4 "At the time of the parameter minimum value renewal, A/F lean value (lean rich)" UWORD COMP_0453 1 100 0 131.07 ECU_ADDRESS 0xFFFFA9CA /begin FUNCTION_LIST KF7-313C.1[36] /end FUNCTION_LIST /end MEASUREMENT
/begin MEASUREMENT vMNRPL_R#5 "At the time of the parameter minimum value renewal, A/F lean value (lean rich)" UWORD COMP_0453 1 100 0 131.07 ECU_ADDRESS 0xFFFFA9CC /begin FUNCTION_LIST KF7-313C.1[36] /end FUNCTION_LIST /end MEASUREMENT
/begin MEASUREMENT vMNRPL_R#6 "At the time of the parameter minimum value renewal, A/F lean value (lean rich)" UWORD COMP_0453 1 100 0 131.07 ECU_ADDRESS 0xFFFFA9CE /begin FUNCTION_LIST KF7-313C.1[36] /end FUNCTION_LIST /end MEASUREMENT
/begin MEASUREMENT vMNRPL_R#7 "At the time of the parameter minimum value renewal, A/F lean value (lean rich)" UWORD COMP_0453 1 100 0 131.07 ECU_ADDRESS 0xFFFFA9D0 /begin FUNCTION_LIST KF7-313C.1[36] /end FUNCTION_LIST /end MEASUREMENT
/begin MEASUREMENT vMNRPL_R#8 "At the time of the parameter minimum value renewal, A/F lean value (lean rich)" UWORD COMP_0453 1 100 0 131.07 ECU_ADDRESS 0xFFFFA9D2 /begin FUNCTION_LIST KF7-313C.1[36] /end FUNCTION_LIST /end MEASUREMENT
/begin MEASUREMENT vMNRPL_R#9 "At the time of the parameter minimum value renewal, A/F lean value (lean rich)" UWORD COMP_0453 1 100 0 131.07 ECU_ADDRESS 0xFFFFA9D4 /begin FUNCTION_LIST KF7-313C.1[36] /end FUNCTION_LIST /end MEASUREMENT
/begin MEASUREMENT vMNRPL_R#10 "At the time of the parameter minimum value renewal, A/F lean value (lean rich)" UWORD COMP_0453 1 100 0 131.07 ECU_ADDRESS 0xFFFFA9D6 /begin FUNCTION_LIST KF7-313C.1[36] /end FUNCTION_LIST /end MEASUREMENT
/begin MEASUREMENT vMNRPL_R#11 "At the time of the parameter minimum value renewal, A/F lean value (lean rich)" UWORD COMP_0453 1 100 0 131.07 ECU_ADDRESS 0xFFFFA9D8 /begin FUNCTION_LIST KF7-313C.1[36] /end FUNCTION_LIST /end MEASUREMENT
/begin MEASUREMENT vMNRPL_R#12 "At the time of the parameter minimum value renewal, A/F lean value (lean rich)" UWORD COMP_0453 1 100 0 131.07 ECU_ADDRESS 0xFFFFA9DA /begin FUNCTION_LIST KF7-313C.1[36] /end FUNCTION_LIST /end MEASUREMENT
/begin MEASUREMENT vMNRPL_R#13 "At the time of the parameter minimum value renewal, A/F lean value (lean rich)" UWORD COMP_0453 1 100 0 131.07 ECU_ADDRESS 0xFFFFA9DC /begin FUNCTION_LIST KF7-313C.1[36] /end FUNCTION_LIST /end MEASUREMENT
/begin MEASUREMENT vMNRPL_R#14 "At the time of the parameter minimum value renewal, A/F lean value (lean rich)" UWORD COMP_0453 1 100 0 131.07 ECU_ADDRESS 0xFFFFA9DE /begin FUNCTION_LIST KF7-313C.1[36] /end FUNCTION_LIST /end MEASUREMENT
/begin MEASUREMENT vMNRPL_R#15 "At the time of the parameter minimum value renewal, A/F lean value (lean rich)" UWORD COMP_0453 1 100 0 131.07 ECU_ADDRESS 0xFFFFA9E0 /begin FUNCTION_LIST KF7-313C.1[36] /end FUNCTION_LIST /end MEASUREMENT
/begin MEASUREMENT vMNRPL_R#16 "At the time of the parameter minimum value renewal, A/F lean value (lean rich)" UWORD COMP_0453 1 100 0 131.07 ECU_ADDRESS 0xFFFFA9E2 /begin FUNCTION_LIST KF7-313C.1[36] /end FUNCTION_LIST /end MEASUREMENT
/begin MEASUREMENT vMNRPR "At the time of the parameter minimum value renewal, A/F rich value (rich lean)" UWORD COMP_0453 1 100 0 131.07 ECU_ADDRESS 0xFFFFA9E4 /begin FUNCTION_LIST KF7-313C.1[36] /end FUNCTION_LIST /end MEASUREMENT
/begin MEASUREMENT vMNRPR_R#1 "At the time of the parameter minimum value renewal, A/F rich value (rich lean)" UWORD COMP_0453 1 100 0 131.07 ECU_ADDRESS 0xFFFFA9E4 /begin FUNCTION_LIST KF7-313C.1[36] /end FUNCTION_LIST /end MEASUREMENT
/begin MEASUREMENT vMNRPR_R#2 "At the time of the parameter minimum value renewal, A/F rich value (rich lean)" UWORD COMP_0453 1 100 0 131.07 ECU_ADDRESS 0xFFFFA9E6 /begin FUNCTION_LIST KF7-313C.1[36] /end FUNCTION_LIST /end MEASUREMENT
/begin MEASUREMENT vMNRPR_R#3 "At the time of the parameter minimum value renewal, A/F rich value (rich lean)" UWORD COMP_0453 1 100 0 131.07 ECU_ADDRESS 0xFFFFA9E8 /begin FUNCTION_LIST KF7-313C.1[36] /end FUNCTION_LIST /end MEASUREMENT
/begin MEASUREMENT vMNRPR_R#4 "At the time of the parameter minimum value renewal, A/F rich value (rich lean)" UWORD COMP_0453 1 100 0 131.07 ECU_ADDRESS 0xFFFFA9EA /begin FUNCTION_LIST KF7-313C.1[36] /end FUNCTION_LIST /end MEASUREMENT
/begin MEASUREMENT vMNRPR_R#5 "At the time of the parameter minimum value renewal, A/F rich value (rich lean)" UWORD COMP_0453 1 100 0 131.07 ECU_ADDRESS 0xFFFFA9EC /begin FUNCTION_LIST KF7-313C.1[36] /end FUNCTION_LIST /end MEASUREMENT
/begin MEASUREMENT vMNRPR_R#6 "At the time of the parameter minimum value renewal, A/F rich value (rich lean)" UWORD COMP_0453 1 100 0 131.07 ECU_ADDRESS 0xFFFFA9EE /begin FUNCTION_LIST KF7-313C.1[36] /end FUNCTION_LIST /end MEASUREMENT
/begin MEASUREMENT vMNRPR_R#7 "At the time of the parameter minimum value renewal, A/F rich value (rich lean)" UWORD COMP_0453 1 100 0 131.07 ECU_ADDRESS 0xFFFFA9F0 /begin FUNCTION_LIST KF7-313C.1[36] /end FUNCTION_LIST /end MEASUREMENT
/begin MEASUREMENT vMNRPR_R#8 "At the time of the parameter minimum value renewal, A/F rich value (rich lean)" UWORD COMP_0453 1 100 0 131.07 ECU_ADDRESS 0xFFFFA9F2 /begin FUNCTION_LIST KF7-313C.1[36] /end FUNCTION_LIST /end MEASUREMENT
/begin MEASUREMENT vMNRPR_R#9 "At the time of the parameter minimum value renewal, A/F rich value (rich lean)" UWORD COMP_0453 1 100 0 131.07 ECU_ADDRESS 0xFFFFA9F4 /begin FUNCTION_LIST KF7-313C.1[36] /end FUNCTION_LIST /end MEASUREMENT
/begin MEASUREMENT vMNRPR_R#10 "At the time of the parameter minimum value renewal, A/F rich value (rich lean)" UWORD COMP_0453 1 100 0 131.07 ECU_ADDRESS 0xFFFFA9F6 /begin FUNCTION_LIST KF7-313C.1[36] /end FUNCTION_LIST /end MEASUREMENT
/begin MEASUREMENT vMNRPR_R#11 "At the time of the parameter minimum value renewal, A/F rich value (rich lean)" UWORD COMP_0453 1 100 0 131.07 ECU_ADDRESS 0xFFFFA9F8 /begin FUNCTION_LIST KF7-313C.1[36] /end FUNCTION_LIST /end MEASUREMENT
/begin MEASUREMENT vMNRPR_R#12 "At the time of the parameter minimum value renewal, A/F rich value (rich lean)" UWORD COMP_0453 1 100 0 131.07 ECU_ADDRESS 0xFFFFA9FA /begin FUNCTION_LIST KF7-313C.1[36] /end FUNCTION_LIST /end MEASUREMENT
/begin MEASUREMENT vMNRPR_R#13 "At the time of the parameter minimum value renewal, A/F rich value (rich lean)" UWORD COMP_0453 1 100 0 131.07 ECU_ADDRESS 0xFFFFA9FC /begin FUNCTION_LIST KF7-313C.1[36] /end FUNCTION_LIST /end MEASUREMENT
/begin MEASUREMENT vMNRPR_R#14 "At the time of the parameter minimum value renewal, A/F rich value (rich lean)" UWORD COMP_0453 1 100 0 131.07 ECU_ADDRESS 0xFFFFA9FE /begin FUNCTION_LIST KF7-313C.1[36] /end FUNCTION_LIST /end MEASUREMENT
/begin MEASUREMENT vMNRPR_R#15 "At the time of the parameter minimum value renewal, A/F rich value (rich lean)" UWORD COMP_0453 1 100 0 131.07 ECU_ADDRESS 0xFFFFAA00 /begin FUNCTION_LIST KF7-313C.1[36] /end FUNCTION_LIST /end MEASUREMENT
/begin MEASUREMENT vMNRPR_R#16 "At the time of the parameter minimum value renewal, A/F rich value (rich lean)" UWORD COMP_0453 1 100 0 131.07 ECU_ADDRESS 0xFFFFAA02 /begin FUNCTION_LIST KF7-313C.1[36] /end FUNCTION_LIST /end MEASUREMENT
/begin MEASUREMENT vMNTANL "At the time of the parameter minimum value renewal, intake air temperature (lean rich)" UBYTE COMP_0035 1 100 -50 205 ECU_ADDRESS 0xFFFFAA04 /begin FUNCTION_LIST KF7-313C.1[36] /end FUNCTION_LIST /end MEASUREMENT
/begin MEASUREMENT vMNTANL_R#1 "At the time of the parameter minimum value renewal, intake air temperature (lean rich)" UBYTE COMP_0035 1 100 -50 205 ECU_ADDRESS 0xFFFFAA04 /begin FUNCTION_LIST KF7-313C.1[36] /end FUNCTION_LIST /end MEASUREMENT
/begin MEASUREMENT vMNTANL_R#2 "At the time of the parameter minimum value renewal, intake air temperature (lean rich)" UBYTE COMP_0035 1 100 -50 205 ECU_ADDRESS 0xFFFFAA05 /begin FUNCTION_LIST KF7-313C.1[36] /end FUNCTION_LIST /end MEASUREMENT
/begin MEASUREMENT vMNTANL_R#3 "At the time of the parameter minimum value renewal, intake air temperature (lean rich)" UBYTE COMP_0035 1 100 -50 205 ECU_ADDRESS 0xFFFFAA06 /begin FUNCTION_LIST KF7-313C.1[36] /end FUNCTION_LIST /end MEASUREMENT
/begin MEASUREMENT vMNTANL_R#4 "At the time of the parameter minimum value renewal, intake air temperature (lean rich)" UBYTE COMP_0035 1 100 -50 205 ECU_ADDRESS 0xFFFFAA07 /begin FUNCTION_LIST KF7-313C.1[36] /end FUNCTION_LIST /end MEASUREMENT
/begin MEASUREMENT vMNTANL_R#5 "At the time of the parameter minimum value renewal, intake air temperature (lean rich)" UBYTE COMP_0035 1 100 -50 205 ECU_ADDRESS 0xFFFFAA08 /begin FUNCTION_LIST KF7-313C.1[36] /end FUNCTION_LIST /end MEASUREMENT
/begin MEASUREMENT vMNTANL_R#6 "At the time of the parameter minimum value renewal, intake air temperature (lean rich)" UBYTE COMP_0035 1 100 -50 205 ECU_ADDRESS 0xFFFFAA09 /begin FUNCTION_LIST KF7-313C.1[36] /end FUNCTION_LIST /end MEASUREMENT
/begin MEASUREMENT vMNTANL_R#7 "At the time of the parameter minimum value renewal, intake air temperature (lean rich)" UBYTE COMP_0035 1 100 -50 205 ECU_ADDRESS 0xFFFFAA0A /begin FUNCTION_LIST KF7-313C.1[36] /end FUNCTION_LIST /end MEASUREMENT
/begin MEASUREMENT vMNTANL_R#8 "At the time of the parameter minimum value renewal, intake air temperature (lean rich)" UBYTE COMP_0035 1 100 -50 205 ECU_ADDRESS 0xFFFFAA0B /begin FUNCTION_LIST KF7-313C.1[36] /end FUNCTION_LIST /end MEASUREMENT
/begin MEASUREMENT vMNTANL_R#9 "At the time of the parameter minimum value renewal, intake air temperature (lean rich)" UBYTE COMP_0035 1 100 -50 205 ECU_ADDRESS 0xFFFFAA0C /begin FUNCTION_LIST KF7-313C.1[36] /end FUNCTION_LIST /end MEASUREMENT
/begin MEASUREMENT vMNTANL_R#10 "At the time of the parameter minimum value renewal, intake air temperature (lean rich)" UBYTE COMP_0035 1 100 -50 205 ECU_ADDRESS 0xFFFFAA0D /begin FUNCTION_LIST KF7-313C.1[36] /end FUNCTION_LIST /end MEASUREMENT
/begin MEASUREMENT vMNTANL_R#11 "At the time of the parameter minimum value renewal, intake air temperature (lean rich)" UBYTE COMP_0035 1 100 -50 205 ECU_ADDRESS 0xFFFFAA0E /begin FUNCTION_LIST KF7-313C.1[36] /end FUNCTION_LIST /end MEASUREMENT
/begin MEASUREMENT vMNTANL_R#12 "At the time of the parameter minimum value renewal, intake air temperature (lean rich)" UBYTE COMP_0035 1 100 -50 205 ECU_ADDRESS 0xFFFFAA0F /begin FUNCTION_LIST KF7-313C.1[36] /end FUNCTION_LIST /end MEASUREMENT
/begin MEASUREMENT vMNTANL_R#13 "At the time of the parameter minimum value renewal, intake air temperature (lean rich)" UBYTE COMP_0035 1 100 -50 205 ECU_ADDRESS 0xFFFFAA10 /begin FUNCTION_LIST KF7-313C.1[36] /end FUNCTION_LIST /end MEASUREMENT
/begin MEASUREMENT vMNTANL_R#14 "At the time of the parameter minimum value renewal, intake air temperature (lean rich)" UBYTE COMP_0035 1 100 -50 205 ECU_ADDRESS 0xFFFFAA11 /begin FUNCTION_LIST KF7-313C.1[36] /end FUNCTION_LIST /end MEASUREMENT
/begin MEASUREMENT vMNTANL_R#15 "At the time of the parameter minimum value renewal, intake air temperature (lean rich)" UBYTE COMP_0035 1 100 -50 205 ECU_ADDRESS 0xFFFFAA12 /begin FUNCTION_LIST KF7-313C.1[36] /end FUNCTION_LIST /end MEASUREMENT
/begin MEASUREMENT vMNTANL_R#16 "At the time of the parameter minimum value renewal, intake air temperature (lean rich)" UBYTE COMP_0035 1 100 -50 205 ECU_ADDRESS 0xFFFFAA13 /begin FUNCTION_LIST KF7-313C.1[36] /end FUNCTION_LIST /end MEASUREMENT
/begin MEASUREMENT vMNTANR "At the time of the parameter minimum value renewal, intake air temperature (rich lean)" UBYTE COMP_0035 1 100 -50 205 ECU_ADDRESS 0xFFFFAA14 /begin FUNCTION_LIST KF7-313C.1[36] /end FUNCTION_LIST /end MEASUREMENT
/begin MEASUREMENT vMNTANR_R#1 "At the time of the parameter minimum value renewal, intake air temperature (rich lean)" UBYTE COMP_0035 1 100 -50 205 ECU_ADDRESS 0xFFFFAA14 /begin FUNCTION_LIST KF7-313C.1[36] /end FUNCTION_LIST /end MEASUREMENT
/begin MEASUREMENT vMNTANR_R#2 "At the time of the parameter minimum value renewal, intake air temperature (rich lean)" UBYTE COMP_0035 1 100 -50 205 ECU_ADDRESS 0xFFFFAA15 /begin FUNCTION_LIST KF7-313C.1[36] /end FUNCTION_LIST /end MEASUREMENT
/begin MEASUREMENT vMNTANR_R#3 "At the time of the parameter minimum value renewal, intake air temperature (rich lean)" UBYTE COMP_0035 1 100 -50 205 ECU_ADDRESS 0xFFFFAA16 /begin FUNCTION_LIST KF7-313C.1[36] /end FUNCTION_LIST /end MEASUREMENT
/begin MEASUREMENT vMNTANR_R#4 "At the time of the parameter minimum value renewal, intake air temperature (rich lean)" UBYTE COMP_0035 1 100 -50 205 ECU_ADDRESS 0xFFFFAA17 /begin FUNCTION_LIST KF7-313C.1[36] /end FUNCTION_LIST /end MEASUREMENT
/begin MEASUREMENT vMNTANR_R#5 "At the time of the parameter minimum value renewal, intake air temperature (rich lean)" UBYTE COMP_0035 1 100 -50 205 ECU_ADDRESS 0xFFFFAA18 /begin FUNCTION_LIST KF7-313C.1[36] /end FUNCTION_LIST /end MEASUREMENT
/begin MEASUREMENT vMNTANR_R#6 "At the time of the parameter minimum value renewal, intake air temperature (rich lean)" UBYTE COMP_0035 1 100 -50 205 ECU_ADDRESS 0xFFFFAA19 /begin FUNCTION_LIST KF7-313C.1[36] /end FUNCTION_LIST /end MEASUREMENT
/begin MEASUREMENT vMNTANR_R#7 "At the time of the parameter minimum value renewal, intake air temperature (rich lean)" UBYTE COMP_0035 1 100 -50 205 ECU_ADDRESS 0xFFFFAA1A /begin FUNCTION_LIST KF7-313C.1[36] /end FUNCTION_LIST /end MEASUREMENT
/begin MEASUREMENT vMNTANR_R#8 "At the time of the parameter minimum value renewal, intake air temperature (rich lean)" UBYTE COMP_0035 1 100 -50 205 ECU_ADDRESS 0xFFFFAA1B /begin FUNCTION_LIST KF7-313C.1[36] /end FUNCTION_LIST /end MEASUREMENT
/begin MEASUREMENT vMNTANR_R#9 "At the time of the parameter minimum value renewal, intake air temperature (rich lean)" UBYTE COMP_0035 1 100 -50 205 ECU_ADDRESS 0xFFFFAA1C /begin FUNCTION_LIST KF7-313C.1[36] /end FUNCTION_LIST /end MEASUREMENT
/begin MEASUREMENT vMNTANR_R#10 "At the time of the parameter minimum value renewal, intake air temperature (rich lean)" UBYTE COMP_0035 1 100 -50 205 ECU_ADDRESS 0xFFFFAA1D /begin FUNCTION_LIST KF7-313C.1[36] /end FUNCTION_LIST /end MEASUREMENT
/begin MEASUREMENT vMNTANR_R#11 "At the time of the parameter minimum value renewal, intake air temperature (rich lean)" UBYTE COMP_0035 1 100 -50 205 ECU_ADDRESS 0xFFFFAA1E /begin FUNCTION_LIST KF7-313C.1[36] /end FUNCTION_LIST /end MEASUREMENT
/begin MEASUREMENT vMNTANR_R#12 "At the time of the parameter minimum value renewal, intake air temperature (rich lean)" UBYTE COMP_0035 1 100 -50 205 ECU_ADDRESS 0xFFFFAA1F /begin FUNCTION_LIST KF7-313C.1[36] /end FUNCTION_LIST /end MEASUREMENT
/begin MEASUREMENT vMNTANR_R#13 "At the time of the parameter minimum value renewal, intake air temperature (rich lean)" UBYTE COMP_0035 1 100 -50 205 ECU_ADDRESS 0xFFFFAA20 /begin FUNCTION_LIST KF7-313C.1[36] /end FUNCTION_LIST /end MEASUREMENT
/begin MEASUREMENT vMNTANR_R#14 "At the time of the parameter minimum value renewal, intake air temperature (rich lean)" UBYTE COMP_0035 1 100 -50 205 ECU_ADDRESS 0xFFFFAA21 /begin FUNCTION_LIST KF7-313C.1[36] /end FUNCTION_LIST /end MEASUREMENT
/begin MEASUREMENT vMNTANR_R#15 "At the time of the parameter minimum value renewal, intake air temperature (rich lean)" UBYTE COMP_0035 1 100 -50 205 ECU_ADDRESS 0xFFFFAA22 /begin FUNCTION_LIST KF7-313C.1[36] /end FUNCTION_LIST /end MEASUREMENT
/begin MEASUREMENT vMNTANR_R#16 "At the time of the parameter minimum value renewal, intake air temperature (rich lean)" UBYTE COMP_0035 1 100 -50 205 ECU_ADDRESS 0xFFFFAA23 /begin FUNCTION_LIST KF7-313C.1[36] /end FUNCTION_LIST /end MEASUREMENT
/begin MEASUREMENT vMNTWNL "At the time of the parameter minimum value renewal, coolant temperature (lean rich)" UBYTE COMP_0035 1 100 -50 205 ECU_ADDRESS 0xFFFFAA24 /begin FUNCTION_LIST KF7-313C.1[36] /end FUNCTION_LIST /end MEASUREMENT
/begin MEASUREMENT vMNTWNL_R#1 "At the time of the parameter minimum value renewal, coolant temperature (lean rich)" UBYTE COMP_0035 1 100 -50 205 ECU_ADDRESS 0xFFFFAA24 /begin FUNCTION_LIST KF7-313C.1[36] /end FUNCTION_LIST /end MEASUREMENT
/begin MEASUREMENT vMNTWNL_R#2 "At the time of the parameter minimum value renewal, coolant temperature (lean rich)" UBYTE COMP_0035 1 100 -50 205 ECU_ADDRESS 0xFFFFAA25 /begin FUNCTION_LIST KF7-313C.1[36] /end FUNCTION_LIST /end MEASUREMENT
/begin MEASUREMENT vMNTWNL_R#3 "At the time of the parameter minimum value renewal, coolant temperature (lean rich)" UBYTE COMP_0035 1 100 -50 205 ECU_ADDRESS 0xFFFFAA26 /begin FUNCTION_LIST KF7-313C.1[36] /end FUNCTION_LIST /end MEASUREMENT
/begin MEASUREMENT vMNTWNL_R#4 "At the time of the parameter minimum value renewal, coolant temperature (lean rich)" UBYTE COMP_0035 1 100 -50 205 ECU_ADDRESS 0xFFFFAA27 /begin FUNCTION_LIST KF7-313C.1[36] /end FUNCTION_LIST /end MEASUREMENT
/begin MEASUREMENT vMNTWNL_R#5 "At the time of the parameter minimum value renewal, coolant temperature (lean rich)" UBYTE COMP_0035 1 100 -50 205 ECU_ADDRESS 0xFFFFAA28 /begin FUNCTION_LIST KF7-313C.1[36] /end FUNCTION_LIST /end MEASUREMENT
/begin MEASUREMENT vMNTWNL_R#6 "At the time of the parameter minimum value renewal, coolant temperature (lean rich)" UBYTE COMP_0035 1 100 -50 205 ECU_ADDRESS 0xFFFFAA29 /begin FUNCTION_LIST KF7-313C.1[36] /end FUNCTION_LIST /end MEASUREMENT
/begin MEASUREMENT vMNTWNL_R#7 "At the time of the parameter minimum value renewal, coolant temperature (lean rich)" UBYTE COMP_0035 1 100 -50 205 ECU_ADDRESS 0xFFFFAA2A /begin FUNCTION_LIST KF7-313C.1[36] /end FUNCTION_LIST /end MEASUREMENT
/begin MEASUREMENT vMNTWNL_R#8 "At the time of the parameter minimum value renewal, coolant temperature (lean rich)" UBYTE COMP_0035 1 100 -50 205 ECU_ADDRESS 0xFFFFAA2B /begin FUNCTION_LIST KF7-313C.1[36] /end FUNCTION_LIST /end MEASUREMENT
/begin MEASUREMENT vMNTWNL_R#9 "At the time of the parameter minimum value renewal, coolant temperature (lean rich)" UBYTE COMP_0035 1 100 -50 205 ECU_ADDRESS 0xFFFFAA2C /begin FUNCTION_LIST KF7-313C.1[36] /end FUNCTION_LIST /end MEASUREMENT
/begin MEASUREMENT vMNTWNL_R#10 "At the time of the parameter minimum value renewal, coolant temperature (lean rich)" UBYTE COMP_0035 1 100 -50 205 ECU_ADDRESS 0xFFFFAA2D /begin FUNCTION_LIST KF7-313C.1[36] /end FUNCTION_LIST /end MEASUREMENT
/begin MEASUREMENT vMNTWNL_R#11 "At the time of the parameter minimum value renewal, coolant temperature (lean rich)" UBYTE COMP_0035 1 100 -50 205 ECU_ADDRESS 0xFFFFAA2E /begin FUNCTION_LIST KF7-313C.1[36] /end FUNCTION_LIST /end MEASUREMENT
/begin MEASUREMENT vMNTWNL_R#12 "At the time of the parameter minimum value renewal, coolant temperature (lean rich)" UBYTE COMP_0035 1 100 -50 205 ECU_ADDRESS 0xFFFFAA2F /begin FUNCTION_LIST KF7-313C.1[36] /end FUNCTION_LIST /end MEASUREMENT
/begin MEASUREMENT vMNTWNL_R#13 "At the time of the parameter minimum value renewal, coolant temperature (lean rich)" UBYTE COMP_0035 1 100 -50 205 ECU_ADDRESS 0xFFFFAA30 /begin FUNCTION_LIST KF7-313C.1[36] /end FUNCTION_LIST /end MEASUREMENT
/begin MEASUREMENT vMNTWNL_R#14 "At the time of the parameter minimum value renewal, coolant temperature (lean rich)" UBYTE COMP_0035 1 100 -50 205 ECU_ADDRESS 0xFFFFAA31 /begin FUNCTION_LIST KF7-313C.1[36] /end FUNCTION_LIST /end MEASUREMENT
/begin MEASUREMENT vMNTWNL_R#15 "At the time of the parameter minimum value renewal, coolant temperature (lean rich)" UBYTE COMP_0035 1 100 -50 205 ECU_ADDRESS 0xFFFFAA32 /begin FUNCTION_LIST KF7-313C.1[36] /end FUNCTION_LIST /end MEASUREMENT
/begin MEASUREMENT vMNTWNL_R#16 "At the time of the parameter minimum value renewal, coolant temperature (lean rich)" UBYTE COMP_0035 1 100 -50 205 ECU_ADDRESS 0xFFFFAA33 /begin FUNCTION_LIST KF7-313C.1[36] /end FUNCTION_LIST /end MEASUREMENT
/begin MEASUREMENT vMNTWNR "At the time of the parameter minimum value renewal, coolant temperature (rich lean)" UBYTE COMP_0035 1 100 -50 205 ECU_ADDRESS 0xFFFFAA34 /begin FUNCTION_LIST KF7-313C.1[36] /end FUNCTION_LIST /end MEASUREMENT
/begin MEASUREMENT vMNTWNR_R#1 "At the time of the parameter minimum value renewal, coolant temperature (rich lean)" UBYTE COMP_0035 1 100 -50 205 ECU_ADDRESS 0xFFFFAA34 /begin FUNCTION_LIST KF7-313C.1[36] /end FUNCTION_LIST /end MEASUREMENT
/begin MEASUREMENT vMNTWNR_R#2 "At the time of the parameter minimum value renewal, coolant temperature (rich lean)" UBYTE COMP_0035 1 100 -50 205 ECU_ADDRESS 0xFFFFAA35 /begin FUNCTION_LIST KF7-313C.1[36] /end FUNCTION_LIST /end MEASUREMENT
/begin MEASUREMENT vMNTWNR_R#3 "At the time of the parameter minimum value renewal, coolant temperature (rich lean)" UBYTE COMP_0035 1 100 -50 205 ECU_ADDRESS 0xFFFFAA36 /begin FUNCTION_LIST KF7-313C.1[36] /end FUNCTION_LIST /end MEASUREMENT
/begin MEASUREMENT vMNTWNR_R#4 "At the time of the parameter minimum value renewal, coolant temperature (rich lean)" UBYTE COMP_0035 1 100 -50 205 ECU_ADDRESS 0xFFFFAA37 /begin FUNCTION_LIST KF7-313C.1[36] /end FUNCTION_LIST /end MEASUREMENT
/begin MEASUREMENT vMNTWNR_R#5 "At the time of the parameter minimum value renewal, coolant temperature (rich lean)" UBYTE COMP_0035 1 100 -50 205 ECU_ADDRESS 0xFFFFAA38 /begin FUNCTION_LIST KF7-313C.1[36] /end FUNCTION_LIST /end MEASUREMENT
/begin MEASUREMENT vMNTWNR_R#6 "At the time of the parameter minimum value renewal, coolant temperature (rich lean)" UBYTE COMP_0035 1 100 -50 205 ECU_ADDRESS 0xFFFFAA39 /begin FUNCTION_LIST KF7-313C.1[36] /end FUNCTION_LIST /end MEASUREMENT
/begin MEASUREMENT vMNTWNR_R#7 "At the time of the parameter minimum value renewal, coolant temperature (rich lean)" UBYTE COMP_0035 1 100 -50 205 ECU_ADDRESS 0xFFFFAA3A /begin FUNCTION_LIST KF7-313C.1[36] /end FUNCTION_LIST /end MEASUREMENT
/begin MEASUREMENT vMNTWNR_R#8 "At the time of the parameter minimum value renewal, coolant temperature (rich lean)" UBYTE COMP_0035 1 100 -50 205 ECU_ADDRESS 0xFFFFAA3B /begin FUNCTION_LIST KF7-313C.1[36] /end FUNCTION_LIST /end MEASUREMENT
/begin MEASUREMENT vMNTWNR_R#9 "At the time of the parameter minimum value renewal, coolant temperature (rich lean)" UBYTE COMP_0035 1 100 -50 205 ECU_ADDRESS 0xFFFFAA3C /begin FUNCTION_LIST KF7-313C.1[36] /end FUNCTION_LIST /end MEASUREMENT
/begin MEASUREMENT vMNTWNR_R#10 "At the time of the parameter minimum value renewal, coolant temperature (rich lean)" UBYTE COMP_0035 1 100 -50 205 ECU_ADDRESS 0xFFFFAA3D /begin FUNCTION_LIST KF7-313C.1[36] /end FUNCTION_LIST /end MEASUREMENT
/begin MEASUREMENT vMNTWNR_R#11 "At the time of the parameter minimum value renewal, coolant temperature (rich lean)" UBYTE COMP_0035 1 100 -50 205 ECU_ADDRESS 0xFFFFAA3E /begin FUNCTION_LIST KF7-313C.1[36] /end FUNCTION_LIST /end MEASUREMENT
/begin MEASUREMENT vMNTWNR_R#12 "At the time of the parameter minimum value renewal, coolant temperature (rich lean)" UBYTE COMP_0035 1 100 -50 205 ECU_ADDRESS 0xFFFFAA3F /begin FUNCTION_LIST KF7-313C.1[36] /end FUNCTION_LIST /end MEASUREMENT
/begin MEASUREMENT vMNTWNR_R#13 "At the time of the parameter minimum value renewal, coolant temperature (rich lean)" UBYTE COMP_0035 1 100 -50 205 ECU_ADDRESS 0xFFFFAA40 /begin FUNCTION_LIST KF7-313C.1[36] /end FUNCTION_LIST /end MEASUREMENT
/begin MEASUREMENT vMNTWNR_R#14 "At the time of the parameter minimum value renewal, coolant temperature (rich lean)" UBYTE COMP_0035 1 100 -50 205 ECU_ADDRESS 0xFFFFAA41 /begin FUNCTION_LIST KF7-313C.1[36] /end FUNCTION_LIST /end MEASUREMENT
/begin MEASUREMENT vMNTWNR_R#15 "At the time of the parameter minimum value renewal, coolant temperature (rich lean)" UBYTE COMP_0035 1 100 -50 205 ECU_ADDRESS 0xFFFFAA42 /begin FUNCTION_LIST KF7-313C.1[36] /end FUNCTION_LIST /end MEASUREMENT
/begin MEASUREMENT vMNTWNR_R#16 "At the time of the parameter minimum value renewal, coolant temperature (rich lean)" UBYTE COMP_0035 1 100 -50 205 ECU_ADDRESS 0xFFFFAA43 /begin FUNCTION_LIST KF7-313C.1[36] /end FUNCTION_LIST /end MEASUREMENT
/begin MEASUREMENT vMODELAF "Model output A/F" UWORD COMP_0453 1 100 0 131.07 ECU_ADDRESS 0xFFFF15A2 /begin FUNCTION_LIST KF7-313C.1[36] /end FUNCTION_LIST /end MEASUREMENT
/begin MEASUREMENT vMODELAF_R#1 "Model output A/F" UWORD COMP_0453 1 100 0 131.07 ECU_ADDRESS 0xFFFF15A2 /begin FUNCTION_LIST KF7-313C.1[36] /end FUNCTION_LIST /end MEASUREMENT
/begin MEASUREMENT vMODELAF_R#2 "Model output A/F" UWORD COMP_0453 1 100 0 131.07 ECU_ADDRESS 0xFFFF15A4 /begin FUNCTION_LIST KF7-313C.1[36] /end FUNCTION_LIST /end MEASUREMENT
/begin MEASUREMENT vMONDLY "After the monitor clamp, CLOSED control prohibition time timer" UWORD COMP_0014 1 100 0 655350 ECU_ADDRESS 0xFFFF2FD8 /begin FUNCTION_LIST KF7-313C.1[36] /end FUNCTION_LIST /end MEASUREMENT
/begin MEASUREMENT vMONDLY_R#1 "After the monitor clamp, CLOSED control prohibition time timer" UWORD COMP_0014 1 100 0 655350 ECU_ADDRESS 0xFFFF2FD8 /begin FUNCTION_LIST KF7-313C.1[36] /end FUNCTION_LIST /end MEASUREMENT
/begin MEASUREMENT vMONDLY_R#2 "After the monitor clamp, CLOSED control prohibition time timer" UWORD COMP_0014 1 100 0 655350 ECU_ADDRESS 0xFFFF2FDA /begin FUNCTION_LIST KF7-313C.1[36] /end FUNCTION_LIST /end MEASUREMENT
/begin MEASUREMENT vMXLRD "Lean rich parameter maximum value" UWORD COMP_0453 1 100 0 131.07 ECU_ADDRESS 0xFFFFAAFC /begin FUNCTION_LIST KF7-313C.1[36] /end FUNCTION_LIST /end MEASUREMENT
/begin MEASUREMENT vMXLRD_R#1 "Lean rich parameter maximum value" UWORD COMP_0453 1 100 0 131.07 ECU_ADDRESS 0xFFFFAAFC /begin FUNCTION_LIST KF7-313C.1[36] /end FUNCTION_LIST /end MEASUREMENT
/begin MEASUREMENT vMXLRD_R#2 "Lean rich parameter maximum value" UWORD COMP_0453 1 100 0 131.07 ECU_ADDRESS 0xFFFFAAFE /begin FUNCTION_LIST KF7-313C.1[36] /end FUNCTION_LIST /end MEASUREMENT
/begin MEASUREMENT vMXLRD_R#3 "Lean rich parameter maximum value" UWORD COMP_0453 1 100 0 131.07 ECU_ADDRESS 0xFFFFAB00 /begin FUNCTION_LIST KF7-313C.1[36] /end FUNCTION_LIST /end MEASUREMENT
/begin MEASUREMENT vMXLRD_R#4 "Lean rich parameter maximum value" UWORD COMP_0453 1 100 0 131.07 ECU_ADDRESS 0xFFFFAB02 /begin FUNCTION_LIST KF7-313C.1[36] /end FUNCTION_LIST /end MEASUREMENT
/begin MEASUREMENT vMXLRD_R#5 "Lean rich parameter maximum value" UWORD COMP_0453 1 100 0 131.07 ECU_ADDRESS 0xFFFFAB04 /begin FUNCTION_LIST KF7-313C.1[36] /end FUNCTION_LIST /end MEASUREMENT
/begin MEASUREMENT vMXLRD_R#6 "Lean rich parameter maximum value" UWORD COMP_0453 1 100 0 131.07 ECU_ADDRESS 0xFFFFAB06 /begin FUNCTION_LIST KF7-313C.1[36] /end FUNCTION_LIST /end MEASUREMENT
/begin MEASUREMENT vMXLRD_R#7 "Lean rich parameter maximum value" UWORD COMP_0453 1 100 0 131.07 ECU_ADDRESS 0xFFFFAB08 /begin FUNCTION_LIST KF7-313C.1[36] /end FUNCTION_LIST /end MEASUREMENT
/begin MEASUREMENT vMXLRD_R#8 "Lean rich parameter maximum value" UWORD COMP_0453 1 100 0 131.07 ECU_ADDRESS 0xFFFFAB0A /begin FUNCTION_LIST KF7-313C.1[36] /end FUNCTION_LIST /end MEASUREMENT
/begin MEASUREMENT vMXLRD_R#9 "Lean rich parameter maximum value" UWORD COMP_0453 1 100 0 131.07 ECU_ADDRESS 0xFFFFAB0C /begin FUNCTION_LIST KF7-313C.1[36] /end FUNCTION_LIST /end MEASUREMENT
/begin MEASUREMENT vMXLRD_R#10 "Lean rich parameter maximum value" UWORD COMP_0453 1 100 0 131.07 ECU_ADDRESS 0xFFFFAB0E /begin FUNCTION_LIST KF7-313C.1[36] /end FUNCTION_LIST /end MEASUREMENT
/begin MEASUREMENT vMXLRD_R#11 "Lean rich parameter maximum value" UWORD COMP_0453 1 100 0 131.07 ECU_ADDRESS 0xFFFFAB10 /begin FUNCTION_LIST KF7-313C.1[36] /end FUNCTION_LIST /end MEASUREMENT
/begin MEASUREMENT vMXLRD_R#12 "Lean rich parameter maximum value" UWORD COMP_0453 1 100 0 131.07 ECU_ADDRESS 0xFFFFAB12 /begin FUNCTION_LIST KF7-313C.1[36] /end FUNCTION_LIST /end MEASUREMENT
/begin MEASUREMENT vMXLRD_R#13 "Lean rich parameter maximum value" UWORD COMP_0453 1 100 0 131.07 ECU_ADDRESS 0xFFFFAB14 /begin FUNCTION_LIST KF7-313C.1[36] /end FUNCTION_LIST /end MEASUREMENT
/begin MEASUREMENT vMXLRD_R#14 "Lean rich parameter maximum value" UWORD COMP_0453 1 100 0 131.07 ECU_ADDRESS 0xFFFFAB16 /begin FUNCTION_LIST KF7-313C.1[36] /end FUNCTION_LIST /end MEASUREMENT
/begin MEASUREMENT vMXLRD_R#15 "Lean rich parameter maximum value" UWORD COMP_0453 1 100 0 131.07 ECU_ADDRESS 0xFFFFAB18 /begin FUNCTION_LIST KF7-313C.1[36] /end FUNCTION_LIST /end MEASUREMENT
/begin MEASUREMENT vMXLRD_R#16 "Lean rich parameter maximum value" UWORD COMP_0453 1 100 0 131.07 ECU_ADDRESS 0xFFFFAB1A /begin FUNCTION_LIST KF7-313C.1[36] /end FUNCTION_LIST /end MEASUREMENT
/begin MEASUREMENT vMXRLD "Rich lean parameter maximum value" UWORD COMP_0453 1 100 0 131.07 ECU_ADDRESS 0xFFFFAB1C /begin FUNCTION_LIST KF7-313C.1[36] /end FUNCTION_LIST /end MEASUREMENT
/begin MEASUREMENT vMXRLD_R#1 "Rich lean parameter maximum value" UWORD COMP_0453 1 100 0 131.07 ECU_ADDRESS 0xFFFFAB1C /begin FUNCTION_LIST KF7-313C.1[36] /end FUNCTION_LIST /end MEASUREMENT
/begin MEASUREMENT vMXRLD_R#2 "Rich lean parameter maximum value" UWORD COMP_0453 1 100 0 131.07 ECU_ADDRESS 0xFFFFAB1E /begin FUNCTION_LIST KF7-313C.1[36] /end FUNCTION_LIST /end MEASUREMENT
/begin MEASUREMENT vMXRLD_R#3 "Rich lean parameter maximum value" UWORD COMP_0453 1 100 0 131.07 ECU_ADDRESS 0xFFFFAB20 /begin FUNCTION_LIST KF7-313C.1[36] /end FUNCTION_LIST /end MEASUREMENT
/begin MEASUREMENT vMXRLD_R#4 "Rich lean parameter maximum value" UWORD COMP_0453 1 100 0 131.07 ECU_ADDRESS 0xFFFFAB22 /begin FUNCTION_LIST KF7-313C.1[36] /end FUNCTION_LIST /end MEASUREMENT
/begin MEASUREMENT vMXRLD_R#5 "Rich lean parameter maximum value" UWORD COMP_0453 1 100 0 131.07 ECU_ADDRESS 0xFFFFAB24 /begin FUNCTION_LIST KF7-313C.1[36] /end FUNCTION_LIST /end MEASUREMENT
/begin MEASUREMENT vMXRLD_R#6 "Rich lean parameter maximum value" UWORD COMP_0453 1 100 0 131.07 ECU_ADDRESS 0xFFFFAB26 /begin FUNCTION_LIST KF7-313C.1[36] /end FUNCTION_LIST /end MEASUREMENT
/begin MEASUREMENT vMXRLD_R#7 "Rich lean parameter maximum value" UWORD COMP_0453 1 100 0 131.07 ECU_ADDRESS 0xFFFFAB28 /begin FUNCTION_LIST KF7-313C.1[36] /end FUNCTION_LIST /end MEASUREMENT
/begin MEASUREMENT vMXRLD_R#8 "Rich lean parameter maximum value" UWORD COMP_0453 1 100 0 131.07 ECU_ADDRESS 0xFFFFAB2A /begin FUNCTION_LIST KF7-313C.1[36] /end FUNCTION_LIST /end MEASUREMENT
/begin MEASUREMENT vMXRLD_R#9 "Rich lean parameter maximum value" UWORD COMP_0453 1 100 0 131.07 ECU_ADDRESS 0xFFFFAB2C /begin FUNCTION_LIST KF7-313C.1[36] /end FUNCTION_LIST /end MEASUREMENT
/begin MEASUREMENT vMXRLD_R#10 "Rich lean parameter maximum value" UWORD COMP_0453 1 100 0 131.07 ECU_ADDRESS 0xFFFFAB2E /begin FUNCTION_LIST KF7-313C.1[36] /end FUNCTION_LIST /end MEASUREMENT
/begin MEASUREMENT vMXRLD_R#11 "Rich lean parameter maximum value" UWORD COMP_0453 1 100 0 131.07 ECU_ADDRESS 0xFFFFAB30 /begin FUNCTION_LIST KF7-313C.1[36] /end FUNCTION_LIST /end MEASUREMENT
/begin MEASUREMENT vMXRLD_R#12 "Rich lean parameter maximum value" UWORD COMP_0453 1 100 0 131.07 ECU_ADDRESS 0xFFFFAB32 /begin FUNCTION_LIST KF7-313C.1[36] /end FUNCTION_LIST /end MEASUREMENT
/begin MEASUREMENT vMXRLD_R#13 "Rich lean parameter maximum value" UWORD COMP_0453 1 100 0 131.07 ECU_ADDRESS 0xFFFFAB34 /begin FUNCTION_LIST KF7-313C.1[36] /end FUNCTION_LIST /end MEASUREMENT
/begin MEASUREMENT vMXRLD_R#14 "Rich lean parameter maximum value" UWORD COMP_0453 1 100 0 131.07 ECU_ADDRESS 0xFFFFAB36 /begin FUNCTION_LIST KF7-313C.1[36] /end FUNCTION_LIST /end MEASUREMENT
/begin MEASUREMENT vMXRLD_R#15 "Rich lean parameter maximum value" UWORD COMP_0453 1 100 0 131.07 ECU_ADDRESS 0xFFFFAB38 /begin FUNCTION_LIST KF7-313C.1[36] /end FUNCTION_LIST /end MEASUREMENT
/begin MEASUREMENT vMXRLD_R#16 "Rich lean parameter maximum value" UWORD COMP_0453 1 100 0 131.07 ECU_ADDRESS 0xFFFFAB3A /begin FUNCTION_LIST KF7-313C.1[36] /end FUNCTION_LIST /end MEASUREMENT
/begin MEASUREMENT vNLRDIFF "Lean rich diagnosis number of times" UWORD COMP_0016 1 100 0 65535 ECU_ADDRESS 0xFFFFADE0 /begin FUNCTION_LIST KF7-313C.1[36] /end FUNCTION_LIST /end MEASUREMENT
/begin MEASUREMENT vNLRDIFF_R#1 "Lean rich diagnosis number of times" UWORD COMP_0016 1 100 0 65535 ECU_ADDRESS 0xFFFFADE0 /begin FUNCTION_LIST KF7-313C.1[36] /end FUNCTION_LIST /end MEASUREMENT
/begin MEASUREMENT vNLRDIFF_R#2 "Lean rich diagnosis number of times" UWORD COMP_0016 1 100 0 65535 ECU_ADDRESS 0xFFFFADE2 /begin FUNCTION_LIST KF7-313C.1[36] /end FUNCTION_LIST /end MEASUREMENT
/begin MEASUREMENT vNLRDIFF_R#3 "Lean rich diagnosis number of times" UWORD COMP_0016 1 100 0 65535 ECU_ADDRESS 0xFFFFADE4 /begin FUNCTION_LIST KF7-313C.1[36] /end FUNCTION_LIST /end MEASUREMENT
/begin MEASUREMENT vNLRDIFF_R#4 "Lean rich diagnosis number of times" UWORD COMP_0016 1 100 0 65535 ECU_ADDRESS 0xFFFFADE6 /begin FUNCTION_LIST KF7-313C.1[36] /end FUNCTION_LIST /end MEASUREMENT
/begin MEASUREMENT vNLRDIFF_R#5 "Lean rich diagnosis number of times" UWORD COMP_0016 1 100 0 65535 ECU_ADDRESS 0xFFFFADE8 /begin FUNCTION_LIST KF7-313C.1[36] /end FUNCTION_LIST /end MEASUREMENT
/begin MEASUREMENT vNLRDIFF_R#6 "Lean rich diagnosis number of times" UWORD COMP_0016 1 100 0 65535 ECU_ADDRESS 0xFFFFADEA /begin FUNCTION_LIST KF7-313C.1[36] /end FUNCTION_LIST /end MEASUREMENT
/begin MEASUREMENT vNLRDIFF_R#7 "Lean rich diagnosis number of times" UWORD COMP_0016 1 100 0 65535 ECU_ADDRESS 0xFFFFADEC /begin FUNCTION_LIST KF7-313C.1[36] /end FUNCTION_LIST /end MEASUREMENT
/begin MEASUREMENT vNLRDIFF_R#8 "Lean rich diagnosis number of times" UWORD COMP_0016 1 100 0 65535 ECU_ADDRESS 0xFFFFADEE /begin FUNCTION_LIST KF7-313C.1[36] /end FUNCTION_LIST /end MEASUREMENT
/begin MEASUREMENT vNLRDIFF_R#9 "Lean rich diagnosis number of times" UWORD COMP_0016 1 100 0 65535 ECU_ADDRESS 0xFFFFADF0 /begin FUNCTION_LIST KF7-313C.1[36] /end FUNCTION_LIST /end MEASUREMENT
/begin MEASUREMENT vNLRDIFF_R#10 "Lean rich diagnosis number of times" UWORD COMP_0016 1 100 0 65535 ECU_ADDRESS 0xFFFFADF2 /begin FUNCTION_LIST KF7-313C.1[36] /end FUNCTION_LIST /end MEASUREMENT
/begin MEASUREMENT vNLRDIFF_R#11 "Lean rich diagnosis number of times" UWORD COMP_0016 1 100 0 65535 ECU_ADDRESS 0xFFFFADF4 /begin FUNCTION_LIST KF7-313C.1[36] /end FUNCTION_LIST /end MEASUREMENT
/begin MEASUREMENT vNLRDIFF_R#12 "Lean rich diagnosis number of times" UWORD COMP_0016 1 100 0 65535 ECU_ADDRESS 0xFFFFADF6 /begin FUNCTION_LIST KF7-313C.1[36] /end FUNCTION_LIST /end MEASUREMENT
/begin MEASUREMENT vNLRDIFF_R#13 "Lean rich diagnosis number of times" UWORD COMP_0016 1 100 0 65535 ECU_ADDRESS 0xFFFFADF8 /begin FUNCTION_LIST KF7-313C.1[36] /end FUNCTION_LIST /end MEASUREMENT
/begin MEASUREMENT vNLRDIFF_R#14 "Lean rich diagnosis number of times" UWORD COMP_0016 1 100 0 65535 ECU_ADDRESS 0xFFFFADFA /begin FUNCTION_LIST KF7-313C.1[36] /end FUNCTION_LIST /end MEASUREMENT
/begin MEASUREMENT vNLRDIFF_R#15 "Lean rich diagnosis number of times" UWORD COMP_0016 1 100 0 65535 ECU_ADDRESS 0xFFFFADFC /begin FUNCTION_LIST KF7-313C.1[36] /end FUNCTION_LIST /end MEASUREMENT
/begin MEASUREMENT vNLRDIFF_R#16 "Lean rich diagnosis number of times" UWORD COMP_0016 1 100 0 65535 ECU_ADDRESS 0xFFFFADFE /begin FUNCTION_LIST KF7-313C.1[36] /end FUNCTION_LIST /end MEASUREMENT
/begin MEASUREMENT vNRLDIFF "Rich lean diagnosis number of times" UWORD COMP_0016 1 100 0 65535 ECU_ADDRESS 0xFFFFAE44 /begin FUNCTION_LIST KF7-313C.1[36] /end FUNCTION_LIST /end MEASUREMENT
/begin MEASUREMENT vNRLDIFF_R#1 "Rich lean diagnosis number of times" UWORD COMP_0016 1 100 0 65535 ECU_ADDRESS 0xFFFFAE44 /begin FUNCTION_LIST KF7-313C.1[36] /end FUNCTION_LIST /end MEASUREMENT
/begin MEASUREMENT vNRLDIFF_R#2 "Rich lean diagnosis number of times" UWORD COMP_0016 1 100 0 65535 ECU_ADDRESS 0xFFFFAE46 /begin FUNCTION_LIST KF7-313C.1[36] /end FUNCTION_LIST /end MEASUREMENT
/begin MEASUREMENT vNRLDIFF_R#3 "Rich lean diagnosis number of times" UWORD COMP_0016 1 100 0 65535 ECU_ADDRESS 0xFFFFAE48 /begin FUNCTION_LIST KF7-313C.1[36] /end FUNCTION_LIST /end MEASUREMENT
/begin MEASUREMENT vNRLDIFF_R#4 "Rich lean diagnosis number of times" UWORD COMP_0016 1 100 0 65535 ECU_ADDRESS 0xFFFFAE4A /begin FUNCTION_LIST KF7-313C.1[36] /end FUNCTION_LIST /end MEASUREMENT
/begin MEASUREMENT vNRLDIFF_R#5 "Rich lean diagnosis number of times" UWORD COMP_0016 1 100 0 65535 ECU_ADDRESS 0xFFFFAE4C /begin FUNCTION_LIST KF7-313C.1[36] /end FUNCTION_LIST /end MEASUREMENT
/begin MEASUREMENT vNRLDIFF_R#6 "Rich lean diagnosis number of times" UWORD COMP_0016 1 100 0 65535 ECU_ADDRESS 0xFFFFAE4E /begin FUNCTION_LIST KF7-313C.1[36] /end FUNCTION_LIST /end MEASUREMENT
/begin MEASUREMENT vNRLDIFF_R#7 "Rich lean diagnosis number of times" UWORD COMP_0016 1 100 0 65535 ECU_ADDRESS 0xFFFFAE50 /begin FUNCTION_LIST KF7-313C.1[36] /end FUNCTION_LIST /end MEASUREMENT
/begin MEASUREMENT vNRLDIFF_R#8 "Rich lean diagnosis number of times" UWORD COMP_0016 1 100 0 65535 ECU_ADDRESS 0xFFFFAE52 /begin FUNCTION_LIST KF7-313C.1[36] /end FUNCTION_LIST /end MEASUREMENT
/begin MEASUREMENT vNRLDIFF_R#9 "Rich lean diagnosis number of times" UWORD COMP_0016 1 100 0 65535 ECU_ADDRESS 0xFFFFAE54 /begin FUNCTION_LIST KF7-313C.1[36] /end FUNCTION_LIST /end MEASUREMENT
/begin MEASUREMENT vNRLDIFF_R#10 "Rich lean diagnosis number of times" UWORD COMP_0016 1 100 0 65535 ECU_ADDRESS 0xFFFFAE56 /begin FUNCTION_LIST KF7-313C.1[36] /end FUNCTION_LIST /end MEASUREMENT
/begin MEASUREMENT vNRLDIFF_R#11 "Rich lean diagnosis number of times" UWORD COMP_0016 1 100 0 65535 ECU_ADDRESS 0xFFFFAE58 /begin FUNCTION_LIST KF7-313C.1[36] /end FUNCTION_LIST /end MEASUREMENT
/begin MEASUREMENT vNRLDIFF_R#12 "Rich lean diagnosis number of times" UWORD COMP_0016 1 100 0 65535 ECU_ADDRESS 0xFFFFAE5A /begin FUNCTION_LIST KF7-313C.1[36] /end FUNCTION_LIST /end MEASUREMENT
/begin MEASUREMENT vNRLDIFF_R#13 "Rich lean diagnosis number of times" UWORD COMP_0016 1 100 0 65535 ECU_ADDRESS 0xFFFFAE5C /begin FUNCTION_LIST KF7-313C.1[36] /end FUNCTION_LIST /end MEASUREMENT
/begin MEASUREMENT vNRLDIFF_R#14 "Rich lean diagnosis number of times" UWORD COMP_0016 1 100 0 65535 ECU_ADDRESS 0xFFFFAE5E /begin FUNCTION_LIST KF7-313C.1[36] /end FUNCTION_LIST /end MEASUREMENT
/begin MEASUREMENT vNRLDIFF_R#15 "Rich lean diagnosis number of times" UWORD COMP_0016 1 100 0 65535 ECU_ADDRESS 0xFFFFAE60 /begin FUNCTION_LIST KF7-313C.1[36] /end FUNCTION_LIST /end MEASUREMENT
/begin MEASUREMENT vNRLDIFF_R#16 "Rich lean diagnosis number of times" UWORD COMP_0016 1 100 0 65535 ECU_ADDRESS 0xFFFFAE62 /begin FUNCTION_LIST KF7-313C.1[36] /end FUNCTION_LIST /end MEASUREMENT
/begin MEASUREMENT vNRPSUML "Lean side speed integration value" ULONG COMP_0006 1 100 0 53687091187.5 ECU_ADDRESS 0xFFFF3014 /begin FUNCTION_LIST KF7-313C.1[36] /end FUNCTION_LIST /end MEASUREMENT
/begin MEASUREMENT vNRPSUML_R#1 "Lean side speed integration value" ULONG COMP_0006 1 100 0 53687091187.5 ECU_ADDRESS 0xFFFF3014 /begin FUNCTION_LIST KF7-313C.1[36] /end FUNCTION_LIST /end MEASUREMENT
/begin MEASUREMENT vNRPSUML_R#2 "Lean side speed integration value" ULONG COMP_0006 1 100 0 53687091187.5 ECU_ADDRESS 0xFFFF3018 /begin FUNCTION_LIST KF7-313C.1[36] /end FUNCTION_LIST /end MEASUREMENT
/begin MEASUREMENT vNRPSUMR "Rich side speed integration value" ULONG COMP_0006 1 100 0 53687091187.5 ECU_ADDRESS 0xFFFF301C /begin FUNCTION_LIST KF7-313C.1[36] /end FUNCTION_LIST /end MEASUREMENT
/begin MEASUREMENT vNRPSUMR_R#1 "Rich side speed integration value" ULONG COMP_0006 1 100 0 53687091187.5 ECU_ADDRESS 0xFFFF301C /begin FUNCTION_LIST KF7-313C.1[36] /end FUNCTION_LIST /end MEASUREMENT
/begin MEASUREMENT vNRPSUMR_R#2 "Rich side speed integration value" ULONG COMP_0006 1 100 0 53687091187.5 ECU_ADDRESS 0xFFFF3020 /begin FUNCTION_LIST KF7-313C.1[36] /end FUNCTION_LIST /end MEASUREMENT
/begin MEASUREMENT vOXYGEN "The amount of O2" SWORD COMP_0611_S 1 100 -327.68 327.67 ECU_ADDRESS 0xFFFF3060 /begin FUNCTION_LIST KF7-313C.1[36] KF7-313C.9[3] KF7-500.21[19] /end FUNCTION_LIST /end MEASUREMENT
/begin MEASUREMENT vOXYGEN_R#1 "The amount of O2" SWORD COMP_0611_S 1 100 -327.68 327.67 ECU_ADDRESS 0xFFFF3060 /begin FUNCTION_LIST KF7-313C.1[36] KF7-313C.9[3] KF7-500.21[19] /end FUNCTION_LIST /end MEASUREMENT
/begin MEASUREMENT vOXYGEN_R#2 "The amount of O2" SWORD COMP_0611_S 1 100 -327.68 327.67 ECU_ADDRESS 0xFFFF3062 /begin FUNCTION_LIST KF7-313C.1[36] KF7-313C.9[3] KF7-500.21[19] /end FUNCTION_LIST /end MEASUREMENT
/begin MEASUREMENT vPREDAF "Prediction A/F" UWORD COMP_0453 1 100 0 131.07 ECU_ADDRESS 0xFFFF1698 /begin FUNCTION_LIST KF7-313C.1[36] /end FUNCTION_LIST /end MEASUREMENT
/begin MEASUREMENT vPREDAF_R#1 "Prediction A/F" UWORD COMP_0453 1 100 0 131.07 ECU_ADDRESS 0xFFFF1698 /begin FUNCTION_LIST KF7-313C.1[36] /end FUNCTION_LIST /end MEASUREMENT
/begin MEASUREMENT vPREDAF_R#2 "Prediction A/F" UWORD COMP_0453 1 100 0 131.07 ECU_ADDRESS 0xFFFF169A /begin FUNCTION_LIST KF7-313C.1[36] /end FUNCTION_LIST /end MEASUREMENT
/begin MEASUREMENT vPVTCTRG "PS-VTC target angle" UBYTE COMP_0048 1 100 0 127.5 ECU_ADDRESS 0xFFFF16A8 /begin FUNCTION_LIST KF7-313C.1[36] /end FUNCTION_LIST /end MEASUREMENT
/begin MEASUREMENT vPVTCTRGE "Electromagnetism VTC target angle (exhaust)" UBYTE COMP_0256 1 100 -64 63.5 ECU_ADDRESS 0xFFFF16AA /begin FUNCTION_LIST KF7-313C.1[36] /end FUNCTION_LIST /end MEASUREMENT
/begin MEASUREMENT vQAE "-" UWORD COMP_0068 1 100 0 65535 ECU_ADDRESS 0xFFFF30BC /begin FUNCTION_LIST KF7-313C.1[36] /end FUNCTION_LIST /end MEASUREMENT
/begin MEASUREMENT vQAESUML "Lean side air quantity integration value" ULONG COMP_0068 1 100 0 4294967295 ECU_ADDRESS 0xFFFF30C0 /begin FUNCTION_LIST KF7-313C.1[36] /end FUNCTION_LIST /end MEASUREMENT
/begin MEASUREMENT vQAESUML_R#1 "Lean side air quantity integration value" ULONG COMP_0068 1 100 0 4294967295 ECU_ADDRESS 0xFFFF30C0 /begin FUNCTION_LIST KF7-313C.1[36] /end FUNCTION_LIST /end MEASUREMENT
/begin MEASUREMENT vQAESUML_R#2 "Lean side air quantity integration value" ULONG COMP_0068 1 100 0 4294967295 ECU_ADDRESS 0xFFFF30C4 /begin FUNCTION_LIST KF7-313C.1[36] /end FUNCTION_LIST /end MEASUREMENT
/begin MEASUREMENT vQAESUMR "Rich side air quantity integration value" ULONG COMP_0068 1 100 0 4294967295 ECU_ADDRESS 0xFFFF30C8 /begin FUNCTION_LIST KF7-313C.1[36] /end FUNCTION_LIST /end MEASUREMENT
/begin MEASUREMENT vQAESUMR_R#1 "Rich side air quantity integration value" ULONG COMP_0068 1 100 0 4294967295 ECU_ADDRESS 0xFFFF30C8 /begin FUNCTION_LIST KF7-313C.1[36] /end FUNCTION_LIST /end MEASUREMENT
/begin MEASUREMENT vQAESUMR_R#2 "Rich side air quantity integration value" ULONG COMP_0068 1 100 0 4294967295 ECU_ADDRESS 0xFFFF30CC /begin FUNCTION_LIST KF7-313C.1[36] /end FUNCTION_LIST /end MEASUREMENT
/begin MEASUREMENT vQAIG "An integral gain Qa compensation coefficient" UBYTE COMP_0388 1 100 0 25.5 ECU_ADDRESS 0xFFFF16B3 /begin FUNCTION_LIST KF7-313C.1[36] /end FUNCTION_LIST /end MEASUREMENT
/begin MEASUREMENT vQAIG_R#1 "An integral gain Qa compensation coefficient" UBYTE COMP_0388 1 100 0 25.5 ECU_ADDRESS 0xFFFF16B3 /begin FUNCTION_LIST KF7-313C.1[36] /end FUNCTION_LIST /end MEASUREMENT
/begin MEASUREMENT vQAIG_R#2 "An integral gain Qa compensation coefficient" UBYTE COMP_0388 1 100 0 25.5 ECU_ADDRESS 0xFFFF16B4 /begin FUNCTION_LIST KF7-313C.1[36] /end FUNCTION_LIST /end MEASUREMENT
/begin MEASUREMENT vQAPHYS "Air flow-quantity Qa physics value" UWORD COMP_0220 1 100 0 65535 ECU_ADDRESS 0xFFFF16B6 /begin FUNCTION_LIST KF7-313C.1[36] /end FUNCTION_LIST /end MEASUREMENT
/begin MEASUREMENT vRAFP "After atomospheric pressure compensation, A/F sensor voltage" UWORD COMP_0093 1 100 0 163837.5 ECU_ADDRESS 0xFFFF30E4 /begin FUNCTION_LIST KF7-313C.1[36] /end FUNCTION_LIST /end MEASUREMENT
/begin MEASUREMENT vRAFP_R#1 "After atomospheric pressure compensation, A/F sensor voltage" UWORD COMP_0093 1 100 0 163837.5 ECU_ADDRESS 0xFFFF30E4 /begin FUNCTION_LIST KF7-313C.1[36] /end FUNCTION_LIST /end MEASUREMENT
/begin MEASUREMENT vRAFP_R#2 "After atomospheric pressure compensation, A/F sensor voltage" UWORD COMP_0093 1 100 0 163837.5 ECU_ADDRESS 0xFFFF30E6 /begin FUNCTION_LIST KF7-313C.1[36] /end FUNCTION_LIST /end MEASUREMENT
/begin MEASUREMENT vRATECNT "A NG diagnosis complete counter for the RATE law" UWORD COMP_0016 1 100 0 65535 ECU_ADDRESS 0xFFFFAEF4 /begin FUNCTION_LIST KF7-313C.1[36] /end FUNCTION_LIST /end MEASUREMENT
/begin MEASUREMENT vRATECNT_R#1 "A NG diagnosis complete counter for the RATE law" UWORD COMP_0016 1 100 0 65535 ECU_ADDRESS 0xFFFFAEF4 /begin FUNCTION_LIST KF7-313C.1[36] /end FUNCTION_LIST /end MEASUREMENT
/begin MEASUREMENT vRATECNT_R#2 "A NG diagnosis complete counter for the RATE law" UWORD COMP_0016 1 100 0 65535 ECU_ADDRESS 0xFFFFAEF6 /begin FUNCTION_LIST KF7-313C.1[36] /end FUNCTION_LIST /end MEASUREMENT
/begin MEASUREMENT vRCOUNT "Rich lean number of times" UBYTE COMP_0016 1 100 0 255 ECU_ADDRESS 0xFFFF30F6 /begin FUNCTION_LIST KF7-313C.1[36] /end FUNCTION_LIST /end MEASUREMENT
/begin MEASUREMENT vRCOUNT_R#1 "Rich lean number of times" UBYTE COMP_0016 1 100 0 255 ECU_ADDRESS 0xFFFF30F6 /begin FUNCTION_LIST KF7-313C.1[36] /end FUNCTION_LIST /end MEASUREMENT
/begin MEASUREMENT vRCOUNT_R#2 "Rich lean number of times" UBYTE COMP_0016 1 100 0 255 ECU_ADDRESS 0xFFFF30F7 /begin FUNCTION_LIST KF7-313C.1[36] /end FUNCTION_LIST /end MEASUREMENT
/begin MEASUREMENT vREGNO "Qa region judgement value" UBYTE COMP_0068 1 100 0 255 ECU_ADDRESS 0xFFFF172E /begin FUNCTION_LIST KF7-313C.1[36] /end FUNCTION_LIST /end MEASUREMENT
/begin MEASUREMENT vRHOLD "Rich maximum value previous value" UWORD COMP_0453 1 100 0 131.07 ECU_ADDRESS 0xFFFF3136 /begin FUNCTION_LIST KF7-313C.1[36] /end FUNCTION_LIST /end MEASUREMENT
/begin MEASUREMENT vRHOLD_R#1 "Rich maximum value previous value" UWORD COMP_0453 1 100 0 131.07 ECU_ADDRESS 0xFFFF3136 /begin FUNCTION_LIST KF7-313C.1[36] /end FUNCTION_LIST /end MEASUREMENT
/begin MEASUREMENT vRHOLD_R#2 "Rich maximum value previous value" UWORD COMP_0453 1 100 0 131.07 ECU_ADDRESS 0xFFFF3138 /begin FUNCTION_LIST KF7-313C.1[36] /end FUNCTION_LIST /end MEASUREMENT
/begin MEASUREMENT vRINTVL "Rich time timer" UWORD COMP_0165_S 1 100 0 655.35 ECU_ADDRESS 0xFFFF313A /begin FUNCTION_LIST KF7-313C.1[36] /end FUNCTION_LIST /end MEASUREMENT
/begin MEASUREMENT vRINTVL_R#1 "Rich time timer" UWORD COMP_0165_S 1 100 0 655.35 ECU_ADDRESS 0xFFFF313A /begin FUNCTION_LIST KF7-313C.1[36] /end FUNCTION_LIST /end MEASUREMENT
/begin MEASUREMENT vRINTVL_R#2 "Rich time timer" UWORD COMP_0165_S 1 100 0 655.35 ECU_ADDRESS 0xFFFF313C /begin FUNCTION_LIST KF7-313C.1[36] /end FUNCTION_LIST /end MEASUREMENT
/begin MEASUREMENT vRLDIFF "Lean rich parameter buffer" UWORD COMP_0453 1 100 0 131.07 ECU_ADDRESS 0xFFFF3142 /begin FUNCTION_LIST KF7-313C.1[36] /end FUNCTION_LIST /end MEASUREMENT
/begin MEASUREMENT vRLDIFF_R#1 "Lean rich parameter buffer" UWORD COMP_0453 1 100 0 131.07 ECU_ADDRESS 0xFFFF3142 /begin FUNCTION_LIST KF7-313C.1[36] /end FUNCTION_LIST /end MEASUREMENT
/begin MEASUREMENT vRLDIFF_R#2 "Lean rich parameter buffer" UWORD COMP_0453 1 100 0 131.07 ECU_ADDRESS 0xFFFF3144 /begin FUNCTION_LIST KF7-313C.1[36] /end FUNCTION_LIST /end MEASUREMENT
/begin MEASUREMENT vRLDSUM "Rich side parameter integration value" ULONG COMP_0453 1 100 0 8589934.59 ECU_ADDRESS 0xFFFF3148 /begin FUNCTION_LIST KF7-313C.1[36] /end FUNCTION_LIST /end MEASUREMENT
/begin MEASUREMENT vRLDSUM_R#1 "Rich side parameter integration value" ULONG COMP_0453 1 100 0 8589934.59 ECU_ADDRESS 0xFFFF3148 /begin FUNCTION_LIST KF7-313C.1[36] /end FUNCTION_LIST /end MEASUREMENT
/begin MEASUREMENT vRLDSUM_R#2 "Rich side parameter integration value" ULONG COMP_0453 1 100 0 8589934.59 ECU_ADDRESS 0xFFFF314C /begin FUNCTION_LIST KF7-313C.1[36] /end FUNCTION_LIST /end MEASUREMENT
/begin MEASUREMENT vRLPEAK "At the time of the rich, RrO2 sensor minimum value" UWORD COMP_0023 1 100 0 327675 ECU_ADDRESS 0xFFFF3158 /begin FUNCTION_LIST KF7-313C.1[36] /end FUNCTION_LIST /end MEASUREMENT
/begin MEASUREMENT vRLPEAK_R#1 "At the time of the rich, RrO2 sensor minimum value" UWORD COMP_0023 1 100 0 327675 ECU_ADDRESS 0xFFFF3158 /begin FUNCTION_LIST KF7-313C.1[36] /end FUNCTION_LIST /end MEASUREMENT
/begin MEASUREMENT vRLPEAK_R#2 "At the time of the rich, RrO2 sensor minimum value" UWORD COMP_0023 1 100 0 327675 ECU_ADDRESS 0xFFFF315A /begin FUNCTION_LIST KF7-313C.1[36] /end FUNCTION_LIST /end MEASUREMENT
/begin MEASUREMENT vRNCNTLR "A NG diagnosis complete counter (lean rich) for the RATE law" UWORD COMP_0016 1 100 0 65535 ECU_ADDRESS 0xFFFFAFF0 /begin FUNCTION_LIST KF7-313C.1[36] /end FUNCTION_LIST /end MEASUREMENT
/begin MEASUREMENT vRNCNTLR_R#1 "A NG diagnosis complete counter (lean rich) for the RATE law" UWORD COMP_0016 1 100 0 65535 ECU_ADDRESS 0xFFFFAFF0 /begin FUNCTION_LIST KF7-313C.1[36] /end FUNCTION_LIST /end MEASUREMENT
/begin MEASUREMENT vRNCNTLR_R#2 "A NG diagnosis complete counter (lean rich) for the RATE law" UWORD COMP_0016 1 100 0 65535 ECU_ADDRESS 0xFFFFAFF2 /begin FUNCTION_LIST KF7-313C.1[36] /end FUNCTION_LIST /end MEASUREMENT
/begin MEASUREMENT vRNCNTRL "A NG diagnosis complete counter (rich lean) for the RATE law" UWORD COMP_0016 1 100 0 65535 ECU_ADDRESS 0xFFFFAFF4 /begin FUNCTION_LIST KF7-313C.1[36] /end FUNCTION_LIST /end MEASUREMENT
/begin MEASUREMENT vRNCNTRL_R#1 "A NG diagnosis complete counter (rich lean) for the RATE law" UWORD COMP_0016 1 100 0 65535 ECU_ADDRESS 0xFFFFAFF4 /begin FUNCTION_LIST KF7-313C.1[36] /end FUNCTION_LIST /end MEASUREMENT
/begin MEASUREMENT vRNCNTRL_R#2 "A NG diagnosis complete counter (rich lean) for the RATE law" UWORD COMP_0016 1 100 0 65535 ECU_ADDRESS 0xFFFFAFF6 /begin FUNCTION_LIST KF7-313C.1[36] /end FUNCTION_LIST /end MEASUREMENT
/begin MEASUREMENT vROCNTLR "OK diagnosis complete counter (lean rich) for the RATE law" UWORD COMP_0016 1 100 0 65535 ECU_ADDRESS 0xFFFFB000 /begin FUNCTION_LIST KF7-313C.1[36] /end FUNCTION_LIST /end MEASUREMENT
/begin MEASUREMENT vROCNTLR_R#1 "OK diagnosis complete counter (lean rich) for the RATE law" UWORD COMP_0016 1 100 0 65535 ECU_ADDRESS 0xFFFFB000 /begin FUNCTION_LIST KF7-313C.1[36] /end FUNCTION_LIST /end MEASUREMENT
/begin MEASUREMENT vROCNTLR_R#2 "OK diagnosis complete counter (lean rich) for the RATE law" UWORD COMP_0016 1 100 0 65535 ECU_ADDRESS 0xFFFFB002 /begin FUNCTION_LIST KF7-313C.1[36] /end FUNCTION_LIST /end MEASUREMENT
/begin MEASUREMENT vROCNTRL "OK diagnosis complete counter (rich lean) for the RATE law" UWORD COMP_0016 1 100 0 65535 ECU_ADDRESS 0xFFFFB004 /begin FUNCTION_LIST KF7-313C.1[36] /end FUNCTION_LIST /end MEASUREMENT
/begin MEASUREMENT vROCNTRL_R#1 "OK diagnosis complete counter (rich lean) for the RATE law" UWORD COMP_0016 1 100 0 65535 ECU_ADDRESS 0xFFFFB004 /begin FUNCTION_LIST KF7-313C.1[36] /end FUNCTION_LIST /end MEASUREMENT
/begin MEASUREMENT vROCNTRL_R#2 "OK diagnosis complete counter (rich lean) for the RATE law" UWORD COMP_0016 1 100 0 65535 ECU_ADDRESS 0xFFFFB006 /begin FUNCTION_LIST KF7-313C.1[36] /end FUNCTION_LIST /end MEASUREMENT
/begin MEASUREMENT vRPEAK "Rich maximum value" UWORD COMP_0453 1 100 0 131.07 ECU_ADDRESS 0xFFFF3186 /begin FUNCTION_LIST KF7-313C.1[36] /end FUNCTION_LIST /end MEASUREMENT
/begin MEASUREMENT vRPEAK_R#1 "Rich maximum value" UWORD COMP_0453 1 100 0 131.07 ECU_ADDRESS 0xFFFF3186 /begin FUNCTION_LIST KF7-313C.1[36] /end FUNCTION_LIST /end MEASUREMENT
/begin MEASUREMENT vRPEAK_R#2 "Rich maximum value" UWORD COMP_0453 1 100 0 131.07 ECU_ADDRESS 0xFFFF3188 /begin FUNCTION_LIST KF7-313C.1[36] /end FUNCTION_LIST /end MEASUREMENT
/begin MEASUREMENT vRRPEAK "At the time of the rich, RrO2 sensor maximum value" UWORD COMP_0023 1 100 0 327675 ECU_ADDRESS 0xFFFF3190 /begin FUNCTION_LIST KF7-313C.1[36] /end FUNCTION_LIST /end MEASUREMENT
/begin MEASUREMENT vRRPEAK_R#1 "At the time of the rich, RrO2 sensor maximum value" UWORD COMP_0023 1 100 0 327675 ECU_ADDRESS 0xFFFF3190 /begin FUNCTION_LIST KF7-313C.1[36] /end FUNCTION_LIST /end MEASUREMENT
/begin MEASUREMENT vRRPEAK_R#2 "At the time of the rich, RrO2 sensor maximum value" UWORD COMP_0023 1 100 0 327675 ECU_ADDRESS 0xFFFF3192 /begin FUNCTION_LIST KF7-313C.1[36] /end FUNCTION_LIST /end MEASUREMENT
/begin MEASUREMENT vRSLICE "Rich side slice value" UWORD COMP_0023 1 100 0 327675 ECU_ADDRESS 0xFFFF3196 /begin FUNCTION_LIST KF7-313C.1[36] /end FUNCTION_LIST /end MEASUREMENT
/begin MEASUREMENT vRSLICE_R#1 "Rich side slice value" UWORD COMP_0023 1 100 0 327675 ECU_ADDRESS 0xFFFF3196 /begin FUNCTION_LIST KF7-313C.1[36] /end FUNCTION_LIST /end MEASUREMENT
/begin MEASUREMENT vRSLICE_R#2 "Rich side slice value" UWORD COMP_0023 1 100 0 327675 ECU_ADDRESS 0xFFFF3198 /begin FUNCTION_LIST KF7-313C.1[36] /end FUNCTION_LIST /end MEASUREMENT
/begin MEASUREMENT vSIGMA "Phase plane condition quantity É–" SWORD COMP_0341_S 1 100 -65.536 65.534 ECU_ADDRESS 0xFFFF1780 /begin FUNCTION_LIST KF7-313C.1[36] /end FUNCTION_LIST /end MEASUREMENT
/begin MEASUREMENT vSIGMA_R#1 "Phase plane condition quantity É–" SWORD COMP_0341_S 1 100 -65.536 65.534 ECU_ADDRESS 0xFFFF1780 /begin FUNCTION_LIST KF7-313C.1[36] /end FUNCTION_LIST /end MEASUREMENT
/begin MEASUREMENT vSIGMA_R#2 "Phase plane condition quantity É–" SWORD COMP_0341_S 1 100 -65.536 65.534 ECU_ADDRESS 0xFFFF1782 /begin FUNCTION_LIST KF7-313C.1[36] /end FUNCTION_LIST /end MEASUREMENT
/begin MEASUREMENT vSM2LRD "Lean rich parameter square peace" ULONG COMP_0453 1 100 0 8589934.59 ECU_ADDRESS 0xFFFFB098 /begin FUNCTION_LIST KF7-313C.1[36] /end FUNCTION_LIST /end MEASUREMENT
/begin MEASUREMENT vSM2LRD_R#1 "Lean rich parameter square peace" ULONG COMP_0453 1 100 0 8589934.59 ECU_ADDRESS 0xFFFFB098 /begin FUNCTION_LIST KF7-313C.1[36] /end FUNCTION_LIST /end MEASUREMENT
/begin MEASUREMENT vSM2LRD_R#2 "Lean rich parameter square peace" ULONG COMP_0453 1 100 0 8589934.59 ECU_ADDRESS 0xFFFFB09C /begin FUNCTION_LIST KF7-313C.1[36] /end FUNCTION_LIST /end MEASUREMENT
/begin MEASUREMENT vSM2LRD_R#3 "Lean rich parameter square peace" ULONG COMP_0453 1 100 0 8589934.59 ECU_ADDRESS 0xFFFFB0A0 /begin FUNCTION_LIST KF7-313C.1[36] /end FUNCTION_LIST /end MEASUREMENT
/begin MEASUREMENT vSM2LRD_R#4 "Lean rich parameter square peace" ULONG COMP_0453 1 100 0 8589934.59 ECU_ADDRESS 0xFFFFB0A4 /begin FUNCTION_LIST KF7-313C.1[36] /end FUNCTION_LIST /end MEASUREMENT
/begin MEASUREMENT vSM2LRD_R#5 "Lean rich parameter square peace" ULONG COMP_0453 1 100 0 8589934.59 ECU_ADDRESS 0xFFFFB0A8 /begin FUNCTION_LIST KF7-313C.1[36] /end FUNCTION_LIST /end MEASUREMENT
/begin MEASUREMENT vSM2LRD_R#6 "Lean rich parameter square peace" ULONG COMP_0453 1 100 0 8589934.59 ECU_ADDRESS 0xFFFFB0AC /begin FUNCTION_LIST KF7-313C.1[36] /end FUNCTION_LIST /end MEASUREMENT
/begin MEASUREMENT vSM2LRD_R#7 "Lean rich parameter square peace" ULONG COMP_0453 1 100 0 8589934.59 ECU_ADDRESS 0xFFFFB0B0 /begin FUNCTION_LIST KF7-313C.1[36] /end FUNCTION_LIST /end MEASUREMENT
/begin MEASUREMENT vSM2LRD_R#8 "Lean rich parameter square peace" ULONG COMP_0453 1 100 0 8589934.59 ECU_ADDRESS 0xFFFFB0B4 /begin FUNCTION_LIST KF7-313C.1[36] /end FUNCTION_LIST /end MEASUREMENT
/begin MEASUREMENT vSM2LRD_R#9 "Lean rich parameter square peace" ULONG COMP_0453 1 100 0 8589934.59 ECU_ADDRESS 0xFFFFB0B8 /begin FUNCTION_LIST KF7-313C.1[36] /end FUNCTION_LIST /end MEASUREMENT
/begin MEASUREMENT vSM2LRD_R#10 "Lean rich parameter square peace" ULONG COMP_0453 1 100 0 8589934.59 ECU_ADDRESS 0xFFFFB0BC /begin FUNCTION_LIST KF7-313C.1[36] /end FUNCTION_LIST /end MEASUREMENT
/begin MEASUREMENT vSM2LRD_R#11 "Lean rich parameter square peace" ULONG COMP_0453 1 100 0 8589934.59 ECU_ADDRESS 0xFFFFB0C0 /begin FUNCTION_LIST KF7-313C.1[36] /end FUNCTION_LIST /end MEASUREMENT
/begin MEASUREMENT vSM2LRD_R#12 "Lean rich parameter square peace" ULONG COMP_0453 1 100 0 8589934.59 ECU_ADDRESS 0xFFFFB0C4 /begin FUNCTION_LIST KF7-313C.1[36] /end FUNCTION_LIST /end MEASUREMENT
/begin MEASUREMENT vSM2LRD_R#13 "Lean rich parameter square peace" ULONG COMP_0453 1 100 0 8589934.59 ECU_ADDRESS 0xFFFFB0C8 /begin FUNCTION_LIST KF7-313C.1[36] /end FUNCTION_LIST /end MEASUREMENT
/begin MEASUREMENT vSM2LRD_R#14 "Lean rich parameter square peace" ULONG COMP_0453 1 100 0 8589934.59 ECU_ADDRESS 0xFFFFB0CC /begin FUNCTION_LIST KF7-313C.1[36] /end FUNCTION_LIST /end MEASUREMENT
/begin MEASUREMENT vSM2LRD_R#15 "Lean rich parameter square peace" ULONG COMP_0453 1 100 0 8589934.59 ECU_ADDRESS 0xFFFFB0D0 /begin FUNCTION_LIST KF7-313C.1[36] /end FUNCTION_LIST /end MEASUREMENT
/begin MEASUREMENT vSM2LRD_R#16 "Lean rich parameter square peace" ULONG COMP_0453 1 100 0 8589934.59 ECU_ADDRESS 0xFFFFB0D4 /begin FUNCTION_LIST KF7-313C.1[36] /end FUNCTION_LIST /end MEASUREMENT
/begin MEASUREMENT vSM2RLD "Rich lean parameter square peace" ULONG COMP_0453 1 100 0 8589934.59 ECU_ADDRESS 0xFFFFB0D8 /begin FUNCTION_LIST KF7-313C.1[36] /end FUNCTION_LIST /end MEASUREMENT
/begin MEASUREMENT vSM2RLD_R#1 "Rich lean parameter square peace" ULONG COMP_0453 1 100 0 8589934.59 ECU_ADDRESS 0xFFFFB0D8 /begin FUNCTION_LIST KF7-313C.1[36] /end FUNCTION_LIST /end MEASUREMENT
/begin MEASUREMENT vSM2RLD_R#2 "Rich lean parameter square peace" ULONG COMP_0453 1 100 0 8589934.59 ECU_ADDRESS 0xFFFFB0DC /begin FUNCTION_LIST KF7-313C.1[36] /end FUNCTION_LIST /end MEASUREMENT
/begin MEASUREMENT vSM2RLD_R#3 "Rich lean parameter square peace" ULONG COMP_0453 1 100 0 8589934.59 ECU_ADDRESS 0xFFFFB0E0 /begin FUNCTION_LIST KF7-313C.1[36] /end FUNCTION_LIST /end MEASUREMENT
/begin MEASUREMENT vSM2RLD_R#4 "Rich lean parameter square peace" ULONG COMP_0453 1 100 0 8589934.59 ECU_ADDRESS 0xFFFFB0E4 /begin FUNCTION_LIST KF7-313C.1[36] /end FUNCTION_LIST /end MEASUREMENT
/begin MEASUREMENT vSM2RLD_R#5 "Rich lean parameter square peace" ULONG COMP_0453 1 100 0 8589934.59 ECU_ADDRESS 0xFFFFB0E8 /begin FUNCTION_LIST KF7-313C.1[36] /end FUNCTION_LIST /end MEASUREMENT
/begin MEASUREMENT vSM2RLD_R#6 "Rich lean parameter square peace" ULONG COMP_0453 1 100 0 8589934.59 ECU_ADDRESS 0xFFFFB0EC /begin FUNCTION_LIST KF7-313C.1[36] /end FUNCTION_LIST /end MEASUREMENT
/begin MEASUREMENT vSM2RLD_R#7 "Rich lean parameter square peace" ULONG COMP_0453 1 100 0 8589934.59 ECU_ADDRESS 0xFFFFB0F0 /begin FUNCTION_LIST KF7-313C.1[36] /end FUNCTION_LIST /end MEASUREMENT
/begin MEASUREMENT vSM2RLD_R#8 "Rich lean parameter square peace" ULONG COMP_0453 1 100 0 8589934.59 ECU_ADDRESS 0xFFFFB0F4 /begin FUNCTION_LIST KF7-313C.1[36] /end FUNCTION_LIST /end MEASUREMENT
/begin MEASUREMENT vSM2RLD_R#9 "Rich lean parameter square peace" ULONG COMP_0453 1 100 0 8589934.59 ECU_ADDRESS 0xFFFFB0F8 /begin FUNCTION_LIST KF7-313C.1[36] /end FUNCTION_LIST /end MEASUREMENT
/begin MEASUREMENT vSM2RLD_R#10 "Rich lean parameter square peace" ULONG COMP_0453 1 100 0 8589934.59 ECU_ADDRESS 0xFFFFB0FC /begin FUNCTION_LIST KF7-313C.1[36] /end FUNCTION_LIST /end MEASUREMENT
/begin MEASUREMENT vSM2RLD_R#11 "Rich lean parameter square peace" ULONG COMP_0453 1 100 0 8589934.59 ECU_ADDRESS 0xFFFFB100 /begin FUNCTION_LIST KF7-313C.1[36] /end FUNCTION_LIST /end MEASUREMENT
/begin MEASUREMENT vSM2RLD_R#12 "Rich lean parameter square peace" ULONG COMP_0453 1 100 0 8589934.59 ECU_ADDRESS 0xFFFFB104 /begin FUNCTION_LIST KF7-313C.1[36] /end FUNCTION_LIST /end MEASUREMENT
/begin MEASUREMENT vSM2RLD_R#13 "Rich lean parameter square peace" ULONG COMP_0453 1 100 0 8589934.59 ECU_ADDRESS 0xFFFFB108 /begin FUNCTION_LIST KF7-313C.1[36] /end FUNCTION_LIST /end MEASUREMENT
/begin MEASUREMENT vSM2RLD_R#14 "Rich lean parameter square peace" ULONG COMP_0453 1 100 0 8589934.59 ECU_ADDRESS 0xFFFFB10C /begin FUNCTION_LIST KF7-313C.1[36] /end FUNCTION_LIST /end MEASUREMENT
/begin MEASUREMENT vSM2RLD_R#15 "Rich lean parameter square peace" ULONG COMP_0453 1 100 0 8589934.59 ECU_ADDRESS 0xFFFFB110 /begin FUNCTION_LIST KF7-313C.1[36] /end FUNCTION_LIST /end MEASUREMENT
/begin MEASUREMENT vSM2RLD_R#16 "Rich lean parameter square peace" ULONG COMP_0453 1 100 0 8589934.59 ECU_ADDRESS 0xFFFFB114 /begin FUNCTION_LIST KF7-313C.1[36] /end FUNCTION_LIST /end MEASUREMENT
/begin MEASUREMENT vSMCIPART "ALPHA I-gain" SWORD COMP_0624_S 1 100 -0.015630336 0.015629859 ECU_ADDRESS 0xFFFF31D6 /begin FUNCTION_LIST KF7-313C.1[36] /end FUNCTION_LIST /end MEASUREMENT
/begin MEASUREMENT vSMCIPART_R#1 "ALPHA I-gain" SWORD COMP_0624_S 1 100 -0.015630336 0.015629859 ECU_ADDRESS 0xFFFF31D6 /begin FUNCTION_LIST KF7-313C.1[36] /end FUNCTION_LIST /end MEASUREMENT
/begin MEASUREMENT vSMCIPART_R#2 "ALPHA I-gain" SWORD COMP_0624_S 1 100 -0.015630336 0.015629859 ECU_ADDRESS 0xFFFF31D8 /begin FUNCTION_LIST KF7-313C.1[36] /end FUNCTION_LIST /end MEASUREMENT
/begin MEASUREMENT vSMCPPART "ALPHA P-gain" SWORD COMP_0625_S 1 100 -0.499974144 0.499958886 ECU_ADDRESS 0xFFFF31DA /begin FUNCTION_LIST KF7-313C.1[36] /end FUNCTION_LIST /end MEASUREMENT
/begin MEASUREMENT vSMCPPART_R#1 "ALPHA P-gain" SWORD COMP_0625_S 1 100 -0.499974144 0.499958886 ECU_ADDRESS 0xFFFF31DA /begin FUNCTION_LIST KF7-313C.1[36] /end FUNCTION_LIST /end MEASUREMENT
/begin MEASUREMENT vSMCPPART_R#2 "ALPHA P-gain" SWORD COMP_0625_S 1 100 -0.499974144 0.499958886 ECU_ADDRESS 0xFFFF31DC /begin FUNCTION_LIST KF7-313C.1[36] /end FUNCTION_LIST /end MEASUREMENT
/begin MEASUREMENT vSMLRDIF "Lean rich parameter integration" ULONG COMP_0453 1 100 0 8589934.59 ECU_ADDRESS 0xFFFFB1A8 /begin FUNCTION_LIST KF7-313C.1[36] /end FUNCTION_LIST /end MEASUREMENT
/begin MEASUREMENT vSMLRDIF_R#1 "Lean rich parameter integration" ULONG COMP_0453 1 100 0 8589934.59 ECU_ADDRESS 0xFFFFB1A8 /begin FUNCTION_LIST KF7-313C.1[36] /end FUNCTION_LIST /end MEASUREMENT
/begin MEASUREMENT vSMLRDIF_R#2 "Lean rich parameter integration" ULONG COMP_0453 1 100 0 8589934.59 ECU_ADDRESS 0xFFFFB1AC /begin FUNCTION_LIST KF7-313C.1[36] /end FUNCTION_LIST /end MEASUREMENT
/begin MEASUREMENT vSMLRDIF_R#3 "Lean rich parameter integration" ULONG COMP_0453 1 100 0 8589934.59 ECU_ADDRESS 0xFFFFB1B0 /begin FUNCTION_LIST KF7-313C.1[36] /end FUNCTION_LIST /end MEASUREMENT
/begin MEASUREMENT vSMLRDIF_R#4 "Lean rich parameter integration" ULONG COMP_0453 1 100 0 8589934.59 ECU_ADDRESS 0xFFFFB1B4 /begin FUNCTION_LIST KF7-313C.1[36] /end FUNCTION_LIST /end MEASUREMENT
/begin MEASUREMENT vSMLRDIF_R#5 "Lean rich parameter integration" ULONG COMP_0453 1 100 0 8589934.59 ECU_ADDRESS 0xFFFFB1B8 /begin FUNCTION_LIST KF7-313C.1[36] /end FUNCTION_LIST /end MEASUREMENT
/begin MEASUREMENT vSMLRDIF_R#6 "Lean rich parameter integration" ULONG COMP_0453 1 100 0 8589934.59 ECU_ADDRESS 0xFFFFB1BC /begin FUNCTION_LIST KF7-313C.1[36] /end FUNCTION_LIST /end MEASUREMENT
/begin MEASUREMENT vSMLRDIF_R#7 "Lean rich parameter integration" ULONG COMP_0453 1 100 0 8589934.59 ECU_ADDRESS 0xFFFFB1C0 /begin FUNCTION_LIST KF7-313C.1[36] /end FUNCTION_LIST /end MEASUREMENT
/begin MEASUREMENT vSMLRDIF_R#8 "Lean rich parameter integration" ULONG COMP_0453 1 100 0 8589934.59 ECU_ADDRESS 0xFFFFB1C4 /begin FUNCTION_LIST KF7-313C.1[36] /end FUNCTION_LIST /end MEASUREMENT
/begin MEASUREMENT vSMLRDIF_R#9 "Lean rich parameter integration" ULONG COMP_0453 1 100 0 8589934.59 ECU_ADDRESS 0xFFFFB1C8 /begin FUNCTION_LIST KF7-313C.1[36] /end FUNCTION_LIST /end MEASUREMENT
/begin MEASUREMENT vSMLRDIF_R#10 "Lean rich parameter integration" ULONG COMP_0453 1 100 0 8589934.59 ECU_ADDRESS 0xFFFFB1CC /begin FUNCTION_LIST KF7-313C.1[36] /end FUNCTION_LIST /end MEASUREMENT
/begin MEASUREMENT vSMLRDIF_R#11 "Lean rich parameter integration" ULONG COMP_0453 1 100 0 8589934.59 ECU_ADDRESS 0xFFFFB1D0 /begin FUNCTION_LIST KF7-313C.1[36] /end FUNCTION_LIST /end MEASUREMENT
/begin MEASUREMENT vSMLRDIF_R#12 "Lean rich parameter integration" ULONG COMP_0453 1 100 0 8589934.59 ECU_ADDRESS 0xFFFFB1D4 /begin FUNCTION_LIST KF7-313C.1[36] /end FUNCTION_LIST /end MEASUREMENT
/begin MEASUREMENT vSMLRDIF_R#13 "Lean rich parameter integration" ULONG COMP_0453 1 100 0 8589934.59 ECU_ADDRESS 0xFFFFB1D8 /begin FUNCTION_LIST KF7-313C.1[36] /end FUNCTION_LIST /end MEASUREMENT
/begin MEASUREMENT vSMLRDIF_R#14 "Lean rich parameter integration" ULONG COMP_0453 1 100 0 8589934.59 ECU_ADDRESS 0xFFFFB1DC /begin FUNCTION_LIST KF7-313C.1[36] /end FUNCTION_LIST /end MEASUREMENT
/begin MEASUREMENT vSMLRDIF_R#15 "Lean rich parameter integration" ULONG COMP_0453 1 100 0 8589934.59 ECU_ADDRESS 0xFFFFB1E0 /begin FUNCTION_LIST KF7-313C.1[36] /end FUNCTION_LIST /end MEASUREMENT
/begin MEASUREMENT vSMLRDIF_R#16 "Lean rich parameter integration" ULONG COMP_0453 1 100 0 8589934.59 ECU_ADDRESS 0xFFFFB1E4 /begin FUNCTION_LIST KF7-313C.1[36] /end FUNCTION_LIST /end MEASUREMENT
/begin MEASUREMENT vSMRLDIF "Rich lean parameter integration" ULONG COMP_0453 1 100 0 8589934.59 ECU_ADDRESS 0xFFFFB1EC /begin FUNCTION_LIST KF7-313C.1[36] /end FUNCTION_LIST /end MEASUREMENT
/begin MEASUREMENT vSMRLDIF_R#1 "Rich lean parameter integration" ULONG COMP_0453 1 100 0 8589934.59 ECU_ADDRESS 0xFFFFB1EC /begin FUNCTION_LIST KF7-313C.1[36] /end FUNCTION_LIST /end MEASUREMENT
/begin MEASUREMENT vSMRLDIF_R#2 "Rich lean parameter integration" ULONG COMP_0453 1 100 0 8589934.59 ECU_ADDRESS 0xFFFFB1F0 /begin FUNCTION_LIST KF7-313C.1[36] /end FUNCTION_LIST /end MEASUREMENT
/begin MEASUREMENT vSMRLDIF_R#3 "Rich lean parameter integration" ULONG COMP_0453 1 100 0 8589934.59 ECU_ADDRESS 0xFFFFB1F4 /begin FUNCTION_LIST KF7-313C.1[36] /end FUNCTION_LIST /end MEASUREMENT
/begin MEASUREMENT vSMRLDIF_R#4 "Rich lean parameter integration" ULONG COMP_0453 1 100 0 8589934.59 ECU_ADDRESS 0xFFFFB1F8 /begin FUNCTION_LIST KF7-313C.1[36] /end FUNCTION_LIST /end MEASUREMENT
/begin MEASUREMENT vSMRLDIF_R#5 "Rich lean parameter integration" ULONG COMP_0453 1 100 0 8589934.59 ECU_ADDRESS 0xFFFFB1FC /begin FUNCTION_LIST KF7-313C.1[36] /end FUNCTION_LIST /end MEASUREMENT
/begin MEASUREMENT vSMRLDIF_R#6 "Rich lean parameter integration" ULONG COMP_0453 1 100 0 8589934.59 ECU_ADDRESS 0xFFFFB200 /begin FUNCTION_LIST KF7-313C.1[36] /end FUNCTION_LIST /end MEASUREMENT
/begin MEASUREMENT vSMRLDIF_R#7 "Rich lean parameter integration" ULONG COMP_0453 1 100 0 8589934.59 ECU_ADDRESS 0xFFFFB204 /begin FUNCTION_LIST KF7-313C.1[36] /end FUNCTION_LIST /end MEASUREMENT
/begin MEASUREMENT vSMRLDIF_R#8 "Rich lean parameter integration" ULONG COMP_0453 1 100 0 8589934.59 ECU_ADDRESS 0xFFFFB208 /begin FUNCTION_LIST KF7-313C.1[36] /end FUNCTION_LIST /end MEASUREMENT
/begin MEASUREMENT vSMRLDIF_R#9 "Rich lean parameter integration" ULONG COMP_0453 1 100 0 8589934.59 ECU_ADDRESS 0xFFFFB20C /begin FUNCTION_LIST KF7-313C.1[36] /end FUNCTION_LIST /end MEASUREMENT
/begin MEASUREMENT vSMRLDIF_R#10 "Rich lean parameter integration" ULONG COMP_0453 1 100 0 8589934.59 ECU_ADDRESS 0xFFFFB210 /begin FUNCTION_LIST KF7-313C.1[36] /end FUNCTION_LIST /end MEASUREMENT
/begin MEASUREMENT vSMRLDIF_R#11 "Rich lean parameter integration" ULONG COMP_0453 1 100 0 8589934.59 ECU_ADDRESS 0xFFFFB214 /begin FUNCTION_LIST KF7-313C.1[36] /end FUNCTION_LIST /end MEASUREMENT
/begin MEASUREMENT vSMRLDIF_R#12 "Rich lean parameter integration" ULONG COMP_0453 1 100 0 8589934.59 ECU_ADDRESS 0xFFFFB218 /begin FUNCTION_LIST KF7-313C.1[36] /end FUNCTION_LIST /end MEASUREMENT
/begin MEASUREMENT vSMRLDIF_R#13 "Rich lean parameter integration" ULONG COMP_0453 1 100 0 8589934.59 ECU_ADDRESS 0xFFFFB21C /begin FUNCTION_LIST KF7-313C.1[36] /end FUNCTION_LIST /end MEASUREMENT
/begin MEASUREMENT vSMRLDIF_R#14 "Rich lean parameter integration" ULONG COMP_0453 1 100 0 8589934.59 ECU_ADDRESS 0xFFFFB220 /begin FUNCTION_LIST KF7-313C.1[36] /end FUNCTION_LIST /end MEASUREMENT
/begin MEASUREMENT vSMRLDIF_R#15 "Rich lean parameter integration" ULONG COMP_0453 1 100 0 8589934.59 ECU_ADDRESS 0xFFFFB224 /begin FUNCTION_LIST KF7-313C.1[36] /end FUNCTION_LIST /end MEASUREMENT
/begin MEASUREMENT vSMRLDIF_R#16 "Rich lean parameter integration" ULONG COMP_0453 1 100 0 8589934.59 ECU_ADDRESS 0xFFFFB228 /begin FUNCTION_LIST KF7-313C.1[36] /end FUNCTION_LIST /end MEASUREMENT
/begin MEASUREMENT vSUMALPA "ALPHA integration value" ULONG COMP_0031 1 100 0 16777215.9960938 ECU_ADDRESS 0xFFFF322C /begin FUNCTION_LIST KF7-313C.1[36] /end FUNCTION_LIST /end MEASUREMENT
/begin MEASUREMENT vSUMALPA_R#1 "ALPHA integration value" ULONG COMP_0031 1 100 0 16777215.9960938 ECU_ADDRESS 0xFFFF322C /begin FUNCTION_LIST KF7-313C.1[36] /end FUNCTION_LIST /end MEASUREMENT
/begin MEASUREMENT vSUMALPA_R#2 "ALPHA integration value" ULONG COMP_0031 1 100 0 16777215.9960938 ECU_ADDRESS 0xFFFF3230 /begin FUNCTION_LIST KF7-313C.1[36] /end FUNCTION_LIST /end MEASUREMENT
/begin MEASUREMENT vTGABFE "Target A/F" UWORD COMP_0453 1 100 0 131.07 ECU_ADDRESS 0xFFFF424C
 /begin FUNCTION_LIST KF7-313C.1[36] KF7-313C.11B[1] KF7-314.1F[1] KF7-371.1E[15] KF7-500.1[54] KF7-500.20B[4] R904.1.Gst_on_can_1_0_1 /end FUNCTION_LIST
/end MEASUREMENT
/begin MEASUREMENT vTGABFE_R#1 "Target A/F" UWORD COMP_0453 1 100 0 131.07 ECU_ADDRESS 0xFFFF424C
 /begin FUNCTION_LIST KF7-313C.1[36] KF7-313C.11B[1] KF7-314.1F[1] KF7-371.1E[15] KF7-500.1[54] KF7-500.20B[4] R904.1.Gst_on_can_1_0_1 /end FUNCTION_LIST
/end MEASUREMENT
/begin MEASUREMENT vTGABFE_R#2 "Target A/F" UWORD COMP_0453 1 100 0 131.07 ECU_ADDRESS 0xFFFF424E
 /begin FUNCTION_LIST KF7-313C.1[36] KF7-313C.11B[1] KF7-314.1F[1] KF7-371.1E[15] KF7-500.1[54] KF7-500.20B[4] R904.1.Gst_on_can_1_0_1 /end FUNCTION_LIST
/end MEASUREMENT
/begin MEASUREMENT vTGAFTMP "At the time of the start, the amount of target A/F shift" ULONG COMP_0490_S 1 100 0 2097.15092576989 ECU_ADDRESS 0xFFFF3300 /begin FUNCTION_LIST KF7-313C.1[36] /end FUNCTION_LIST /end MEASUREMENT
/begin MEASUREMENT vTGPPART "Target A/F P-gain" SWORD COMP_0632_S 1 100 -1.99999488 1.999933845 ECU_ADDRESS 0xFFFF3306 /begin FUNCTION_LIST KF7-313C.1[36] /end FUNCTION_LIST /end MEASUREMENT
/begin MEASUREMENT vTGPPART_R#1 "Target A/F P-gain" SWORD COMP_0632_S 1 100 -1.99999488 1.999933845 ECU_ADDRESS 0xFFFF3306 /begin FUNCTION_LIST KF7-313C.1[36] /end FUNCTION_LIST /end MEASUREMENT
/begin MEASUREMENT vTGPPART_R#2 "Target A/F P-gain" SWORD COMP_0632_S 1 100 -1.99999488 1.999933845 ECU_ADDRESS 0xFFFF3308 /begin FUNCTION_LIST KF7-313C.1[36] /end FUNCTION_LIST /end MEASUREMENT
/begin MEASUREMENT vTGX1 "Condition variable X1 target value" SWORD COMP_0633_S 1 100 -1966.08 1966.02 ECU_ADDRESS 0xFFFF1928 /begin FUNCTION_LIST KF7-313C.1[36] /end FUNCTION_LIST /end MEASUREMENT
/begin MEASUREMENT vTGX1_R#1 "Condition variable X1 target value" SWORD COMP_0633_S 1 100 -1966.08 1966.02 ECU_ADDRESS 0xFFFF1928 /begin FUNCTION_LIST KF7-313C.1[36] /end FUNCTION_LIST /end MEASUREMENT
/begin MEASUREMENT vTGX1_R#2 "Condition variable X1 target value" SWORD COMP_0633_S 1 100 -1966.08 1966.02 ECU_ADDRESS 0xFFFF192A /begin FUNCTION_LIST KF7-313C.1[36] /end FUNCTION_LIST /end MEASUREMENT
/begin MEASUREMENT vTLRCNT "Lean rich diagnosis number of times counter" UBYTE COMP_0016 1 100 0 255 ECU_ADDRESS 0xFFFF3337 /begin FUNCTION_LIST KF7-313C.1[36] /end FUNCTION_LIST /end MEASUREMENT
/begin MEASUREMENT vTLRCNT_R#1 "Lean rich diagnosis number of times counter" UBYTE COMP_0016 1 100 0 255 ECU_ADDRESS 0xFFFF3337 /begin FUNCTION_LIST KF7-313C.1[36] /end FUNCTION_LIST /end MEASUREMENT
/begin MEASUREMENT vTLRCNT_R#2 "Lean rich diagnosis number of times counter" UBYTE COMP_0016 1 100 0 255 ECU_ADDRESS 0xFFFF3338 /begin FUNCTION_LIST KF7-313C.1[36] /end FUNCTION_LIST /end MEASUREMENT
/begin MEASUREMENT vTRLCNT "Rich lean diagnosis number of times counter" UBYTE COMP_0016 1 100 0 255 ECU_ADDRESS 0xFFFF33C0 /begin FUNCTION_LIST KF7-313C.1[36] /end FUNCTION_LIST /end MEASUREMENT
/begin MEASUREMENT vTRLCNT_R#1 "Rich lean diagnosis number of times counter" UBYTE COMP_0016 1 100 0 255 ECU_ADDRESS 0xFFFF33C0 /begin FUNCTION_LIST KF7-313C.1[36] /end FUNCTION_LIST /end MEASUREMENT
/begin MEASUREMENT vTRLCNT_R#2 "Rich lean diagnosis number of times counter" UBYTE COMP_0016 1 100 0 255 ECU_ADDRESS 0xFFFF33C1 /begin FUNCTION_LIST KF7-313C.1[36] /end FUNCTION_LIST /end MEASUREMENT
/begin MEASUREMENT vUEQ "Equivalent input of control" SWORD COMP_0641_S 1 100 -26.2144 26.2136 ECU_ADDRESS 0xFFFF1A48 /begin FUNCTION_LIST KF7-313C.1[36] /end FUNCTION_LIST /end MEASUREMENT
/begin MEASUREMENT vUEQ_R#1 "Equivalent input of control" SWORD COMP_0641_S 1 100 -26.2144 26.2136 ECU_ADDRESS 0xFFFF1A48 /begin FUNCTION_LIST KF7-313C.1[36] /end FUNCTION_LIST /end MEASUREMENT
/begin MEASUREMENT vUEQ_R#2 "Equivalent input of control" SWORD COMP_0641_S 1 100 -26.2144 26.2136 ECU_ADDRESS 0xFFFF1A4A /begin FUNCTION_LIST KF7-313C.1[36] /end FUNCTION_LIST /end MEASUREMENT
/begin MEASUREMENT vULINEAR "Input of line shape" SLONG COMP_0642_S 1 100 -21474.83648 21474.83647 ECU_ADDRESS 0xFFFF1A4C /begin FUNCTION_LIST KF7-313C.1[36] /end FUNCTION_LIST /end MEASUREMENT
/begin MEASUREMENT vULINEAR_R#1 "Input of line shape" SLONG COMP_0642_S 1 100 -21474.83648 21474.83647 ECU_ADDRESS 0xFFFF1A4C /begin FUNCTION_LIST KF7-313C.1[36] /end FUNCTION_LIST /end MEASUREMENT
/begin MEASUREMENT vULINEAR_R#2 "Input of line shape" SLONG COMP_0642_S 1 100 -21474.83648 21474.83647 ECU_ADDRESS 0xFFFF1A50 /begin FUNCTION_LIST KF7-313C.1[36] /end FUNCTION_LIST /end MEASUREMENT
/begin MEASUREMENT vUNONLIN "Input of non-line shape" SWORD COMP_0341_S 1 100 -65.536 65.534 ECU_ADDRESS 0xFFFF1A56 /begin FUNCTION_LIST KF7-313C.1[36] /end FUNCTION_LIST /end MEASUREMENT
/begin MEASUREMENT vUNONLIN_R#1 "Input of non-line shape" SWORD COMP_0341_S 1 100 -65.536 65.534 ECU_ADDRESS 0xFFFF1A56 /begin FUNCTION_LIST KF7-313C.1[36] /end FUNCTION_LIST /end MEASUREMENT
/begin MEASUREMENT vUNONLIN_R#2 "Input of non-line shape" SWORD COMP_0341_S 1 100 -65.536 65.534 ECU_ADDRESS 0xFFFF1A58 /begin FUNCTION_LIST KF7-313C.1[36] /end FUNCTION_LIST /end MEASUREMENT
/begin MEASUREMENT vUSL "The amount of ÉXÉâÉCÉfÉBÉìÉOÉÇÅ[Éh operation" SWORD COMP_0341_S 1 100 -65.536 65.534 ECU_ADDRESS 0xFFFF1A5A /begin FUNCTION_LIST KF7-313C.1[36] /end FUNCTION_LIST /end MEASUREMENT
/begin MEASUREMENT vUSL_R#1 "The amount of ÉXÉâÉCÉfÉBÉìÉOÉÇÅ[Éh operation" SWORD COMP_0341_S 1 100 -65.536 65.534 ECU_ADDRESS 0xFFFF1A5A /begin FUNCTION_LIST KF7-313C.1[36] /end FUNCTION_LIST /end MEASUREMENT
/begin MEASUREMENT vUSL_R#2 "The amount of ÉXÉâÉCÉfÉBÉìÉOÉÇÅ[Éh operation" SWORD COMP_0341_S 1 100 -65.536 65.534 ECU_ADDRESS 0xFFFF1A5C /begin FUNCTION_LIST KF7-313C.1[36] /end FUNCTION_LIST /end MEASUREMENT
/begin MEASUREMENT vX1 "Condition variable X1" SWORD COMP_0633_S 1 100 -1966.08 1966.02 ECU_ADDRESS 0xFFFF1C10 /begin FUNCTION_LIST KF7-313C.1[36] /end FUNCTION_LIST /end MEASUREMENT
/begin MEASUREMENT vX1_R#1 "Condition variable X1" SWORD COMP_0633_S 1 100 -1966.08 1966.02 ECU_ADDRESS 0xFFFF1C10 /begin FUNCTION_LIST KF7-313C.1[36] /end FUNCTION_LIST /end MEASUREMENT
/begin MEASUREMENT vX1_R#2 "Condition variable X1" SWORD COMP_0633_S 1 100 -1966.08 1966.02 ECU_ADDRESS 0xFFFF1C12 /begin FUNCTION_LIST KF7-313C.1[36] /end FUNCTION_LIST /end MEASUREMENT
/begin MEASUREMENT vX1HAT "Condition variable X1 estimated value" SWORD COMP_0633_S 1 100 -1966.08 1966.02 ECU_ADDRESS 0xFFFF1C14 /begin FUNCTION_LIST KF7-313C.1[36] /end FUNCTION_LIST /end MEASUREMENT
/begin MEASUREMENT vX1HAT_R#1 "Condition variable X1 estimated value" SWORD COMP_0633_S 1 100 -1966.08 1966.02 ECU_ADDRESS 0xFFFF1C14 /begin FUNCTION_LIST KF7-313C.1[36] /end FUNCTION_LIST /end MEASUREMENT
/begin MEASUREMENT vX1HAT_R#2 "Condition variable X1 estimated value" SWORD COMP_0633_S 1 100 -1966.08 1966.02 ECU_ADDRESS 0xFFFF1C16 /begin FUNCTION_LIST KF7-313C.1[36] /end FUNCTION_LIST /end MEASUREMENT
/begin MEASUREMENT vX2 "Condition variable X2" SWORD COMP_0633_S 1 100 -1966.08 1966.02 ECU_ADDRESS 0xFFFF1C18 /begin FUNCTION_LIST KF7-313C.1[36] /end FUNCTION_LIST /end MEASUREMENT
/begin MEASUREMENT vX2_R#1 "Condition variable X2" SWORD COMP_0633_S 1 100 -1966.08 1966.02 ECU_ADDRESS 0xFFFF1C18 /begin FUNCTION_LIST KF7-313C.1[36] /end FUNCTION_LIST /end MEASUREMENT
/begin MEASUREMENT vX2_R#2 "Condition variable X2" SWORD COMP_0633_S 1 100 -1966.08 1966.02 ECU_ADDRESS 0xFFFF1C1A /begin FUNCTION_LIST KF7-313C.1[36] /end FUNCTION_LIST /end MEASUREMENT
/begin MEASUREMENT vX2HAT "Condition variable X2 estimated value" SWORD COMP_0633_S 1 100 -1966.08 1966.02 ECU_ADDRESS 0xFFFF1C1C /begin FUNCTION_LIST KF7-313C.1[36] /end FUNCTION_LIST /end MEASUREMENT
/begin MEASUREMENT vX2HAT_R#1 "Condition variable X2 estimated value" SWORD COMP_0633_S 1 100 -1966.08 1966.02 ECU_ADDRESS 0xFFFF1C1C /begin FUNCTION_LIST KF7-313C.1[36] /end FUNCTION_LIST /end MEASUREMENT
/begin MEASUREMENT vX2HAT_R#2 "Condition variable X2 estimated value" SWORD COMP_0633_S 1 100 -1966.08 1966.02 ECU_ADDRESS 0xFFFF1C1E /begin FUNCTION_LIST KF7-313C.1[36] /end FUNCTION_LIST /end MEASUREMENT
/begin MEASUREMENT vY "The amount of canister adsorption" UWORD COMP_0656_S 1 100 0 255.97971 ECU_ADDRESS 0xFFFF34D6
 /begin FUNCTION_LIST KF7-313C.1[36] KF7-313C.11B[1] KF7-371.1E[15] KF7-377.1A[19] KF7-500.26[17] KF7-580.1[8] /end FUNCTION_LIST
/end MEASUREMENT
/begin MEASUREMENT vYUKAO2 "The amount of the bottom O2 storage of the floor" SLONG COMP_0263 1 100 -2147483648 2147483647 ECU_ADDRESS 0xFFFF34D8 /begin FUNCTION_LIST KF7-313C.1[36] /end FUNCTION_LIST /end MEASUREMENT
/begin MEASUREMENT vYUKAO2_R#1 "The amount of the bottom O2 storage of the floor" SLONG COMP_0263 1 100 -2147483648 2147483647 ECU_ADDRESS 0xFFFF34D8 /begin FUNCTION_LIST KF7-313C.1[36] /end FUNCTION_LIST /end MEASUREMENT
/begin MEASUREMENT vYUKAO2_R#2 "The amount of the bottom O2 storage of the floor" SLONG COMP_0263 1 100 -2147483648 2147483647 ECU_ADDRESS 0xFFFF34DC /begin FUNCTION_LIST KF7-313C.1[36] /end FUNCTION_LIST /end MEASUREMENT
/begin MEASUREMENT vfASHLGOE "A/F sensor shift learning permission flag (0: prohibition 1: permission)" UBYTE COMP_0283 1 100 0 255 ECU_ADDRESS 0xFFFF2CF4 /begin FUNCTION_LIST KF7-313C.1[36] /end FUNCTION_LIST /end MEASUREMENT
/begin MEASUREMENT vfASHLGOE_R#1 "A/F sensor shift learning permission flag (0: prohibition 1: permission)" UBYTE COMP_0283 1 100 0 255 ECU_ADDRESS 0xFFFF2CF4 /begin FUNCTION_LIST KF7-313C.1[36] /end FUNCTION_LIST /end MEASUREMENT
/begin MEASUREMENT vfASHLGOE_R#2 "A/F sensor shift learning permission flag (0: prohibition 1: permission)" UBYTE COMP_0283 1 100 0 255 ECU_ADDRESS 0xFFFF2CF5 /begin FUNCTION_LIST KF7-313C.1[36] /end FUNCTION_LIST /end MEASUREMENT
/begin MEASUREMENT vfCNTSTL "Lean rich diagnosis monitor trigger flag" UBYTE COMP_0068 1 100 0 255 ECU_ADDRESS 0xFFFF2D28 /begin FUNCTION_LIST KF7-313C.1[36] /end FUNCTION_LIST /end MEASUREMENT
/begin MEASUREMENT vfCNTSTL_R#1 "Lean rich diagnosis monitor trigger flag" UBYTE COMP_0068 1 100 0 255 ECU_ADDRESS 0xFFFF2D28 /begin FUNCTION_LIST KF7-313C.1[36] /end FUNCTION_LIST /end MEASUREMENT
/begin MEASUREMENT vfCNTSTL_R#2 "Lean rich diagnosis monitor trigger flag" UBYTE COMP_0068 1 100 0 255 ECU_ADDRESS 0xFFFF2D29 /begin FUNCTION_LIST KF7-313C.1[36] /end FUNCTION_LIST /end MEASUREMENT
/begin MEASUREMENT vfCNTSTR "Rich lean diagnosis monitor trigger flag" UBYTE COMP_0068 1 100 0 255 ECU_ADDRESS 0xFFFF2D2A /begin FUNCTION_LIST KF7-313C.1[36] /end FUNCTION_LIST /end MEASUREMENT
/begin MEASUREMENT vfCNTSTR_R#1 "Rich lean diagnosis monitor trigger flag" UBYTE COMP_0068 1 100 0 255 ECU_ADDRESS 0xFFFF2D2A /begin FUNCTION_LIST KF7-313C.1[36] /end FUNCTION_LIST /end MEASUREMENT
/begin MEASUREMENT vfCNTSTR_R#2 "Rich lean diagnosis monitor trigger flag" UBYTE COMP_0068 1 100 0 255 ECU_ADDRESS 0xFFFF2D2B /begin FUNCTION_LIST KF7-313C.1[36] /end FUNCTION_LIST /end MEASUREMENT
/begin MEASUREMENT vfDGNGRD "Gradual clamp" UBYTE COMP_0068 1 100 0 255 ECU_ADDRESS 0xFFFF2D34 /begin FUNCTION_LIST KF7-313C.1[36] /end FUNCTION_LIST /end MEASUREMENT
/begin MEASUREMENT vfDGNGRD_R#1 "Gradual clamp" UBYTE COMP_0068 1 100 0 255 ECU_ADDRESS 0xFFFF2D34 /begin FUNCTION_LIST KF7-313C.1[36] /end FUNCTION_LIST /end MEASUREMENT
/begin MEASUREMENT vfDGNGRD_R#2 "Gradual clamp" UBYTE COMP_0068 1 100 0 255 ECU_ADDRESS 0xFFFF2D35 /begin FUNCTION_LIST KF7-313C.1[36] /end FUNCTION_LIST /end MEASUREMENT
/begin MEASUREMENT vfDGNIMD "As soon as possible, clamp" UBYTE COMP_0068 1 100 0 255 ECU_ADDRESS 0xFFFF2D36 /begin FUNCTION_LIST KF7-313C.1[36] KF7-580.1[8] /end FUNCTION_LIST /end MEASUREMENT
/begin MEASUREMENT vfDGNIMD_R#1 "As soon as possible, clamp" UBYTE COMP_0068 1 100 0 255 ECU_ADDRESS 0xFFFF2D36 /begin FUNCTION_LIST KF7-313C.1[36] KF7-580.1[8] /end FUNCTION_LIST /end MEASUREMENT
/begin MEASUREMENT vfDGNIMD_R#2 "As soon as possible, clamp" UBYTE COMP_0068 1 100 0 255 ECU_ADDRESS 0xFFFF2D37 /begin FUNCTION_LIST KF7-313C.1[36] KF7-580.1[8] /end FUNCTION_LIST /end MEASUREMENT
/begin MEASUREMENT vfDLREND "Lean rich diagnosis completion flag" UBYTE COMP_0068 1 100 0 255 ECU_ADDRESS 0xFFFF2D38 /begin FUNCTION_LIST KF7-313C.1[36] /end FUNCTION_LIST /end MEASUREMENT
/begin MEASUREMENT vfDLREND_R#1 "Lean rich diagnosis completion flag" UBYTE COMP_0068 1 100 0 255 ECU_ADDRESS 0xFFFF2D38 /begin FUNCTION_LIST KF7-313C.1[36] /end FUNCTION_LIST /end MEASUREMENT
/begin MEASUREMENT vfDLREND_R#2 "Lean rich diagnosis completion flag" UBYTE COMP_0068 1 100 0 255 ECU_ADDRESS 0xFFFF2D39 /begin FUNCTION_LIST KF7-313C.1[36] /end FUNCTION_LIST /end MEASUREMENT
/begin MEASUREMENT vfDRLEND "Rich lean diagnosis completion flag" UBYTE COMP_0068 1 100 0 255 ECU_ADDRESS 0xFFFF2D3E /begin FUNCTION_LIST KF7-313C.1[36] /end FUNCTION_LIST /end MEASUREMENT
/begin MEASUREMENT vfDRLEND_R#1 "Rich lean diagnosis completion flag" UBYTE COMP_0068 1 100 0 255 ECU_ADDRESS 0xFFFF2D3E /begin FUNCTION_LIST KF7-313C.1[36] /end FUNCTION_LIST /end MEASUREMENT
/begin MEASUREMENT vfDRLEND_R#2 "Rich lean diagnosis completion flag" UBYTE COMP_0068 1 100 0 255 ECU_ADDRESS 0xFFFF2D3F /begin FUNCTION_LIST KF7-313C.1[36] /end FUNCTION_LIST /end MEASUREMENT
/begin MEASUREMENT vfLMDCLPE "Lambda control open close judgement flag (the rest O2 sensor feedback in the CLOSED LOOP control prohibition condition is ignored.)" UBYTE COMP_0283 1 100 0 255 ECU_ADDRESS 0xFFFF2D72 /begin FUNCTION_LIST KF7-313C.1[36] /end FUNCTION_LIST /end MEASUREMENT
/begin MEASUREMENT vfLMDCLPE_R#1 "Lambda control open close judgement flag (the rest O2 sensor feedback in the CLOSED LOOP control prohibition condition is ignored.)" UBYTE COMP_0283 1 100 0 255 ECU_ADDRESS 0xFFFF2D72 /begin FUNCTION_LIST KF7-313C.1[36] /end FUNCTION_LIST /end MEASUREMENT
/begin MEASUREMENT vfLMDCLPE_R#2 "Lambda control open close judgement flag (the rest O2 sensor feedback in the CLOSED LOOP control prohibition condition is ignored.)" UBYTE COMP_0283 1 100 0 255 ECU_ADDRESS 0xFFFF2D73 /begin FUNCTION_LIST KF7-313C.1[36] /end FUNCTION_LIST /end MEASUREMENT
/begin MEASUREMENT vfLRDNG "Lean rich diagnosis NG flag" UBYTE COMP_0068 1 100 0 255 ECU_ADDRESS 0xFFFF2D76 /begin FUNCTION_LIST KF7-313C.1[36] /end FUNCTION_LIST /end MEASUREMENT
/begin MEASUREMENT vfLRDNG_R#1 "Lean rich diagnosis NG flag" UBYTE COMP_0068 1 100 0 255 ECU_ADDRESS 0xFFFF2D76 /begin FUNCTION_LIST KF7-313C.1[36] /end FUNCTION_LIST /end MEASUREMENT
/begin MEASUREMENT vfLRDNG_R#2 "Lean rich diagnosis NG flag" UBYTE COMP_0068 1 100 0 255 ECU_ADDRESS 0xFFFF2D77 /begin FUNCTION_LIST KF7-313C.1[36] /end FUNCTION_LIST /end MEASUREMENT
/begin MEASUREMENT vfLRDOK "Lean rich diagnosis OK flag" UBYTE COMP_0068 1 100 0 255 ECU_ADDRESS 0xFFFF2D78 /begin FUNCTION_LIST KF7-313C.1[36] /end FUNCTION_LIST /end MEASUREMENT
/begin MEASUREMENT vfLRDOK_R#1 "Lean rich diagnosis OK flag" UBYTE COMP_0068 1 100 0 255 ECU_ADDRESS 0xFFFF2D78 /begin FUNCTION_LIST KF7-313C.1[36] /end FUNCTION_LIST /end MEASUREMENT
/begin MEASUREMENT vfLRDOK_R#2 "Lean rich diagnosis OK flag" UBYTE COMP_0068 1 100 0 255 ECU_ADDRESS 0xFFFF2D79 /begin FUNCTION_LIST KF7-313C.1[36] /end FUNCTION_LIST /end MEASUREMENT
/begin MEASUREMENT vfOOFPT "Diagnosis complete flag" UBYTE COMP_0068 1 100 0 255 ECU_ADDRESS 0xFFFF2D96 /begin FUNCTION_LIST KF7-313C.1[36] /end FUNCTION_LIST /end MEASUREMENT
/begin MEASUREMENT vfOOFPT_R#1 "Diagnosis complete flag" UBYTE COMP_0068 1 100 0 255 ECU_ADDRESS 0xFFFF2D96 /begin FUNCTION_LIST KF7-313C.1[36] /end FUNCTION_LIST /end MEASUREMENT
/begin MEASUREMENT vfOOFPT_R#2 "Diagnosis complete flag" UBYTE COMP_0068 1 100 0 255 ECU_ADDRESS 0xFFFF2D97 /begin FUNCTION_LIST KF7-313C.1[36] /end FUNCTION_LIST /end MEASUREMENT
/begin MEASUREMENT vfRLDNG "Rich lean diagnosis NG flag" UBYTE COMP_0068 1 100 0 255 ECU_ADDRESS 0xFFFF2DA7 /begin FUNCTION_LIST KF7-313C.1[36] /end FUNCTION_LIST /end MEASUREMENT
/begin MEASUREMENT vfRLDNG_R#1 "Rich lean diagnosis NG flag" UBYTE COMP_0068 1 100 0 255 ECU_ADDRESS 0xFFFF2DA7 /begin FUNCTION_LIST KF7-313C.1[36] /end FUNCTION_LIST /end MEASUREMENT
/begin MEASUREMENT vfRLDNG_R#2 "Rich lean diagnosis NG flag" UBYTE COMP_0068 1 100 0 255 ECU_ADDRESS 0xFFFF2DA8 /begin FUNCTION_LIST KF7-313C.1[36] /end FUNCTION_LIST /end MEASUREMENT
/begin MEASUREMENT vfRLDOK "Rich lean diagnosis OK flag" UBYTE COMP_0068 1 100 0 255 ECU_ADDRESS 0xFFFF2DA9 /begin FUNCTION_LIST KF7-313C.1[36] /end FUNCTION_LIST /end MEASUREMENT
/begin MEASUREMENT vfRLDOK_R#1 "Rich lean diagnosis OK flag" UBYTE COMP_0068 1 100 0 255 ECU_ADDRESS 0xFFFF2DA9 /begin FUNCTION_LIST KF7-313C.1[36] /end FUNCTION_LIST /end MEASUREMENT
/begin MEASUREMENT vfRLDOK_R#2 "Rich lean diagnosis OK flag" UBYTE COMP_0068 1 100 0 255 ECU_ADDRESS 0xFFFF2DAA /begin FUNCTION_LIST KF7-313C.1[36] /end FUNCTION_LIST /end MEASUREMENT
/begin MEASUREMENT vfRO2FBCLP "RAM value vfRO2FBCLP" UBYTE COMP_0068 1 100 0 255 ECU_ADDRESS 0xFFFF2DAD /begin FUNCTION_LIST KF7-313C.1[36] KF7-313C.4[3] KF7-313C.5[3] /end FUNCTION_LIST /end MEASUREMENT
/begin MEASUREMENT vtAFEDLY "Completion tense movement time" UWORD COMP_0165_S 1 100 0 655.35 ECU_ADDRESS 0xFFFF32AC /begin FUNCTION_LIST KF7-313C.1[36] /end FUNCTION_LIST /end MEASUREMENT
/begin MEASUREMENT vtAFEDLY_R#1 "Completion tense movement time" UWORD COMP_0165_S 1 100 0 655.35 ECU_ADDRESS 0xFFFF32AC /begin FUNCTION_LIST KF7-313C.1[36] /end FUNCTION_LIST /end MEASUREMENT
/begin MEASUREMENT vtAFEDLY_R#2 "Completion tense movement time" UWORD COMP_0165_S 1 100 0 655.35 ECU_ADDRESS 0xFFFF32AE /begin FUNCTION_LIST KF7-313C.1[36] /end FUNCTION_LIST /end MEASUREMENT
/begin MEASUREMENT vtCALPDLY "Reference A/F convergent time" UWORD COMP_0165_S 1 100 0 655.35 ECU_ADDRESS 0xFFFF32BC /begin FUNCTION_LIST KF7-313C.1[36] /end FUNCTION_LIST /end MEASUREMENT
/begin COMPU_METHOD COMP_0068 "1-" RAT_FUNC "%8.2" "-" COEFFS 0 1 0 0 0 1 /end COMPU_METHOD
/begin COMPU_METHOD COMP_0004 "1Å|" RAT_FUNC "%8.2" "Å|" COEFFS 0 1 0 0 0 1 /end COMPU_METHOD
/begin COMPU_METHOD COMP_0061 "5mv" RAT_FUNC "%8.2" "mv" COEFFS 0 1 0 0 0 5 /end COMPU_METHOD
/begin COMPU_METHOD COMP_0023 "5mV" RAT_FUNC "%8.2" "mV" COEFFS 0 1 0 0 0 5 /end COMPU_METHOD
/begin COMPU_METHOD COMP_0045 "1/128-" RAT_FUNC "%8.4" "-" COEFFS 0 1 0 0 0 0.0078125 /end COMPU_METHOD
/begin COMPU_METHOD COMP_0336_S "0.0001-" RAT_FUNC "%8.5" "-" COEFFS 0 1 0 0 0 0.0001 /end COMPU_METHOD
/begin COMPU_METHOD COMP_0453 "0.002-" RAT_FUNC "%8.4" "-" COEFFS 0 1 0 0 0 0.002 /end COMPU_METHOD
/begin COMPU_METHOD COMP_0014 "10ms" RAT_FUNC "%8.2" "ms" COEFFS 0 1 0 0 0 10 /end COMPU_METHOD
/begin COMPU_METHOD COMP_0006 "12.5rpm" RAT_FUNC "%8.2" "rpm" COEFFS 0 1 0 0 0 12.5 /end COMPU_METHOD
/begin COMPU_METHOD COMP_0008 "100ms" RAT_FUNC "%8.2" "ms" COEFFS 0 1 0 0 0 100 /end COMPU_METHOD
/begin COMPU_METHOD COMP_0165_S "secsec" RAT_FUNC "%8.3" "sec" COEFFS 0 1 0 0 0 0.01 /end COMPU_METHOD
/begin COMPU_METHOD COMP_0093 "2.5mV" RAT_FUNC "%8.2" "mV" COEFFS 0 1 0 0 0 2.5 /end COMPU_METHOD
/begin COMPU_METHOD COMP_0030 "1âÒ" RAT_FUNC "%8.2" "âÒ" COEFFS 0 1 0 0 0 1 /end COMPU_METHOD
/begin COMPU_METHOD COMP_0341_S "0.002-" RAT_FUNC "%8.4" "-" COEFFS 0 1 0 0 0 0.002 /end COMPU_METHOD
/begin COMPU_METHOD COMP_0031 "1/256%" RAT_FUNC "%8.4" "%" COEFFS 0 1 0 0 0 0.00390625 /end COMPU_METHOD
/begin COMPU_METHOD COMP_0048 "64/128degCA" RAT_FUNC "%8.2" "degCA" COEFFS 0 1 0 0 0 0.5 /end COMPU_METHOD
/begin COMPU_METHOD COMP_0016 "1count" RAT_FUNC "%8.2" "count" COEFFS 0 1 0 0 0 1 /end COMPU_METHOD
/begin COMPU_METHOD COMP_0050 "5/64mV" RAT_FUNC "%8.3" "mV" COEFFS 0 1 0 0 0 0.078125 /end COMPU_METHOD
/begin COMPU_METHOD COMP_0035 "X-50Åé" RAT_FUNC "%8.2" "Åé" COEFFS 0 1 50 0 0 1 /end COMPU_METHOD
/begin COMPU_METHOD COMP_0256 "64/128degCA" RAT_FUNC "%8.2" "degCA" COEFFS 0 1 64 0 0 0.5 /end COMPU_METHOD
/begin COMPU_METHOD COMP_0094_S "mgmg" RAT_FUNC "%8.3" "mg" COEFFS 0 1 0 0 0 0.01 /end COMPU_METHOD
/begin COMPU_METHOD COMP_0220 "1l/min" RAT_FUNC "%8.2" "l/min" COEFFS 0 1 0 0 0 1 /end COMPU_METHOD
/begin COMPU_METHOD COMP_0263 "1-" RAT_FUNC "%8.2" "-" COEFFS 0 1 0 0 0 1 /end COMPU_METHOD
/begin COMPU_METHOD COMP_0388 "0.1-" RAT_FUNC "%8.2" "-" COEFFS 0 1 0 0 0 0.1 /end COMPU_METHOD
/begin COMPU_METHOD COMP_0490_S "0.002/4096-" RAT_FUNC "%8.6" "-" COEFFS 0 1 0 0 0 0.000000488281 /end COMPU_METHOD
/begin COMPU_METHOD COMP_0283 "1flag" RAT_FUNC "%8.2" "flag" COEFFS 0 1 0 0 0 1 /end COMPU_METHOD
/begin COMPU_METHOD COMP_0569_S "*10ms*10ms" RAT_FUNC "%8.2" "*10ms" COEFFS 0 1 0 0 0 1 /end COMPU_METHOD
/begin COMPU_METHOD COMP_0593_S "ms/cylms/cyl" RAT_FUNC "%8.5" "ms/cyl" COEFFS 0 1 0 0 0 0.000488281 /end COMPU_METHOD
/begin COMPU_METHOD COMP_0611_S "mg/10msmg/10ms" RAT_FUNC "%8.3" "mg/10ms" COEFFS 0 1 0 0 0 0.01 /end COMPU_METHOD
/begin COMPU_METHOD COMP_0624_S "--" RAT_FUNC "%8.6" "-" COEFFS 0 1 0 0 0 0.000000477 /end COMPU_METHOD
/begin COMPU_METHOD COMP_0625_S "--" RAT_FUNC "%8.6" "-" COEFFS 0 1 0 0 0 0.000015258 /end COMPU_METHOD
/begin COMPU_METHOD COMP_0632_S "--" RAT_FUNC "%8.6" "-" COEFFS 0 1 0 0 0 0.000061035 /end COMPU_METHOD
/begin COMPU_METHOD COMP_0633_S "--" RAT_FUNC "%8.3" "-" COEFFS 0 1 0 0 0 0.06 /end COMPU_METHOD
/begin COMPU_METHOD COMP_0641_S "--" RAT_FUNC "%8.5" "-" COEFFS 0 1 0 0 0 0.0008 /end COMPU_METHOD
/begin COMPU_METHOD COMP_0642_S "--" RAT_FUNC "%8.6" "-" COEFFS 0 1 0 0 0 0.00001 /end COMPU_METHOD
/begin COMPU_METHOD COMP_0656_S "gg" RAT_FUNC "%8.4" "g" COEFFS 0 1 0 0 0 0.003906 /end COMPU_METHOD
/end MODULE
/end PROJECT
