ASAP2_VERSION 1 3_BETA
/begin PROJECT TK_X91_EUR_VC ""
/begin HEADER "" /* key HEADER ++ "comment" Ç… Par.scomment */ PROJECT_NO TK_X91_EUR_VC /* key PROJECT_NO ++ project number Ç… car_eng_desti_lot */ VERSION "7V4YHZEB2" /* key VERSION ++ version number Ç… mProgver */ /end HEADER
/begin MODULE DIM ""
/begin MOD_COMMON "" DEPOSIT ABSOLUTE BYTE_ORDER MSB_FIRST /* ﬁ≤ƒµ∞¿ﬁ∞Ç™ÿÃﬂ⁄∞ΩÇ≥ÇÍÇÈ */ /end MOD_COMMON
/begin MEASUREMENT vTTETBL2_R#4 "After the change rate limiter treatment for the common FAST torque going down, target torque storage RAM" SWORD COMP_0228 1 100 -3276.8 3276.7 ECU_ADDRESS 0xFFFF1A22 /begin FUNCTION_LIST /end FUNCTION_LIST /end MEASUREMENT
/begin MEASUREMENT vTTETBL2_R#5 "After the change rate limiter treatment for the common FAST torque going down, target torque storage RAM" SWORD COMP_0228 1 100 -3276.8 3276.7 ECU_ADDRESS 0xFFFF1A24 /begin FUNCTION_LIST /end FUNCTION_LIST /end MEASUREMENT
/begin MEASUREMENT vTTETBL2_R#6 "After the change rate limiter treatment for the common FAST torque going down, target torque storage RAM" SWORD COMP_0228 1 100 -3276.8 3276.7 ECU_ADDRESS 0xFFFF1A26 /begin FUNCTION_LIST /end FUNCTION_LIST /end MEASUREMENT
/begin MEASUREMENT vTTETBL2_R#7 "After the change rate limiter treatment for the common FAST torque going down, target torque storage RAM" SWORD COMP_0228 1 100 -3276.8 3276.7 ECU_ADDRESS 0xFFFF1A28 /begin FUNCTION_LIST /end FUNCTION_LIST /end MEASUREMENT
/begin MEASUREMENT vTTETBL2_R#8 "After the change rate limiter treatment for the common FAST torque going down, target torque storage RAM" SWORD COMP_0228 1 100 -3276.8 3276.7 ECU_ADDRESS 0xFFFF1A2A /begin FUNCTION_LIST /end FUNCTION_LIST /end MEASUREMENT
/begin MEASUREMENT vTTETBL2_R#9 "After the change rate limiter treatment for the common FAST torque going down, target torque storage RAM" SWORD COMP_0228 1 100 -3276.8 3276.7 ECU_ADDRESS 0xFFFF1A2C /begin FUNCTION_LIST /end FUNCTION_LIST /end MEASUREMENT
/begin MEASUREMENT vTTETBL2_R#10 "After the change rate limiter treatment for the common FAST torque going down, target torque storage RAM" SWORD COMP_0228 1 100 -3276.8 3276.7 ECU_ADDRESS 0xFFFF1A2E /begin FUNCTION_LIST /end FUNCTION_LIST /end MEASUREMENT
/begin MEASUREMENT vTTETX "After the accelerator full-close position equivalent torque limiter treatment, target torque" SWORD COMP_0228 1 100 -3276.8 3276.7 ECU_ADDRESS 0xFFFF1A30 /begin FUNCTION_LIST /end FUNCTION_LIST /end MEASUREMENT
/begin MEASUREMENT vTTETX0 "Target engine torque" SWORD COMP_0228 1 100 -3276.8 3276.7 ECU_ADDRESS 0xFFFF1A32 /begin FUNCTION_LIST /end FUNCTION_LIST /end MEASUREMENT
/begin MEASUREMENT vTTETX1 "After the change rate limiter treatment, target torque" SWORD COMP_0228 1 100 -3276.8 3276.7 ECU_ADDRESS 0xFFFF1A34 /begin FUNCTION_LIST /end FUNCTION_LIST /end MEASUREMENT
/begin MEASUREMENT vTTETXD "After it deals with slow-response delay, target torque" SWORD COMP_0228 1 100 -3276.8 3276.7 ECU_ADDRESS 0xFFFF1A36 /begin FUNCTION_LIST /end FUNCTION_LIST /end MEASUREMENT
/begin MEASUREMENT vTTETXF "After the first-ordered filter treatment, target torque" SWORD COMP_0228 1 100 -3276.8 3276.7 ECU_ADDRESS 0xFFFF1A38 /begin FUNCTION_LIST /end FUNCTION_LIST /end MEASUREMENT
/begin MEASUREMENT vTTEVCN1 "A timer for the diagnosis permission condition judgement time" UBYTE COMP_0008 1 100 0 25500 ECU_ADDRESS 0xFFFF3404 /begin FUNCTION_LIST /end FUNCTION_LIST /end MEASUREMENT
/begin MEASUREMENT vTTEVCN2 "A timer for the JGEVP2 monitor delay time" UBYTE COMP_0008 1 100 0 25500 ECU_ADDRESS 0xFFFF3405 /begin FUNCTION_LIST /end FUNCTION_LIST /end MEASUREMENT
/begin MEASUREMENT vTTEVPNG "Monitor condition formation timer" UBYTE COMP_0008 1 100 0 25500 ECU_ADDRESS 0xFFFF3407 /begin FUNCTION_LIST /end FUNCTION_LIST /end MEASUREMENT
/begin MEASUREMENT vTTMPST1 "Condition formation timer" UBYTE COMP_0008 1 100 0 25500 ECU_ADDRESS 0xFFFF340D /begin FUNCTION_LIST /end FUNCTION_LIST /end MEASUREMENT
/begin MEASUREMENT vTTVOMIN "TGTVO un-adjustment judgement time (minimum value)" UBYTE COMP_0014 1 100 0 2550 ECU_ADDRESS 0xFFFFB2AE /begin FUNCTION_LIST /end FUNCTION_LIST /end MEASUREMENT
/begin MEASUREMENT vTVF1MIN "Fuel pressure sensor voltage NG timer" UBYTE COMP_0014 1 100 0 2550 ECU_ADDRESS 0xFFFFB2B1 /begin FUNCTION_LIST /end FUNCTION_LIST /end MEASUREMENT
/begin MEASUREMENT vTVF2MIN "Fuel pressure sensor voltage NG timer" UBYTE COMP_0014 1 100 0 2550 ECU_ADDRESS 0xFFFFB2B2 /begin FUNCTION_LIST /end FUNCTION_LIST /end MEASUREMENT
/begin MEASUREMENT vTVF3MIN "Fuel pressure decline NG timer" UBYTE COMP_0014 1 100 0 2550 ECU_ADDRESS 0xFFFFB2B3 /begin FUNCTION_LIST /end FUNCTION_LIST /end MEASUREMENT
/begin MEASUREMENT vTVF4LMIN "Fuel pressure decline NG timer" UBYTE COMP_0008 1 100 0 25500 ECU_ADDRESS 0xFFFFB2B4 /begin FUNCTION_LIST /end FUNCTION_LIST /end MEASUREMENT
/begin MEASUREMENT vTVF5LMIN "Fuel pressure decline NG timer" UBYTE COMP_0008 1 100 0 25500 ECU_ADDRESS 0xFFFFB2B5 /begin FUNCTION_LIST /end FUNCTION_LIST /end MEASUREMENT
/begin MEASUREMENT vTVIRCNT "CVT input rotation sensor pulse periodic measuring pulse input counter" UBYTE COMP_0016 1 100 0 255 ECU_ADDRESS 0xFFFF227C /begin FUNCTION_LIST /end FUNCTION_LIST /end MEASUREMENT
/begin MEASUREMENT vTVO100 "100mS" UBYTE COMP_0002 1 100 0 89.25 ECU_ADDRESS 0xFFFF3F99 /begin FUNCTION_LIST /end FUNCTION_LIST /end MEASUREMENT
/begin MEASUREMENT vTVOCMPS_1 "The sign of TVOCMP_1" UBYTE COMP_0004 1 100 0 255 ECU_ADDRESS 0xFFFF3799 /begin FUNCTION_LIST /end FUNCTION_LIST /end MEASUREMENT
/begin MEASUREMENT vTVOCMP_1 "A variable for the model matching compensation vessel output operation" ULONG COMP_0178_S 1 100 0 16385.300230425 ECU_ADDRESS 0xFFFF3794 /begin FUNCTION_LIST /end FUNCTION_LIST /end MEASUREMENT
/begin MEASUREMENT vTVOCNT "TVO After they become NG and OK, a going down counter to the third TP calculation completion" UBYTE COMP_0030 1 100 0 255 ECU_ADDRESS 0xFFFF1DD7 /begin FUNCTION_LIST /end FUNCTION_LIST /end MEASUREMENT
/begin MEASUREMENT vTVOCOM0S "The sign of TVOCOM0" UBYTE COMP_0068 1 100 0 255 ECU_ADDRESS 0xFFFF379C /begin FUNCTION_LIST /end FUNCTION_LIST /end MEASUREMENT
/begin MEASUREMENT vTVOFBKS_1 "The sign of TVOFBK_1" UBYTE COMP_0004 1 100 0 255 ECU_ADDRESS 0xFFFF37B9 /begin FUNCTION_LIST /end FUNCTION_LIST /end MEASUREMENT
/begin MEASUREMENT vTVOFBKS_2 "The sign of TVOFBK_2" UBYTE COMP_0004 1 100 0 255 ECU_ADDRESS 0xFFFF37BA /begin FUNCTION_LIST /end FUNCTION_LIST /end MEASUREMENT
/begin MEASUREMENT vTVOFBK_1 "The variable for the operation of the model matching compensation vessel L output" ULONG COMP_0178_S 1 100 0 16385.300230425 ECU_ADDRESS 0xFFFF37B0 /begin FUNCTION_LIST /end FUNCTION_LIST /end MEASUREMENT
/begin MEASUREMENT vTVOFBK_2 "The variable for the operation of the model matching compensation vessel L output" ULONG COMP_0178_S 1 100 0 16385.300230425 ECU_ADDRESS 0xFFFF37B4 /begin FUNCTION_LIST /end FUNCTION_LIST /end MEASUREMENT
/begin MEASUREMENT vTVOINTO "Before the throttle full-close position learning value 10mS" UWORD COMP_0023 1 100 0 327675 ECU_ADDRESS 0xFFFF1F46 /begin FUNCTION_LIST /end FUNCTION_LIST /end MEASUREMENT
/begin MEASUREMENT vTVOLPFSz2 "The sign of TVOLPF" UBYTE COMP_0004 1 100 0 255 ECU_ADDRESS 0xFFFF37BB /begin FUNCTION_LIST /end FUNCTION_LIST /end MEASUREMENT
/begin MEASUREMENT vTVOLPFz2 "Throttle open-degree for the digital filter" ULONG COMP_0179_S 1 100 0 4097.39879943 ECU_ADDRESS 0xFFFF37BC /begin FUNCTION_LIST /end FUNCTION_LIST /end MEASUREMENT
/begin MEASUREMENT vTVOz7 "Before TVOi* 10mS" UBYTE COMP_0002 1 100 0 89.25 ECU_ADDRESS 0xFFFF1F54 /begin FUNCTION_LIST /end FUNCTION_LIST /end MEASUREMENT
/begin MEASUREMENT vTVSPASCD "Vehicle speed signal pulse period" ULONG COMP_0181_S 1 100 0 429496729.5 ECU_ADDRESS 0xFFFF49BC /begin FUNCTION_LIST /end FUNCTION_LIST /end MEASUREMENT
/begin MEASUREMENT vTVSPCNT2 "Vehicle speed sensor NG judgement delay timer (for RATE)" UBYTE COMP_0013 1 100 0 255 ECU_ADDRESS 0xFFFF3424 /begin FUNCTION_LIST /end FUNCTION_LIST /end MEASUREMENT
/begin MEASUREMENT vTVSPIR "Vehicle speed pulse period" ULONG COMP_0139_S 1 100 0 107374182.375 ECU_ADDRESS 0xFFFF2280 /begin FUNCTION_LIST /end FUNCTION_LIST /end MEASUREMENT
/begin MEASUREMENT vTVSPPLS "Vehicle speed pulse non-input measuring time" UBYTE COMP_0014 1 100 0 2550 ECU_ADDRESS 0xFFFF3426 /begin FUNCTION_LIST /end FUNCTION_LIST /end MEASUREMENT
/begin MEASUREMENT vTWINTF "At the time of the start for the judgement, coolant temperature" UBYTE COMP_0035 1 100 -50 205 ECU_ADDRESS 0xFFFF342A /begin FUNCTION_LIST /end FUNCTION_LIST /end MEASUREMENT
/begin MEASUREMENT vTWKZ "A coolant temperature previous value for the table reference" UBYTE COMP_0356 1 100 -40 119.375 ECU_ADDRESS 0xFFFF1A42 /begin FUNCTION_LIST /end FUNCTION_LIST /end MEASUREMENT
/begin MEASUREMENT vTWNXABS "For the coolant temperature sensor voltage difference" UBYTE COMP_0054 1 100 0 5100 ECU_ADDRESS 0xFFFF1A46 /begin FUNCTION_LIST /end FUNCTION_LIST /end MEASUREMENT
/begin MEASUREMENT vTWSCV "A coolant temperature for the SCV judgement" UBYTE COMP_0035 1 100 -50 205 ECU_ADDRESS 0xFFFF1A47 /begin FUNCTION_LIST /end FUNCTION_LIST /end MEASUREMENT
/begin MEASUREMENT vTXBYTGST "The number of all transmitting bytes" UBYTE COMP_0016 1 100 0 255 ECU_ADDRESS 0xFFFF3F9A /begin FUNCTION_LIST /end FUNCTION_LIST /end MEASUREMENT
/begin MEASUREMENT vTXREQ "CAN transmitting requirement flag" UWORD COMP_0092 1 100 0 65535 ECU_ADDRESS 0xFFFF3F9C /begin FUNCTION_LIST /end FUNCTION_LIST /end MEASUREMENT
/begin MEASUREMENT vTXREQ0 "CAN transmitting requirement flag (for HCAN0)" UWORD COMP_0092 1 100 0 65535 ECU_ADDRESS 0xFFFF3F9E /begin FUNCTION_LIST /end FUNCTION_LIST /end MEASUREMENT
/begin MEASUREMENT vTXREQL "CAN transmitting requirement flag (SH 7058 editions)" ULONG COMP_0092 1 100 0 4294967295 ECU_ADDRESS 0xFFFF3FA0 /begin FUNCTION_LIST /end FUNCTION_LIST /end MEASUREMENT
/begin MEASUREMENT vTXTD "TCS throttle open-degree requirement value" UBYTE COMP_0047 1 100 0 127.5 ECU_ADDRESS 0xFFFF3FA4 /begin FUNCTION_LIST /end FUNCTION_LIST /end MEASUREMENT
/begin MEASUREMENT vTXTIME "Timer for transmission timing" UBYTE COMP_0014 1 100 0 2550 ECU_ADDRESS 0xFFFF3FA5 /begin FUNCTION_LIST /end FUNCTION_LIST /end MEASUREMENT
/begin MEASUREMENT vT_ADSTRS "FFD CCSL - Steering wheel push buttons voltage" UWORD COMP_0537_S 1 100 0 65.535 ECU_ADDRESS 0xFFFF3270 /begin FUNCTION_LIST /end FUNCTION_LIST /end MEASUREMENT
/begin MEASUREMENT vT_ADVD "FFD advance timng for save (for Diag on CAN)" UWORD COMP_0595_S 1 100 -655.34 655.36 ECU_ADDRESS 0xFFFF3272 /begin FUNCTION_LIST /end FUNCTION_LIST /end MEASUREMENT
/begin MEASUREMENT vT_AFFRVM "FFD CCSL - Status" UBYTE COMP_0068 1 100 0 255 ECU_ADDRESS 0xFFFF3274 /begin FUNCTION_LIST /end FUNCTION_LIST /end MEASUREMENT
/begin MEASUREMENT vT_APS1V "FFD Accelerator pedal voltage - track 1" UWORD COMP_0537_S 1 100 0 65.535 ECU_ADDRESS 0xFFFF3276 /begin FUNCTION_LIST /end FUNCTION_LIST /end MEASUREMENT
/begin MEASUREMENT vT_APS2V "FFD Accelerator pedal voltage - track 2" UWORD COMP_0537_S 1 100 0 65.535 ECU_ADDRESS 0xFFFF3278 /begin FUNCTION_LIST /end FUNCTION_LIST /end MEASUREMENT
/begin MEASUREMENT vT_AVCC "FFD Sensors supply voltage 1 for save" UWORD COMP_0537_S 1 100 0 65.535 ECU_ADDRESS 0xFFFF327A /begin FUNCTION_LIST /end FUNCTION_LIST /end MEASUREMENT
/begin MEASUREMENT vT_CCFAL "FFD CCSL? Status of the reversible failures not due to CC which cause CC failure" UBYTE COMP_0068 1 100 0 255 ECU_ADDRESS 0xFFFF327C /begin FUNCTION_LIST /end FUNCTION_LIST /end MEASUREMENT
/begin MEASUREMENT vT_CCSLFA "FFD CCSL - Status of the reversible failures not due to CCSL which cause CCSL failure" UBYTE COMP_0068 1 100 0 255 ECU_ADDRESS 0xFFFF327D /begin FUNCTION_LIST /end FUNCTION_LIST /end MEASUREMENT
/begin MEASUREMENT vT_COMDTM "FFD CCSL - Steering wheel push buttons state" UBYTE COMP_0068 1 100 0 255 ECU_ADDRESS 0xFFFF327E /begin FUNCTION_LIST /end FUNCTION_LIST /end MEASUREMENT
/begin MEASUREMENT vT_CRUCMP "FFD CCSL - Status of the failures which cause irreversible CC safety failure" UBYTE COMP_0068 1 100 0 255 ECU_ADDRESS 0xFFFF327F /begin FUNCTION_LIST /end FUNCTION_LIST /end MEASUREMENT
/begin MEASUREMENT vT_ETAMOT "FFD Engine states for save" UBYTE COMP_0068 1 100 0 255 ECU_ADDRESS 0xFFFF3280 /begin FUNCTION_LIST /end FUNCTION_LIST /end MEASUREMENT
/begin MEASUREMENT vT_FCCYL "FFD Fuel cut cylinder for save" UBYTE COMP_0068 1 100 0 255 ECU_ADDRESS 0xFFFF3281 /begin FUNCTION_LIST /end FUNCTION_LIST /end MEASUREMENT
/begin MEASUREMENT vT_IGNSW "FFD Key state" UBYTE COMP_0068 1 100 0 255 ECU_ADDRESS 0xFFFF3282 /begin FUNCTION_LIST /end FUNCTION_LIST /end MEASUREMENT
/begin MEASUREMENT vT_ITACD "FFD Cylinder intake filling up efficiency for save" UWORD COMP_0217 1 100 0 3.999941832 ECU_ADDRESS 0xFFFF3284 /begin FUNCTION_LIST /end FUNCTION_LIST /end MEASUREMENT
/begin MEASUREMENT vT_PAMB "FFD Atmospheric pressure for save (for Diag on CAN)" UWORD COMP_0491_S 1 100 0 65535 ECU_ADDRESS 0xFFFF3286 /begin FUNCTION_LIST /end FUNCTION_LIST /end MEASUREMENT
/begin MEASUREMENT vT_PDPRES "FFD Freon pressure sensor voltage" UWORD COMP_0537_S 1 100 0 65.535 ECU_ADDRESS 0xFFFF3288 /begin FUNCTION_LIST /end FUNCTION_LIST /end MEASUREMENT
/begin MEASUREMENT vT_PRSCLI "FFD Freon pressure" UWORD COMP_0420_S 1 100 0 6553.5 ECU_ADDRESS 0xFFFF328A /begin FUNCTION_LIST /end FUNCTION_LIST /end MEASUREMENT
/begin MEASUREMENT vT_RAPOFS "FFD Accelerator pedal position for save" UWORD COMP_0575_S 1 100 -327.67 327.68 ECU_ADDRESS 0xFFFF328C /begin FUNCTION_LIST /end FUNCTION_LIST /end MEASUREMENT
/begin MEASUREMENT vT_RTENG "FFD Estimated effective engine torque for save" UWORD COMP_0345_S 1 100 -400 1647.96875 ECU_ADDRESS 0xFFFF328E /begin FUNCTION_LIST /end FUNCTION_LIST /end MEASUREMENT
/begin MEASUREMENT vT_RTTEP "FFD Final indicated torque target for save" UWORD COMP_0470_S 1 100 0 2047.96875 ECU_ADDRESS 0xFFFF3290 /begin FUNCTION_LIST /end FUNCTION_LIST /end MEASUREMENT
/begin MEASUREMENT vT_TAND "Evacuation F.F. data buffer intake air temperature (for DiagOnCAN)" UWORD COMP_0573_S 1 100 -273 6280.5 ECU_ADDRESS 0xFFFF3292 /begin FUNCTION_LIST /end FUNCTION_LIST /end MEASUREMENT
/begin MEASUREMENT vT_TGTVOD "FFD Throttle valve opening for save (for Diag on CAN)" UWORD COMP_0575_S 1 100 -327.67 327.68 ECU_ADDRESS 0xFFFF3294 /begin FUNCTION_LIST /end FUNCTION_LIST /end MEASUREMENT
/begin MEASUREMENT vT_TIPS "FFD At the time of the sequential injection for save, output pulse width" UWORD COMP_0578_S 1 100 0 262140 ECU_ADDRESS 0xFFFF3296 /begin FUNCTION_LIST /end FUNCTION_LIST /end MEASUREMENT
/begin MEASUREMENT vT_TIPS_R#1 "FFD At the time of the sequential injection for save, output pulse width" UWORD COMP_0578_S 1 100 0 262140 ECU_ADDRESS 0xFFFF3296 /begin FUNCTION_LIST /end FUNCTION_LIST /end MEASUREMENT
/begin MEASUREMENT vT_TIPS_R#2 "FFD At the time of the sequential injection for save, output pulse width" UWORD COMP_0578_S 1 100 0 262140 ECU_ADDRESS 0xFFFF3298 /begin FUNCTION_LIST /end FUNCTION_LIST /end MEASUREMENT
/begin MEASUREMENT vT_TVOD "Evacuation F.F. buffer throttle open-degree (for DiagOnCAN)" UWORD COMP_0575_S 1 100 -327.67 327.68 ECU_ADDRESS 0xFFFF329A /begin FUNCTION_LIST /end FUNCTION_LIST /end MEASUREMENT
/begin MEASUREMENT vT_TWND "Evacuation F.F. data buffer engine cooling coolant temperature (for DiagOnCAN)" UWORD COMP_0573_S 1 100 -273 6280.5 ECU_ADDRESS 0xFFFF329C /begin FUNCTION_LIST /end FUNCTION_LIST /end MEASUREMENT
/begin MEASUREMENT vT_VB "Evacuation F.F. data buffer battery voltage" UWORD COMP_0537_S 1 100 0 65.535 ECU_ADDRESS 0xFFFF329E /begin FUNCTION_LIST /end FUNCTION_LIST /end MEASUREMENT
/begin MEASUREMENT vT_VITESM "FFD Displayed vehicle speed unit" UBYTE COMP_0068 1 100 0 255 ECU_ADDRESS 0xFFFF32A0 /begin FUNCTION_LIST /end FUNCTION_LIST /end MEASUREMENT
/begin MEASUREMENT vT_VITESP "FFD Displayed vehicle speed received on the CAN network" UBYTE COMP_0068 1 100 0 255 ECU_ADDRESS 0xFFFF32A1 /begin FUNCTION_LIST /end FUNCTION_LIST /end MEASUREMENT
/begin MEASUREMENT vT_VSPD "Evacuation F.F. data buffer vehicle speed occasion (for DiagOnCAN)" UWORD COMP_0375_S 1 100 0 655.35 ECU_ADDRESS 0xFFFF32A2 /begin FUNCTION_LIST /end FUNCTION_LIST /end MEASUREMENT
/begin MEASUREMENT vT_VTCNOW "FFD An incumbent VTC operation for save" UWORD COMP_0595_S 1 100 -655.34 655.36 ECU_ADDRESS 0xFFFF32A4 /begin FUNCTION_LIST /end FUNCTION_LIST /end MEASUREMENT
/begin MEASUREMENT vT_VTCNOW_R#1 "FFD An incumbent VTC operation for save" UWORD COMP_0595_S 1 100 -655.34 655.36 ECU_ADDRESS 0xFFFF32A4 /begin FUNCTION_LIST /end FUNCTION_LIST /end MEASUREMENT
/begin MEASUREMENT vT_VTCNOW_R#2 "FFD An incumbent VTC operation for save" UWORD COMP_0595_S 1 100 -655.34 655.36 ECU_ADDRESS 0xFFFF32A6 /begin FUNCTION_LIST /end FUNCTION_LIST /end MEASUREMENT
/begin MEASUREMENT vT_VTCTRG "FFD VTC target operation angle for save" UWORD COMP_0595_S 1 100 -655.34 655.36 ECU_ADDRESS 0xFFFF32A8 /begin FUNCTION_LIST /end FUNCTION_LIST /end MEASUREMENT
/begin MEASUREMENT vT_XXGEAR "FFD Current gear engaged" UBYTE COMP_0068 1 100 0 255 ECU_ADDRESS 0xFFFF32AA /begin FUNCTION_LIST /end FUNCTION_LIST /end MEASUREMENT
/begin MEASUREMENT vUBNCNTEND "RAM value vUBNCNTEND" UBYTE COMP_0004 1 100 0 255 ECU_ADDRESS 0xFFFF3440 /begin FUNCTION_LIST /end FUNCTION_LIST /end MEASUREMENT
/begin MEASUREMENT vUBNCNTOKf "UBNCNT (for the bank) count judgement flag" UBYTE COMP_0004 1 100 0 255 ECU_ADDRESS 0xFFFF3441 /begin FUNCTION_LIST /end FUNCTION_LIST /end MEASUREMENT
/begin MEASUREMENT vUCHMUX1 "Data UCH NO.1" UBYTE COMP_0068 1 100 0 255 ECU_ADDRESS 0xFFFF3FA6 /begin FUNCTION_LIST /end FUNCTION_LIST /end MEASUREMENT
/begin MEASUREMENT vUCHMUX2 "Data UCH NO.2" UBYTE COMP_0068 1 100 0 255 ECU_ADDRESS 0xFFFF3FA7 /begin FUNCTION_LIST /end FUNCTION_LIST /end MEASUREMENT
/begin MEASUREMENT vUCHMUX3 "Data UCH NO.3" UBYTE COMP_0068 1 100 0 255 ECU_ADDRESS 0xFFFF3FA8 /begin FUNCTION_LIST /end FUNCTION_LIST /end MEASUREMENT
/begin MEASUREMENT vUCHMUX4 "Data UCH NO.4" UBYTE COMP_0068 1 100 0 255 ECU_ADDRESS 0xFFFF3FA9 /begin FUNCTION_LIST /end FUNCTION_LIST /end MEASUREMENT
/begin MEASUREMENT vUCHMUX5 "Data UCH NO.5" UBYTE COMP_0068 1 100 0 255 ECU_ADDRESS 0xFFFF3FAA /begin FUNCTION_LIST /end FUNCTION_LIST /end MEASUREMENT
/begin MEASUREMENT vUF28DGN "RAM for the ST micro-IC UF28" UWORD COMP_0004 1 100 0 65535 ECU_ADDRESS 0xFFFF4996 /begin FUNCTION_LIST /end FUNCTION_LIST /end MEASUREMENT
/begin MEASUREMENT vUHREGNG "UH reception NG counter RAM" UBYTE COMP_0068 1 100 0 255 ECU_ADDRESS 0xFFFFB656 /begin FUNCTION_LIST /end FUNCTION_LIST /end MEASUREMENT
/begin MEASUREMENT vUHRXCT "UH receiving counter RAM" UBYTE COMP_0068 1 100 0 255 ECU_ADDRESS 0xFFFF1F57 /begin FUNCTION_LIST /end FUNCTION_LIST /end MEASUREMENT
/begin MEASUREMENT vUHRXWK "UH reception WK RAM" UWORD COMP_0068 1 100 0 65535 ECU_ADDRESS 0xFFFF1F58 /begin FUNCTION_LIST /end FUNCTION_LIST /end MEASUREMENT
/begin MEASUREMENT vURPFCNT "Present failure counter : USM fast frame reception.    Stored in E2PROM." UBYTE COMP_0068 1 100 0 255 ECU_ADDRESS 0xFFFFB2BD /begin FUNCTION_LIST /end FUNCTION_LIST /end MEASUREMENT
/begin MEASUREMENT vUU "Upper limit limitation value (QP big region)" UWORD COMP_0015 1 100 0 8191.875 ECU_ADDRESS 0xFFFF1A60 /begin FUNCTION_LIST /end FUNCTION_LIST /end MEASUREMENT
/begin MEASUREMENT vVAFSCNT "Lambda point output integration number of times" UBYTE COMP_0030 1 100 0 255 ECU_ADDRESS 0xFFFF3FAE /begin FUNCTION_LIST /end FUNCTION_LIST /end MEASUREMENT
/begin MEASUREMENT vVAFSSUM "Lambda point output value in total" UWORD COMP_0023 1 100 0 327675 ECU_ADDRESS 0xFFFF3FB0 /begin FUNCTION_LIST /end FUNCTION_LIST /end MEASUREMENT
/begin MEASUREMENT vVAPM "Imaginary vapor monitor timer" UWORD COMP_0008 1 100 0 6553500 ECU_ADDRESS 0xFFFF3444 /begin FUNCTION_LIST /end FUNCTION_LIST /end MEASUREMENT
/begin MEASUREMENT vVAPO100Z "Throttle open-degree target value (virtual) before 100mS" UWORD COMP_0005 1 100 0 7208.85 ECU_ADDRESS 0xFFFF1A62 /begin FUNCTION_LIST /end FUNCTION_LIST /end MEASUREMENT
/begin MEASUREMENT vVAPO35 "Throttle open-degree target value (virtual) 0.35deg" UBYTE COMP_0002 1 100 0 89.25 ECU_ADDRESS 0xFFFF3446 /begin FUNCTION_LIST /end FUNCTION_LIST /end MEASUREMENT
/begin MEASUREMENT vVAPODLT "Present throttle open-degree target value (virtual) throttle open-degree target value (virtual) -100mS" ULONG COMP_0005 1 100 0 472446402.45 ECU_ADDRESS 0xFFFF1A68 /begin FUNCTION_LIST /end FUNCTION_LIST /end MEASUREMENT
/begin MEASUREMENT vVAPOz1 "Before VAPOi* 10mS" UWORD COMP_0005 1 100 0 7208.85 ECU_ADDRESS 0xFFFF1A6C /begin FUNCTION_LIST /end FUNCTION_LIST /end MEASUREMENT
/begin MEASUREMENT vVAPOz10 "Before VAPOi* 10mS" UWORD COMP_0005 1 100 0 7208.85 ECU_ADDRESS 0xFFFF1A6E /begin FUNCTION_LIST /end FUNCTION_LIST /end MEASUREMENT
/begin MEASUREMENT vVAPOz2 "Before VAPOi* 10mS" UWORD COMP_0005 1 100 0 7208.85 ECU_ADDRESS 0xFFFF1A70 /begin FUNCTION_LIST /end FUNCTION_LIST /end MEASUREMENT
/begin MEASUREMENT vVAPOz3 "Before VAPOi* 10mS" UWORD COMP_0005 1 100 0 7208.85 ECU_ADDRESS 0xFFFF1A72 /begin FUNCTION_LIST /end FUNCTION_LIST /end MEASUREMENT
/begin MEASUREMENT vVAPOz5 "Before VAPOi* 10mS" UWORD COMP_0005 1 100 0 7208.85 ECU_ADDRESS 0xFFFF1A76 /begin FUNCTION_LIST /end FUNCTION_LIST /end MEASUREMENT
/begin MEASUREMENT vVAPOz6 "Before VAPOi* 10mS" UWORD COMP_0005 1 100 0 7208.85 ECU_ADDRESS 0xFFFF1A78 /begin FUNCTION_LIST /end FUNCTION_LIST /end MEASUREMENT
/begin MEASUREMENT vVAPOz7 "Before VAPOi* 10mS" UWORD COMP_0005 1 100 0 7208.85 ECU_ADDRESS 0xFFFF1A7A /begin FUNCTION_LIST /end FUNCTION_LIST /end MEASUREMENT
/begin MEASUREMENT vVAPOz8 "Before VAPOi* 10mS" UWORD COMP_0005 1 100 0 7208.85 ECU_ADDRESS 0xFFFF1A7C /begin FUNCTION_LIST /end FUNCTION_LIST /end MEASUREMENT
/begin MEASUREMENT vVAPOz9 "Before VAPOi* 10mS" UWORD COMP_0005 1 100 0 7208.85 ECU_ADDRESS 0xFFFF1A7E /begin FUNCTION_LIST /end FUNCTION_LIST /end MEASUREMENT
/begin MEASUREMENT vVATM "Atomospheric pressure sensor voltage" UBYTE COMP_0022 1 100 0 5100 ECU_ADDRESS 0xFFFF3447 /begin FUNCTION_LIST /end FUNCTION_LIST /end MEASUREMENT
/begin MEASUREMENT vVBALT "VB for the alternator control" UWORD COMP_0054 1 100 0 1310700 ECU_ADDRESS 0xFFFF1DDA /begin FUNCTION_LIST /end FUNCTION_LIST /end MEASUREMENT
/begin MEASUREMENT vVBALT2 "VB weighted average value for the alternator control" UWORD COMP_0054 1 100 0 1310700 ECU_ADDRESS 0xFFFF1DDC /begin FUNCTION_LIST /end FUNCTION_LIST /end MEASUREMENT
/begin MEASUREMENT vVBALTC "Battery terminal voltage estimated value" UBYTE COMP_0033 1 100 0 20400 ECU_ADDRESS 0xFFFF1A80 /begin FUNCTION_LIST /end FUNCTION_LIST /end MEASUREMENT
/begin MEASUREMENT vVBALTN "VB (after the failsafe) for the alternator control" UWORD COMP_0054 1 100 0 1310700 ECU_ADDRESS 0xFFFF1DDE /begin FUNCTION_LIST /end FUNCTION_LIST /end MEASUREMENT
/begin MEASUREMENT vVBHOSEI "Generating electricity voltage learn value" UWORD COMP_0522 1 100 -64 63.998046875 ECU_ADDRESS 0xFFFFB2C4 /begin FUNCTION_LIST /end FUNCTION_LIST /end MEASUREMENT
/begin MEASUREMENT vVBSET "Target generating electricity voltage" UWORD COMP_0054 1 100 0 1310700 ECU_ADDRESS 0xFFFF244C /begin FUNCTION_LIST /end FUNCTION_LIST /end MEASUREMENT
/begin MEASUREMENT vVBSETW "A target generating electricity voltage for the except for C terminal control" UWORD COMP_0054 1 100 0 1310700 ECU_ADDRESS 0xFFFF1A82 /begin FUNCTION_LIST /end FUNCTION_LIST /end MEASUREMENT
/begin MEASUREMENT vVBXFLG "DiagCAN Flag buffer for the RDBLID transmission" UBYTE COMP_0068 1 100 0 255 ECU_ADDRESS 0xFFFF35D0 /begin FUNCTION_LIST /end FUNCTION_LIST /end MEASUREMENT
/begin MEASUREMENT vVCLSLf "O2 sensor activated judgement (lean)" UBYTE COMP_0004 1 100 0 255 ECU_ADDRESS 0xFFFF1A84 /begin FUNCTION_LIST /end FUNCTION_LIST /end MEASUREMENT
/begin MEASUREMENT vVCLSRf "O2 sensor activated judgement (rich)" UBYTE COMP_0004 1 100 0 255 ECU_ADDRESS 0xFFFF1A85 /begin FUNCTION_LIST /end FUNCTION_LIST /end MEASUREMENT
/begin MEASUREMENT vVCLSf "O2 sensor activation (rich or lean) experience flag" UBYTE COMP_0004 1 100 0 255 ECU_ADDRESS 0xFFFF344F /begin FUNCTION_LIST /end FUNCTION_LIST /end MEASUREMENT
/begin MEASUREMENT vVDCMSG1T "VDCMSG1 reception interval counter" UBYTE COMP_0014 1 100 0 2550 ECU_ADDRESS 0xFFFF4998 /begin FUNCTION_LIST /end FUNCTION_LIST /end MEASUREMENT
/begin MEASUREMENT vVDUTY "Voltage compensation duty" UBYTE COMP_0047 1 100 0 127.5 ECU_ADDRESS 0xFFFF1A86 /begin FUNCTION_LIST /end FUNCTION_LIST /end MEASUREMENT
/begin MEASUREMENT vVDUTYW "VTCDUTY for the wind up countermeasure control" UBYTE COMP_0021 1 100 0 99.609375 ECU_ADDRESS 0xFFFF1A87 /begin FUNCTION_LIST /end FUNCTION_LIST /end MEASUREMENT
/begin MEASUREMENT vVEVP "Coil resistance reading value" UWORD COMP_0023 1 100 0 327675 ECU_ADDRESS 0xFFFF4088 /begin FUNCTION_LIST /end FUNCTION_LIST /end MEASUREMENT
/begin MEASUREMENT vVFUEL "Fuel pressure sensor voltage" UWORD COMP_0023 1 100 0 327675 ECU_ADDRESS 0xFFFF8862 /begin FUNCTION_LIST /end FUNCTION_LIST /end MEASUREMENT
/begin MEASUREMENT vVFUMAX "Fuel pressure sensor voltage" UWORD COMP_0023 1 100 0 327675 ECU_ADDRESS 0xFFFFB2C6 /begin FUNCTION_LIST /end FUNCTION_LIST /end MEASUREMENT
/begin MEASUREMENT vVFUMIN "Fuel pressure sensor voltage" UWORD COMP_0023 1 100 0 327675 ECU_ADDRESS 0xFFFFB2C8 /begin FUNCTION_LIST /end FUNCTION_LIST /end MEASUREMENT
/begin MEASUREMENT vVINDDL "DDL2 response code" UBYTE COMP_0004 1 100 0 255 ECU_ADDRESS 0xFFFF425B /begin FUNCTION_LIST /end FUNCTION_LIST /end MEASUREMENT
/begin MEASUREMENT vVIP0 "A/F output" SWORD COMP_0644_S 1 100 -81920 81917.5 ECU_ADDRESS 0xFFFF40A8 /begin FUNCTION_LIST /end FUNCTION_LIST /end MEASUREMENT
/begin MEASUREMENT vVLIMASCD "After the limiter treatment, vehicle speed" SLONG COMP_0209_S 1 100 -1843.20024746394 1843.20024660563 ECU_ADDRESS 0xFFFF3454 /begin FUNCTION_LIST /end FUNCTION_LIST /end MEASUREMENT
/begin MEASUREMENT vVMAVR1_S "VMV1 weighted average SubCpu calculation" UWORD COMP_0050 1 100 0 5119.921875 ECU_ADDRESS 0xFFFF49A6 /begin FUNCTION_LIST /end FUNCTION_LIST /end MEASUREMENT
/begin MEASUREMENT vVMAVR2_S "VMV2 weighted average SubCpu calculation" UWORD COMP_0050 1 100 0 5119.921875 ECU_ADDRESS 0xFFFF353A /begin FUNCTION_LIST /end FUNCTION_LIST /end MEASUREMENT
/begin MEASUREMENT vVMBAVR1 "VMV1 weighted average" UWORD COMP_0050 1 100 0 5119.921875 ECU_ADDRESS 0xFFFF478A /begin FUNCTION_LIST /end FUNCTION_LIST /end MEASUREMENT
/begin MEASUREMENT vVMBAVR2 "VMV2 weighted average" UWORD COMP_0050 1 100 0 5119.921875 ECU_ADDRESS 0xFFFF3FD6 /begin FUNCTION_LIST /end FUNCTION_LIST /end MEASUREMENT
/begin MEASUREMENT vVMBLIM2 "A negative pressure deficiency judgement threshold equivalent voltage" UWORD COMP_0050 1 100 0 5119.921875 ECU_ADDRESS 0xFFFF3FD8 /begin FUNCTION_LIST /end FUNCTION_LIST /end MEASUREMENT
/begin MEASUREMENT vVMMAX "VMV1 weighted average maximum value" UWORD COMP_0050 1 100 0 5119.921875 ECU_ADDRESS 0xFFFF3FDA /begin FUNCTION_LIST /end FUNCTION_LIST /end MEASUREMENT
/begin MEASUREMENT vVMMIN "VMV1 weighted average minimum value" UWORD COMP_0050 1 100 0 5119.921875 ECU_ADDRESS 0xFFFF3FDC /begin FUNCTION_LIST /end FUNCTION_LIST /end MEASUREMENT
/begin MEASUREMENT vVMV1 "M/vac negative pressure sensor voltage sample value" UWORD COMP_0023 1 100 0 327675 ECU_ADDRESS 0xFFFF3FE0 /begin FUNCTION_LIST /end FUNCTION_LIST /end MEASUREMENT
/begin MEASUREMENT vVMV2 "Negative pressure sensor voltage sample value for the SW function" UWORD COMP_0023 1 100 0 327675 ECU_ADDRESS 0xFFFF3FE2 /begin FUNCTION_LIST /end FUNCTION_LIST /end MEASUREMENT
/begin MEASUREMENT vVMVMAX "The atmosphere side brake negative pressure maintenance value" UWORD COMP_0524 1 100 0 5120.24955 ECU_ADDRESS 0xFFFF3FE4 /begin FUNCTION_LIST /end FUNCTION_LIST /end MEASUREMENT
/begin MEASUREMENT vVMVMIN "Vacuum side brake negative pressure maintenance value" UWORD COMP_0524 1 100 0 5120.24955 ECU_ADDRESS 0xFFFF3FE6 /begin FUNCTION_LIST /end FUNCTION_LIST /end MEASUREMENT
/begin MEASUREMENT vVO24M "O2 sensor input (4mS sampling)" UBYTE COMP_0104 1 100 0 2550 ECU_ADDRESS 0xFFFF3808 /begin FUNCTION_LIST /end FUNCTION_LIST /end MEASUREMENT
/begin MEASUREMENT vVO2MIN "O2 sensor voltage minimum value" UBYTE COMP_0104 1 100 0 2550 ECU_ADDRESS 0xFFFF1A98 /begin FUNCTION_LIST /end FUNCTION_LIST /end MEASUREMENT
/begin MEASUREMENT vVO2MIN_R#1 "O2 sensor voltage minimum value" UBYTE COMP_0104 1 100 0 2550 ECU_ADDRESS 0xFFFF1A98 /begin FUNCTION_LIST /end FUNCTION_LIST /end MEASUREMENT
/begin MEASUREMENT vVO2MIN_R#2 "O2 sensor voltage minimum value" UBYTE COMP_0104 1 100 0 2550 ECU_ADDRESS 0xFFFF1A99 /begin FUNCTION_LIST /end FUNCTION_LIST /end MEASUREMENT
/begin MEASUREMENT vVPAMBL "During the diagnosis, atomospheric pressure change speed" UBYTE COMP_0476_S 1 100 0 19.921875 ECU_ADDRESS 0xFFFF3458 /begin FUNCTION_LIST /end FUNCTION_LIST /end MEASUREMENT
/begin MEASUREMENT vVPB "Intake pressure sensor voltage value (A/D sampling value)" UWORD COMP_0023 1 100 0 327675 ECU_ADDRESS 0xFFFF35D2 /begin FUNCTION_LIST /end FUNCTION_LIST /end MEASUREMENT
/begin MEASUREMENT vVPBCNT "After they become a supercharge pressure sensor NG and OK, a going down counter to the third TP calculation completion" UBYTE COMP_0030 1 100 0 255 ECU_ADDRESS 0xFFFF1DE0 /begin FUNCTION_LIST /end FUNCTION_LIST /end MEASUREMENT
/begin MEASUREMENT vVPKRF "Reference electric potential" UWORD COMP_0023 1 100 0 327675 ECU_ADDRESS 0xFFFF8A5E /begin FUNCTION_LIST /end FUNCTION_LIST /end MEASUREMENT
/begin MEASUREMENT vVPRESCUT "Absolute pressure sensor voltage" UWORD COMP_0050 1 100 0 5119.921875 ECU_ADDRESS 0xFFFF1F5C /begin FUNCTION_LIST /end FUNCTION_LIST /end MEASUREMENT
/begin MEASUREMENT vVPRESEX "Absolute pressure sensor voltage" UWORD COMP_0050 1 100 0 5119.921875 ECU_ADDRESS 0xFFFF1F5E /begin FUNCTION_LIST /end FUNCTION_LIST /end MEASUREMENT
/begin MEASUREMENT vVRO2If "VRO2 one's personal history set judgement" UBYTE COMP_0004 1 100 0 255 ECU_ADDRESS 0xFFFF3FE9 /begin FUNCTION_LIST /end FUNCTION_LIST /end MEASUREMENT
/begin MEASUREMENT vVRO2NGf "VRO2 NG judgement flag" UBYTE COMP_0004 1 100 0 255 ECU_ADDRESS 0xFFFF3459 /begin FUNCTION_LIST /end FUNCTION_LIST /end MEASUREMENT
/begin MEASUREMENT vVRO2Z "VRO2 one's personal history (for the bank t)" UBYTE COMP_0104 1 100 0 2550 ECU_ADDRESS 0xFFFF3FEA /begin FUNCTION_LIST /end FUNCTION_LIST /end MEASUREMENT
/begin MEASUREMENT vVRO2Z_C#1_R#1 "VRO2 one's personal history (for the bank t)" UBYTE COMP_0104 1 100 0 2550 ECU_ADDRESS 0xFFFF3FEA /begin FUNCTION_LIST /end FUNCTION_LIST /end MEASUREMENT
/begin MEASUREMENT vVRO2Z_C#1_R#2 "VRO2 one's personal history (for the bank t)" UBYTE COMP_0104 1 100 0 2550 ECU_ADDRESS 0xFFFF3FEB /begin FUNCTION_LIST /end FUNCTION_LIST /end MEASUREMENT
/begin MEASUREMENT vVRO2Z_C#1_R#3 "VRO2 one's personal history (for the bank t)" UBYTE COMP_0104 1 100 0 2550 ECU_ADDRESS 0xFFFF3FEC /begin FUNCTION_LIST /end FUNCTION_LIST /end MEASUREMENT
/begin MEASUREMENT vVRO2Z_C#1_R#4 "VRO2 one's personal history (for the bank t)" UBYTE COMP_0104 1 100 0 2550 ECU_ADDRESS 0xFFFF3FED /begin FUNCTION_LIST /end FUNCTION_LIST /end MEASUREMENT
/begin MEASUREMENT vVRO2Z_C#1_R#5 "VRO2 one's personal history (for the bank t)" UBYTE COMP_0104 1 100 0 2550 ECU_ADDRESS 0xFFFF3FEE /begin FUNCTION_LIST /end FUNCTION_LIST /end MEASUREMENT
/begin MEASUREMENT vVRO2Z_C#2_R#1 "VRO2 one's personal history (for the bank t)" UBYTE COMP_0104 1 100 0 2550 ECU_ADDRESS 0xFFFF3FEF /begin FUNCTION_LIST /end FUNCTION_LIST /end MEASUREMENT
/begin MEASUREMENT vVRO2Z_C#2_R#2 "VRO2 one's personal history (for the bank t)" UBYTE COMP_0104 1 100 0 2550 ECU_ADDRESS 0xFFFF3FF0 /begin FUNCTION_LIST /end FUNCTION_LIST /end MEASUREMENT
/begin MEASUREMENT vVRO2Z_C#2_R#3 "VRO2 one's personal history (for the bank t)" UBYTE COMP_0104 1 100 0 2550 ECU_ADDRESS 0xFFFF3FF1 /begin FUNCTION_LIST /end FUNCTION_LIST /end MEASUREMENT
/begin MEASUREMENT vVRO2Z_C#2_R#4 "VRO2 one's personal history (for the bank t)" UBYTE COMP_0104 1 100 0 2550 ECU_ADDRESS 0xFFFF3FF2 /begin FUNCTION_LIST /end FUNCTION_LIST /end MEASUREMENT
/begin MEASUREMENT vVRO2Z_C#2_R#5 "VRO2 one's personal history (for the bank t)" UBYTE COMP_0104 1 100 0 2550 ECU_ADDRESS 0xFFFF3FF3 /begin FUNCTION_LIST /end FUNCTION_LIST /end MEASUREMENT
/begin MEASUREMENT vVRO2z5 "For 500mS, VRO2 voltage" UBYTE COMP_0104 1 100 0 2550 ECU_ADDRESS 0xFFFF3FF4 /begin FUNCTION_LIST /end FUNCTION_LIST /end MEASUREMENT
/begin MEASUREMENT vVRSHO1f "The rest O the 21st weighted average first flag" UBYTE COMP_0004 1 100 0 255 ECU_ADDRESS 0xFFFF3FF6 /begin FUNCTION_LIST /end FUNCTION_LIST /end MEASUREMENT
/begin MEASUREMENT vVS2NGD1 "NG judgement timer count rise delay count (for RATE)" UBYTE COMP_0013 1 100 0 255 ECU_ADDRESS 0xFFFF345A /begin FUNCTION_LIST /end FUNCTION_LIST /end MEASUREMENT
/begin MEASUREMENT vVS2NGD2 "NG judgement timer clear delay count (for RATE)" UBYTE COMP_0013 1 100 0 255 ECU_ADDRESS 0xFFFF345B /begin FUNCTION_LIST /end FUNCTION_LIST /end MEASUREMENT
/begin MEASUREMENT vVSP014 "A high precision vehicle speed sensor pulse periodic measuring measurement mode" UBYTE COMP_0068 1 100 0 255 ECU_ADDRESS 0xFFFF2286 /begin FUNCTION_LIST /end FUNCTION_LIST /end MEASUREMENT
/begin MEASUREMENT vVSP1 "Vehicle speed" UBYTE COMP_0007 1 100 0 510 ECU_ADDRESS 0xFFFF8864 /begin FUNCTION_LIST /end FUNCTION_LIST /end MEASUREMENT
/begin MEASUREMENT vVSP1Z "In front of 1s, VSP" UBYTE COMP_0007 1 100 0 510 ECU_ADDRESS 0xFFFF3460 /begin FUNCTION_LIST /end FUNCTION_LIST /end MEASUREMENT
/begin MEASUREMENT vVSP2 "Vehicle speed" UBYTE COMP_0007 1 100 0 510 ECU_ADDRESS 0xFFFF8865 /begin FUNCTION_LIST /end FUNCTION_LIST /end MEASUREMENT
/begin MEASUREMENT vVSP2Z "In front of 2s, VSP" UBYTE COMP_0007 1 100 0 510 ECU_ADDRESS 0xFFFF3461 /begin FUNCTION_LIST /end FUNCTION_LIST /end MEASUREMENT
/begin MEASUREMENT vVSP2ZCNT "In front of 2s, VSP set judgement counter" UBYTE COMP_0016 1 100 0 255 ECU_ADDRESS 0xFFFF3462 /begin FUNCTION_LIST /end FUNCTION_LIST /end MEASUREMENT
/begin MEASUREMENT vVSPASCD "A vehicle speed for ASCD" SLONG COMP_0209_S 1 100 -1843.20024746394 1843.20024660563 ECU_ADDRESS 0xFFFF4260 /begin FUNCTION_LIST /end FUNCTION_LIST /end MEASUREMENT
/begin MEASUREMENT vVSPASCDK "Vehicle speed past value for ASCD" SLONG COMP_0001_S 1 100 -1842.540969984 1842.540969126 ECU_ADDRESS 0xFFFF3468 /begin FUNCTION_LIST /end FUNCTION_LIST /end MEASUREMENT
/begin MEASUREMENT vVSPCMP "Phase compensation vessel output value for the vehicle speed servo" SLONG COMP_0646_S 1 100 -3686.39190499328 3686.39190327667 ECU_ADDRESS 0xFFFF3478 /begin FUNCTION_LIST /end FUNCTION_LIST /end MEASUREMENT
/begin MEASUREMENT vVSPCOLD "Memory vehicle speed value to start increase and decrease" SLONG COMP_0209_S 1 100 -1843.20024746394 1843.20024660563 ECU_ADDRESS 0xFFFF3480 /begin FUNCTION_LIST /end FUNCTION_LIST /end MEASUREMENT
/begin MEASUREMENT vVSPCOM "Relative vehicle speed order value for the vehicle speed servo" SLONG COMP_0209_S 1 100 -1843.20024746394 1843.20024660563 ECU_ADDRESS 0xFFFF3484 /begin FUNCTION_LIST /end FUNCTION_LIST /end MEASUREMENT
/begin MEASUREMENT vVSPCOMB "A reference vehicle speed for the vehicle speed servo" SLONG COMP_0209_S 1 100 -1843.20024746394 1843.20024660563 ECU_ADDRESS 0xFFFF3488 /begin FUNCTION_LIST /end FUNCTION_LIST /end MEASUREMENT
/begin MEASUREMENT vVSPCOMN "Vehicle speed order value (final value)" SLONG COMP_0209_S 1 100 -1843.20024746394 1843.20024660563 ECU_ADDRESS 0xFFFF4268 /begin FUNCTION_LIST /end FUNCTION_LIST /end MEASUREMENT
/begin MEASUREMENT vVSPCOMO "Vehicle speed order value (temporary value)" SLONG COMP_0209_S 1 100 -1843.20024746394 1843.20024660563 ECU_ADDRESS 0xFFFF348C /begin FUNCTION_LIST /end FUNCTION_LIST /end MEASUREMENT
/begin MEASUREMENT vVSPDEC "DECISC control vehicle speed" UBYTE COMP_0007 1 100 0 510 ECU_ADDRESS 0xFFFF1A9E /begin FUNCTION_LIST /end FUNCTION_LIST /end MEASUREMENT
/begin MEASUREMENT vVSPHHL "Lean vehicle speed upper limit" UBYTE COMP_0007 1 100 0 510 ECU_ADDRESS 0xFFFF1A9F /begin FUNCTION_LIST /end FUNCTION_LIST /end MEASUREMENT
/begin MEASUREMENT vVSPHSL "Stratified vehicle speed upper limit" UBYTE COMP_0007 1 100 0 510 ECU_ADDRESS 0xFFFF1AA0 /begin FUNCTION_LIST /end FUNCTION_LIST /end MEASUREMENT
/begin MEASUREMENT vVSPICOLD "A timer previous value for vehicle speed signal pulse periodic measuring" ULONG COMP_0181_S 1 100 0 429496729.5 ECU_ADDRESS 0xFFFF408C /begin FUNCTION_LIST /end FUNCTION_LIST /end MEASUREMENT
/begin MEASUREMENT vVSPLSL "Lean vehicle speed lower limit" UBYTE COMP_0007 1 100 0 510 ECU_ADDRESS 0xFFFF1AA1 /begin FUNCTION_LIST /end FUNCTION_LIST /end MEASUREMENT
/begin MEASUREMENT vVSPNOW "A relative vehicle speed for the vehicle speed servo" SLONG COMP_0209_S 1 100 -1843.20024746394 1843.20024660563 ECU_ADDRESS 0xFFFF3494 /begin FUNCTION_LIST /end FUNCTION_LIST /end MEASUREMENT
/begin MEASUREMENT vVSPOLD "Before 706mS, VSP" UBYTE COMP_0007 1 100 0 510 ECU_ADDRESS 0xFFFF3FF7 /begin FUNCTION_LIST /end FUNCTION_LIST /end MEASUREMENT
/begin MEASUREMENT vVSPRSL1 "Vehicle speed" UBYTE COMP_0429 1 100 0 255 ECU_ADDRESS 0xFFFF3FF8 /begin FUNCTION_LIST /end FUNCTION_LIST /end MEASUREMENT
/begin MEASUREMENT vVSPRTO "The vehicle speed exchange rate" ULONG COMP_0648_S 1 100 0 36864.0049406957 ECU_ADDRESS 0xFFFF3FFC /begin FUNCTION_LIST /end FUNCTION_LIST /end MEASUREMENT
/begin MEASUREMENT vVSPSBF "Vehicle speed deviation LPF output value" SLONG COMP_0209_S 1 100 -1843.20024746394 1843.20024660563 ECU_ADDRESS 0xFFFF3498 /begin FUNCTION_LIST /end FUNCTION_LIST /end MEASUREMENT
/begin MEASUREMENT vVSPTH "An injection quantity upper limit table for the judgement" UBYTE COMP_0001 1 100 0 31.875 ECU_ADDRESS 0xFFFF349C /begin FUNCTION_LIST /end FUNCTION_LIST /end MEASUREMENT
/begin MEASUREMENT vVSPTL "An injection quantity lower limit table for the judgement" UBYTE COMP_0001 1 100 0 31.875 ECU_ADDRESS 0xFFFF349D /begin FUNCTION_LIST /end FUNCTION_LIST /end MEASUREMENT
/begin MEASUREMENT vVSPTRP "More than a vehicle speed >= 40km /h, more than accumulation 300 seconds" UWORD COMP_0049 1 100 0 65535 ECU_ADDRESS 0xFFFF349E /begin FUNCTION_LIST /end FUNCTION_LIST /end MEASUREMENT
/begin MEASUREMENT vVSPm2 "A vehicle speed with -2 hysteresis" UBYTE COMP_0007 1 100 0 510 ECU_ADDRESS 0xFFFF89E3 /begin FUNCTION_LIST /end FUNCTION_LIST /end MEASUREMENT
/begin MEASUREMENT vVSPm4 "A vehicle speed with -4 hysteresis" UBYTE COMP_0007 1 100 0 510 ECU_ADDRESS 0xFFFF89E4 /begin FUNCTION_LIST /end FUNCTION_LIST /end MEASUREMENT
/begin MEASUREMENT vVSPp2 "A vehicle speed with ÅE2 hysteresis" UBYTE COMP_0007 1 100 0 510 ECU_ADDRESS 0xFFFF89E5 /begin FUNCTION_LIST /end FUNCTION_LIST /end MEASUREMENT
/begin MEASUREMENT vVTBASKE "VTC maximum-retard degree diagnosis reference position learning value" UWORD COMP_0174_S 1 100 0 127.998046875 ECU_ADDRESS 0xFFFFB2DE /begin FUNCTION_LIST /end FUNCTION_LIST /end MEASUREMENT
/begin MEASUREMENT vVTBASKE_R#1 "VTC maximum-retard degree diagnosis reference position learning value" UWORD COMP_0174_S 1 100 0 127.998046875 ECU_ADDRESS 0xFFFFB2DE /begin FUNCTION_LIST /end FUNCTION_LIST /end MEASUREMENT
/begin MEASUREMENT vVTBASKE_R#2 "VTC maximum-retard degree diagnosis reference position learning value" UWORD COMP_0174_S 1 100 0 127.998046875 ECU_ADDRESS 0xFFFFB2E0 /begin FUNCTION_LIST /end FUNCTION_LIST /end MEASUREMENT
/begin MEASUREMENT vVTBASKI "VTC maximum-retard degree diagnosis reference position learning value" UWORD COMP_0174_S 1 100 0 127.998046875 ECU_ADDRESS 0xFFFFB2E2 /begin FUNCTION_LIST /end FUNCTION_LIST /end MEASUREMENT
/begin MEASUREMENT vVTBASKI_R#1 "VTC maximum-retard degree diagnosis reference position learning value" UWORD COMP_0174_S 1 100 0 127.998046875 ECU_ADDRESS 0xFFFFB2E2 /begin FUNCTION_LIST /end FUNCTION_LIST /end MEASUREMENT
/begin MEASUREMENT vVTBASKI_R#2 "VTC maximum-retard degree diagnosis reference position learning value" UWORD COMP_0174_S 1 100 0 127.998046875 ECU_ADDRESS 0xFFFFB2E4 /begin FUNCTION_LIST /end FUNCTION_LIST /end MEASUREMENT
/begin MEASUREMENT vVTCB2 "The amount of dizzer control" UBYTE COMP_0257 1 100 -128 127 ECU_ADDRESS 0xFFFF1AA8 /begin FUNCTION_LIST /end FUNCTION_LIST /end MEASUREMENT
/begin MEASUREMENT vVTCB2_R#1 "The amount of dizzer control" UBYTE COMP_0257 1 100 -128 127 ECU_ADDRESS 0xFFFF1AA8 /begin FUNCTION_LIST /end FUNCTION_LIST /end MEASUREMENT
/begin MEASUREMENT vVTCB2_R#2 "The amount of dizzer control" UBYTE COMP_0257 1 100 -128 127 ECU_ADDRESS 0xFFFF1AA9 /begin FUNCTION_LIST /end FUNCTION_LIST /end MEASUREMENT
/begin MEASUREMENT vVTCBAK "FMP parameter BACKUPMAP" UWORD COMP_0068 1 100 0 65535 ECU_ADDRESS 0xFFFFB2E6 /begin FUNCTION_LIST /end FUNCTION_LIST /end MEASUREMENT
/begin MEASUREMENT vVTCBAK_C#1_R#1 "FMP parameter BACKUPMAP" UWORD COMP_0068 1 100 0 65535 ECU_ADDRESS 0xFFFFB2E6 /begin FUNCTION_LIST /end FUNCTION_LIST /end MEASUREMENT
/begin MEASUREMENT vVTCBAK_C#1_R#2 "FMP parameter BACKUPMAP" UWORD COMP_0068 1 100 0 65535 ECU_ADDRESS 0xFFFFB2E8 /begin FUNCTION_LIST /end FUNCTION_LIST /end MEASUREMENT
/begin MEASUREMENT vVTCBAK_C#1_R#3 "FMP parameter BACKUPMAP" UWORD COMP_0068 1 100 0 65535 ECU_ADDRESS 0xFFFFB2EA /begin FUNCTION_LIST /end FUNCTION_LIST /end MEASUREMENT
/begin MEASUREMENT vVTCBAK_C#1_R#4 "FMP parameter BACKUPMAP" UWORD COMP_0068 1 100 0 65535 ECU_ADDRESS 0xFFFFB2EC /begin FUNCTION_LIST /end FUNCTION_LIST /end MEASUREMENT
/begin MEASUREMENT vVTCBAK_C#1_R#5 "FMP parameter BACKUPMAP" UWORD COMP_0068 1 100 0 65535 ECU_ADDRESS 0xFFFFB2EE /begin FUNCTION_LIST /end FUNCTION_LIST /end MEASUREMENT
/begin MEASUREMENT vVTCBAK_C#1_R#6 "FMP parameter BACKUPMAP" UWORD COMP_0068 1 100 0 65535 ECU_ADDRESS 0xFFFFB2F0 /begin FUNCTION_LIST /end FUNCTION_LIST /end MEASUREMENT
/begin MEASUREMENT vVTCBAK_C#1_R#7 "FMP parameter BACKUPMAP" UWORD COMP_0068 1 100 0 65535 ECU_ADDRESS 0xFFFFB2F2 /begin FUNCTION_LIST /end FUNCTION_LIST /end MEASUREMENT
/begin MEASUREMENT vVTCBAK_C#1_R#8 "FMP parameter BACKUPMAP" UWORD COMP_0068 1 100 0 65535 ECU_ADDRESS 0xFFFFB2F4 /begin FUNCTION_LIST /end FUNCTION_LIST /end MEASUREMENT
/begin MEASUREMENT vVTCBAK_C#1_R#9 "FMP parameter BACKUPMAP" UWORD COMP_0068 1 100 0 65535 ECU_ADDRESS 0xFFFFB2F6 /begin FUNCTION_LIST /end FUNCTION_LIST /end MEASUREMENT
/begin MEASUREMENT vVTCBAK_C#1_R#10 "FMP parameter BACKUPMAP" UWORD COMP_0068 1 100 0 65535 ECU_ADDRESS 0xFFFFB2F8 /begin FUNCTION_LIST /end FUNCTION_LIST /end MEASUREMENT
/begin MEASUREMENT vVTCBAK_C#1_R#11 "FMP parameter BACKUPMAP" UWORD COMP_0068 1 100 0 65535 ECU_ADDRESS 0xFFFFB2FA /begin FUNCTION_LIST /end FUNCTION_LIST /end MEASUREMENT
/begin MEASUREMENT vVTCBAK_C#1_R#12 "FMP parameter BACKUPMAP" UWORD COMP_0068 1 100 0 65535 ECU_ADDRESS 0xFFFFB2FC /begin FUNCTION_LIST /end FUNCTION_LIST /end MEASUREMENT
/begin MEASUREMENT vVTCBAK_C#1_R#13 "FMP parameter BACKUPMAP" UWORD COMP_0068 1 100 0 65535 ECU_ADDRESS 0xFFFFB2FE /begin FUNCTION_LIST /end FUNCTION_LIST /end MEASUREMENT
/begin MEASUREMENT vVTCBAK_C#1_R#14 "FMP parameter BACKUPMAP" UWORD COMP_0068 1 100 0 65535 ECU_ADDRESS 0xFFFFB300 /begin FUNCTION_LIST /end FUNCTION_LIST /end MEASUREMENT
/begin MEASUREMENT vVTCBAK_C#1_R#15 "FMP parameter BACKUPMAP" UWORD COMP_0068 1 100 0 65535 ECU_ADDRESS 0xFFFFB302 /begin FUNCTION_LIST /end FUNCTION_LIST /end MEASUREMENT
/begin MEASUREMENT vVTCBAK_C#1_R#16 "FMP parameter BACKUPMAP" UWORD COMP_0068 1 100 0 65535 ECU_ADDRESS 0xFFFFB304 /begin FUNCTION_LIST /end FUNCTION_LIST /end MEASUREMENT
/begin MEASUREMENT vVTCBAK_C#1_R#17 "FMP parameter BACKUPMAP" UWORD COMP_0068 1 100 0 65535 ECU_ADDRESS 0xFFFFB306 /begin FUNCTION_LIST /end FUNCTION_LIST /end MEASUREMENT
/begin MEASUREMENT vVTCBAK_C#1_R#18 "FMP parameter BACKUPMAP" UWORD COMP_0068 1 100 0 65535 ECU_ADDRESS 0xFFFFB308 /begin FUNCTION_LIST /end FUNCTION_LIST /end MEASUREMENT
/begin MEASUREMENT vVTCBAK_C#1_R#19 "FMP parameter BACKUPMAP" UWORD COMP_0068 1 100 0 65535 ECU_ADDRESS 0xFFFFB30A /begin FUNCTION_LIST /end FUNCTION_LIST /end MEASUREMENT
/begin MEASUREMENT vVTCBAK_C#1_R#20 "FMP parameter BACKUPMAP" UWORD COMP_0068 1 100 0 65535 ECU_ADDRESS 0xFFFFB30C /begin FUNCTION_LIST /end FUNCTION_LIST /end MEASUREMENT
/begin MEASUREMENT vVTCBAK_C#1_R#21 "FMP parameter BACKUPMAP" UWORD COMP_0068 1 100 0 65535 ECU_ADDRESS 0xFFFFB30E /begin FUNCTION_LIST /end FUNCTION_LIST /end MEASUREMENT
/begin MEASUREMENT vVTCBAK_C#1_R#22 "FMP parameter BACKUPMAP" UWORD COMP_0068 1 100 0 65535 ECU_ADDRESS 0xFFFFB310 /begin FUNCTION_LIST /end FUNCTION_LIST /end MEASUREMENT
/begin MEASUREMENT vVTCBAK_C#1_R#23 "FMP parameter BACKUPMAP" UWORD COMP_0068 1 100 0 65535 ECU_ADDRESS 0xFFFFB312 /begin FUNCTION_LIST /end FUNCTION_LIST /end MEASUREMENT
/begin MEASUREMENT vVTCBAK_C#1_R#24 "FMP parameter BACKUPMAP" UWORD COMP_0068 1 100 0 65535 ECU_ADDRESS 0xFFFFB314 /begin FUNCTION_LIST /end FUNCTION_LIST /end MEASUREMENT
/begin MEASUREMENT vVTCBAK_C#1_R#25 "FMP parameter BACKUPMAP" UWORD COMP_0068 1 100 0 65535 ECU_ADDRESS 0xFFFFB316 /begin FUNCTION_LIST /end FUNCTION_LIST /end MEASUREMENT
/begin MEASUREMENT vVTCBAK_C#1_R#26 "FMP parameter BACKUPMAP" UWORD COMP_0068 1 100 0 65535 ECU_ADDRESS 0xFFFFB318 /begin FUNCTION_LIST /end FUNCTION_LIST /end MEASUREMENT
/begin MEASUREMENT vVTCBAK_C#1_R#27 "FMP parameter BACKUPMAP" UWORD COMP_0068 1 100 0 65535 ECU_ADDRESS 0xFFFFB31A /begin FUNCTION_LIST /end FUNCTION_LIST /end MEASUREMENT
/begin MEASUREMENT vVTCBAK_C#1_R#28 "FMP parameter BACKUPMAP" UWORD COMP_0068 1 100 0 65535 ECU_ADDRESS 0xFFFFB31C /begin FUNCTION_LIST /end FUNCTION_LIST /end MEASUREMENT
/begin MEASUREMENT vVTCBAK_C#1_R#29 "FMP parameter BACKUPMAP" UWORD COMP_0068 1 100 0 65535 ECU_ADDRESS 0xFFFFB31E /begin FUNCTION_LIST /end FUNCTION_LIST /end MEASUREMENT
/begin MEASUREMENT vVTCBAK_C#1_R#30 "FMP parameter BACKUPMAP" UWORD COMP_0068 1 100 0 65535 ECU_ADDRESS 0xFFFFB320 /begin FUNCTION_LIST /end FUNCTION_LIST /end MEASUREMENT
/begin MEASUREMENT vVTCBAK_C#1_R#31 "FMP parameter BACKUPMAP" UWORD COMP_0068 1 100 0 65535 ECU_ADDRESS 0xFFFFB322 /begin FUNCTION_LIST /end FUNCTION_LIST /end MEASUREMENT
/begin MEASUREMENT vVTCBAK_C#1_R#32 "FMP parameter BACKUPMAP" UWORD COMP_0068 1 100 0 65535 ECU_ADDRESS 0xFFFFB324 /begin FUNCTION_LIST /end FUNCTION_LIST /end MEASUREMENT
/begin MEASUREMENT vVTCBAK_C#1_R#33 "FMP parameter BACKUPMAP" UWORD COMP_0068 1 100 0 65535 ECU_ADDRESS 0xFFFFB326 /begin FUNCTION_LIST /end FUNCTION_LIST /end MEASUREMENT
/begin MEASUREMENT vVTCBAK_C#1_R#34 "FMP parameter BACKUPMAP" UWORD COMP_0068 1 100 0 65535 ECU_ADDRESS 0xFFFFB328 /begin FUNCTION_LIST /end FUNCTION_LIST /end MEASUREMENT
/begin MEASUREMENT vVTCBAK_C#1_R#35 "FMP parameter BACKUPMAP" UWORD COMP_0068 1 100 0 65535 ECU_ADDRESS 0xFFFFB32A /begin FUNCTION_LIST /end FUNCTION_LIST /end MEASUREMENT
/begin MEASUREMENT vVTCBAK_C#2_R#1 "FMP parameter BACKUPMAP" UWORD COMP_0068 1 100 0 65535 ECU_ADDRESS 0xFFFFB32C /begin FUNCTION_LIST /end FUNCTION_LIST /end MEASUREMENT
/begin MEASUREMENT vVTCBAK_C#2_R#2 "FMP parameter BACKUPMAP" UWORD COMP_0068 1 100 0 65535 ECU_ADDRESS 0xFFFFB32E /begin FUNCTION_LIST /end FUNCTION_LIST /end MEASUREMENT
/begin MEASUREMENT vVTCBAK_C#2_R#3 "FMP parameter BACKUPMAP" UWORD COMP_0068 1 100 0 65535 ECU_ADDRESS 0xFFFFB330 /begin FUNCTION_LIST /end FUNCTION_LIST /end MEASUREMENT
/begin MEASUREMENT vVTCBAK_C#2_R#4 "FMP parameter BACKUPMAP" UWORD COMP_0068 1 100 0 65535 ECU_ADDRESS 0xFFFFB332 /begin FUNCTION_LIST /end FUNCTION_LIST /end MEASUREMENT
/begin MEASUREMENT vVTCBAK_C#2_R#5 "FMP parameter BACKUPMAP" UWORD COMP_0068 1 100 0 65535 ECU_ADDRESS 0xFFFFB334 /begin FUNCTION_LIST /end FUNCTION_LIST /end MEASUREMENT
/begin MEASUREMENT vVTCBAK_C#2_R#6 "FMP parameter BACKUPMAP" UWORD COMP_0068 1 100 0 65535 ECU_ADDRESS 0xFFFFB336 /begin FUNCTION_LIST /end FUNCTION_LIST /end MEASUREMENT
/begin MEASUREMENT vVTCBAK_C#2_R#7 "FMP parameter BACKUPMAP" UWORD COMP_0068 1 100 0 65535 ECU_ADDRESS 0xFFFFB338 /begin FUNCTION_LIST /end FUNCTION_LIST /end MEASUREMENT
/begin MEASUREMENT vVTCBAK_C#2_R#8 "FMP parameter BACKUPMAP" UWORD COMP_0068 1 100 0 65535 ECU_ADDRESS 0xFFFFB33A /begin FUNCTION_LIST /end FUNCTION_LIST /end MEASUREMENT
/begin MEASUREMENT vVTCBAK_C#2_R#9 "FMP parameter BACKUPMAP" UWORD COMP_0068 1 100 0 65535 ECU_ADDRESS 0xFFFFB33C /begin FUNCTION_LIST /end FUNCTION_LIST /end MEASUREMENT
/begin MEASUREMENT vVTCBAK_C#2_R#10 "FMP parameter BACKUPMAP" UWORD COMP_0068 1 100 0 65535 ECU_ADDRESS 0xFFFFB33E /begin FUNCTION_LIST /end FUNCTION_LIST /end MEASUREMENT
/begin MEASUREMENT vVTCBAK_C#2_R#11 "FMP parameter BACKUPMAP" UWORD COMP_0068 1 100 0 65535 ECU_ADDRESS 0xFFFFB340 /begin FUNCTION_LIST /end FUNCTION_LIST /end MEASUREMENT
/begin MEASUREMENT vVTCBAK_C#2_R#12 "FMP parameter BACKUPMAP" UWORD COMP_0068 1 100 0 65535 ECU_ADDRESS 0xFFFFB342 /begin FUNCTION_LIST /end FUNCTION_LIST /end MEASUREMENT
/begin MEASUREMENT vVTCBAK_C#2_R#13 "FMP parameter BACKUPMAP" UWORD COMP_0068 1 100 0 65535 ECU_ADDRESS 0xFFFFB344 /begin FUNCTION_LIST /end FUNCTION_LIST /end MEASUREMENT
/begin MEASUREMENT vVTCBAK_C#2_R#14 "FMP parameter BACKUPMAP" UWORD COMP_0068 1 100 0 65535 ECU_ADDRESS 0xFFFFB346 /begin FUNCTION_LIST /end FUNCTION_LIST /end MEASUREMENT
/begin MEASUREMENT vVTCBAK_C#2_R#15 "FMP parameter BACKUPMAP" UWORD COMP_0068 1 100 0 65535 ECU_ADDRESS 0xFFFFB348 /begin FUNCTION_LIST /end FUNCTION_LIST /end MEASUREMENT
/begin MEASUREMENT vVTCBAK_C#2_R#16 "FMP parameter BACKUPMAP" UWORD COMP_0068 1 100 0 65535 ECU_ADDRESS 0xFFFFB34A /begin FUNCTION_LIST /end FUNCTION_LIST /end MEASUREMENT
/begin MEASUREMENT vVTCBAK_C#2_R#17 "FMP parameter BACKUPMAP" UWORD COMP_0068 1 100 0 65535 ECU_ADDRESS 0xFFFFB34C /begin FUNCTION_LIST /end FUNCTION_LIST /end MEASUREMENT
/begin MEASUREMENT vVTCBAK_C#2_R#18 "FMP parameter BACKUPMAP" UWORD COMP_0068 1 100 0 65535 ECU_ADDRESS 0xFFFFB34E /begin FUNCTION_LIST /end FUNCTION_LIST /end MEASUREMENT
/begin MEASUREMENT vVTCBAK_C#2_R#19 "FMP parameter BACKUPMAP" UWORD COMP_0068 1 100 0 65535 ECU_ADDRESS 0xFFFFB350 /begin FUNCTION_LIST /end FUNCTION_LIST /end MEASUREMENT
/begin MEASUREMENT vVTCBAK_C#2_R#20 "FMP parameter BACKUPMAP" UWORD COMP_0068 1 100 0 65535 ECU_ADDRESS 0xFFFFB352 /begin FUNCTION_LIST /end FUNCTION_LIST /end MEASUREMENT
/begin MEASUREMENT vVTCBAK_C#2_R#21 "FMP parameter BACKUPMAP" UWORD COMP_0068 1 100 0 65535 ECU_ADDRESS 0xFFFFB354 /begin FUNCTION_LIST /end FUNCTION_LIST /end MEASUREMENT
/begin MEASUREMENT vVTCBAK_C#2_R#22 "FMP parameter BACKUPMAP" UWORD COMP_0068 1 100 0 65535 ECU_ADDRESS 0xFFFFB356 /begin FUNCTION_LIST /end FUNCTION_LIST /end MEASUREMENT
/begin MEASUREMENT vVTCBAK_C#2_R#23 "FMP parameter BACKUPMAP" UWORD COMP_0068 1 100 0 65535 ECU_ADDRESS 0xFFFFB358 /begin FUNCTION_LIST /end FUNCTION_LIST /end MEASUREMENT
/begin MEASUREMENT vVTCBAK_C#2_R#24 "FMP parameter BACKUPMAP" UWORD COMP_0068 1 100 0 65535 ECU_ADDRESS 0xFFFFB35A /begin FUNCTION_LIST /end FUNCTION_LIST /end MEASUREMENT
/begin MEASUREMENT vVTCBAK_C#2_R#25 "FMP parameter BACKUPMAP" UWORD COMP_0068 1 100 0 65535 ECU_ADDRESS 0xFFFFB35C /begin FUNCTION_LIST /end FUNCTION_LIST /end MEASUREMENT
/begin MEASUREMENT vVTCBAK_C#2_R#26 "FMP parameter BACKUPMAP" UWORD COMP_0068 1 100 0 65535 ECU_ADDRESS 0xFFFFB35E /begin FUNCTION_LIST /end FUNCTION_LIST /end MEASUREMENT
/begin MEASUREMENT vVTCBAK_C#2_R#27 "FMP parameter BACKUPMAP" UWORD COMP_0068 1 100 0 65535 ECU_ADDRESS 0xFFFFB360 /begin FUNCTION_LIST /end FUNCTION_LIST /end MEASUREMENT
/begin MEASUREMENT vVTCBAK_C#2_R#28 "FMP parameter BACKUPMAP" UWORD COMP_0068 1 100 0 65535 ECU_ADDRESS 0xFFFFB362 /begin FUNCTION_LIST /end FUNCTION_LIST /end MEASUREMENT
/begin MEASUREMENT vVTCBAK_C#2_R#29 "FMP parameter BACKUPMAP" UWORD COMP_0068 1 100 0 65535 ECU_ADDRESS 0xFFFFB364 /begin FUNCTION_LIST /end FUNCTION_LIST /end MEASUREMENT
/begin MEASUREMENT vVTCBAK_C#2_R#30 "FMP parameter BACKUPMAP" UWORD COMP_0068 1 100 0 65535 ECU_ADDRESS 0xFFFFB366 /begin FUNCTION_LIST /end FUNCTION_LIST /end MEASUREMENT
/begin MEASUREMENT vVTCBAK_C#2_R#31 "FMP parameter BACKUPMAP" UWORD COMP_0068 1 100 0 65535 ECU_ADDRESS 0xFFFFB368 /begin FUNCTION_LIST /end FUNCTION_LIST /end MEASUREMENT
/begin MEASUREMENT vVTCBAK_C#2_R#32 "FMP parameter BACKUPMAP" UWORD COMP_0068 1 100 0 65535 ECU_ADDRESS 0xFFFFB36A /begin FUNCTION_LIST /end FUNCTION_LIST /end MEASUREMENT
/begin MEASUREMENT vVTCBAK_C#2_R#33 "FMP parameter BACKUPMAP" UWORD COMP_0068 1 100 0 65535 ECU_ADDRESS 0xFFFFB36C /begin FUNCTION_LIST /end FUNCTION_LIST /end MEASUREMENT
/begin MEASUREMENT vVTCBAK_C#2_R#34 "FMP parameter BACKUPMAP" UWORD COMP_0068 1 100 0 65535 ECU_ADDRESS 0xFFFFB36E /begin FUNCTION_LIST /end FUNCTION_LIST /end MEASUREMENT
/begin MEASUREMENT vVTCBAK_C#2_R#35 "FMP parameter BACKUPMAP" UWORD COMP_0068 1 100 0 65535 ECU_ADDRESS 0xFFFFB370 /begin FUNCTION_LIST /end FUNCTION_LIST /end MEASUREMENT
/begin MEASUREMENT vVTCBAK_C#3_R#1 "FMP parameter BACKUPMAP" UWORD COMP_0068 1 100 0 65535 ECU_ADDRESS 0xFFFFB372 /begin FUNCTION_LIST /end FUNCTION_LIST /end MEASUREMENT
/begin MEASUREMENT vVTCBAK_C#3_R#2 "FMP parameter BACKUPMAP" UWORD COMP_0068 1 100 0 65535 ECU_ADDRESS 0xFFFFB374 /begin FUNCTION_LIST /end FUNCTION_LIST /end MEASUREMENT
/begin MEASUREMENT vVTCBAK_C#3_R#3 "FMP parameter BACKUPMAP" UWORD COMP_0068 1 100 0 65535 ECU_ADDRESS 0xFFFFB376 /begin FUNCTION_LIST /end FUNCTION_LIST /end MEASUREMENT
/begin MEASUREMENT vVTCBAK_C#3_R#4 "FMP parameter BACKUPMAP" UWORD COMP_0068 1 100 0 65535 ECU_ADDRESS 0xFFFFB378 /begin FUNCTION_LIST /end FUNCTION_LIST /end MEASUREMENT
/begin MEASUREMENT vVTCBAK_C#3_R#5 "FMP parameter BACKUPMAP" UWORD COMP_0068 1 100 0 65535 ECU_ADDRESS 0xFFFFB37A /begin FUNCTION_LIST /end FUNCTION_LIST /end MEASUREMENT
/begin MEASUREMENT vVTCBAK_C#3_R#6 "FMP parameter BACKUPMAP" UWORD COMP_0068 1 100 0 65535 ECU_ADDRESS 0xFFFFB37C /begin FUNCTION_LIST /end FUNCTION_LIST /end MEASUREMENT
/begin MEASUREMENT vVTCBAK_C#3_R#7 "FMP parameter BACKUPMAP" UWORD COMP_0068 1 100 0 65535 ECU_ADDRESS 0xFFFFB37E /begin FUNCTION_LIST /end FUNCTION_LIST /end MEASUREMENT
/begin MEASUREMENT vVTCBAK_C#3_R#8 "FMP parameter BACKUPMAP" UWORD COMP_0068 1 100 0 65535 ECU_ADDRESS 0xFFFFB380 /begin FUNCTION_LIST /end FUNCTION_LIST /end MEASUREMENT
/begin MEASUREMENT vVTCBAK_C#3_R#9 "FMP parameter BACKUPMAP" UWORD COMP_0068 1 100 0 65535 ECU_ADDRESS 0xFFFFB382 /begin FUNCTION_LIST /end FUNCTION_LIST /end MEASUREMENT
/begin MEASUREMENT vVTCBAK_C#3_R#10 "FMP parameter BACKUPMAP" UWORD COMP_0068 1 100 0 65535 ECU_ADDRESS 0xFFFFB384 /begin FUNCTION_LIST /end FUNCTION_LIST /end MEASUREMENT
/begin MEASUREMENT vVTCBAK_C#3_R#11 "FMP parameter BACKUPMAP" UWORD COMP_0068 1 100 0 65535 ECU_ADDRESS 0xFFFFB386 /begin FUNCTION_LIST /end FUNCTION_LIST /end MEASUREMENT
/begin MEASUREMENT vVTCBAK_C#3_R#12 "FMP parameter BACKUPMAP" UWORD COMP_0068 1 100 0 65535 ECU_ADDRESS 0xFFFFB388 /begin FUNCTION_LIST /end FUNCTION_LIST /end MEASUREMENT
/begin MEASUREMENT vVTCBAK_C#3_R#13 "FMP parameter BACKUPMAP" UWORD COMP_0068 1 100 0 65535 ECU_ADDRESS 0xFFFFB38A /begin FUNCTION_LIST /end FUNCTION_LIST /end MEASUREMENT
/begin MEASUREMENT vVTCBAK_C#3_R#14 "FMP parameter BACKUPMAP" UWORD COMP_0068 1 100 0 65535 ECU_ADDRESS 0xFFFFB38C /begin FUNCTION_LIST /end FUNCTION_LIST /end MEASUREMENT
/begin MEASUREMENT vVTCBAK_C#3_R#15 "FMP parameter BACKUPMAP" UWORD COMP_0068 1 100 0 65535 ECU_ADDRESS 0xFFFFB38E /begin FUNCTION_LIST /end FUNCTION_LIST /end MEASUREMENT
/begin MEASUREMENT vVTCBAK_C#3_R#16 "FMP parameter BACKUPMAP" UWORD COMP_0068 1 100 0 65535 ECU_ADDRESS 0xFFFFB390 /begin FUNCTION_LIST /end FUNCTION_LIST /end MEASUREMENT
/begin MEASUREMENT vVTCBAK_C#3_R#17 "FMP parameter BACKUPMAP" UWORD COMP_0068 1 100 0 65535 ECU_ADDRESS 0xFFFFB392 /begin FUNCTION_LIST /end FUNCTION_LIST /end MEASUREMENT
/begin MEASUREMENT vVTCBAK_C#3_R#18 "FMP parameter BACKUPMAP" UWORD COMP_0068 1 100 0 65535 ECU_ADDRESS 0xFFFFB394 /begin FUNCTION_LIST /end FUNCTION_LIST /end MEASUREMENT
/begin MEASUREMENT vVTCBAK_C#3_R#19 "FMP parameter BACKUPMAP" UWORD COMP_0068 1 100 0 65535 ECU_ADDRESS 0xFFFFB396 /begin FUNCTION_LIST /end FUNCTION_LIST /end MEASUREMENT
/begin MEASUREMENT vVTCBAK_C#3_R#20 "FMP parameter BACKUPMAP" UWORD COMP_0068 1 100 0 65535 ECU_ADDRESS 0xFFFFB398 /begin FUNCTION_LIST /end FUNCTION_LIST /end MEASUREMENT
/begin MEASUREMENT vVTCBAK_C#3_R#21 "FMP parameter BACKUPMAP" UWORD COMP_0068 1 100 0 65535 ECU_ADDRESS 0xFFFFB39A /begin FUNCTION_LIST /end FUNCTION_LIST /end MEASUREMENT
/begin MEASUREMENT vVTCBAK_C#3_R#22 "FMP parameter BACKUPMAP" UWORD COMP_0068 1 100 0 65535 ECU_ADDRESS 0xFFFFB39C /begin FUNCTION_LIST /end FUNCTION_LIST /end MEASUREMENT
/begin MEASUREMENT vVTCBAK_C#3_R#23 "FMP parameter BACKUPMAP" UWORD COMP_0068 1 100 0 65535 ECU_ADDRESS 0xFFFFB39E /begin FUNCTION_LIST /end FUNCTION_LIST /end MEASUREMENT
/begin MEASUREMENT vVTCBAK_C#3_R#24 "FMP parameter BACKUPMAP" UWORD COMP_0068 1 100 0 65535 ECU_ADDRESS 0xFFFFB3A0 /begin FUNCTION_LIST /end FUNCTION_LIST /end MEASUREMENT
/begin MEASUREMENT vVTCBAK_C#3_R#25 "FMP parameter BACKUPMAP" UWORD COMP_0068 1 100 0 65535 ECU_ADDRESS 0xFFFFB3A2 /begin FUNCTION_LIST /end FUNCTION_LIST /end MEASUREMENT
/begin MEASUREMENT vVTCBAK_C#3_R#26 "FMP parameter BACKUPMAP" UWORD COMP_0068 1 100 0 65535 ECU_ADDRESS 0xFFFFB3A4 /begin FUNCTION_LIST /end FUNCTION_LIST /end MEASUREMENT
/begin MEASUREMENT vVTCBAK_C#3_R#27 "FMP parameter BACKUPMAP" UWORD COMP_0068 1 100 0 65535 ECU_ADDRESS 0xFFFFB3A6 /begin FUNCTION_LIST /end FUNCTION_LIST /end MEASUREMENT
/begin MEASUREMENT vVTCBAK_C#3_R#28 "FMP parameter BACKUPMAP" UWORD COMP_0068 1 100 0 65535 ECU_ADDRESS 0xFFFFB3A8 /begin FUNCTION_LIST /end FUNCTION_LIST /end MEASUREMENT
/begin MEASUREMENT vVTCBAK_C#3_R#29 "FMP parameter BACKUPMAP" UWORD COMP_0068 1 100 0 65535 ECU_ADDRESS 0xFFFFB3AA /begin FUNCTION_LIST /end FUNCTION_LIST /end MEASUREMENT
/begin MEASUREMENT vVTCBAK_C#3_R#30 "FMP parameter BACKUPMAP" UWORD COMP_0068 1 100 0 65535 ECU_ADDRESS 0xFFFFB3AC /begin FUNCTION_LIST /end FUNCTION_LIST /end MEASUREMENT
/begin MEASUREMENT vVTCBAK_C#3_R#31 "FMP parameter BACKUPMAP" UWORD COMP_0068 1 100 0 65535 ECU_ADDRESS 0xFFFFB3AE /begin FUNCTION_LIST /end FUNCTION_LIST /end MEASUREMENT
/begin MEASUREMENT vVTCBAK_C#3_R#32 "FMP parameter BACKUPMAP" UWORD COMP_0068 1 100 0 65535 ECU_ADDRESS 0xFFFFB3B0 /begin FUNCTION_LIST /end FUNCTION_LIST /end MEASUREMENT
/begin MEASUREMENT vVTCBAK_C#3_R#33 "FMP parameter BACKUPMAP" UWORD COMP_0068 1 100 0 65535 ECU_ADDRESS 0xFFFFB3B2 /begin FUNCTION_LIST /end FUNCTION_LIST /end MEASUREMENT
/begin MEASUREMENT vVTCBAK_C#3_R#34 "FMP parameter BACKUPMAP" UWORD COMP_0068 1 100 0 65535 ECU_ADDRESS 0xFFFFB3B4 /begin FUNCTION_LIST /end FUNCTION_LIST /end MEASUREMENT
/begin MEASUREMENT vVTCBAK_C#3_R#35 "FMP parameter BACKUPMAP" UWORD COMP_0068 1 100 0 65535 ECU_ADDRESS 0xFFFFB3B6 /begin FUNCTION_LIST /end FUNCTION_LIST /end MEASUREMENT
/begin MEASUREMENT vVTCBAK_C#4_R#1 "FMP parameter BACKUPMAP" UWORD COMP_0068 1 100 0 65535 ECU_ADDRESS 0xFFFFB3B8 /begin FUNCTION_LIST /end FUNCTION_LIST /end MEASUREMENT
/begin MEASUREMENT vVTCBAK_C#4_R#2 "FMP parameter BACKUPMAP" UWORD COMP_0068 1 100 0 65535 ECU_ADDRESS 0xFFFFB3BA /begin FUNCTION_LIST /end FUNCTION_LIST /end MEASUREMENT
/begin MEASUREMENT vVTCBAK_C#4_R#3 "FMP parameter BACKUPMAP" UWORD COMP_0068 1 100 0 65535 ECU_ADDRESS 0xFFFFB3BC /begin FUNCTION_LIST /end FUNCTION_LIST /end MEASUREMENT
/begin MEASUREMENT vVTCBAK_C#4_R#4 "FMP parameter BACKUPMAP" UWORD COMP_0068 1 100 0 65535 ECU_ADDRESS 0xFFFFB3BE /begin FUNCTION_LIST /end FUNCTION_LIST /end MEASUREMENT
/begin MEASUREMENT vVTCBAK_C#4_R#5 "FMP parameter BACKUPMAP" UWORD COMP_0068 1 100 0 65535 ECU_ADDRESS 0xFFFFB3C0 /begin FUNCTION_LIST /end FUNCTION_LIST /end MEASUREMENT
/begin MEASUREMENT vVTCBAK_C#4_R#6 "FMP parameter BACKUPMAP" UWORD COMP_0068 1 100 0 65535 ECU_ADDRESS 0xFFFFB3C2 /begin FUNCTION_LIST /end FUNCTION_LIST /end MEASUREMENT
/begin MEASUREMENT vVTCBAK_C#4_R#7 "FMP parameter BACKUPMAP" UWORD COMP_0068 1 100 0 65535 ECU_ADDRESS 0xFFFFB3C4 /begin FUNCTION_LIST /end FUNCTION_LIST /end MEASUREMENT
/begin MEASUREMENT vVTCBAK_C#4_R#8 "FMP parameter BACKUPMAP" UWORD COMP_0068 1 100 0 65535 ECU_ADDRESS 0xFFFFB3C6 /begin FUNCTION_LIST /end FUNCTION_LIST /end MEASUREMENT
/begin MEASUREMENT vVTCBAK_C#4_R#9 "FMP parameter BACKUPMAP" UWORD COMP_0068 1 100 0 65535 ECU_ADDRESS 0xFFFFB3C8 /begin FUNCTION_LIST /end FUNCTION_LIST /end MEASUREMENT
/begin MEASUREMENT vVTCBAK_C#4_R#10 "FMP parameter BACKUPMAP" UWORD COMP_0068 1 100 0 65535 ECU_ADDRESS 0xFFFFB3CA /begin FUNCTION_LIST /end FUNCTION_LIST /end MEASUREMENT
/begin MEASUREMENT vVTCBAK_C#4_R#11 "FMP parameter BACKUPMAP" UWORD COMP_0068 1 100 0 65535 ECU_ADDRESS 0xFFFFB3CC /begin FUNCTION_LIST /end FUNCTION_LIST /end MEASUREMENT
/begin MEASUREMENT vVTCBAK_C#4_R#12 "FMP parameter BACKUPMAP" UWORD COMP_0068 1 100 0 65535 ECU_ADDRESS 0xFFFFB3CE /begin FUNCTION_LIST /end FUNCTION_LIST /end MEASUREMENT
/begin MEASUREMENT vVTCBAK_C#4_R#13 "FMP parameter BACKUPMAP" UWORD COMP_0068 1 100 0 65535 ECU_ADDRESS 0xFFFFB3D0 /begin FUNCTION_LIST /end FUNCTION_LIST /end MEASUREMENT
/begin MEASUREMENT vVTCBAK_C#4_R#14 "FMP parameter BACKUPMAP" UWORD COMP_0068 1 100 0 65535 ECU_ADDRESS 0xFFFFB3D2 /begin FUNCTION_LIST /end FUNCTION_LIST /end MEASUREMENT
/begin MEASUREMENT vVTCBAK_C#4_R#15 "FMP parameter BACKUPMAP" UWORD COMP_0068 1 100 0 65535 ECU_ADDRESS 0xFFFFB3D4 /begin FUNCTION_LIST /end FUNCTION_LIST /end MEASUREMENT
/begin MEASUREMENT vVTCBAK_C#4_R#16 "FMP parameter BACKUPMAP" UWORD COMP_0068 1 100 0 65535 ECU_ADDRESS 0xFFFFB3D6 /begin FUNCTION_LIST /end FUNCTION_LIST /end MEASUREMENT
/begin MEASUREMENT vVTCBAK_C#4_R#17 "FMP parameter BACKUPMAP" UWORD COMP_0068 1 100 0 65535 ECU_ADDRESS 0xFFFFB3D8 /begin FUNCTION_LIST /end FUNCTION_LIST /end MEASUREMENT
/begin MEASUREMENT vVTCBAK_C#4_R#18 "FMP parameter BACKUPMAP" UWORD COMP_0068 1 100 0 65535 ECU_ADDRESS 0xFFFFB3DA /begin FUNCTION_LIST /end FUNCTION_LIST /end MEASUREMENT
/begin MEASUREMENT vVTCBAK_C#4_R#19 "FMP parameter BACKUPMAP" UWORD COMP_0068 1 100 0 65535 ECU_ADDRESS 0xFFFFB3DC /begin FUNCTION_LIST /end FUNCTION_LIST /end MEASUREMENT
/begin MEASUREMENT vVTCBAK_C#4_R#20 "FMP parameter BACKUPMAP" UWORD COMP_0068 1 100 0 65535 ECU_ADDRESS 0xFFFFB3DE /begin FUNCTION_LIST /end FUNCTION_LIST /end MEASUREMENT
/begin MEASUREMENT vVTCBAK_C#4_R#21 "FMP parameter BACKUPMAP" UWORD COMP_0068 1 100 0 65535 ECU_ADDRESS 0xFFFFB3E0 /begin FUNCTION_LIST /end FUNCTION_LIST /end MEASUREMENT
/begin MEASUREMENT vVTCBAK_C#4_R#22 "FMP parameter BACKUPMAP" UWORD COMP_0068 1 100 0 65535 ECU_ADDRESS 0xFFFFB3E2 /begin FUNCTION_LIST /end FUNCTION_LIST /end MEASUREMENT
/begin MEASUREMENT vVTCBAK_C#4_R#23 "FMP parameter BACKUPMAP" UWORD COMP_0068 1 100 0 65535 ECU_ADDRESS 0xFFFFB3E4 /begin FUNCTION_LIST /end FUNCTION_LIST /end MEASUREMENT
/begin MEASUREMENT vVTCBAK_C#4_R#24 "FMP parameter BACKUPMAP" UWORD COMP_0068 1 100 0 65535 ECU_ADDRESS 0xFFFFB3E6 /begin FUNCTION_LIST /end FUNCTION_LIST /end MEASUREMENT
/begin MEASUREMENT vVTCBAK_C#4_R#25 "FMP parameter BACKUPMAP" UWORD COMP_0068 1 100 0 65535 ECU_ADDRESS 0xFFFFB3E8 /begin FUNCTION_LIST /end FUNCTION_LIST /end MEASUREMENT
/begin MEASUREMENT vVTCBAK_C#4_R#26 "FMP parameter BACKUPMAP" UWORD COMP_0068 1 100 0 65535 ECU_ADDRESS 0xFFFFB3EA /begin FUNCTION_LIST /end FUNCTION_LIST /end MEASUREMENT
/begin MEASUREMENT vVTCBAK_C#4_R#27 "FMP parameter BACKUPMAP" UWORD COMP_0068 1 100 0 65535 ECU_ADDRESS 0xFFFFB3EC /begin FUNCTION_LIST /end FUNCTION_LIST /end MEASUREMENT
/begin MEASUREMENT vVTCBAK_C#4_R#28 "FMP parameter BACKUPMAP" UWORD COMP_0068 1 100 0 65535 ECU_ADDRESS 0xFFFFB3EE /begin FUNCTION_LIST /end FUNCTION_LIST /end MEASUREMENT
/begin MEASUREMENT vVTCBAK_C#4_R#29 "FMP parameter BACKUPMAP" UWORD COMP_0068 1 100 0 65535 ECU_ADDRESS 0xFFFFB3F0 /begin FUNCTION_LIST /end FUNCTION_LIST /end MEASUREMENT
/begin MEASUREMENT vVTCBAK_C#4_R#30 "FMP parameter BACKUPMAP" UWORD COMP_0068 1 100 0 65535 ECU_ADDRESS 0xFFFFB3F2 /begin FUNCTION_LIST /end FUNCTION_LIST /end MEASUREMENT
/begin MEASUREMENT vVTCBAK_C#4_R#31 "FMP parameter BACKUPMAP" UWORD COMP_0068 1 100 0 65535 ECU_ADDRESS 0xFFFFB3F4 /begin FUNCTION_LIST /end FUNCTION_LIST /end MEASUREMENT
/begin MEASUREMENT vVTCBAK_C#4_R#32 "FMP parameter BACKUPMAP" UWORD COMP_0068 1 100 0 65535 ECU_ADDRESS 0xFFFFB3F6 /begin FUNCTION_LIST /end FUNCTION_LIST /end MEASUREMENT
/begin MEASUREMENT vVTCBAK_C#4_R#33 "FMP parameter BACKUPMAP" UWORD COMP_0068 1 100 0 65535 ECU_ADDRESS 0xFFFFB3F8 /begin FUNCTION_LIST /end FUNCTION_LIST /end MEASUREMENT
/begin MEASUREMENT vVTCBAK_C#4_R#34 "FMP parameter BACKUPMAP" UWORD COMP_0068 1 100 0 65535 ECU_ADDRESS 0xFFFFB3FA /begin FUNCTION_LIST /end FUNCTION_LIST /end MEASUREMENT
/begin MEASUREMENT vVTCBAK_C#4_R#35 "FMP parameter BACKUPMAP" UWORD COMP_0068 1 100 0 65535 ECU_ADDRESS 0xFFFFB3FC /begin FUNCTION_LIST /end FUNCTION_LIST /end MEASUREMENT
/begin MEASUREMENT vVTCBAK_C#5_R#1 "FMP parameter BACKUPMAP" UWORD COMP_0068 1 100 0 65535 ECU_ADDRESS 0xFFFFB3FE /begin FUNCTION_LIST /end FUNCTION_LIST /end MEASUREMENT
/begin MEASUREMENT vVTCBAK_C#5_R#2 "FMP parameter BACKUPMAP" UWORD COMP_0068 1 100 0 65535 ECU_ADDRESS 0xFFFFB400 /begin FUNCTION_LIST /end FUNCTION_LIST /end MEASUREMENT
/begin MEASUREMENT vVTCBAK_C#5_R#3 "FMP parameter BACKUPMAP" UWORD COMP_0068 1 100 0 65535 ECU_ADDRESS 0xFFFFB402 /begin FUNCTION_LIST /end FUNCTION_LIST /end MEASUREMENT
/begin MEASUREMENT vVTCBAK_C#5_R#4 "FMP parameter BACKUPMAP" UWORD COMP_0068 1 100 0 65535 ECU_ADDRESS 0xFFFFB404 /begin FUNCTION_LIST /end FUNCTION_LIST /end MEASUREMENT
/begin MEASUREMENT vVTCBAK_C#5_R#5 "FMP parameter BACKUPMAP" UWORD COMP_0068 1 100 0 65535 ECU_ADDRESS 0xFFFFB406 /begin FUNCTION_LIST /end FUNCTION_LIST /end MEASUREMENT
/begin MEASUREMENT vVTCBAK_C#5_R#6 "FMP parameter BACKUPMAP" UWORD COMP_0068 1 100 0 65535 ECU_ADDRESS 0xFFFFB408 /begin FUNCTION_LIST /end FUNCTION_LIST /end MEASUREMENT
/begin MEASUREMENT vVTCBAK_C#5_R#7 "FMP parameter BACKUPMAP" UWORD COMP_0068 1 100 0 65535 ECU_ADDRESS 0xFFFFB40A /begin FUNCTION_LIST /end FUNCTION_LIST /end MEASUREMENT
/begin MEASUREMENT vVTCBAK_C#5_R#8 "FMP parameter BACKUPMAP" UWORD COMP_0068 1 100 0 65535 ECU_ADDRESS 0xFFFFB40C /begin FUNCTION_LIST /end FUNCTION_LIST /end MEASUREMENT
/begin MEASUREMENT vVTCBAK_C#5_R#9 "FMP parameter BACKUPMAP" UWORD COMP_0068 1 100 0 65535 ECU_ADDRESS 0xFFFFB40E /begin FUNCTION_LIST /end FUNCTION_LIST /end MEASUREMENT
/begin MEASUREMENT vVTCBAK_C#5_R#10 "FMP parameter BACKUPMAP" UWORD COMP_0068 1 100 0 65535 ECU_ADDRESS 0xFFFFB410 /begin FUNCTION_LIST /end FUNCTION_LIST /end MEASUREMENT
/begin MEASUREMENT vVTCBAK_C#5_R#11 "FMP parameter BACKUPMAP" UWORD COMP_0068 1 100 0 65535 ECU_ADDRESS 0xFFFFB412 /begin FUNCTION_LIST /end FUNCTION_LIST /end MEASUREMENT
/begin MEASUREMENT vVTCBAK_C#5_R#12 "FMP parameter BACKUPMAP" UWORD COMP_0068 1 100 0 65535 ECU_ADDRESS 0xFFFFB414 /begin FUNCTION_LIST /end FUNCTION_LIST /end MEASUREMENT
/begin MEASUREMENT vVTCBAK_C#5_R#13 "FMP parameter BACKUPMAP" UWORD COMP_0068 1 100 0 65535 ECU_ADDRESS 0xFFFFB416 /begin FUNCTION_LIST /end FUNCTION_LIST /end MEASUREMENT
/begin MEASUREMENT vVTCBAK_C#5_R#14 "FMP parameter BACKUPMAP" UWORD COMP_0068 1 100 0 65535 ECU_ADDRESS 0xFFFFB418 /begin FUNCTION_LIST /end FUNCTION_LIST /end MEASUREMENT
/begin MEASUREMENT vVTCBAK_C#5_R#15 "FMP parameter BACKUPMAP" UWORD COMP_0068 1 100 0 65535 ECU_ADDRESS 0xFFFFB41A /begin FUNCTION_LIST /end FUNCTION_LIST /end MEASUREMENT
/begin MEASUREMENT vVTCBAK_C#5_R#16 "FMP parameter BACKUPMAP" UWORD COMP_0068 1 100 0 65535 ECU_ADDRESS 0xFFFFB41C /begin FUNCTION_LIST /end FUNCTION_LIST /end MEASUREMENT
/begin MEASUREMENT vVTCBAK_C#5_R#17 "FMP parameter BACKUPMAP" UWORD COMP_0068 1 100 0 65535 ECU_ADDRESS 0xFFFFB41E /begin FUNCTION_LIST /end FUNCTION_LIST /end MEASUREMENT
/begin MEASUREMENT vVTCBAK_C#5_R#18 "FMP parameter BACKUPMAP" UWORD COMP_0068 1 100 0 65535 ECU_ADDRESS 0xFFFFB420 /begin FUNCTION_LIST /end FUNCTION_LIST /end MEASUREMENT
/begin MEASUREMENT vVTCBAK_C#5_R#19 "FMP parameter BACKUPMAP" UWORD COMP_0068 1 100 0 65535 ECU_ADDRESS 0xFFFFB422 /begin FUNCTION_LIST /end FUNCTION_LIST /end MEASUREMENT
/begin MEASUREMENT vVTCBAK_C#5_R#20 "FMP parameter BACKUPMAP" UWORD COMP_0068 1 100 0 65535 ECU_ADDRESS 0xFFFFB424 /begin FUNCTION_LIST /end FUNCTION_LIST /end MEASUREMENT
/begin MEASUREMENT vVTCBAK_C#5_R#21 "FMP parameter BACKUPMAP" UWORD COMP_0068 1 100 0 65535 ECU_ADDRESS 0xFFFFB426 /begin FUNCTION_LIST /end FUNCTION_LIST /end MEASUREMENT
/begin MEASUREMENT vVTCBAK_C#5_R#22 "FMP parameter BACKUPMAP" UWORD COMP_0068 1 100 0 65535 ECU_ADDRESS 0xFFFFB428 /begin FUNCTION_LIST /end FUNCTION_LIST /end MEASUREMENT
/begin MEASUREMENT vVTCBAK_C#5_R#23 "FMP parameter BACKUPMAP" UWORD COMP_0068 1 100 0 65535 ECU_ADDRESS 0xFFFFB42A /begin FUNCTION_LIST /end FUNCTION_LIST /end MEASUREMENT
/begin MEASUREMENT vVTCBAK_C#5_R#24 "FMP parameter BACKUPMAP" UWORD COMP_0068 1 100 0 65535 ECU_ADDRESS 0xFFFFB42C /begin FUNCTION_LIST /end FUNCTION_LIST /end MEASUREMENT
/begin MEASUREMENT vVTCBAK_C#5_R#25 "FMP parameter BACKUPMAP" UWORD COMP_0068 1 100 0 65535 ECU_ADDRESS 0xFFFFB42E /begin FUNCTION_LIST /end FUNCTION_LIST /end MEASUREMENT
/begin MEASUREMENT vVTCBAK_C#5_R#26 "FMP parameter BACKUPMAP" UWORD COMP_0068 1 100 0 65535 ECU_ADDRESS 0xFFFFB430 /begin FUNCTION_LIST /end FUNCTION_LIST /end MEASUREMENT
/begin MEASUREMENT vVTCBAK_C#5_R#27 "FMP parameter BACKUPMAP" UWORD COMP_0068 1 100 0 65535 ECU_ADDRESS 0xFFFFB432 /begin FUNCTION_LIST /end FUNCTION_LIST /end MEASUREMENT
/begin MEASUREMENT vVTCBAK_C#5_R#28 "FMP parameter BACKUPMAP" UWORD COMP_0068 1 100 0 65535 ECU_ADDRESS 0xFFFFB434 /begin FUNCTION_LIST /end FUNCTION_LIST /end MEASUREMENT
/begin MEASUREMENT vVTCBAK_C#5_R#29 "FMP parameter BACKUPMAP" UWORD COMP_0068 1 100 0 65535 ECU_ADDRESS 0xFFFFB436 /begin FUNCTION_LIST /end FUNCTION_LIST /end MEASUREMENT
/begin MEASUREMENT vVTCBAK_C#5_R#30 "FMP parameter BACKUPMAP" UWORD COMP_0068 1 100 0 65535 ECU_ADDRESS 0xFFFFB438 /begin FUNCTION_LIST /end FUNCTION_LIST /end MEASUREMENT
/begin MEASUREMENT vVTCBAK_C#5_R#31 "FMP parameter BACKUPMAP" UWORD COMP_0068 1 100 0 65535 ECU_ADDRESS 0xFFFFB43A /begin FUNCTION_LIST /end FUNCTION_LIST /end MEASUREMENT
/begin MEASUREMENT vVTCBAK_C#5_R#32 "FMP parameter BACKUPMAP" UWORD COMP_0068 1 100 0 65535 ECU_ADDRESS 0xFFFFB43C /begin FUNCTION_LIST /end FUNCTION_LIST /end MEASUREMENT
/begin MEASUREMENT vVTCBAK_C#5_R#33 "FMP parameter BACKUPMAP" UWORD COMP_0068 1 100 0 65535 ECU_ADDRESS 0xFFFFB43E /begin FUNCTION_LIST /end FUNCTION_LIST /end MEASUREMENT
/begin MEASUREMENT vVTCBAK_C#5_R#34 "FMP parameter BACKUPMAP" UWORD COMP_0068 1 100 0 65535 ECU_ADDRESS 0xFFFFB440 /begin FUNCTION_LIST /end FUNCTION_LIST /end MEASUREMENT
/begin MEASUREMENT vVTCBAK_C#5_R#35 "FMP parameter BACKUPMAP" UWORD COMP_0068 1 100 0 65535 ECU_ADDRESS 0xFFFFB442 /begin FUNCTION_LIST /end FUNCTION_LIST /end MEASUREMENT
/begin MEASUREMENT vVTCBAK_C#6_R#1 "FMP parameter BACKUPMAP" UWORD COMP_0068 1 100 0 65535 ECU_ADDRESS 0xFFFFB444 /begin FUNCTION_LIST /end FUNCTION_LIST /end MEASUREMENT
/begin MEASUREMENT vVTCBAK_C#6_R#2 "FMP parameter BACKUPMAP" UWORD COMP_0068 1 100 0 65535 ECU_ADDRESS 0xFFFFB446 /begin FUNCTION_LIST /end FUNCTION_LIST /end MEASUREMENT
/begin MEASUREMENT vVTCBAK_C#6_R#3 "FMP parameter BACKUPMAP" UWORD COMP_0068 1 100 0 65535 ECU_ADDRESS 0xFFFFB448 /begin FUNCTION_LIST /end FUNCTION_LIST /end MEASUREMENT
/begin MEASUREMENT vVTCBAK_C#6_R#4 "FMP parameter BACKUPMAP" UWORD COMP_0068 1 100 0 65535 ECU_ADDRESS 0xFFFFB44A /begin FUNCTION_LIST /end FUNCTION_LIST /end MEASUREMENT
/begin MEASUREMENT vVTCBAK_C#6_R#5 "FMP parameter BACKUPMAP" UWORD COMP_0068 1 100 0 65535 ECU_ADDRESS 0xFFFFB44C /begin FUNCTION_LIST /end FUNCTION_LIST /end MEASUREMENT
/begin MEASUREMENT vVTCBAK_C#6_R#6 "FMP parameter BACKUPMAP" UWORD COMP_0068 1 100 0 65535 ECU_ADDRESS 0xFFFFB44E /begin FUNCTION_LIST /end FUNCTION_LIST /end MEASUREMENT
/begin MEASUREMENT vVTCBAK_C#6_R#7 "FMP parameter BACKUPMAP" UWORD COMP_0068 1 100 0 65535 ECU_ADDRESS 0xFFFFB450 /begin FUNCTION_LIST /end FUNCTION_LIST /end MEASUREMENT
/begin MEASUREMENT vVTCBAK_C#6_R#8 "FMP parameter BACKUPMAP" UWORD COMP_0068 1 100 0 65535 ECU_ADDRESS 0xFFFFB452 /begin FUNCTION_LIST /end FUNCTION_LIST /end MEASUREMENT
/begin MEASUREMENT vVTCBAK_C#6_R#9 "FMP parameter BACKUPMAP" UWORD COMP_0068 1 100 0 65535 ECU_ADDRESS 0xFFFFB454 /begin FUNCTION_LIST /end FUNCTION_LIST /end MEASUREMENT
/begin MEASUREMENT vVTCBAK_C#6_R#10 "FMP parameter BACKUPMAP" UWORD COMP_0068 1 100 0 65535 ECU_ADDRESS 0xFFFFB456 /begin FUNCTION_LIST /end FUNCTION_LIST /end MEASUREMENT
/begin MEASUREMENT vVTCBAK_C#6_R#11 "FMP parameter BACKUPMAP" UWORD COMP_0068 1 100 0 65535 ECU_ADDRESS 0xFFFFB458 /begin FUNCTION_LIST /end FUNCTION_LIST /end MEASUREMENT
/begin MEASUREMENT vVTCBAK_C#6_R#12 "FMP parameter BACKUPMAP" UWORD COMP_0068 1 100 0 65535 ECU_ADDRESS 0xFFFFB45A /begin FUNCTION_LIST /end FUNCTION_LIST /end MEASUREMENT
/begin MEASUREMENT vVTCBAK_C#6_R#13 "FMP parameter BACKUPMAP" UWORD COMP_0068 1 100 0 65535 ECU_ADDRESS 0xFFFFB45C /begin FUNCTION_LIST /end FUNCTION_LIST /end MEASUREMENT
/begin MEASUREMENT vVTCBAK_C#6_R#14 "FMP parameter BACKUPMAP" UWORD COMP_0068 1 100 0 65535 ECU_ADDRESS 0xFFFFB45E /begin FUNCTION_LIST /end FUNCTION_LIST /end MEASUREMENT
/begin MEASUREMENT vVTCBAK_C#6_R#15 "FMP parameter BACKUPMAP" UWORD COMP_0068 1 100 0 65535 ECU_ADDRESS 0xFFFFB460 /begin FUNCTION_LIST /end FUNCTION_LIST /end MEASUREMENT
/begin MEASUREMENT vVTCBAK_C#6_R#16 "FMP parameter BACKUPMAP" UWORD COMP_0068 1 100 0 65535 ECU_ADDRESS 0xFFFFB462 /begin FUNCTION_LIST /end FUNCTION_LIST /end MEASUREMENT
/begin MEASUREMENT vVTCBAK_C#6_R#17 "FMP parameter BACKUPMAP" UWORD COMP_0068 1 100 0 65535 ECU_ADDRESS 0xFFFFB464 /begin FUNCTION_LIST /end FUNCTION_LIST /end MEASUREMENT
/begin MEASUREMENT vVTCBAK_C#6_R#18 "FMP parameter BACKUPMAP" UWORD COMP_0068 1 100 0 65535 ECU_ADDRESS 0xFFFFB466 /begin FUNCTION_LIST /end FUNCTION_LIST /end MEASUREMENT
/begin MEASUREMENT vVTCBAK_C#6_R#19 "FMP parameter BACKUPMAP" UWORD COMP_0068 1 100 0 65535 ECU_ADDRESS 0xFFFFB468 /begin FUNCTION_LIST /end FUNCTION_LIST /end MEASUREMENT
/begin MEASUREMENT vVTCBAK_C#6_R#20 "FMP parameter BACKUPMAP" UWORD COMP_0068 1 100 0 65535 ECU_ADDRESS 0xFFFFB46A /begin FUNCTION_LIST /end FUNCTION_LIST /end MEASUREMENT
/begin MEASUREMENT vVTCBAK_C#6_R#21 "FMP parameter BACKUPMAP" UWORD COMP_0068 1 100 0 65535 ECU_ADDRESS 0xFFFFB46C /begin FUNCTION_LIST /end FUNCTION_LIST /end MEASUREMENT
/begin MEASUREMENT vVTCBAK_C#6_R#22 "FMP parameter BACKUPMAP" UWORD COMP_0068 1 100 0 65535 ECU_ADDRESS 0xFFFFB46E /begin FUNCTION_LIST /end FUNCTION_LIST /end MEASUREMENT
/begin MEASUREMENT vVTCBAK_C#6_R#23 "FMP parameter BACKUPMAP" UWORD COMP_0068 1 100 0 65535 ECU_ADDRESS 0xFFFFB470 /begin FUNCTION_LIST /end FUNCTION_LIST /end MEASUREMENT
/begin MEASUREMENT vVTCBAK_C#6_R#24 "FMP parameter BACKUPMAP" UWORD COMP_0068 1 100 0 65535 ECU_ADDRESS 0xFFFFB472 /begin FUNCTION_LIST /end FUNCTION_LIST /end MEASUREMENT
/begin MEASUREMENT vVTCBAK_C#6_R#25 "FMP parameter BACKUPMAP" UWORD COMP_0068 1 100 0 65535 ECU_ADDRESS 0xFFFFB474 /begin FUNCTION_LIST /end FUNCTION_LIST /end MEASUREMENT
/begin MEASUREMENT vVTCBAK_C#6_R#26 "FMP parameter BACKUPMAP" UWORD COMP_0068 1 100 0 65535 ECU_ADDRESS 0xFFFFB476 /begin FUNCTION_LIST /end FUNCTION_LIST /end MEASUREMENT
/begin MEASUREMENT vVTCBAK_C#6_R#27 "FMP parameter BACKUPMAP" UWORD COMP_0068 1 100 0 65535 ECU_ADDRESS 0xFFFFB478 /begin FUNCTION_LIST /end FUNCTION_LIST /end MEASUREMENT
/begin MEASUREMENT vVTCBAK_C#6_R#28 "FMP parameter BACKUPMAP" UWORD COMP_0068 1 100 0 65535 ECU_ADDRESS 0xFFFFB47A /begin FUNCTION_LIST /end FUNCTION_LIST /end MEASUREMENT
/begin MEASUREMENT vVTCBAK_C#6_R#29 "FMP parameter BACKUPMAP" UWORD COMP_0068 1 100 0 65535 ECU_ADDRESS 0xFFFFB47C /begin FUNCTION_LIST /end FUNCTION_LIST /end MEASUREMENT
/begin MEASUREMENT vVTCBAK_C#6_R#30 "FMP parameter BACKUPMAP" UWORD COMP_0068 1 100 0 65535 ECU_ADDRESS 0xFFFFB47E /begin FUNCTION_LIST /end FUNCTION_LIST /end MEASUREMENT
/begin MEASUREMENT vVTCBAK_C#6_R#31 "FMP parameter BACKUPMAP" UWORD COMP_0068 1 100 0 65535 ECU_ADDRESS 0xFFFFB480 /begin FUNCTION_LIST /end FUNCTION_LIST /end MEASUREMENT
/begin MEASUREMENT vVTCBAK_C#6_R#32 "FMP parameter BACKUPMAP" UWORD COMP_0068 1 100 0 65535 ECU_ADDRESS 0xFFFFB482 /begin FUNCTION_LIST /end FUNCTION_LIST /end MEASUREMENT
/begin MEASUREMENT vVTCBAK_C#6_R#33 "FMP parameter BACKUPMAP" UWORD COMP_0068 1 100 0 65535 ECU_ADDRESS 0xFFFFB484 /begin FUNCTION_LIST /end FUNCTION_LIST /end MEASUREMENT
/begin MEASUREMENT vVTCBAK_C#6_R#34 "FMP parameter BACKUPMAP" UWORD COMP_0068 1 100 0 65535 ECU_ADDRESS 0xFFFFB486 /begin FUNCTION_LIST /end FUNCTION_LIST /end MEASUREMENT
/begin MEASUREMENT vVTCBAK_C#6_R#35 "FMP parameter BACKUPMAP" UWORD COMP_0068 1 100 0 65535 ECU_ADDRESS 0xFFFFB488 /begin FUNCTION_LIST /end FUNCTION_LIST /end MEASUREMENT
/begin MEASUREMENT vVTCBAK_C#7_R#1 "FMP parameter BACKUPMAP" UWORD COMP_0068 1 100 0 65535 ECU_ADDRESS 0xFFFFB48A /begin FUNCTION_LIST /end FUNCTION_LIST /end MEASUREMENT
/begin MEASUREMENT vVTCBAK_C#7_R#2 "FMP parameter BACKUPMAP" UWORD COMP_0068 1 100 0 65535 ECU_ADDRESS 0xFFFFB48C /begin FUNCTION_LIST /end FUNCTION_LIST /end MEASUREMENT
/begin MEASUREMENT vVTCBAK_C#7_R#3 "FMP parameter BACKUPMAP" UWORD COMP_0068 1 100 0 65535 ECU_ADDRESS 0xFFFFB48E /begin FUNCTION_LIST /end FUNCTION_LIST /end MEASUREMENT
/begin MEASUREMENT vVTCBAK_C#7_R#4 "FMP parameter BACKUPMAP" UWORD COMP_0068 1 100 0 65535 ECU_ADDRESS 0xFFFFB490 /begin FUNCTION_LIST /end FUNCTION_LIST /end MEASUREMENT
/begin MEASUREMENT vVTCBAK_C#7_R#5 "FMP parameter BACKUPMAP" UWORD COMP_0068 1 100 0 65535 ECU_ADDRESS 0xFFFFB492 /begin FUNCTION_LIST /end FUNCTION_LIST /end MEASUREMENT
/begin MEASUREMENT vVTCBAK_C#7_R#6 "FMP parameter BACKUPMAP" UWORD COMP_0068 1 100 0 65535 ECU_ADDRESS 0xFFFFB494 /begin FUNCTION_LIST /end FUNCTION_LIST /end MEASUREMENT
/begin MEASUREMENT vVTCBAK_C#7_R#7 "FMP parameter BACKUPMAP" UWORD COMP_0068 1 100 0 65535 ECU_ADDRESS 0xFFFFB496 /begin FUNCTION_LIST /end FUNCTION_LIST /end MEASUREMENT
/begin MEASUREMENT vVTCBAK_C#7_R#8 "FMP parameter BACKUPMAP" UWORD COMP_0068 1 100 0 65535 ECU_ADDRESS 0xFFFFB498 /begin FUNCTION_LIST /end FUNCTION_LIST /end MEASUREMENT
/begin MEASUREMENT vVTCBAK_C#7_R#9 "FMP parameter BACKUPMAP" UWORD COMP_0068 1 100 0 65535 ECU_ADDRESS 0xFFFFB49A /begin FUNCTION_LIST /end FUNCTION_LIST /end MEASUREMENT
/begin MEASUREMENT vVTCBAK_C#7_R#10 "FMP parameter BACKUPMAP" UWORD COMP_0068 1 100 0 65535 ECU_ADDRESS 0xFFFFB49C /begin FUNCTION_LIST /end FUNCTION_LIST /end MEASUREMENT
/begin MEASUREMENT vVTCBAK_C#7_R#11 "FMP parameter BACKUPMAP" UWORD COMP_0068 1 100 0 65535 ECU_ADDRESS 0xFFFFB49E /begin FUNCTION_LIST /end FUNCTION_LIST /end MEASUREMENT
/begin MEASUREMENT vVTCBAK_C#7_R#12 "FMP parameter BACKUPMAP" UWORD COMP_0068 1 100 0 65535 ECU_ADDRESS 0xFFFFB4A0 /begin FUNCTION_LIST /end FUNCTION_LIST /end MEASUREMENT
/begin MEASUREMENT vVTCBAK_C#7_R#13 "FMP parameter BACKUPMAP" UWORD COMP_0068 1 100 0 65535 ECU_ADDRESS 0xFFFFB4A2 /begin FUNCTION_LIST /end FUNCTION_LIST /end MEASUREMENT
/begin MEASUREMENT vVTCBAK_C#7_R#14 "FMP parameter BACKUPMAP" UWORD COMP_0068 1 100 0 65535 ECU_ADDRESS 0xFFFFB4A4 /begin FUNCTION_LIST /end FUNCTION_LIST /end MEASUREMENT
/begin MEASUREMENT vVTCBAK_C#7_R#15 "FMP parameter BACKUPMAP" UWORD COMP_0068 1 100 0 65535 ECU_ADDRESS 0xFFFFB4A6 /begin FUNCTION_LIST /end FUNCTION_LIST /end MEASUREMENT
/begin MEASUREMENT vVTCBAK_C#7_R#16 "FMP parameter BACKUPMAP" UWORD COMP_0068 1 100 0 65535 ECU_ADDRESS 0xFFFFB4A8 /begin FUNCTION_LIST /end FUNCTION_LIST /end MEASUREMENT
/begin MEASUREMENT vVTCBAK_C#7_R#17 "FMP parameter BACKUPMAP" UWORD COMP_0068 1 100 0 65535 ECU_ADDRESS 0xFFFFB4AA /begin FUNCTION_LIST /end FUNCTION_LIST /end MEASUREMENT
/begin MEASUREMENT vVTCBAK_C#7_R#18 "FMP parameter BACKUPMAP" UWORD COMP_0068 1 100 0 65535 ECU_ADDRESS 0xFFFFB4AC /begin FUNCTION_LIST /end FUNCTION_LIST /end MEASUREMENT
/begin MEASUREMENT vVTCBAK_C#7_R#19 "FMP parameter BACKUPMAP" UWORD COMP_0068 1 100 0 65535 ECU_ADDRESS 0xFFFFB4AE /begin FUNCTION_LIST /end FUNCTION_LIST /end MEASUREMENT
/begin MEASUREMENT vVTCBAK_C#7_R#20 "FMP parameter BACKUPMAP" UWORD COMP_0068 1 100 0 65535 ECU_ADDRESS 0xFFFFB4B0 /begin FUNCTION_LIST /end FUNCTION_LIST /end MEASUREMENT
/begin MEASUREMENT vVTCBAK_C#7_R#21 "FMP parameter BACKUPMAP" UWORD COMP_0068 1 100 0 65535 ECU_ADDRESS 0xFFFFB4B2 /begin FUNCTION_LIST /end FUNCTION_LIST /end MEASUREMENT
/begin MEASUREMENT vVTCBAK_C#7_R#22 "FMP parameter BACKUPMAP" UWORD COMP_0068 1 100 0 65535 ECU_ADDRESS 0xFFFFB4B4 /begin FUNCTION_LIST /end FUNCTION_LIST /end MEASUREMENT
/begin MEASUREMENT vVTCBAK_C#7_R#23 "FMP parameter BACKUPMAP" UWORD COMP_0068 1 100 0 65535 ECU_ADDRESS 0xFFFFB4B6 /begin FUNCTION_LIST /end FUNCTION_LIST /end MEASUREMENT
/begin MEASUREMENT vVTCBAK_C#7_R#24 "FMP parameter BACKUPMAP" UWORD COMP_0068 1 100 0 65535 ECU_ADDRESS 0xFFFFB4B8 /begin FUNCTION_LIST /end FUNCTION_LIST /end MEASUREMENT
/begin MEASUREMENT vVTCBAK_C#7_R#25 "FMP parameter BACKUPMAP" UWORD COMP_0068 1 100 0 65535 ECU_ADDRESS 0xFFFFB4BA /begin FUNCTION_LIST /end FUNCTION_LIST /end MEASUREMENT
/begin MEASUREMENT vVTCBAK_C#7_R#26 "FMP parameter BACKUPMAP" UWORD COMP_0068 1 100 0 65535 ECU_ADDRESS 0xFFFFB4BC /begin FUNCTION_LIST /end FUNCTION_LIST /end MEASUREMENT
/begin MEASUREMENT vVTCBAK_C#7_R#27 "FMP parameter BACKUPMAP" UWORD COMP_0068 1 100 0 65535 ECU_ADDRESS 0xFFFFB4BE /begin FUNCTION_LIST /end FUNCTION_LIST /end MEASUREMENT
/begin MEASUREMENT vVTCBAK_C#7_R#28 "FMP parameter BACKUPMAP" UWORD COMP_0068 1 100 0 65535 ECU_ADDRESS 0xFFFFB4C0 /begin FUNCTION_LIST /end FUNCTION_LIST /end MEASUREMENT
/begin MEASUREMENT vVTCBAK_C#7_R#29 "FMP parameter BACKUPMAP" UWORD COMP_0068 1 100 0 65535 ECU_ADDRESS 0xFFFFB4C2 /begin FUNCTION_LIST /end FUNCTION_LIST /end MEASUREMENT
/begin MEASUREMENT vVTCBAK_C#7_R#30 "FMP parameter BACKUPMAP" UWORD COMP_0068 1 100 0 65535 ECU_ADDRESS 0xFFFFB4C4 /begin FUNCTION_LIST /end FUNCTION_LIST /end MEASUREMENT
/begin MEASUREMENT vVTCBAK_C#7_R#31 "FMP parameter BACKUPMAP" UWORD COMP_0068 1 100 0 65535 ECU_ADDRESS 0xFFFFB4C6 /begin FUNCTION_LIST /end FUNCTION_LIST /end MEASUREMENT
/begin MEASUREMENT vVTCBAK_C#7_R#32 "FMP parameter BACKUPMAP" UWORD COMP_0068 1 100 0 65535 ECU_ADDRESS 0xFFFFB4C8 /begin FUNCTION_LIST /end FUNCTION_LIST /end MEASUREMENT
/begin MEASUREMENT vVTCBAK_C#7_R#33 "FMP parameter BACKUPMAP" UWORD COMP_0068 1 100 0 65535 ECU_ADDRESS 0xFFFFB4CA /begin FUNCTION_LIST /end FUNCTION_LIST /end MEASUREMENT
/begin MEASUREMENT vVTCBAK_C#7_R#34 "FMP parameter BACKUPMAP" UWORD COMP_0068 1 100 0 65535 ECU_ADDRESS 0xFFFFB4CC /begin FUNCTION_LIST /end FUNCTION_LIST /end MEASUREMENT
/begin MEASUREMENT vVTCBAK_C#7_R#35 "FMP parameter BACKUPMAP" UWORD COMP_0068 1 100 0 65535 ECU_ADDRESS 0xFFFFB4CE /begin FUNCTION_LIST /end FUNCTION_LIST /end MEASUREMENT
/begin MEASUREMENT vVTCBAK_C#8_R#1 "FMP parameter BACKUPMAP" UWORD COMP_0068 1 100 0 65535 ECU_ADDRESS 0xFFFFB4D0 /begin FUNCTION_LIST /end FUNCTION_LIST /end MEASUREMENT
/begin MEASUREMENT vVTCBAK_C#8_R#2 "FMP parameter BACKUPMAP" UWORD COMP_0068 1 100 0 65535 ECU_ADDRESS 0xFFFFB4D2 /begin FUNCTION_LIST /end FUNCTION_LIST /end MEASUREMENT
/begin MEASUREMENT vVTCBAK_C#8_R#3 "FMP parameter BACKUPMAP" UWORD COMP_0068 1 100 0 65535 ECU_ADDRESS 0xFFFFB4D4 /begin FUNCTION_LIST /end FUNCTION_LIST /end MEASUREMENT
/begin MEASUREMENT vVTCBAK_C#8_R#4 "FMP parameter BACKUPMAP" UWORD COMP_0068 1 100 0 65535 ECU_ADDRESS 0xFFFFB4D6 /begin FUNCTION_LIST /end FUNCTION_LIST /end MEASUREMENT
/begin MEASUREMENT vVTCBAK_C#8_R#5 "FMP parameter BACKUPMAP" UWORD COMP_0068 1 100 0 65535 ECU_ADDRESS 0xFFFFB4D8 /begin FUNCTION_LIST /end FUNCTION_LIST /end MEASUREMENT
/begin MEASUREMENT vVTCBAK_C#8_R#6 "FMP parameter BACKUPMAP" UWORD COMP_0068 1 100 0 65535 ECU_ADDRESS 0xFFFFB4DA /begin FUNCTION_LIST /end FUNCTION_LIST /end MEASUREMENT
/begin MEASUREMENT vVTCBAK_C#8_R#7 "FMP parameter BACKUPMAP" UWORD COMP_0068 1 100 0 65535 ECU_ADDRESS 0xFFFFB4DC /begin FUNCTION_LIST /end FUNCTION_LIST /end MEASUREMENT
/begin MEASUREMENT vVTCBAK_C#8_R#8 "FMP parameter BACKUPMAP" UWORD COMP_0068 1 100 0 65535 ECU_ADDRESS 0xFFFFB4DE /begin FUNCTION_LIST /end FUNCTION_LIST /end MEASUREMENT
/begin MEASUREMENT vVTCBAK_C#8_R#9 "FMP parameter BACKUPMAP" UWORD COMP_0068 1 100 0 65535 ECU_ADDRESS 0xFFFFB4E0 /begin FUNCTION_LIST /end FUNCTION_LIST /end MEASUREMENT
/begin MEASUREMENT vVTCBAK_C#8_R#10 "FMP parameter BACKUPMAP" UWORD COMP_0068 1 100 0 65535 ECU_ADDRESS 0xFFFFB4E2 /begin FUNCTION_LIST /end FUNCTION_LIST /end MEASUREMENT
/begin MEASUREMENT vVTCBAK_C#8_R#11 "FMP parameter BACKUPMAP" UWORD COMP_0068 1 100 0 65535 ECU_ADDRESS 0xFFFFB4E4 /begin FUNCTION_LIST /end FUNCTION_LIST /end MEASUREMENT
/begin MEASUREMENT vVTCBAK_C#8_R#12 "FMP parameter BACKUPMAP" UWORD COMP_0068 1 100 0 65535 ECU_ADDRESS 0xFFFFB4E6 /begin FUNCTION_LIST /end FUNCTION_LIST /end MEASUREMENT
/begin MEASUREMENT vVTCBAK_C#8_R#13 "FMP parameter BACKUPMAP" UWORD COMP_0068 1 100 0 65535 ECU_ADDRESS 0xFFFFB4E8 /begin FUNCTION_LIST /end FUNCTION_LIST /end MEASUREMENT
/begin MEASUREMENT vVTCBAK_C#8_R#14 "FMP parameter BACKUPMAP" UWORD COMP_0068 1 100 0 65535 ECU_ADDRESS 0xFFFFB4EA /begin FUNCTION_LIST /end FUNCTION_LIST /end MEASUREMENT
/begin MEASUREMENT vVTCBAK_C#8_R#15 "FMP parameter BACKUPMAP" UWORD COMP_0068 1 100 0 65535 ECU_ADDRESS 0xFFFFB4EC /begin FUNCTION_LIST /end FUNCTION_LIST /end MEASUREMENT
/begin MEASUREMENT vVTCBAK_C#8_R#16 "FMP parameter BACKUPMAP" UWORD COMP_0068 1 100 0 65535 ECU_ADDRESS 0xFFFFB4EE /begin FUNCTION_LIST /end FUNCTION_LIST /end MEASUREMENT
/begin MEASUREMENT vVTCBAK_C#8_R#17 "FMP parameter BACKUPMAP" UWORD COMP_0068 1 100 0 65535 ECU_ADDRESS 0xFFFFB4F0 /begin FUNCTION_LIST /end FUNCTION_LIST /end MEASUREMENT
/begin MEASUREMENT vVTCBAK_C#8_R#18 "FMP parameter BACKUPMAP" UWORD COMP_0068 1 100 0 65535 ECU_ADDRESS 0xFFFFB4F2 /begin FUNCTION_LIST /end FUNCTION_LIST /end MEASUREMENT
/begin MEASUREMENT vVTCBAK_C#8_R#19 "FMP parameter BACKUPMAP" UWORD COMP_0068 1 100 0 65535 ECU_ADDRESS 0xFFFFB4F4 /begin FUNCTION_LIST /end FUNCTION_LIST /end MEASUREMENT
/begin MEASUREMENT vVTCBAK_C#8_R#20 "FMP parameter BACKUPMAP" UWORD COMP_0068 1 100 0 65535 ECU_ADDRESS 0xFFFFB4F6 /begin FUNCTION_LIST /end FUNCTION_LIST /end MEASUREMENT
/begin MEASUREMENT vVTCBAK_C#8_R#21 "FMP parameter BACKUPMAP" UWORD COMP_0068 1 100 0 65535 ECU_ADDRESS 0xFFFFB4F8 /begin FUNCTION_LIST /end FUNCTION_LIST /end MEASUREMENT
/begin MEASUREMENT vVTCBAK_C#8_R#22 "FMP parameter BACKUPMAP" UWORD COMP_0068 1 100 0 65535 ECU_ADDRESS 0xFFFFB4FA /begin FUNCTION_LIST /end FUNCTION_LIST /end MEASUREMENT
/begin MEASUREMENT vVTCBAK_C#8_R#23 "FMP parameter BACKUPMAP" UWORD COMP_0068 1 100 0 65535 ECU_ADDRESS 0xFFFFB4FC /begin FUNCTION_LIST /end FUNCTION_LIST /end MEASUREMENT
/begin MEASUREMENT vVTCBAK_C#8_R#24 "FMP parameter BACKUPMAP" UWORD COMP_0068 1 100 0 65535 ECU_ADDRESS 0xFFFFB4FE /begin FUNCTION_LIST /end FUNCTION_LIST /end MEASUREMENT
/begin MEASUREMENT vVTCBAK_C#8_R#25 "FMP parameter BACKUPMAP" UWORD COMP_0068 1 100 0 65535 ECU_ADDRESS 0xFFFFB500 /begin FUNCTION_LIST /end FUNCTION_LIST /end MEASUREMENT
/begin MEASUREMENT vVTCBAK_C#8_R#26 "FMP parameter BACKUPMAP" UWORD COMP_0068 1 100 0 65535 ECU_ADDRESS 0xFFFFB502 /begin FUNCTION_LIST /end FUNCTION_LIST /end MEASUREMENT
/begin MEASUREMENT vVTCBAK_C#8_R#27 "FMP parameter BACKUPMAP" UWORD COMP_0068 1 100 0 65535 ECU_ADDRESS 0xFFFFB504 /begin FUNCTION_LIST /end FUNCTION_LIST /end MEASUREMENT
/begin MEASUREMENT vVTCBAK_C#8_R#28 "FMP parameter BACKUPMAP" UWORD COMP_0068 1 100 0 65535 ECU_ADDRESS 0xFFFFB506 /begin FUNCTION_LIST /end FUNCTION_LIST /end MEASUREMENT
/begin MEASUREMENT vVTCBAK_C#8_R#29 "FMP parameter BACKUPMAP" UWORD COMP_0068 1 100 0 65535 ECU_ADDRESS 0xFFFFB508 /begin FUNCTION_LIST /end FUNCTION_LIST /end MEASUREMENT
/begin MEASUREMENT vVTCBAK_C#8_R#30 "FMP parameter BACKUPMAP" UWORD COMP_0068 1 100 0 65535 ECU_ADDRESS 0xFFFFB50A /begin FUNCTION_LIST /end FUNCTION_LIST /end MEASUREMENT
/begin MEASUREMENT vVTCBAK_C#8_R#31 "FMP parameter BACKUPMAP" UWORD COMP_0068 1 100 0 65535 ECU_ADDRESS 0xFFFFB50C /begin FUNCTION_LIST /end FUNCTION_LIST /end MEASUREMENT
/begin MEASUREMENT vVTCBAK_C#8_R#32 "FMP parameter BACKUPMAP" UWORD COMP_0068 1 100 0 65535 ECU_ADDRESS 0xFFFFB50E /begin FUNCTION_LIST /end FUNCTION_LIST /end MEASUREMENT
/begin MEASUREMENT vVTCBAK_C#8_R#33 "FMP parameter BACKUPMAP" UWORD COMP_0068 1 100 0 65535 ECU_ADDRESS 0xFFFFB510 /begin FUNCTION_LIST /end FUNCTION_LIST /end MEASUREMENT
/begin MEASUREMENT vVTCBAK_C#8_R#34 "FMP parameter BACKUPMAP" UWORD COMP_0068 1 100 0 65535 ECU_ADDRESS 0xFFFFB512 /begin FUNCTION_LIST /end FUNCTION_LIST /end MEASUREMENT
/begin MEASUREMENT vVTCBAK_C#8_R#35 "FMP parameter BACKUPMAP" UWORD COMP_0068 1 100 0 65535 ECU_ADDRESS 0xFFFFB514 /begin FUNCTION_LIST /end FUNCTION_LIST /end MEASUREMENT
/begin MEASUREMENT vVTCBKCNT "BACKUP region counter" UBYTE COMP_0068 1 100 0 255 ECU_ADDRESS 0xFFFFB516 /begin FUNCTION_LIST /end FUNCTION_LIST /end MEASUREMENT
/begin MEASUREMENT vVTCD2 "The amount of D control" UBYTE COMP_0257 1 100 -128 127 ECU_ADDRESS 0xFFFF1AB1 /begin FUNCTION_LIST /end FUNCTION_LIST /end MEASUREMENT
/begin MEASUREMENT vVTCD2_R#1 "The amount of D control" UBYTE COMP_0257 1 100 -128 127 ECU_ADDRESS 0xFFFF1AB1 /begin FUNCTION_LIST /end FUNCTION_LIST /end MEASUREMENT
/begin MEASUREMENT vVTCD2_R#2 "The amount of D control" UBYTE COMP_0257 1 100 -128 127 ECU_ADDRESS 0xFFFF1AB2 /begin FUNCTION_LIST /end FUNCTION_LIST /end MEASUREMENT
/begin MEASUREMENT vVTCDBE "Base DUTY ratio" UWORD COMP_0038_S 1 100 -3200 3199.90234375 ECU_ADDRESS 0xFFFF1AB6 /begin FUNCTION_LIST /end FUNCTION_LIST /end MEASUREMENT
/begin MEASUREMENT vVTCDBE_R#1 "Base DUTY ratio" UWORD COMP_0038_S 1 100 -3200 3199.90234375 ECU_ADDRESS 0xFFFF1AB6 /begin FUNCTION_LIST /end FUNCTION_LIST /end MEASUREMENT
/begin MEASUREMENT vVTCDBE_R#2 "Base DUTY ratio" UWORD COMP_0038_S 1 100 -3200 3199.90234375 ECU_ADDRESS 0xFFFF1AB8 /begin FUNCTION_LIST /end FUNCTION_LIST /end MEASUREMENT
/begin MEASUREMENT vVTCDBI "Base DUTY ratio" UWORD COMP_0038_S 1 100 -3200 3199.90234375 ECU_ADDRESS 0xFFFF1ABA /begin FUNCTION_LIST /end FUNCTION_LIST /end MEASUREMENT
/begin MEASUREMENT vVTCDBI_R#1 "Base DUTY ratio" UWORD COMP_0038_S 1 100 -3200 3199.90234375 ECU_ADDRESS 0xFFFF1ABA /begin FUNCTION_LIST /end FUNCTION_LIST /end MEASUREMENT
/begin MEASUREMENT vVTCDBI_R#2 "Base DUTY ratio" UWORD COMP_0038_S 1 100 -3200 3199.90234375 ECU_ADDRESS 0xFFFF1ABC /begin FUNCTION_LIST /end FUNCTION_LIST /end MEASUREMENT
/begin MEASUREMENT vVTCDE "The amount of D control" UBYTE COMP_0256 1 100 -64 63.5 ECU_ADDRESS 0xFFFF1ABE /begin FUNCTION_LIST /end FUNCTION_LIST /end MEASUREMENT
/begin MEASUREMENT vVTCDE_R#1 "The amount of D control" UBYTE COMP_0256 1 100 -64 63.5 ECU_ADDRESS 0xFFFF1ABE /begin FUNCTION_LIST /end FUNCTION_LIST /end MEASUREMENT
/begin MEASUREMENT vVTCDE_R#2 "The amount of D control" UBYTE COMP_0256 1 100 -64 63.5 ECU_ADDRESS 0xFFFF1ABF /begin FUNCTION_LIST /end FUNCTION_LIST /end MEASUREMENT
/begin MEASUREMENT vVTCDFE "VTC feedback DUTY ratio (DUTY)" ULONG COMP_0649_S 1 100 -200.00052084736 6200.01614477804 ECU_ADDRESS 0xFFFF1AC4 /begin FUNCTION_LIST /end FUNCTION_LIST /end MEASUREMENT
/begin MEASUREMENT vVTCDFE_R#1 "VTC feedback DUTY ratio (DUTY)" ULONG COMP_0649_S 1 100 -200.00052084736 6200.01614477804 ECU_ADDRESS 0xFFFF1AC4 /begin FUNCTION_LIST /end FUNCTION_LIST /end MEASUREMENT
/begin MEASUREMENT vVTCDFE_R#2 "VTC feedback DUTY ratio (DUTY)" ULONG COMP_0649_S 1 100 -200.00052084736 6200.01614477804 ECU_ADDRESS 0xFFFF1AC8 /begin FUNCTION_LIST /end FUNCTION_LIST /end MEASUREMENT
/begin MEASUREMENT vVTCDFI "VTC feedback DUTY ratio (DUTY)" ULONG COMP_0649_S 1 100 -200.00052084736 6200.01614477804 ECU_ADDRESS 0xFFFF1ACC /begin FUNCTION_LIST /end FUNCTION_LIST /end MEASUREMENT
/begin MEASUREMENT vVTCDFI_R#1 "VTC feedback DUTY ratio (DUTY)" ULONG COMP_0649_S 1 100 -200.00052084736 6200.01614477804 ECU_ADDRESS 0xFFFF1ACC /begin FUNCTION_LIST /end FUNCTION_LIST /end MEASUREMENT
/begin MEASUREMENT vVTCDFI_R#2 "VTC feedback DUTY ratio (DUTY)" ULONG COMP_0649_S 1 100 -200.00052084736 6200.01614477804 ECU_ADDRESS 0xFFFF1AD0 /begin FUNCTION_LIST /end FUNCTION_LIST /end MEASUREMENT
/begin MEASUREMENT vVTCDG1_Sf "Diagnosis NG" UBYTE COMP_0004 1 100 0 255 ECU_ADDRESS 0xFFFF353C /begin FUNCTION_LIST /end FUNCTION_LIST /end MEASUREMENT
/begin MEASUREMENT vVTCDG2_Sf "Diagnosis NG" UBYTE COMP_0004 1 100 0 255 ECU_ADDRESS 0xFFFF353D /begin FUNCTION_LIST /end FUNCTION_LIST /end MEASUREMENT
/begin MEASUREMENT vVTCDG3ISf "VTC offset diagnosis permission condition judgement (for the idle)" UBYTE COMP_0004 1 100 0 255 ECU_ADDRESS 0xFFFF34A2 /begin FUNCTION_LIST /end FUNCTION_LIST /end MEASUREMENT
/begin MEASUREMENT vVTCDG3_Sf "Diagnosis NG" UBYTE COMP_0004 1 100 0 255 ECU_ADDRESS 0xFFFF353E /begin FUNCTION_LIST /end FUNCTION_LIST /end MEASUREMENT
/begin MEASUREMENT vVTCDG4_Sf "Diagnosis NG" UBYTE COMP_0004 1 100 0 255 ECU_ADDRESS 0xFFFF353F /begin FUNCTION_LIST /end FUNCTION_LIST /end MEASUREMENT
/begin MEASUREMENT vVTCDG5_Sf "Diagnosis NG" UBYTE COMP_0004 1 100 0 255 ECU_ADDRESS 0xFFFF3540 /begin FUNCTION_LIST /end FUNCTION_LIST /end MEASUREMENT
/begin MEASUREMENT vVTCDGE1f "Trouble breakage diagnosis NG (exhaust side)" UBYTE COMP_0004 1 100 0 255 ECU_ADDRESS 0xFFFF34A3 /begin FUNCTION_LIST /end FUNCTION_LIST /end MEASUREMENT
/begin MEASUREMENT vVTCDGE2f "Momentary-disconnection, noise diagnosis NG (exhaust side)" UBYTE COMP_0004 1 100 0 255 ECU_ADDRESS 0xFFFF34A4 /begin FUNCTION_LIST /end FUNCTION_LIST /end MEASUREMENT
/begin MEASUREMENT vVTCDGE3f "Diagnosis NG" UBYTE COMP_0004 1 100 0 255 ECU_ADDRESS 0xFFFF34A5 /begin FUNCTION_LIST /end FUNCTION_LIST /end MEASUREMENT
/begin MEASUREMENT vVTCDGE4f "Diagnosis NG" UBYTE COMP_0004 1 100 0 255 ECU_ADDRESS 0xFFFF34A6 /begin FUNCTION_LIST /end FUNCTION_LIST /end MEASUREMENT
/begin MEASUREMENT vVTCDGE5f "Diagnosis NG" UBYTE COMP_0004 1 100 0 255 ECU_ADDRESS 0xFFFF34A7 /begin FUNCTION_LIST /end FUNCTION_LIST /end MEASUREMENT
/begin MEASUREMENT vVTCDGI1f "Trouble breakage diagnosis NG (intake side)" UBYTE COMP_0004 1 100 0 255 ECU_ADDRESS 0xFFFF34A8 /begin FUNCTION_LIST /end FUNCTION_LIST /end MEASUREMENT
/begin MEASUREMENT vVTCDGI2f "Momentary-disconnection, noise diagnosis NG (intake side)" UBYTE COMP_0004 1 100 0 255 ECU_ADDRESS 0xFFFF34A9 /begin FUNCTION_LIST /end FUNCTION_LIST /end MEASUREMENT
/begin MEASUREMENT vVTCDGI3f "Diagnosis NG" UBYTE COMP_0004 1 100 0 255 ECU_ADDRESS 0xFFFF34AA /begin FUNCTION_LIST /end FUNCTION_LIST /end MEASUREMENT
/begin MEASUREMENT vVTCDGI4f "Diagnosis NG" UBYTE COMP_0004 1 100 0 255 ECU_ADDRESS 0xFFFF34AB /begin FUNCTION_LIST /end FUNCTION_LIST /end MEASUREMENT
/begin MEASUREMENT vVTCDGI5f "Diagnosis NG" UBYTE COMP_0004 1 100 0 255 ECU_ADDRESS 0xFFFF34AC /begin FUNCTION_LIST /end FUNCTION_LIST /end MEASUREMENT
/begin MEASUREMENT vVTCDGN1SE "RAM value vVTCDGN1SE" UBYTE COMP_0004 1 100 0 255 ECU_ADDRESS 0xFFFF426C /begin FUNCTION_LIST /end FUNCTION_LIST /end MEASUREMENT
/begin MEASUREMENT vVTCDGN1SI "RAM value vVTCDGN1SI" UBYTE COMP_0004 1 100 0 255 ECU_ADDRESS 0xFFFF426E /begin FUNCTION_LIST /end FUNCTION_LIST /end MEASUREMENT
/begin MEASUREMENT vVTCDGN1Sf "Diagnosis NG flag" UBYTE COMP_0004 1 100 0 255 ECU_ADDRESS 0xFFFF426D /begin FUNCTION_LIST /end FUNCTION_LIST /end MEASUREMENT
/begin MEASUREMENT vVTCDGN2SE "RAM value vVTCDGN2SE" UBYTE COMP_0004 1 100 0 255 ECU_ADDRESS 0xFFFF426F /begin FUNCTION_LIST /end FUNCTION_LIST /end MEASUREMENT
/begin MEASUREMENT vVTCDGN2SI "RAM value vVTCDGN2SI" UBYTE COMP_0004 1 100 0 255 ECU_ADDRESS 0xFFFF4271 /begin FUNCTION_LIST /end FUNCTION_LIST /end MEASUREMENT
/begin MEASUREMENT vVTCDGN2Sf "Diagnosis NG flag" UBYTE COMP_0004 1 100 0 255 ECU_ADDRESS 0xFFFF4270 /begin FUNCTION_LIST /end FUNCTION_LIST /end MEASUREMENT
/begin MEASUREMENT vVTCDGN2f "VTC drive diagnosis condition formation" UBYTE COMP_0004 1 100 0 255 ECU_ADDRESS 0xFFFF34AD /begin FUNCTION_LIST /end FUNCTION_LIST /end MEASUREMENT
/begin MEASUREMENT vVTCDGN3Sf "VTC offset diagnosis permission condition judgement" UBYTE COMP_0004 1 100 0 255 ECU_ADDRESS 0xFFFF34AE /begin FUNCTION_LIST /end FUNCTION_LIST /end MEASUREMENT
/begin MEASUREMENT vVTCDGN4Sf "VTC drive abnormality diagnosis permission condition judgement" UBYTE COMP_0004 1 100 0 255 ECU_ADDRESS 0xFFFF34AF /begin FUNCTION_LIST /end FUNCTION_LIST /end MEASUREMENT
/begin MEASUREMENT vVTCDGN5Ef "VTC solenoid, usually, diagnosis condition formation" UBYTE COMP_0004 1 100 0 255 ECU_ADDRESS 0xFFFF26EC /begin FUNCTION_LIST /end FUNCTION_LIST /end MEASUREMENT
/begin MEASUREMENT vVTCDGN5f "VTC solenoid, usually, diagnosis condition formation" UBYTE COMP_0004 1 100 0 255 ECU_ADDRESS 0xFFFF26ED /begin FUNCTION_LIST /end FUNCTION_LIST /end MEASUREMENT
/begin MEASUREMENT vVTCDGN6f "VTC solenoid SSOFF éû diagnosis condition formation" UBYTE COMP_0004 1 100 0 255 ECU_ADDRESS 0xFFFF26EE /begin FUNCTION_LIST /end FUNCTION_LIST /end MEASUREMENT
/begin MEASUREMENT vVTCDGNf "VTC drive diagnosis condition formation" UBYTE COMP_0004 1 100 0 255 ECU_ADDRESS 0xFFFF34B0 /begin FUNCTION_LIST /end FUNCTION_LIST /end MEASUREMENT
/begin MEASUREMENT vVTCDHE "VTC hysteresis DUTY ratio" UWORD COMP_0038_S 1 100 -3200 3199.90234375 ECU_ADDRESS 0xFFFF1AD4 /begin FUNCTION_LIST /end FUNCTION_LIST /end MEASUREMENT
/begin MEASUREMENT vVTCDHE_R#1 "VTC hysteresis DUTY ratio" UWORD COMP_0038_S 1 100 -3200 3199.90234375 ECU_ADDRESS 0xFFFF1AD4 /begin FUNCTION_LIST /end FUNCTION_LIST /end MEASUREMENT
/begin MEASUREMENT vVTCDHE_R#2 "VTC hysteresis DUTY ratio" UWORD COMP_0038_S 1 100 -3200 3199.90234375 ECU_ADDRESS 0xFFFF1AD6 /begin FUNCTION_LIST /end FUNCTION_LIST /end MEASUREMENT
/begin MEASUREMENT vVTCDHI "VTC hysteresis DUTY ratio" UWORD COMP_0038_S 1 100 -3200 3199.90234375 ECU_ADDRESS 0xFFFF1AD8 /begin FUNCTION_LIST /end FUNCTION_LIST /end MEASUREMENT
/begin MEASUREMENT vVTCDHI_R#1 "VTC hysteresis DUTY ratio" UWORD COMP_0038_S 1 100 -3200 3199.90234375 ECU_ADDRESS 0xFFFF1AD8 /begin FUNCTION_LIST /end FUNCTION_LIST /end MEASUREMENT
/begin MEASUREMENT vVTCDHI_R#2 "VTC hysteresis DUTY ratio" UWORD COMP_0038_S 1 100 -3200 3199.90234375 ECU_ADDRESS 0xFFFF1ADA /begin FUNCTION_LIST /end FUNCTION_LIST /end MEASUREMENT
/begin MEASUREMENT vVTCDI "The amount of D control" UBYTE COMP_0256 1 100 -64 63.5 ECU_ADDRESS 0xFFFF1ADC /begin FUNCTION_LIST /end FUNCTION_LIST /end MEASUREMENT
/begin MEASUREMENT vVTCDI_R#1 "The amount of D control" UBYTE COMP_0256 1 100 -64 63.5 ECU_ADDRESS 0xFFFF1ADC /begin FUNCTION_LIST /end FUNCTION_LIST /end MEASUREMENT
/begin MEASUREMENT vVTCDI_R#2 "The amount of D control" UBYTE COMP_0256 1 100 -64 63.5 ECU_ADDRESS 0xFFFF1ADD /begin FUNCTION_LIST /end FUNCTION_LIST /end MEASUREMENT
/begin MEASUREMENT vVTCDTYE "Clutch solenoid drive DUTY ratio (battery voltage compensation value)" ULONG COMP_0650_S 1 100 0 6400.0166656254 ECU_ADDRESS 0xFFFF1AE8 /begin FUNCTION_LIST /end FUNCTION_LIST /end MEASUREMENT
/begin MEASUREMENT vVTCDTYE_R#1 "Clutch solenoid drive DUTY ratio (battery voltage compensation value)" ULONG COMP_0650_S 1 100 0 6400.0166656254 ECU_ADDRESS 0xFFFF1AE8 /begin FUNCTION_LIST /end FUNCTION_LIST /end MEASUREMENT
/begin MEASUREMENT vVTCDTYE_R#2 "Clutch solenoid drive DUTY ratio (battery voltage compensation value)" ULONG COMP_0650_S 1 100 0 6400.0166656254 ECU_ADDRESS 0xFFFF1AEC /begin FUNCTION_LIST /end FUNCTION_LIST /end MEASUREMENT
/begin MEASUREMENT vVTCDTYI "Clutch solenoid drive DUTY ratio (battery voltage compensation value)" ULONG COMP_0650_S 1 100 0 6400.0166656254 ECU_ADDRESS 0xFFFF1AF0 /begin FUNCTION_LIST /end FUNCTION_LIST /end MEASUREMENT
/begin MEASUREMENT vVTCDTYI_R#1 "Clutch solenoid drive DUTY ratio (battery voltage compensation value)" ULONG COMP_0650_S 1 100 0 6400.0166656254 ECU_ADDRESS 0xFFFF1AF0 /begin FUNCTION_LIST /end FUNCTION_LIST /end MEASUREMENT
/begin MEASUREMENT vVTCDTYI_R#2 "Clutch solenoid drive DUTY ratio (battery voltage compensation value)" ULONG COMP_0650_S 1 100 0 6400.0166656254 ECU_ADDRESS 0xFFFF1AF4 /begin FUNCTION_LIST /end FUNCTION_LIST /end MEASUREMENT
/begin MEASUREMENT vVTCERRE "The amount of VTC operation angle deviation" UBYTE COMP_0256 1 100 -64 63.5 ECU_ADDRESS 0xFFFF1040 /begin FUNCTION_LIST /end FUNCTION_LIST /end MEASUREMENT
/begin MEASUREMENT vVTCERRE_R#1 "The amount of VTC operation angle deviation" UBYTE COMP_0256 1 100 -64 63.5 ECU_ADDRESS 0xFFFF1040 /begin FUNCTION_LIST /end FUNCTION_LIST /end MEASUREMENT
/begin MEASUREMENT vVTCERRE_R#2 "The amount of VTC operation angle deviation" UBYTE COMP_0256 1 100 -64 63.5 ECU_ADDRESS 0xFFFF1041 /begin FUNCTION_LIST /end FUNCTION_LIST /end MEASUREMENT
/begin MEASUREMENT vVTCERRI "The amount of VTC operation angle deviation" UBYTE COMP_0256 1 100 -64 63.5 ECU_ADDRESS 0xFFFF1042 /begin FUNCTION_LIST /end FUNCTION_LIST /end MEASUREMENT
/begin MEASUREMENT vVTCERRI_R#1 "The amount of VTC operation angle deviation" UBYTE COMP_0256 1 100 -64 63.5 ECU_ADDRESS 0xFFFF1042 /begin FUNCTION_LIST /end FUNCTION_LIST /end MEASUREMENT
/begin MEASUREMENT vVTCERRI_R#2 "The amount of VTC operation angle deviation" UBYTE COMP_0256 1 100 -64 63.5 ECU_ADDRESS 0xFFFF1043 /begin FUNCTION_LIST /end FUNCTION_LIST /end MEASUREMENT
/begin MEASUREMENT vVTCFS3_Sf "VTC offset diagnosis failsafe NG judgement" UBYTE COMP_0004 1 100 0 255 ECU_ADDRESS 0xFFFF3541 /begin FUNCTION_LIST /end FUNCTION_LIST /end MEASUREMENT
/begin MEASUREMENT vVTCFS4_Sf "VTC drive abnormality diagnosis failsafe NG judgement" UBYTE COMP_0004 1 100 0 255 ECU_ADDRESS 0xFFFF3542 /begin FUNCTION_LIST /end FUNCTION_LIST /end MEASUREMENT
/begin MEASUREMENT vVTCFS5_Sf "Diagnosis trouble judgement" UBYTE COMP_0004 1 100 0 255 ECU_ADDRESS 0xFFFF3543 /begin FUNCTION_LIST /end FUNCTION_LIST /end MEASUREMENT
/begin MEASUREMENT vVTCFSE3f "Diagnosis failsafe" UBYTE COMP_0004 1 100 0 255 ECU_ADDRESS 0xFFFF34B1 /begin FUNCTION_LIST /end FUNCTION_LIST /end MEASUREMENT
/begin MEASUREMENT vVTCFSE4f "Diagnosis failsafe" UBYTE COMP_0004 1 100 0 255 ECU_ADDRESS 0xFFFF34B2 /begin FUNCTION_LIST /end FUNCTION_LIST /end MEASUREMENT
/begin MEASUREMENT vVTCFSE5f "Diagnosis trouble judgement" UBYTE COMP_0004 1 100 0 255 ECU_ADDRESS 0xFFFF34B3 /begin FUNCTION_LIST /end FUNCTION_LIST /end MEASUREMENT
/begin MEASUREMENT vVTCFSI3f "Diagnosis failsafe" UBYTE COMP_0004 1 100 0 255 ECU_ADDRESS 0xFFFF34B4 /begin FUNCTION_LIST /end FUNCTION_LIST /end MEASUREMENT
/begin MEASUREMENT vVTCFSI4f "Diagnosis failsafe" UBYTE COMP_0004 1 100 0 255 ECU_ADDRESS 0xFFFF34B5 /begin FUNCTION_LIST /end FUNCTION_LIST /end MEASUREMENT
/begin MEASUREMENT vVTCFSI5f "Diagnosis trouble judgement" UBYTE COMP_0004 1 100 0 255 ECU_ADDRESS 0xFFFF34B6 /begin FUNCTION_LIST /end FUNCTION_LIST /end MEASUREMENT
/begin MEASUREMENT vVTCHDTE "F/B control permission judgement flag 10 o'clock VTCDUTYE maintenance value" UWORD COMP_0447 1 100 0 6399.90234375 ECU_ADDRESS 0xFFFF1B00 /begin FUNCTION_LIST /end FUNCTION_LIST /end MEASUREMENT
/begin MEASUREMENT vVTCHDTE_R#1 "F/B control permission judgement flag 10 o'clock VTCDUTYE maintenance value" UWORD COMP_0447 1 100 0 6399.90234375 ECU_ADDRESS 0xFFFF1B00 /begin FUNCTION_LIST /end FUNCTION_LIST /end MEASUREMENT
/begin MEASUREMENT vVTCHDTE_R#2 "F/B control permission judgement flag 10 o'clock VTCDUTYE maintenance value" UWORD COMP_0447 1 100 0 6399.90234375 ECU_ADDRESS 0xFFFF1B02 /begin FUNCTION_LIST /end FUNCTION_LIST /end MEASUREMENT
/begin MEASUREMENT vVTCHDTI "F/B control permission judgement flag 10 o'clock VTCDUTYI maintenance value" UWORD COMP_0447 1 100 0 6399.90234375 ECU_ADDRESS 0xFFFF1B04 /begin FUNCTION_LIST /end FUNCTION_LIST /end MEASUREMENT
/begin MEASUREMENT vVTCHDTI_R#1 "F/B control permission judgement flag 10 o'clock VTCDUTYI maintenance value" UWORD COMP_0447 1 100 0 6399.90234375 ECU_ADDRESS 0xFFFF1B04 /begin FUNCTION_LIST /end FUNCTION_LIST /end MEASUREMENT
/begin MEASUREMENT vVTCHDTI_R#2 "F/B control permission judgement flag 10 o'clock VTCDUTYI maintenance value" UWORD COMP_0447 1 100 0 6399.90234375 ECU_ADDRESS 0xFFFF1B06 /begin FUNCTION_LIST /end FUNCTION_LIST /end MEASUREMENT
/begin MEASUREMENT vVTCI2 "The amount of I-gain control" ULONG COMP_0527 1 100 -128.0000917504 65408.0468691956 ECU_ADDRESS 0xFFFF1B0C /begin FUNCTION_LIST /end FUNCTION_LIST /end MEASUREMENT
/begin MEASUREMENT vVTCI2_R#1 "The amount of I-gain control" ULONG COMP_0527 1 100 -128.0000917504 65408.0468691956 ECU_ADDRESS 0xFFFF1B0C /begin FUNCTION_LIST /end FUNCTION_LIST /end MEASUREMENT
/begin MEASUREMENT vVTCI2_R#2 "The amount of I-gain control" ULONG COMP_0527 1 100 -128.0000917504 65408.0468691956 ECU_ADDRESS 0xFFFF1B10 /begin FUNCTION_LIST /end FUNCTION_LIST /end MEASUREMENT
/begin MEASUREMENT vVTCIE "The amount of I-gain control" ULONG COMP_0526 1 100 -63.99996198912 32703.9805688109 ECU_ADDRESS 0xFFFF1B1C /begin FUNCTION_LIST /end FUNCTION_LIST /end MEASUREMENT
/begin MEASUREMENT vVTCIE_R#1 "The amount of I-gain control" ULONG COMP_0526 1 100 -63.99996198912 32703.9805688109 ECU_ADDRESS 0xFFFF1B1C /begin FUNCTION_LIST /end FUNCTION_LIST /end MEASUREMENT
/begin MEASUREMENT vVTCIE_R#2 "The amount of I-gain control" ULONG COMP_0526 1 100 -63.99996198912 32703.9805688109 ECU_ADDRESS 0xFFFF1B20 /begin FUNCTION_LIST /end FUNCTION_LIST /end MEASUREMENT
/begin MEASUREMENT vVTCIECLRf "VTCIE clear requirement flag" UBYTE COMP_0004 1 100 0 255 ECU_ADDRESS 0xFFFF1B24 /begin FUNCTION_LIST /end FUNCTION_LIST /end MEASUREMENT
/begin MEASUREMENT vVTCII "The amount of I-gain control" ULONG COMP_0526 1 100 -63.99996198912 32703.9805688109 ECU_ADDRESS 0xFFFF1B28 /begin FUNCTION_LIST /end FUNCTION_LIST /end MEASUREMENT
/begin MEASUREMENT vVTCII_R#1 "The amount of I-gain control" ULONG COMP_0526 1 100 -63.99996198912 32703.9805688109 ECU_ADDRESS 0xFFFF1B28 /begin FUNCTION_LIST /end FUNCTION_LIST /end MEASUREMENT
/begin MEASUREMENT vVTCII_R#2 "The amount of I-gain control" ULONG COMP_0526 1 100 -63.99996198912 32703.9805688109 ECU_ADDRESS 0xFFFF1B2C /begin FUNCTION_LIST /end FUNCTION_LIST /end MEASUREMENT
/begin MEASUREMENT vVTCIICLRf "VTCII clear requirement flag" UBYTE COMP_0004 1 100 0 255 ECU_ADDRESS 0xFFFF1B30 /begin FUNCTION_LIST /end FUNCTION_LIST /end MEASUREMENT
/begin MEASUREMENT vVTCLHTC "Cleaning time" UBYTE COMP_0014 1 100 0 2550 ECU_ADDRESS 0xFFFF1D20 /begin FUNCTION_LIST /end FUNCTION_LIST /end MEASUREMENT
/begin MEASUREMENT vVTCLIE "The amount of line shape feedback control" UWORD COMP_0651_S 1 100 -2.0000014336 1.9999403984 ECU_ADDRESS 0xFFFF1B32 /begin FUNCTION_LIST /end FUNCTION_LIST /end MEASUREMENT
/begin MEASUREMENT vVTCLIE_R#1 "The amount of line shape feedback control" UWORD COMP_0651_S 1 100 -2.0000014336 1.9999403984 ECU_ADDRESS 0xFFFF1B32 /begin FUNCTION_LIST /end FUNCTION_LIST /end MEASUREMENT
/begin MEASUREMENT vVTCLIE_R#2 "The amount of line shape feedback control" UWORD COMP_0651_S 1 100 -2.0000014336 1.9999403984 ECU_ADDRESS 0xFFFF1B34 /begin FUNCTION_LIST /end FUNCTION_LIST /end MEASUREMENT
/begin MEASUREMENT vVTCLIE2 "The amount of line shape feedback control" ULONG COMP_0652_S 1 100 -131072.09395241 131072.093891374 ECU_ADDRESS 0xFFFF1B38 /begin FUNCTION_LIST /end FUNCTION_LIST /end MEASUREMENT
/begin MEASUREMENT vVTCLIE2_R#1 "The amount of line shape feedback control" ULONG COMP_0652_S 1 100 -131072.09395241 131072.093891374 ECU_ADDRESS 0xFFFF1B38 /begin FUNCTION_LIST /end FUNCTION_LIST /end MEASUREMENT
/begin MEASUREMENT vVTCLIE2_R#2 "The amount of line shape feedback control" ULONG COMP_0652_S 1 100 -131072.09395241 131072.093891374 ECU_ADDRESS 0xFFFF1B3C /begin FUNCTION_LIST /end FUNCTION_LIST /end MEASUREMENT
/begin MEASUREMENT vVTCLII "The amount of line shape feedback control" UWORD COMP_0651_S 1 100 -2.0000014336 1.9999403984 ECU_ADDRESS 0xFFFF1B40 /begin FUNCTION_LIST /end FUNCTION_LIST /end MEASUREMENT
/begin MEASUREMENT vVTCLII_R#1 "The amount of line shape feedback control" UWORD COMP_0651_S 1 100 -2.0000014336 1.9999403984 ECU_ADDRESS 0xFFFF1B40 /begin FUNCTION_LIST /end FUNCTION_LIST /end MEASUREMENT
/begin MEASUREMENT vVTCLII_R#2 "The amount of line shape feedback control" UWORD COMP_0651_S 1 100 -2.0000014336 1.9999403984 ECU_ADDRESS 0xFFFF1B42 /begin FUNCTION_LIST /end FUNCTION_LIST /end MEASUREMENT
/begin MEASUREMENT vVTCLII2 "The amount of line shape feedback control" ULONG COMP_0652_S 1 100 -131072.09395241 131072.093891374 ECU_ADDRESS 0xFFFF1B44 /begin FUNCTION_LIST /end FUNCTION_LIST /end MEASUREMENT
/begin MEASUREMENT vVTCLII2_R#1 "The amount of line shape feedback control" ULONG COMP_0652_S 1 100 -131072.09395241 131072.093891374 ECU_ADDRESS 0xFFFF1B44 /begin FUNCTION_LIST /end FUNCTION_LIST /end MEASUREMENT
/begin MEASUREMENT vVTCLII2_R#2 "The amount of line shape feedback control" ULONG COMP_0652_S 1 100 -131072.09395241 131072.093891374 ECU_ADDRESS 0xFFFF1B48 /begin FUNCTION_LIST /end FUNCTION_LIST /end MEASUREMENT
/begin MEASUREMENT vVTCMON "Incumbent VTC angle monitor value" UBYTE COMP_0257 1 100 -128 127 ECU_ADDRESS 0xFFFF1B4C /begin FUNCTION_LIST /end FUNCTION_LIST /end MEASUREMENT
/begin MEASUREMENT vVTCMTRE "At the time of the stoichiometric, VTC basic target angle (after the coolant temperature interpolation)" UBYTE COMP_0256 1 100 -64 63.5 ECU_ADDRESS 0xFFFF1B4D /begin FUNCTION_LIST /end FUNCTION_LIST /end MEASUREMENT
/begin MEASUREMENT vVTCMTRHI "VTC target operation angle computed map reference value (at the time of the high coolant temperature)" UBYTE COMP_0256 1 100 -64 63.5 ECU_ADDRESS 0xFFFF1B4E /begin FUNCTION_LIST /end FUNCTION_LIST /end MEASUREMENT
/begin MEASUREMENT vVTCMTRI "At the time of the stoichiometric, VTC basic target angle (after the coolant temperature interpolation)" UBYTE COMP_0256 1 100 -64 63.5 ECU_ADDRESS 0xFFFF1B4F /begin FUNCTION_LIST /end FUNCTION_LIST /end MEASUREMENT
/begin MEASUREMENT vVTCMTRLI "VTC target operation angle computed map reference value (at the time of the low coolant temperature)" UBYTE COMP_0256 1 100 -64 63.5 ECU_ADDRESS 0xFFFF1B50 /begin FUNCTION_LIST /end FUNCTION_LIST /end MEASUREMENT
/begin MEASUREMENT vVTCNACTEf "VTCNOWE<mVTCNACT" UBYTE COMP_0004 1 100 0 255 ECU_ADDRESS 0xFFFF1B51 /begin FUNCTION_LIST /end FUNCTION_LIST /end MEASUREMENT
/begin MEASUREMENT vVTCNACTf "VTCNOWI<mVTCNACT" UBYTE COMP_0004 1 100 0 255 ECU_ADDRESS 0xFFFF1B52 /begin FUNCTION_LIST /end FUNCTION_LIST /end MEASUREMENT
/begin MEASUREMENT vVTCNLIE "The amount of non-line shape feedback control" UWORD COMP_0651_S 1 100 -2.0000014336 1.9999403984 ECU_ADDRESS 0xFFFF1B58 /begin FUNCTION_LIST /end FUNCTION_LIST /end MEASUREMENT
/begin MEASUREMENT vVTCNLIE_R#1 "The amount of non-line shape feedback control" UWORD COMP_0651_S 1 100 -2.0000014336 1.9999403984 ECU_ADDRESS 0xFFFF1B58 /begin FUNCTION_LIST /end FUNCTION_LIST /end MEASUREMENT
/begin MEASUREMENT vVTCNLIE_R#2 "The amount of non-line shape feedback control" UWORD COMP_0651_S 1 100 -2.0000014336 1.9999403984 ECU_ADDRESS 0xFFFF1B5A /begin FUNCTION_LIST /end FUNCTION_LIST /end MEASUREMENT
/begin MEASUREMENT vVTCNLIE2 "The amount of non-line shape feedback control" ULONG COMP_0652_S 1 100 -131072.09395241 131072.093891374 ECU_ADDRESS 0xFFFF1B5C /begin FUNCTION_LIST /end FUNCTION_LIST /end MEASUREMENT
/begin MEASUREMENT vVTCNLIE2_R#1 "The amount of non-line shape feedback control" ULONG COMP_0652_S 1 100 -131072.09395241 131072.093891374 ECU_ADDRESS 0xFFFF1B5C /begin FUNCTION_LIST /end FUNCTION_LIST /end MEASUREMENT
/begin MEASUREMENT vVTCNLIE2_R#2 "The amount of non-line shape feedback control" ULONG COMP_0652_S 1 100 -131072.09395241 131072.093891374 ECU_ADDRESS 0xFFFF1B60 /begin FUNCTION_LIST /end FUNCTION_LIST /end MEASUREMENT
/begin MEASUREMENT vVTCNLII "The amount of non-line shape feedback control" UWORD COMP_0651_S 1 100 -2.0000014336 1.9999403984 ECU_ADDRESS 0xFFFF1B64 /begin FUNCTION_LIST /end FUNCTION_LIST /end MEASUREMENT
/begin MEASUREMENT vVTCNLII_R#1 "The amount of non-line shape feedback control" UWORD COMP_0651_S 1 100 -2.0000014336 1.9999403984 ECU_ADDRESS 0xFFFF1B64 /begin FUNCTION_LIST /end FUNCTION_LIST /end MEASUREMENT
/begin MEASUREMENT vVTCNLII_R#2 "The amount of non-line shape feedback control" UWORD COMP_0651_S 1 100 -2.0000014336 1.9999403984 ECU_ADDRESS 0xFFFF1B66 /begin FUNCTION_LIST /end FUNCTION_LIST /end MEASUREMENT
/begin MEASUREMENT vVTCNLII2 "The amount of non-line shape feedback control" ULONG COMP_0652_S 1 100 -131072.09395241 131072.093891374 ECU_ADDRESS 0xFFFF1B68 /begin FUNCTION_LIST /end FUNCTION_LIST /end MEASUREMENT
/begin MEASUREMENT vVTCNLII2_R#1 "The amount of non-line shape feedback control" ULONG COMP_0652_S 1 100 -131072.09395241 131072.093891374 ECU_ADDRESS 0xFFFF1B68 /begin FUNCTION_LIST /end FUNCTION_LIST /end MEASUREMENT
/begin MEASUREMENT vVTCNLII2_R#2 "The amount of non-line shape feedback control" ULONG COMP_0652_S 1 100 -131072.09395241 131072.093891374 ECU_ADDRESS 0xFFFF1B6C /begin FUNCTION_LIST /end FUNCTION_LIST /end MEASUREMENT
/begin MEASUREMENT vVTCONTE "VTC Unusual (exhaust side) for the judgement counter breakage trouble diagnosis" UBYTE COMP_0016 1 100 0 255 ECU_ADDRESS 0xFFFF4090 /begin FUNCTION_LIST /end FUNCTION_LIST /end MEASUREMENT
/begin MEASUREMENT vVTCONTE_R#1 "VTC Unusual (exhaust side) for the judgement counter breakage trouble diagnosis" UBYTE COMP_0016 1 100 0 255 ECU_ADDRESS 0xFFFF4090 /begin FUNCTION_LIST /end FUNCTION_LIST /end MEASUREMENT
/begin MEASUREMENT vVTCONTE_R#2 "VTC Unusual (exhaust side) for the judgement counter breakage trouble diagnosis" UBYTE COMP_0016 1 100 0 255 ECU_ADDRESS 0xFFFF4091 /begin FUNCTION_LIST /end FUNCTION_LIST /end MEASUREMENT
/begin MEASUREMENT vVTCONTE2 "VTC Unusual (exhaust side) for the judgement counter momentary-disconnection, noise diagnosis" UBYTE COMP_0016 1 100 0 255 ECU_ADDRESS 0xFFFF4092 /begin FUNCTION_LIST /end FUNCTION_LIST /end MEASUREMENT
/begin MEASUREMENT vVTCONTE2_R#1 "VTC Unusual (exhaust side) for the judgement counter momentary-disconnection, noise diagnosis" UBYTE COMP_0016 1 100 0 255 ECU_ADDRESS 0xFFFF4092 /begin FUNCTION_LIST /end FUNCTION_LIST /end MEASUREMENT
/begin MEASUREMENT vVTCONTE2_R#2 "VTC Unusual (exhaust side) for the judgement counter momentary-disconnection, noise diagnosis" UBYTE COMP_0016 1 100 0 255 ECU_ADDRESS 0xFFFF4093 /begin FUNCTION_LIST /end FUNCTION_LIST /end MEASUREMENT
/begin MEASUREMENT vVTCP2 "The amount of P-gain control" UWORD COMP_0529 1 100 -128 127.99609375 ECU_ADDRESS 0xFFFF1B74 /begin FUNCTION_LIST /end FUNCTION_LIST /end MEASUREMENT
/begin MEASUREMENT vVTCP2_R#1 "The amount of P-gain control" UWORD COMP_0529 1 100 -128 127.99609375 ECU_ADDRESS 0xFFFF1B74 /begin FUNCTION_LIST /end FUNCTION_LIST /end MEASUREMENT
/begin MEASUREMENT vVTCP2_R#2 "The amount of P-gain control" UWORD COMP_0529 1 100 -128 127.99609375 ECU_ADDRESS 0xFFFF1B76 /begin FUNCTION_LIST /end FUNCTION_LIST /end MEASUREMENT
/begin MEASUREMENT vVTCPE "The amount of P-gain control" UWORD COMP_0528 1 100 -64 63.998046875 ECU_ADDRESS 0xFFFF1B7C /begin FUNCTION_LIST /end FUNCTION_LIST /end MEASUREMENT
/begin MEASUREMENT vVTCPE_R#1 "The amount of P-gain control" UWORD COMP_0528 1 100 -64 63.998046875 ECU_ADDRESS 0xFFFF1B7C /begin FUNCTION_LIST /end FUNCTION_LIST /end MEASUREMENT
/begin MEASUREMENT vVTCPE_R#2 "The amount of P-gain control" UWORD COMP_0528 1 100 -64 63.998046875 ECU_ADDRESS 0xFFFF1B7E /begin FUNCTION_LIST /end FUNCTION_LIST /end MEASUREMENT
/begin MEASUREMENT vVTCPI "The amount of P-gain control" UWORD COMP_0528 1 100 -64 63.998046875 ECU_ADDRESS 0xFFFF1B80 /begin FUNCTION_LIST /end FUNCTION_LIST /end MEASUREMENT
/begin MEASUREMENT vVTCPI_R#1 "The amount of P-gain control" UWORD COMP_0528 1 100 -64 63.998046875 ECU_ADDRESS 0xFFFF1B80 /begin FUNCTION_LIST /end FUNCTION_LIST /end MEASUREMENT
/begin MEASUREMENT vVTCPI_R#2 "The amount of P-gain control" UWORD COMP_0528 1 100 -64 63.998046875 ECU_ADDRESS 0xFFFF1B82 /begin FUNCTION_LIST /end FUNCTION_LIST /end MEASUREMENT
/begin MEASUREMENT vVTCPID2 "PID control quantity (angle)" ULONG COMP_0527 1 100 -128.0000917504 65408.0468691956 ECU_ADDRESS 0xFFFF1B88 /begin FUNCTION_LIST /end FUNCTION_LIST /end MEASUREMENT
/begin MEASUREMENT vVTCPID2_R#1 "PID control quantity (angle)" ULONG COMP_0527 1 100 -128.0000917504 65408.0468691956 ECU_ADDRESS 0xFFFF1B88 /begin FUNCTION_LIST /end FUNCTION_LIST /end MEASUREMENT
/begin MEASUREMENT vVTCPID2_R#2 "PID control quantity (angle)" ULONG COMP_0527 1 100 -128.0000917504 65408.0468691956 ECU_ADDRESS 0xFFFF1B8C /begin FUNCTION_LIST /end FUNCTION_LIST /end MEASUREMENT
/begin MEASUREMENT vVTCPIDE "PID control quantity (angle)" ULONG COMP_0526 1 100 -63.99996198912 32703.9805688109 ECU_ADDRESS 0xFFFF1B98 /begin FUNCTION_LIST /end FUNCTION_LIST /end MEASUREMENT
/begin MEASUREMENT vVTCPIDE_R#1 "PID control quantity (angle)" ULONG COMP_0526 1 100 -63.99996198912 32703.9805688109 ECU_ADDRESS 0xFFFF1B98 /begin FUNCTION_LIST /end FUNCTION_LIST /end MEASUREMENT
/begin MEASUREMENT vVTCPIDE_R#2 "PID control quantity (angle)" ULONG COMP_0526 1 100 -63.99996198912 32703.9805688109 ECU_ADDRESS 0xFFFF1B9C /begin FUNCTION_LIST /end FUNCTION_LIST /end MEASUREMENT
/begin MEASUREMENT vVTCPIDI "PID control quantity (angle)" ULONG COMP_0526 1 100 -63.99996198912 32703.9805688109 ECU_ADDRESS 0xFFFF1BA0 /begin FUNCTION_LIST /end FUNCTION_LIST /end MEASUREMENT
/begin MEASUREMENT vVTCPIDI_R#1 "PID control quantity (angle)" ULONG COMP_0526 1 100 -63.99996198912 32703.9805688109 ECU_ADDRESS 0xFFFF1BA0 /begin FUNCTION_LIST /end FUNCTION_LIST /end MEASUREMENT
/begin MEASUREMENT vVTCPIDI_R#2 "PID control quantity (angle)" ULONG COMP_0526 1 100 -63.99996198912 32703.9805688109 ECU_ADDRESS 0xFFFF1BA4 /begin FUNCTION_LIST /end FUNCTION_LIST /end MEASUREMENT
/begin MEASUREMENT vVTCPOS421 "Between the VTC reference signal - the cam target signal, measuring angle (before one time)" UBYTE COMP_0266 1 100 0 127.5 ECU_ADDRESS 0xFFFF2290 /begin FUNCTION_LIST /end FUNCTION_LIST /end MEASUREMENT
/begin MEASUREMENT vVTCPOS421_R#1 "Between the VTC reference signal - the cam target signal, measuring angle (before one time)" UBYTE COMP_0266 1 100 0 127.5 ECU_ADDRESS 0xFFFF2290 /begin FUNCTION_LIST /end FUNCTION_LIST /end MEASUREMENT
/begin MEASUREMENT vVTCPOS421_R#2 "Between the VTC reference signal - the cam target signal, measuring angle (before one time)" UBYTE COMP_0266 1 100 0 127.5 ECU_ADDRESS 0xFFFF2291 /begin FUNCTION_LIST /end FUNCTION_LIST /end MEASUREMENT
/begin MEASUREMENT vVTCPOS422 "Between the VTC reference signal - the cam target signal, measuring angle (before two times)" UBYTE COMP_0266 1 100 0 127.5 ECU_ADDRESS 0xFFFF2292 /begin FUNCTION_LIST /end FUNCTION_LIST /end MEASUREMENT
/begin MEASUREMENT vVTCPOS422_R#1 "Between the VTC reference signal - the cam target signal, measuring angle (before two times)" UBYTE COMP_0266 1 100 0 127.5 ECU_ADDRESS 0xFFFF2292 /begin FUNCTION_LIST /end FUNCTION_LIST /end MEASUREMENT
/begin MEASUREMENT vVTCPOS422_R#2 "Between the VTC reference signal - the cam target signal, measuring angle (before two times)" UBYTE COMP_0266 1 100 0 127.5 ECU_ADDRESS 0xFFFF2293 /begin FUNCTION_LIST /end FUNCTION_LIST /end MEASUREMENT
/begin MEASUREMENT vVTCPOSE "Between the VTC reference signal - the cam target signal, measuring angle" UBYTE COMP_0048 1 100 0 127.5 ECU_ADDRESS 0xFFFF8A60 /begin FUNCTION_LIST /end FUNCTION_LIST /end MEASUREMENT
/begin MEASUREMENT vVTCPOSE_R#1 "Between the VTC reference signal - the cam target signal, measuring angle" UBYTE COMP_0048 1 100 0 127.5 ECU_ADDRESS 0xFFFF8A60 /begin FUNCTION_LIST /end FUNCTION_LIST /end MEASUREMENT
/begin MEASUREMENT vVTCPOSE_R#2 "Between the VTC reference signal - the cam target signal, measuring angle" UBYTE COMP_0048 1 100 0 127.5 ECU_ADDRESS 0xFFFF8A61 /begin FUNCTION_LIST /end FUNCTION_LIST /end MEASUREMENT
/begin MEASUREMENT vVTCPOSEz1 "Between the VTC reference signal - the cam target signal, measuring angle (before one time)" UBYTE COMP_0048 1 100 0 127.5 ECU_ADDRESS 0xFFFF8A62 /begin FUNCTION_LIST /end FUNCTION_LIST /end MEASUREMENT
/begin MEASUREMENT vVTCPOSEz1_R#1 "Between the VTC reference signal - the cam target signal, measuring angle (before one time)" UBYTE COMP_0048 1 100 0 127.5 ECU_ADDRESS 0xFFFF8A62 /begin FUNCTION_LIST /end FUNCTION_LIST /end MEASUREMENT
/begin MEASUREMENT vVTCPOSEz1_R#2 "Between the VTC reference signal - the cam target signal, measuring angle (before one time)" UBYTE COMP_0048 1 100 0 127.5 ECU_ADDRESS 0xFFFF8A63 /begin FUNCTION_LIST /end FUNCTION_LIST /end MEASUREMENT
/begin MEASUREMENT vVTCPOSEz2 "Between the VTC reference signal - the cam target signal, measuring angle (before two times)" UBYTE COMP_0048 1 100 0 127.5 ECU_ADDRESS 0xFFFF8A64 /begin FUNCTION_LIST /end FUNCTION_LIST /end MEASUREMENT
/begin MEASUREMENT vVTCPOSEz2_R#1 "Between the VTC reference signal - the cam target signal, measuring angle (before two times)" UBYTE COMP_0048 1 100 0 127.5 ECU_ADDRESS 0xFFFF8A64 /begin FUNCTION_LIST /end FUNCTION_LIST /end MEASUREMENT
/begin MEASUREMENT vVTCPOSEz2_R#2 "Between the VTC reference signal - the cam target signal, measuring angle (before two times)" UBYTE COMP_0048 1 100 0 127.5 ECU_ADDRESS 0xFFFF8A65 /begin FUNCTION_LIST /end FUNCTION_LIST /end MEASUREMENT
/begin MEASUREMENT vVTCPOSI "Between the VTC reference signal - the cam target signal, measuring angle" UBYTE COMP_0048 1 100 0 127.5 ECU_ADDRESS 0xFFFF8A66 /begin FUNCTION_LIST /end FUNCTION_LIST /end MEASUREMENT
/begin MEASUREMENT vVTCPOSI_R#1 "Between the VTC reference signal - the cam target signal, measuring angle" UBYTE COMP_0048 1 100 0 127.5 ECU_ADDRESS 0xFFFF8A66 /begin FUNCTION_LIST /end FUNCTION_LIST /end MEASUREMENT
/begin MEASUREMENT vVTCPOSI_R#2 "Between the VTC reference signal - the cam target signal, measuring angle" UBYTE COMP_0048 1 100 0 127.5 ECU_ADDRESS 0xFFFF8A67 /begin FUNCTION_LIST /end FUNCTION_LIST /end MEASUREMENT
/begin MEASUREMENT vVTCPOSIz1 "Between the VTC reference signal - the cam target signal, measuring angle (before one time)" UBYTE COMP_0048 1 100 0 127.5 ECU_ADDRESS 0xFFFF8A68 /begin FUNCTION_LIST /end FUNCTION_LIST /end MEASUREMENT
/begin MEASUREMENT vVTCPOSIz1_R#1 "Between the VTC reference signal - the cam target signal, measuring angle (before one time)" UBYTE COMP_0048 1 100 0 127.5 ECU_ADDRESS 0xFFFF8A68 /begin FUNCTION_LIST /end FUNCTION_LIST /end MEASUREMENT
/begin MEASUREMENT vVTCPOSIz1_R#2 "Between the VTC reference signal - the cam target signal, measuring angle (before one time)" UBYTE COMP_0048 1 100 0 127.5 ECU_ADDRESS 0xFFFF8A69 /begin FUNCTION_LIST /end FUNCTION_LIST /end MEASUREMENT
/begin MEASUREMENT vVTCPOSIz2 "Between the VTC reference signal - the cam target signal, measuring angle (before two times)" UBYTE COMP_0048 1 100 0 127.5 ECU_ADDRESS 0xFFFF8A6A /begin FUNCTION_LIST /end FUNCTION_LIST /end MEASUREMENT
/begin MEASUREMENT vVTCPOSIz2_R#1 "Between the VTC reference signal - the cam target signal, measuring angle (before two times)" UBYTE COMP_0048 1 100 0 127.5 ECU_ADDRESS 0xFFFF8A6A /begin FUNCTION_LIST /end FUNCTION_LIST /end MEASUREMENT
/begin MEASUREMENT vVTCPOSIz2_R#2 "Between the VTC reference signal - the cam target signal, measuring angle (before two times)" UBYTE COMP_0048 1 100 0 127.5 ECU_ADDRESS 0xFFFF8A6B /begin FUNCTION_LIST /end FUNCTION_LIST /end MEASUREMENT
/begin MEASUREMENT vVTCSMCIE "SMC control quantity (electric current)" UWORD COMP_0654_S 1 100 0 3.999941832 ECU_ADDRESS 0xFFFF1BAA /begin FUNCTION_LIST /end FUNCTION_LIST /end MEASUREMENT
/begin MEASUREMENT vVTCSMCIE_R#1 "SMC control quantity (electric current)" UWORD COMP_0654_S 1 100 0 3.999941832 ECU_ADDRESS 0xFFFF1BAA /begin FUNCTION_LIST /end FUNCTION_LIST /end MEASUREMENT
/begin MEASUREMENT vVTCSMCIE_R#2 "SMC control quantity (electric current)" UWORD COMP_0654_S 1 100 0 3.999941832 ECU_ADDRESS 0xFFFF1BAC /begin FUNCTION_LIST /end FUNCTION_LIST /end MEASUREMENT
/begin MEASUREMENT vVTCSMCII "SMC control quantity (electric current)" UWORD COMP_0654_S 1 100 0 3.999941832 ECU_ADDRESS 0xFFFF1BAE /begin FUNCTION_LIST /end FUNCTION_LIST /end MEASUREMENT
/begin MEASUREMENT vVTCSMCII_R#1 "SMC control quantity (electric current)" UWORD COMP_0654_S 1 100 0 3.999941832 ECU_ADDRESS 0xFFFF1BAE /begin FUNCTION_LIST /end FUNCTION_LIST /end MEASUREMENT
/begin MEASUREMENT vVTCSMCII_R#2 "SMC control quantity (electric current)" UWORD COMP_0654_S 1 100 0 3.999941832 ECU_ADDRESS 0xFFFF1BB0 /begin FUNCTION_LIST /end FUNCTION_LIST /end MEASUREMENT
/begin MEASUREMENT vVTCSOLE "The judgement counter whose solenoid diagnosis is unusual" UBYTE COMP_0030 1 100 0 255 ECU_ADDRESS 0xFFFF34B9 /begin FUNCTION_LIST /end FUNCTION_LIST /end MEASUREMENT
/begin MEASUREMENT vVTCSOLE_R#1 "The judgement counter whose solenoid diagnosis is unusual" UBYTE COMP_0030 1 100 0 255 ECU_ADDRESS 0xFFFF34B9 /begin FUNCTION_LIST /end FUNCTION_LIST /end MEASUREMENT
/begin MEASUREMENT vVTCSOLE_R#2 "The judgement counter whose solenoid diagnosis is unusual" UBYTE COMP_0030 1 100 0 255 ECU_ADDRESS 0xFFFF34BA /begin FUNCTION_LIST /end FUNCTION_LIST /end MEASUREMENT
/begin MEASUREMENT vVTCSOLEf "Tooth solenoid output flag" UBYTE COMP_0004 1 100 0 255 ECU_ADDRESS 0xFFFF2452 /begin FUNCTION_LIST /end FUNCTION_LIST /end MEASUREMENT
/begin MEASUREMENT vVTCSOLIf "Tooth solenoid output flag" UBYTE COMP_0004 1 100 0 255 ECU_ADDRESS 0xFFFF2453 /begin FUNCTION_LIST /end FUNCTION_LIST /end MEASUREMENT
/begin MEASUREMENT vVTCSTE "VTC drive sequence stage NO." UBYTE COMP_0004 1 100 0 255 ECU_ADDRESS 0xFFFF1BB2 /begin FUNCTION_LIST /end FUNCTION_LIST /end MEASUREMENT
/begin MEASUREMENT vVTCSTE_R#1 "VTC drive sequence stage NO." UBYTE COMP_0004 1 100 0 255 ECU_ADDRESS 0xFFFF1BB2 /begin FUNCTION_LIST /end FUNCTION_LIST /end MEASUREMENT
/begin MEASUREMENT vVTCSTE_R#2 "VTC drive sequence stage NO." UBYTE COMP_0004 1 100 0 255 ECU_ADDRESS 0xFFFF1BB3 /begin FUNCTION_LIST /end FUNCTION_LIST /end MEASUREMENT
/begin MEASUREMENT vVTCSTI "VTC drive sequence stage NO." UBYTE COMP_0004 1 100 0 255 ECU_ADDRESS 0xFFFF1BB4 /begin FUNCTION_LIST /end FUNCTION_LIST /end MEASUREMENT
/begin MEASUREMENT vVTCSTI_R#1 "VTC drive sequence stage NO." UBYTE COMP_0004 1 100 0 255 ECU_ADDRESS 0xFFFF1BB4 /begin FUNCTION_LIST /end FUNCTION_LIST /end MEASUREMENT
/begin MEASUREMENT vVTCSTI_R#2 "VTC drive sequence stage NO." UBYTE COMP_0004 1 100 0 255 ECU_ADDRESS 0xFFFF1BB5 /begin FUNCTION_LIST /end FUNCTION_LIST /end MEASUREMENT
/begin MEASUREMENT vVTCTRH2 "VTC target operation angle computed map reference value (at the time of the high coolant temperature)" UBYTE COMP_0257 1 100 -128 127 ECU_ADDRESS 0xFFFF1BB7 /begin FUNCTION_LIST /end FUNCTION_LIST /end MEASUREMENT
/begin MEASUREMENT vVTCTRHE "Basic target angle computed map reference value" UBYTE COMP_0256 1 100 -64 63.5 ECU_ADDRESS 0xFFFF1BB8 /begin FUNCTION_LIST /end FUNCTION_LIST /end MEASUREMENT
/begin MEASUREMENT vVTCTRL2 "VTC target operation angle computed map reference value (at the time of the low coolant temperature)" UBYTE COMP_0257 1 100 -128 127 ECU_ADDRESS 0xFFFF1BBB /begin FUNCTION_LIST /end FUNCTION_LIST /end MEASUREMENT
/begin MEASUREMENT vVTCTRLE "Basic target angle computed map reference value (a low coolant temperature)" UBYTE COMP_0256 1 100 -64 63.5 ECU_ADDRESS 0xFFFF1BBC /begin FUNCTION_LIST /end FUNCTION_LIST /end MEASUREMENT
/begin MEASUREMENT vVTDGN3ESf "VTC alignment check diagnosis permission condition judgement" UBYTE COMP_0004 1 100 0 255 ECU_ADDRESS 0xFFFF34BB /begin FUNCTION_LIST /end FUNCTION_LIST /end MEASUREMENT
/begin MEASUREMENT vVTDGN4ESf "VTC drive abnormality diagnosis permission condition judgement" UBYTE COMP_0004 1 100 0 255 ECU_ADDRESS 0xFFFF34BC /begin FUNCTION_LIST /end FUNCTION_LIST /end MEASUREMENT
/begin MEASUREMENT vVTDMNOWE "VTC DM virtual is located." UWORD COMP_0026_S 1 100 0 6553.5 ECU_ADDRESS 0xFFFF104C /begin FUNCTION_LIST /end FUNCTION_LIST /end MEASUREMENT
/begin MEASUREMENT vVTDMNOWE_R#1 "VTC DM virtual is located." UWORD COMP_0026_S 1 100 0 6553.5 ECU_ADDRESS 0xFFFF104C /begin FUNCTION_LIST /end FUNCTION_LIST /end MEASUREMENT
/begin MEASUREMENT vVTDMNOWE_R#2 "VTC DM virtual is located." UWORD COMP_0026_S 1 100 0 6553.5 ECU_ADDRESS 0xFFFF104E /begin FUNCTION_LIST /end FUNCTION_LIST /end MEASUREMENT
/begin MEASUREMENT vVTDMNOWI "VTC DM virtual is located." UWORD COMP_0026_S 1 100 0 6553.5 ECU_ADDRESS 0xFFFF1050 /begin FUNCTION_LIST /end FUNCTION_LIST /end MEASUREMENT
/begin MEASUREMENT vVTDMNOWI_R#1 "VTC DM virtual is located." UWORD COMP_0026_S 1 100 0 6553.5 ECU_ADDRESS 0xFFFF1050 /begin FUNCTION_LIST /end FUNCTION_LIST /end MEASUREMENT
/begin MEASUREMENT vVTDMNOWI_R#2 "VTC DM virtual is located." UWORD COMP_0026_S 1 100 0 6553.5 ECU_ADDRESS 0xFFFF1052 /begin FUNCTION_LIST /end FUNCTION_LIST /end MEASUREMENT
/begin MEASUREMENT vVTDMOM2E "VTC DM corner speed 2" ULONG COMP_0198_S 1 100 -838860800 838860799.609375 ECU_ADDRESS 0xFFFF1BC4 /begin FUNCTION_LIST /end FUNCTION_LIST /end MEASUREMENT
/begin MEASUREMENT vVTDMOM2E_R#1 "VTC DM corner speed 2" ULONG COMP_0198_S 1 100 -838860800 838860799.609375 ECU_ADDRESS 0xFFFF1BC4 /begin FUNCTION_LIST /end FUNCTION_LIST /end MEASUREMENT
/begin MEASUREMENT vVTDMOM2E_R#2 "VTC DM corner speed 2" ULONG COMP_0198_S 1 100 -838860800 838860799.609375 ECU_ADDRESS 0xFFFF1BC8 /begin FUNCTION_LIST /end FUNCTION_LIST /end MEASUREMENT
/begin MEASUREMENT vVTDMOM2I "VTC DM corner speed 2" ULONG COMP_0198_S 1 100 -838860800 838860799.609375 ECU_ADDRESS 0xFFFF1BCC /begin FUNCTION_LIST /end FUNCTION_LIST /end MEASUREMENT
/begin MEASUREMENT vVTDMOM2I_R#1 "VTC DM corner speed 2" ULONG COMP_0198_S 1 100 -838860800 838860799.609375 ECU_ADDRESS 0xFFFF1BCC /begin FUNCTION_LIST /end FUNCTION_LIST /end MEASUREMENT
/begin MEASUREMENT vVTDMOM2I_R#2 "VTC DM corner speed 2" ULONG COMP_0198_S 1 100 -838860800 838860799.609375 ECU_ADDRESS 0xFFFF1BD0 /begin FUNCTION_LIST /end FUNCTION_LIST /end MEASUREMENT
/begin MEASUREMENT vVTDMOME "VTC DM corner speed" UWORD COMP_0199_S 1 100 -12800 12799.609375 ECU_ADDRESS 0xFFFF1BD4 /begin FUNCTION_LIST /end FUNCTION_LIST /end MEASUREMENT
/begin MEASUREMENT vVTDMOME_R#1 "VTC DM corner speed" UWORD COMP_0199_S 1 100 -12800 12799.609375 ECU_ADDRESS 0xFFFF1BD4 /begin FUNCTION_LIST /end FUNCTION_LIST /end MEASUREMENT
/begin MEASUREMENT vVTDMOME_R#2 "VTC DM corner speed" UWORD COMP_0199_S 1 100 -12800 12799.609375 ECU_ADDRESS 0xFFFF1BD6 /begin FUNCTION_LIST /end FUNCTION_LIST /end MEASUREMENT
/begin MEASUREMENT vVTDMOMI "VTC DM corner speed" UWORD COMP_0199_S 1 100 -12800 12799.609375 ECU_ADDRESS 0xFFFF1BD8 /begin FUNCTION_LIST /end FUNCTION_LIST /end MEASUREMENT
/begin MEASUREMENT vVTDMOMI_R#1 "VTC DM corner speed" UWORD COMP_0199_S 1 100 -12800 12799.609375 ECU_ADDRESS 0xFFFF1BD8 /begin FUNCTION_LIST /end FUNCTION_LIST /end MEASUREMENT
/begin MEASUREMENT vVTDMOMI_R#2 "VTC DM corner speed" UWORD COMP_0199_S 1 100 -12800 12799.609375 ECU_ADDRESS 0xFFFF1BDA /begin FUNCTION_LIST /end FUNCTION_LIST /end MEASUREMENT
/begin MEASUREMENT vVTDUTYE "Clutch solenoid drive DUTY ratio (the front compensated at the time of control switching)" UWORD COMP_0447 1 100 0 6399.90234375 ECU_ADDRESS 0xFFFF1BDC /begin FUNCTION_LIST /end FUNCTION_LIST /end MEASUREMENT
/begin MEASUREMENT vVTDUTYE_R#1 "Clutch solenoid drive DUTY ratio (the front compensated at the time of control switching)" UWORD COMP_0447 1 100 0 6399.90234375 ECU_ADDRESS 0xFFFF1BDC /begin FUNCTION_LIST /end FUNCTION_LIST /end MEASUREMENT
/begin MEASUREMENT vVTDUTYE_R#2 "Clutch solenoid drive DUTY ratio (the front compensated at the time of control switching)" UWORD COMP_0447 1 100 0 6399.90234375 ECU_ADDRESS 0xFFFF1BDE /begin FUNCTION_LIST /end FUNCTION_LIST /end MEASUREMENT
/begin MEASUREMENT vVTDUTYI "Clutch solenoid drive DUTY ratio (the front compensated at the time of control switching)" UWORD COMP_0447 1 100 0 6399.90234375 ECU_ADDRESS 0xFFFF1BE0 /begin FUNCTION_LIST /end FUNCTION_LIST /end MEASUREMENT
/begin MEASUREMENT vVTDUTYI_R#1 "Clutch solenoid drive DUTY ratio (the front compensated at the time of control switching)" UWORD COMP_0447 1 100 0 6399.90234375 ECU_ADDRESS 0xFFFF1BE0 /begin FUNCTION_LIST /end FUNCTION_LIST /end MEASUREMENT
/begin MEASUREMENT vVTDUTYI_R#2 "Clutch solenoid drive DUTY ratio (the front compensated at the time of control switching)" UWORD COMP_0447 1 100 0 6399.90234375 ECU_ADDRESS 0xFFFF1BE2 /begin FUNCTION_LIST /end FUNCTION_LIST /end MEASUREMENT
/begin MEASUREMENT vVTERE "After VTCTRGE=0degCA, progress timer" UBYTE COMP_0014 1 100 0 2550 ECU_ADDRESS 0xFFFF1BE4 /begin FUNCTION_LIST /end FUNCTION_LIST /end MEASUREMENT
/begin MEASUREMENT vVTFBONEf "F/B control permission judgement flag" UBYTE COMP_0004 1 100 0 255 ECU_ADDRESS 0xFFFF1054 /begin FUNCTION_LIST /end FUNCTION_LIST /end MEASUREMENT
/begin MEASUREMENT vVTFBONIf "F/B control permission judgement flag" UBYTE COMP_0004 1 100 0 255 ECU_ADDRESS 0xFFFF1055 /begin FUNCTION_LIST /end FUNCTION_LIST /end MEASUREMENT
/begin MEASUREMENT vVTFFTHE "The amount of retard feedback control for the VTC clutch protection" UBYTE COMP_0048 1 100 0 127.5 ECU_ADDRESS 0xFFFF1BE6 /begin FUNCTION_LIST /end FUNCTION_LIST /end MEASUREMENT
/begin MEASUREMENT vVTFFTHI "The amount of retard feedback control for the VTC clutch protection" UBYTE COMP_0048 1 100 0 127.5 ECU_ADDRESS 0xFFFF1BE7 /begin FUNCTION_LIST /end FUNCTION_LIST /end MEASUREMENT
/begin MEASUREMENT vVTFTHE "The amount of retard for the VTC clutch protection" UBYTE COMP_0256 1 100 -64 63.5 ECU_ADDRESS 0xFFFF1BE8 /begin FUNCTION_LIST /end FUNCTION_LIST /end MEASUREMENT
/begin MEASUREMENT vVTFTHI "The amount of retard for the VTC clutch protection" UBYTE COMP_0256 1 100 -64 63.5 ECU_ADDRESS 0xFFFF1BE9 /begin FUNCTION_LIST /end FUNCTION_LIST /end MEASUREMENT
/begin MEASUREMENT vVTFTIE2 "The amount of clutch protection retard quantity computed I-gain control" UWORD COMP_0174_S 1 100 0 127.998046875 ECU_ADDRESS 0xFFFF1BEA /begin FUNCTION_LIST /end FUNCTION_LIST /end MEASUREMENT
/begin MEASUREMENT vVTFTII2 "The amount of clutch protection retard quantity computed I-gain control" UWORD COMP_0174_S 1 100 0 127.998046875 ECU_ADDRESS 0xFFFF1BEC /begin FUNCTION_LIST /end FUNCTION_LIST /end MEASUREMENT
/begin MEASUREMENT vVTFTPE "The amount of clutch protection retard quantity computed P-gain control" UBYTE COMP_0048 1 100 0 127.5 ECU_ADDRESS 0xFFFF1BEE /begin FUNCTION_LIST /end FUNCTION_LIST /end MEASUREMENT
/begin MEASUREMENT vVTFTPI "The amount of clutch protection retard quantity computed P-gain control" UBYTE COMP_0048 1 100 0 127.5 ECU_ADDRESS 0xFFFF1BEF /begin FUNCTION_LIST /end FUNCTION_LIST /end MEASUREMENT
/begin MEASUREMENT vVTLMTGI "VTC basic target angle (after it deals with a change rate limitation, two bytes)" UWORD COMP_0528 1 100 -64 63.998046875 ECU_ADDRESS 0xFFFF1BF0 /begin FUNCTION_LIST /end FUNCTION_LIST /end MEASUREMENT
/begin MEASUREMENT vVTLNEEf "At fVTFBONE= 10 o'clock, VTLNEL#<=HNRPM<=VTLNEH# condition judgement" UBYTE COMP_0004 1 100 0 255 ECU_ADDRESS 0xFFFF1056 /begin FUNCTION_LIST /end FUNCTION_LIST /end MEASUREMENT
/begin MEASUREMENT vVTLNEIf "At fVTFBONI= 10 o'clock, VTLNEL#<=HNRPM<=VTLNEH# condition judgement" UBYTE COMP_0004 1 100 0 255 ECU_ADDRESS 0xFFFF1057 /begin FUNCTION_LIST /end FUNCTION_LIST /end MEASUREMENT
/begin MEASUREMENT vVTLNEREf "VTC, usually, learning renewal treatment left-right bank completion judgement" UBYTE COMP_0004 1 100 0 255 ECU_ADDRESS 0xFFFF1BF2 /begin FUNCTION_LIST /end FUNCTION_LIST /end MEASUREMENT
/begin MEASUREMENT vVTLNERIf "VTC, usually, learning renewal treatment left-right bank completion judgement" UBYTE COMP_0004 1 100 0 255 ECU_ADDRESS 0xFFFF1BF3 /begin FUNCTION_LIST /end FUNCTION_LIST /end MEASUREMENT
/begin MEASUREMENT vVTMTRHE "At the time of the stoichiometric, VTC target angle computed map reference value" UBYTE COMP_0256 1 100 -64 63.5 ECU_ADDRESS 0xFFFF1BF4 /begin FUNCTION_LIST /end FUNCTION_LIST /end MEASUREMENT
/begin MEASUREMENT vVTMTRHI "At the time of the stoichiometric, VTC target angle computed map reference value" UBYTE COMP_0256 1 100 -64 63.5 ECU_ADDRESS 0xFFFF1BF5 /begin FUNCTION_LIST /end FUNCTION_LIST /end MEASUREMENT
/begin MEASUREMENT vVTMTRLE "At the time of the stoichiometric, target angle computed map reference value (a low coolant temperature)" UBYTE COMP_0256 1 100 -64 63.5 ECU_ADDRESS 0xFFFF1BF6 /begin FUNCTION_LIST /end FUNCTION_LIST /end MEASUREMENT
/begin MEASUREMENT vVTMTRLI "At the time of the stoichiometric, target angle computed map reference value (a low coolant temperature)" UBYTE COMP_0256 1 100 -64 63.5 ECU_ADDRESS 0xFFFF1BF7 /begin FUNCTION_LIST /end FUNCTION_LIST /end MEASUREMENT
/begin MEASUREMENT vVTNOWPE "VTC operation angle" UBYTE COMP_0256 1 100 -64 63.5 ECU_ADDRESS 0xFFFF1BF8 /begin FUNCTION_LIST /end FUNCTION_LIST /end MEASUREMENT
/begin MEASUREMENT vVTNOWPE_R#1 "VTC operation angle" UBYTE COMP_0256 1 100 -64 63.5 ECU_ADDRESS 0xFFFF1BF8 /begin FUNCTION_LIST /end FUNCTION_LIST /end MEASUREMENT
/begin MEASUREMENT vVTNOWPE_R#2 "VTC operation angle" UBYTE COMP_0256 1 100 -64 63.5 ECU_ADDRESS 0xFFFF1BF9 /begin FUNCTION_LIST /end FUNCTION_LIST /end MEASUREMENT
/begin MEASUREMENT vVTNOWPI "VTC operation angle" UBYTE COMP_0256 1 100 -64 63.5 ECU_ADDRESS 0xFFFF1BFA /begin FUNCTION_LIST /end FUNCTION_LIST /end MEASUREMENT
/begin MEASUREMENT vVTNOWPI_R#1 "VTC operation angle" UBYTE COMP_0256 1 100 -64 63.5 ECU_ADDRESS 0xFFFF1BFA /begin FUNCTION_LIST /end FUNCTION_LIST /end MEASUREMENT
/begin MEASUREMENT vVTNOWPI_R#2 "VTC operation angle" UBYTE COMP_0256 1 100 -64 63.5 ECU_ADDRESS 0xFFFF1BFB /begin FUNCTION_LIST /end FUNCTION_LIST /end MEASUREMENT
/begin MEASUREMENT vVTNWPE "VTC operation angle" UBYTE COMP_0256 1 100 -64 63.5 ECU_ADDRESS 0xFFFF1BFC /begin FUNCTION_LIST /end FUNCTION_LIST /end MEASUREMENT
/begin MEASUREMENT vVTNWPE_R#1 "VTC operation angle" UBYTE COMP_0256 1 100 -64 63.5 ECU_ADDRESS 0xFFFF1BFC /begin FUNCTION_LIST /end FUNCTION_LIST /end MEASUREMENT
/begin MEASUREMENT vVTNWPE_R#2 "VTC operation angle" UBYTE COMP_0256 1 100 -64 63.5 ECU_ADDRESS 0xFFFF1BFD /begin FUNCTION_LIST /end FUNCTION_LIST /end MEASUREMENT
/begin MEASUREMENT vVTNWPEz1 "VTC operation angle (before one time)" UBYTE COMP_0256 1 100 -64 63.5 ECU_ADDRESS 0xFFFF1BFE /begin FUNCTION_LIST /end FUNCTION_LIST /end MEASUREMENT
/begin MEASUREMENT vVTNWPEz1_R#1 "VTC operation angle (before one time)" UBYTE COMP_0256 1 100 -64 63.5 ECU_ADDRESS 0xFFFF1BFE /begin FUNCTION_LIST /end FUNCTION_LIST /end MEASUREMENT
/begin MEASUREMENT vVTNWPEz1_R#2 "VTC operation angle (before one time)" UBYTE COMP_0256 1 100 -64 63.5 ECU_ADDRESS 0xFFFF1BFF /begin FUNCTION_LIST /end FUNCTION_LIST /end MEASUREMENT
/begin MEASUREMENT vVTNWPEz2 "VTC operation angle (before two times)" UBYTE COMP_0256 1 100 -64 63.5 ECU_ADDRESS 0xFFFF1C00 /begin FUNCTION_LIST /end FUNCTION_LIST /end MEASUREMENT
/begin MEASUREMENT vVTNWPEz2_R#1 "VTC operation angle (before two times)" UBYTE COMP_0256 1 100 -64 63.5 ECU_ADDRESS 0xFFFF1C00 /begin FUNCTION_LIST /end FUNCTION_LIST /end MEASUREMENT
/begin MEASUREMENT vVTNWPEz2_R#2 "VTC operation angle (before two times)" UBYTE COMP_0256 1 100 -64 63.5 ECU_ADDRESS 0xFFFF1C01 /begin FUNCTION_LIST /end FUNCTION_LIST /end MEASUREMENT
/begin MEASUREMENT vVTNWPI "VTC operation angle" UBYTE COMP_0256 1 100 -64 63.5 ECU_ADDRESS 0xFFFF1C02 /begin FUNCTION_LIST /end FUNCTION_LIST /end MEASUREMENT
/begin MEASUREMENT vVTNWPI_R#1 "VTC operation angle" UBYTE COMP_0256 1 100 -64 63.5 ECU_ADDRESS 0xFFFF1C02 /begin FUNCTION_LIST /end FUNCTION_LIST /end MEASUREMENT
/begin MEASUREMENT vVTNWPI_R#2 "VTC operation angle" UBYTE COMP_0256 1 100 -64 63.5 ECU_ADDRESS 0xFFFF1C03 /begin FUNCTION_LIST /end FUNCTION_LIST /end MEASUREMENT
/begin MEASUREMENT vVTNWPIz1 "VTC operation angle (before one time)" UBYTE COMP_0256 1 100 -64 63.5 ECU_ADDRESS 0xFFFF1C04 /begin FUNCTION_LIST /end FUNCTION_LIST /end MEASUREMENT
/begin MEASUREMENT vVTNWPIz1_R#1 "VTC operation angle (before one time)" UBYTE COMP_0256 1 100 -64 63.5 ECU_ADDRESS 0xFFFF1C04 /begin FUNCTION_LIST /end FUNCTION_LIST /end MEASUREMENT
/begin MEASUREMENT vVTNWPIz1_R#2 "VTC operation angle (before one time)" UBYTE COMP_0256 1 100 -64 63.5 ECU_ADDRESS 0xFFFF1C05 /begin FUNCTION_LIST /end FUNCTION_LIST /end MEASUREMENT
/begin MEASUREMENT vVTNWPIz2 "VTC operation angle (before two times)" UBYTE COMP_0256 1 100 -64 63.5 ECU_ADDRESS 0xFFFF1C06 /begin FUNCTION_LIST /end FUNCTION_LIST /end MEASUREMENT
/begin MEASUREMENT vVTNWPIz2_R#1 "VTC operation angle (before two times)" UBYTE COMP_0256 1 100 -64 63.5 ECU_ADDRESS 0xFFFF1C06 /begin FUNCTION_LIST /end FUNCTION_LIST /end MEASUREMENT
/begin MEASUREMENT vVTNWPIz2_R#2 "VTC operation angle (before two times)" UBYTE COMP_0256 1 100 -64 63.5 ECU_ADDRESS 0xFFFF1C07 /begin FUNCTION_LIST /end FUNCTION_LIST /end MEASUREMENT
/begin MEASUREMENT vVTRLNEEf "VTC rapid learning renewal treatment left-right bank completion judgement" UBYTE COMP_0004 1 100 0 255 ECU_ADDRESS 0xFFFF1C08 /begin FUNCTION_LIST /end FUNCTION_LIST /end MEASUREMENT
/begin MEASUREMENT vVTRLNEIf "VTC rapid learning renewal treatment left-right bank completion judgement" UBYTE COMP_0004 1 100 0 255 ECU_ADDRESS 0xFFFF1C09 /begin FUNCTION_LIST /end FUNCTION_LIST /end MEASUREMENT
/begin MEASUREMENT vVTTOIL "Clutch temperature computed oil temperature" UBYTE COMP_0035 1 100 -50 205 ECU_ADDRESS 0xFFFF34BD /begin FUNCTION_LIST /end FUNCTION_LIST /end MEASUREMENT
/begin MEASUREMENT vVTTRGE "VTC basic target angle (After it deals with a change rate limitation.)" UBYTE COMP_0256 1 100 -64 63.5 ECU_ADDRESS 0xFFFF1C0A /begin FUNCTION_LIST /end FUNCTION_LIST /end MEASUREMENT
/begin MEASUREMENT vVTTRGI "VTC basic target angle (After it deals with a change rate limitation.)" UBYTE COMP_0256 1 100 -64 63.5 ECU_ADDRESS 0xFFFF1C0B /begin FUNCTION_LIST /end FUNCTION_LIST /end MEASUREMENT
/begin MEASUREMENT vVXXGEARZ "Transmission ratio    for manual gearbox calculated by the engine control unit (previous value)" SBYTE COMP_0263 1 100 -128 127 ECU_ADDRESS 0xFFFF34BF /begin FUNCTION_LIST /end FUNCTION_LIST /end MEASUREMENT
/begin MEASUREMENT vV_APS_F "A filter is finished, ACC (virtual accelerator open-degree)" UBYTE COMP_0425 1 100 0 99.99999981 ECU_ADDRESS 0xFFFF1F5A /begin FUNCTION_LIST /end FUNCTION_LIST /end MEASUREMENT
/begin MEASUREMENT vWALPH2 "ALPHA (this time, just before the P-gain addition time) memory" UWORD COMP_0027 1 100 0 65535 ECU_ADDRESS 0xFFFF4000 /begin FUNCTION_LIST /end FUNCTION_LIST /end MEASUREMENT
/begin MEASUREMENT vWALPH3 "ALPHA (in front of one time, just before the P-gain addition time) memory" UWORD COMP_0027 1 100 0 65535 ECU_ADDRESS 0xFFFF4004 /begin FUNCTION_LIST /end FUNCTION_LIST /end MEASUREMENT
/begin MEASUREMENT vWALPH4 "ALPHA (in front of two times, just before the P-gain addition time) memory" UWORD COMP_0027 1 100 0 65535 ECU_ADDRESS 0xFFFF4008 /begin FUNCTION_LIST /end FUNCTION_LIST /end MEASUREMENT
/begin MEASUREMENT vWDTMAX "vWDTNGC_M MAX value" UBYTE COMP_0030 1 100 0 255 ECU_ADDRESS 0xFFFFB517 /begin FUNCTION_LIST /end FUNCTION_LIST /end MEASUREMENT
/begin MEASUREMENT vWFMFCA "Occurrence misfire number (the part of A) work by the region" UBYTE COMP_0016 1 100 0 255 ECU_ADDRESS 0xFFFF37C0 /begin FUNCTION_LIST /end FUNCTION_LIST /end MEASUREMENT
/begin MEASUREMENT vWFMFCB "Occurrence misfire number (the part of B) work by the region" UBYTE COMP_0016 1 100 0 255 ECU_ADDRESS 0xFFFF37C1 /begin FUNCTION_LIST /end FUNCTION_LIST /end MEASUREMENT
/begin MEASUREMENT vWFMFCC "Occurrence misfire number (the part of C) work by the region" UBYTE COMP_0016 1 100 0 255 ECU_ADDRESS 0xFFFF37C2 /begin FUNCTION_LIST /end FUNCTION_LIST /end MEASUREMENT
/begin MEASUREMENT vWFMFCD "Occurrence misfire number (the part of D) work by the region" UBYTE COMP_0016 1 100 0 255 ECU_ADDRESS 0xFFFF37C3 /begin FUNCTION_LIST /end FUNCTION_LIST /end MEASUREMENT
/begin MEASUREMENT vWFMFCE "Occurrence misfire number (the part of E) work by the region" UBYTE COMP_0016 1 100 0 255 ECU_ADDRESS 0xFFFF37C4 /begin FUNCTION_LIST /end FUNCTION_LIST /end MEASUREMENT
/begin MEASUREMENT vWFMFCF "Occurrence misfire number (the part of F) work by the region" UBYTE COMP_0016 1 100 0 255 ECU_ADDRESS 0xFFFF37C5 /begin FUNCTION_LIST /end FUNCTION_LIST /end MEASUREMENT
/begin MEASUREMENT vWRCKCT1_M "Again, writing counter 1" UBYTE COMP_0016 1 100 0 255 ECU_ADDRESS 0xFFFF34D4 /begin FUNCTION_LIST /end FUNCTION_LIST /end MEASUREMENT
/begin MEASUREMENT vWRCKCT2_M "Again, writing counter 2" UBYTE COMP_0016 1 100 0 255 ECU_ADDRESS 0xFFFF34D5 /begin FUNCTION_LIST /end FUNCTION_LIST /end MEASUREMENT
/begin MEASUREMENT vXL "PHOS1 lower limit peak value" UWORD COMP_0265 1 100 -8.000012288 7.999768147 ECU_ADDRESS 0xFFFF1C20 /begin FUNCTION_LIST /end FUNCTION_LIST /end MEASUREMENT
/begin MEASUREMENT vXL_R#1 "PHOS1 lower limit peak value" UWORD COMP_0265 1 100 -8.000012288 7.999768147 ECU_ADDRESS 0xFFFF1C20 /begin FUNCTION_LIST /end FUNCTION_LIST /end MEASUREMENT
/begin MEASUREMENT vXL_R#2 "PHOS1 lower limit peak value" UWORD COMP_0265 1 100 -8.000012288 7.999768147 ECU_ADDRESS 0xFFFF1C22 /begin FUNCTION_LIST /end FUNCTION_LIST /end MEASUREMENT
/begin MEASUREMENT vXLZ "PHOS minimum value" UWORD COMP_0265 1 100 -8.000012288 7.999768147 ECU_ADDRESS 0xFFFFB520 /begin FUNCTION_LIST /end FUNCTION_LIST /end MEASUREMENT
/begin MEASUREMENT vXLZ_R#1 "PHOS minimum value" UWORD COMP_0265 1 100 -8.000012288 7.999768147 ECU_ADDRESS 0xFFFFB520 /begin FUNCTION_LIST /end FUNCTION_LIST /end MEASUREMENT
/begin MEASUREMENT vXLZ_R#2 "PHOS minimum value" UWORD COMP_0265 1 100 -8.000012288 7.999768147 ECU_ADDRESS 0xFFFFB522 /begin FUNCTION_LIST /end FUNCTION_LIST /end MEASUREMENT
/begin MEASUREMENT vXPBAV "PBAV weighted average index number" UBYTE COMP_0068 1 100 0 255 ECU_ADDRESS 0xFFFF1DE1 /begin FUNCTION_LIST /end FUNCTION_LIST /end MEASUREMENT
/begin MEASUREMENT vXU "PHOS1 upper limit peak value" UWORD COMP_0265 1 100 -8.000012288 7.999768147 ECU_ADDRESS 0xFFFF1C24 /begin FUNCTION_LIST /end FUNCTION_LIST /end MEASUREMENT
/begin MEASUREMENT vXU_R#1 "PHOS1 upper limit peak value" UWORD COMP_0265 1 100 -8.000012288 7.999768147 ECU_ADDRESS 0xFFFF1C24 /begin FUNCTION_LIST /end FUNCTION_LIST /end MEASUREMENT
/begin MEASUREMENT vXU_R#2 "PHOS1 upper limit peak value" UWORD COMP_0265 1 100 -8.000012288 7.999768147 ECU_ADDRESS 0xFFFF1C26 /begin FUNCTION_LIST /end FUNCTION_LIST /end MEASUREMENT
/begin MEASUREMENT vXUZ "PHOS maximum value" UWORD COMP_0265 1 100 -8.000012288 7.999768147 ECU_ADDRESS 0xFFFFB524 /begin FUNCTION_LIST /end FUNCTION_LIST /end MEASUREMENT
/begin MEASUREMENT vXUZ_R#1 "PHOS maximum value" UWORD COMP_0265 1 100 -8.000012288 7.999768147 ECU_ADDRESS 0xFFFFB524 /begin FUNCTION_LIST /end FUNCTION_LIST /end MEASUREMENT
/begin MEASUREMENT vXUZ_R#2 "PHOS maximum value" UWORD COMP_0265 1 100 -8.000012288 7.999768147 ECU_ADDRESS 0xFFFFB526 /begin FUNCTION_LIST /end FUNCTION_LIST /end MEASUREMENT
/begin MEASUREMENT vZDETDLYf "ZDET signal delay excuse" UBYTE COMP_0068 1 100 0 255 ECU_ADDRESS 0xFFFF4020 /begin FUNCTION_LIST /end FUNCTION_LIST /end MEASUREMENT
/begin MEASUREMENT vZOKAf "Increase decrease flag" UBYTE COMP_0004 1 100 0 255 ECU_ADDRESS 0xFFFF3838 /begin FUNCTION_LIST /end FUNCTION_LIST /end MEASUREMENT
/begin MEASUREMENT vZPRSCLM "Climate pressure area" UBYTE COMP_0068 1 100 0 255 ECU_ADDRESS 0xFFFF34E0 /begin FUNCTION_LIST /end FUNCTION_LIST /end MEASUREMENT
/begin MEASUREMENT vbfALPCALE "ALPHA operation judgement (0: 1: that it wasn't calculated was calculated.)" UBYTE COMP_0283 1 100 0 255 ECU_ADDRESS 0xFFFF28D4 /begin FUNCTION_LIST /end FUNCTION_LIST /end MEASUREMENT
/begin MEASUREMENT vbfALPCALE_R#1 "ALPHA operation judgement (0: 1: that it wasn't calculated was calculated.)" UBYTE COMP_0283 1 100 0 255 ECU_ADDRESS 0xFFFF28D4 /begin FUNCTION_LIST /end FUNCTION_LIST /end MEASUREMENT
/begin MEASUREMENT vbfALPCALE_R#2 "ALPHA operation judgement (0: 1: that it wasn't calculated was calculated.)" UBYTE COMP_0283 1 100 0 255 ECU_ADDRESS 0xFFFF28D5 /begin FUNCTION_LIST /end FUNCTION_LIST /end MEASUREMENT
/begin MEASUREMENT vbfLMCLSTE "Close control start flag" UBYTE COMP_0283 1 100 0 255 ECU_ADDRESS 0xFFFF28E0 /begin FUNCTION_LIST /end FUNCTION_LIST /end MEASUREMENT
/begin MEASUREMENT vbfLMCLSTE_R#1 "Close control start flag" UBYTE COMP_0283 1 100 0 255 ECU_ADDRESS 0xFFFF28E0 /begin FUNCTION_LIST /end FUNCTION_LIST /end MEASUREMENT
/begin MEASUREMENT vbfLMCLSTE_R#2 "Close control start flag" UBYTE COMP_0283 1 100 0 255 ECU_ADDRESS 0xFFFF28E1 /begin FUNCTION_LIST /end FUNCTION_LIST /end MEASUREMENT
/begin MEASUREMENT vbfLMDCLSE "Lambda control open close judgement flag" UBYTE COMP_0283 1 100 0 255 ECU_ADDRESS 0xFFFF28E2 /begin FUNCTION_LIST /end FUNCTION_LIST /end MEASUREMENT
/begin MEASUREMENT vbfLMDCLSE_R#1 "Lambda control open close judgement flag" UBYTE COMP_0283 1 100 0 255 ECU_ADDRESS 0xFFFF28E2 /begin FUNCTION_LIST /end FUNCTION_LIST /end MEASUREMENT
/begin MEASUREMENT vbfLMDCLSE_R#2 "Lambda control open close judgement flag" UBYTE COMP_0283 1 100 0 255 ECU_ADDRESS 0xFFFF28E3 /begin FUNCTION_LIST /end FUNCTION_LIST /end MEASUREMENT
/begin MEASUREMENT vbfLMDRCHE "Lambda control rich lean judgement flag (0: lean    1: rich)" UBYTE COMP_0283 1 100 0 255 ECU_ADDRESS 0xFFFF28E4 /begin FUNCTION_LIST /end FUNCTION_LIST /end MEASUREMENT
/begin MEASUREMENT vbfLMDRCHE_R#1 "Lambda control rich lean judgement flag (0: lean    1: rich)" UBYTE COMP_0283 1 100 0 255 ECU_ADDRESS 0xFFFF28E4 /begin FUNCTION_LIST /end FUNCTION_LIST /end MEASUREMENT
/begin MEASUREMENT vbfLMDRCHE_R#2 "Lambda control rich lean judgement flag (0: lean    1: rich)" UBYTE COMP_0283 1 100 0 255 ECU_ADDRESS 0xFFFF28E5 /begin FUNCTION_LIST /end FUNCTION_LIST /end MEASUREMENT
/begin MEASUREMENT vbfMOPENE "Monitor clamp occurrence judgement (0: There is no occurrence.    1: occurrence)" UBYTE COMP_0283 1 100 0 255 ECU_ADDRESS 0xFFFF28E6 /begin FUNCTION_LIST /end FUNCTION_LIST /end MEASUREMENT
/begin MEASUREMENT vbfMOPENE_R#1 "Monitor clamp occurrence judgement (0: There is no occurrence.    1: occurrence)" UBYTE COMP_0283 1 100 0 255 ECU_ADDRESS 0xFFFF28E6 /begin FUNCTION_LIST /end FUNCTION_LIST /end MEASUREMENT
/begin MEASUREMENT vbfMOPENE_R#2 "Monitor clamp occurrence judgement (0: There is no occurrence.    1: occurrence)" UBYTE COMP_0283 1 100 0 255 ECU_ADDRESS 0xFFFF28E7 /begin FUNCTION_LIST /end FUNCTION_LIST /end MEASUREMENT
/begin MEASUREMENT vfABFCMPE "A/F clamp requirement flag (0: the 1: clamp which doesn't do a clamp)" UBYTE COMP_0068 1 100 0 255 ECU_ADDRESS 0xFFFF2CE5 /begin FUNCTION_LIST /end FUNCTION_LIST /end MEASUREMENT
/begin MEASUREMENT vfABFCMPE_R#1 "A/F clamp requirement flag (0: the 1: clamp which doesn't do a clamp)" UBYTE COMP_0068 1 100 0 255 ECU_ADDRESS 0xFFFF2CE5 /begin FUNCTION_LIST /end FUNCTION_LIST /end MEASUREMENT
/begin MEASUREMENT vfABFCMPE_R#2 "A/F clamp requirement flag (0: the 1: clamp which doesn't do a clamp)" UBYTE COMP_0068 1 100 0 255 ECU_ADDRESS 0xFFFF2CE6 /begin FUNCTION_LIST /end FUNCTION_LIST /end MEASUREMENT
/begin MEASUREMENT vfAFDFIN "Diagnosis completion flag" UBYTE COMP_0068 1 100 0 255 ECU_ADDRESS 0xFFFF2CEB /begin FUNCTION_LIST /end FUNCTION_LIST /end MEASUREMENT
/begin MEASUREMENT vfAFDFIN_R#1 "Diagnosis completion flag" UBYTE COMP_0068 1 100 0 255 ECU_ADDRESS 0xFFFF2CEB /begin FUNCTION_LIST /end FUNCTION_LIST /end MEASUREMENT
/begin MEASUREMENT vfAFDFIN_R#2 "Diagnosis completion flag" UBYTE COMP_0068 1 100 0 255 ECU_ADDRESS 0xFFFF2CEC /begin FUNCTION_LIST /end FUNCTION_LIST /end MEASUREMENT
/begin MEASUREMENT vfAFDGNSTP "A diagnosis prohibition flag by other diagnoses" UBYTE COMP_0068 1 100 0 255 ECU_ADDRESS 0xFFFF2CED /begin FUNCTION_LIST /end FUNCTION_LIST /end MEASUREMENT
/begin MEASUREMENT vfAFDGNSTP_R#1 "A diagnosis prohibition flag by other diagnoses" UBYTE COMP_0068 1 100 0 255 ECU_ADDRESS 0xFFFF2CED /begin FUNCTION_LIST /end FUNCTION_LIST /end MEASUREMENT
/begin MEASUREMENT vfAFDGNSTP_R#2 "A diagnosis prohibition flag by other diagnoses" UBYTE COMP_0068 1 100 0 255 ECU_ADDRESS 0xFFFF2CEE /begin FUNCTION_LIST /end FUNCTION_LIST /end MEASUREMENT
/begin MEASUREMENT vfCALPSET "Reference A/F, very, ALPHA computed completion flag" UBYTE COMP_0068 1 100 0 255 ECU_ADDRESS 0xFFFF2CFF /begin FUNCTION_LIST /end FUNCTION_LIST /end MEASUREMENT
/begin MEASUREMENT vfCALPSET_R#1 "Reference A/F, very, ALPHA computed completion flag" UBYTE COMP_0068 1 100 0 255 ECU_ADDRESS 0xFFFF2CFF /begin FUNCTION_LIST /end FUNCTION_LIST /end MEASUREMENT
/begin MEASUREMENT vfCALPSET_R#2 "Reference A/F, very, ALPHA computed completion flag" UBYTE COMP_0068 1 100 0 255 ECU_ADDRESS 0xFFFF2D00 /begin FUNCTION_LIST /end FUNCTION_LIST /end MEASUREMENT
/begin MEASUREMENT vfCATDIL "A former time lean judgement flag for the catalyst diagnosis" UBYTE COMP_0283 1 100 0 255 ECU_ADDRESS 0xFFFF2D0F /begin FUNCTION_LIST /end FUNCTION_LIST /end MEASUREMENT
/begin MEASUREMENT vfCATDIL_R#1 "A former time lean judgement flag for the catalyst diagnosis" UBYTE COMP_0283 1 100 0 255 ECU_ADDRESS 0xFFFF2D0F /begin FUNCTION_LIST /end FUNCTION_LIST /end MEASUREMENT
/begin MEASUREMENT vfCATDIL_R#2 "A former time lean judgement flag for the catalyst diagnosis" UBYTE COMP_0283 1 100 0 255 ECU_ADDRESS 0xFFFF2D10 /begin FUNCTION_LIST /end FUNCTION_LIST /end MEASUREMENT
/begin MEASUREMENT vfCATDIR "A former time rich judgement flag for the catalyst diagnosis" UBYTE COMP_0283 1 100 0 255 ECU_ADDRESS 0xFFFF2D11 /begin FUNCTION_LIST /end FUNCTION_LIST /end MEASUREMENT
/begin MEASUREMENT vfCATDIR_R#1 "A former time rich judgement flag for the catalyst diagnosis" UBYTE COMP_0283 1 100 0 255 ECU_ADDRESS 0xFFFF2D11 /begin FUNCTION_LIST /end FUNCTION_LIST /end MEASUREMENT
/begin MEASUREMENT vfCATDIR_R#2 "A former time rich judgement flag for the catalyst diagnosis" UBYTE COMP_0283 1 100 0 255 ECU_ADDRESS 0xFFFF2D12 /begin FUNCTION_LIST /end FUNCTION_LIST /end MEASUREMENT
/begin MEASUREMENT vfCLMPAE "Clamp judgement flag" UBYTE COMP_0283 1 100 0 255 ECU_ADDRESS 0xFFFF2D24 /begin FUNCTION_LIST /end FUNCTION_LIST /end MEASUREMENT
/begin MEASUREMENT vfCLMPAE_R#1 "Clamp judgement flag" UBYTE COMP_0283 1 100 0 255 ECU_ADDRESS 0xFFFF2D24 /begin FUNCTION_LIST /end FUNCTION_LIST /end MEASUREMENT
/begin MEASUREMENT vfCLMPAE_R#2 "Clamp judgement flag" UBYTE COMP_0283 1 100 0 255 ECU_ADDRESS 0xFFFF2D25 /begin FUNCTION_LIST /end FUNCTION_LIST /end MEASUREMENT
/begin MEASUREMENT vfCLMPE "Gradual clamp flag" UBYTE COMP_0283 1 100 0 255 ECU_ADDRESS 0xFFFF2D26 /begin FUNCTION_LIST /end FUNCTION_LIST /end MEASUREMENT
/begin MEASUREMENT vfCLMPE_R#1 "Gradual clamp flag" UBYTE COMP_0283 1 100 0 255 ECU_ADDRESS 0xFFFF2D26 /begin FUNCTION_LIST /end FUNCTION_LIST /end MEASUREMENT
/begin MEASUREMENT vfCLMPE_R#2 "Gradual clamp flag" UBYTE COMP_0283 1 100 0 255 ECU_ADDRESS 0xFFFF2D27 /begin FUNCTION_LIST /end FUNCTION_LIST /end MEASUREMENT
/begin MEASUREMENT vfCLTFB0E "CLOSED LOOP for the catalyst early activated control, TFBYA condition" UBYTE COMP_0283 1 100 0 255 ECU_ADDRESS 0xFFFF1368 /begin FUNCTION_LIST /end FUNCTION_LIST /end MEASUREMENT
/begin MEASUREMENT vfDCLMPO "Slowdown lean clamp judgement flag" UBYTE COMP_0068 1 100 0 255 ECU_ADDRESS 0xFFFF2D33 /begin FUNCTION_LIST /end FUNCTION_LIST /end MEASUREMENT
/begin MEASUREMENT vfDRVJUGE "Operation countermeasure region judgement flag (0: except for the operation countermeasure region, 1: operation countermeasure region)" UBYTE COMP_0283 1 100 0 255 ECU_ADDRESS 0xFFFF2D41 /begin FUNCTION_LIST /end FUNCTION_LIST /end MEASUREMENT
/begin MEASUREMENT vfDRVJUGE_R#1 "Operation countermeasure region judgement flag (0: except for the operation countermeasure region, 1: operation countermeasure region)" UBYTE COMP_0283 1 100 0 255 ECU_ADDRESS 0xFFFF2D41 /begin FUNCTION_LIST /end FUNCTION_LIST /end MEASUREMENT
/begin MEASUREMENT vfDRVJUGE_R#2 "Operation countermeasure region judgement flag (0: except for the operation countermeasure region, 1: operation countermeasure region)" UBYTE COMP_0283 1 100 0 255 ECU_ADDRESS 0xFFFF2D42 /begin FUNCTION_LIST /end FUNCTION_LIST /end MEASUREMENT
/begin MEASUREMENT vfETRP54E "Trip counter completion flag" UBYTE COMP_0068 1 100 0 255 ECU_ADDRESS 0xFFFF2D4A /begin FUNCTION_LIST /end FUNCTION_LIST /end MEASUREMENT
/begin MEASUREMENT vfFAFSACTE "A/F sensor activated judgement (0: failure    1: formation)" UBYTE COMP_0068 1 100 0 255 ECU_ADDRESS 0xFFFF2D4E /begin FUNCTION_LIST /end FUNCTION_LIST /end MEASUREMENT
/begin MEASUREMENT vfFAFSACTE_R#1 "A/F sensor activated judgement (0: failure    1: formation)" UBYTE COMP_0068 1 100 0 255 ECU_ADDRESS 0xFFFF2D4E /begin FUNCTION_LIST /end FUNCTION_LIST /end MEASUREMENT
/begin MEASUREMENT vfFAFSACTE_R#2 "A/F sensor activated judgement (0: failure    1: formation)" UBYTE COMP_0068 1 100 0 255 ECU_ADDRESS 0xFFFF2D4F /begin FUNCTION_LIST /end FUNCTION_LIST /end MEASUREMENT
/begin MEASUREMENT vfFCIN "The bottom storage count set flag of the floor" UBYTE COMP_0068 1 100 0 255 ECU_ADDRESS 0xFFFF2D50 /begin FUNCTION_LIST /end FUNCTION_LIST /end MEASUREMENT
/begin MEASUREMENT vfFCUTRCVE "Fuel cut recover flag (0 : during the F/C recover inside 1:F/C recover)" UBYTE COMP_0283 1 100 0 255 ECU_ADDRESS 0xFFFF2D51 /begin FUNCTION_LIST /end FUNCTION_LIST /end MEASUREMENT
/begin MEASUREMENT vfFCUTRCVE_R#1 "Fuel cut recover flag (0 : during the F/C recover inside 1:F/C recover)" UBYTE COMP_0283 1 100 0 255 ECU_ADDRESS 0xFFFF2D51 /begin FUNCTION_LIST /end FUNCTION_LIST /end MEASUREMENT
/begin MEASUREMENT vfFCUTRCVE_R#2 "Fuel cut recover flag (0 : during the F/C recover inside 1:F/C recover)" UBYTE COMP_0283 1 100 0 255 ECU_ADDRESS 0xFFFF2D52 /begin FUNCTION_LIST /end FUNCTION_LIST /end MEASUREMENT
/begin MEASUREMENT vfFRODWN "Lean direction movement flag" UBYTE COMP_0283 1 100 0 255 ECU_ADDRESS 0xFFFF2D5B /begin FUNCTION_LIST /end FUNCTION_LIST /end MEASUREMENT
/begin MEASUREMENT vfFRODWN_R#1 "Lean direction movement flag" UBYTE COMP_0283 1 100 0 255 ECU_ADDRESS 0xFFFF2D5B /begin FUNCTION_LIST /end FUNCTION_LIST /end MEASUREMENT
/begin MEASUREMENT vfFRODWN_R#2 "Lean direction movement flag" UBYTE COMP_0283 1 100 0 255 ECU_ADDRESS 0xFFFF2D5C /begin FUNCTION_LIST /end FUNCTION_LIST /end MEASUREMENT
/begin MEASUREMENT vfFROUP "Rich direction movement flag" UBYTE COMP_0283 1 100 0 255 ECU_ADDRESS 0xFFFF2D5D /begin FUNCTION_LIST /end FUNCTION_LIST /end MEASUREMENT
/begin MEASUREMENT vfFROUP_R#1 "Rich direction movement flag" UBYTE COMP_0283 1 100 0 255 ECU_ADDRESS 0xFFFF2D5D /begin FUNCTION_LIST /end FUNCTION_LIST /end MEASUREMENT
/begin MEASUREMENT vfFROUP_R#2 "Rich direction movement flag" UBYTE COMP_0283 1 100 0 255 ECU_ADDRESS 0xFFFF2D5E /begin FUNCTION_LIST /end FUNCTION_LIST /end MEASUREMENT
/begin MEASUREMENT vfGRDCLPM "After the monitor clamp, CLOSE control prohibition time timer count start flag" UBYTE COMP_0283 1 100 0 255 ECU_ADDRESS 0xFFFF2D62 /begin FUNCTION_LIST /end FUNCTION_LIST /end MEASUREMENT
/begin MEASUREMENT vfGRDCLPM_R#1 "After the monitor clamp, CLOSE control prohibition time timer count start flag" UBYTE COMP_0283 1 100 0 255 ECU_ADDRESS 0xFFFF2D62 /begin FUNCTION_LIST /end FUNCTION_LIST /end MEASUREMENT
/begin MEASUREMENT vfGRDCLPM_R#2 "After the monitor clamp, CLOSE control prohibition time timer count start flag" UBYTE COMP_0283 1 100 0 255 ECU_ADDRESS 0xFFFF2D63 /begin FUNCTION_LIST /end FUNCTION_LIST /end MEASUREMENT
/begin MEASUREMENT vfHIAIRFCE "A high air quantity fuel cut judgement (0: failure 1: formation)" UBYTE COMP_0283 1 100 0 255 ECU_ADDRESS 0xFFFF2D64 /begin FUNCTION_LIST /end FUNCTION_LIST /end MEASUREMENT
/begin MEASUREMENT vfHIAIRFCE_R#1 "A high air quantity fuel cut judgement (0: failure 1: formation)" UBYTE COMP_0283 1 100 0 255 ECU_ADDRESS 0xFFFF2D64 /begin FUNCTION_LIST /end FUNCTION_LIST /end MEASUREMENT
/begin MEASUREMENT vfHIAIRFCE_R#2 "A high air quantity fuel cut judgement (0: failure 1: formation)" UBYTE COMP_0283 1 100 0 255 ECU_ADDRESS 0xFFFF2D65 /begin FUNCTION_LIST /end FUNCTION_LIST /end MEASUREMENT
/begin MEASUREMENT vfIDLEE "Idle switch (0: off    1:0 N)" UBYTE COMP_0068 1 100 0 255 ECU_ADDRESS 0xFFFF2D68 /begin FUNCTION_LIST /end FUNCTION_LIST /end MEASUREMENT
/begin MEASUREMENT vfLIMEX "After F/C, LSOSQ release start flag" UBYTE COMP_0283 1 100 0 255 ECU_ADDRESS 0xFFFF2D6E /begin FUNCTION_LIST /end FUNCTION_LIST /end MEASUREMENT
/begin MEASUREMENT vfLIMEX_R#1 "After F/C, LSOSQ release start flag" UBYTE COMP_0283 1 100 0 255 ECU_ADDRESS 0xFFFF2D6E /begin FUNCTION_LIST /end FUNCTION_LIST /end MEASUREMENT
/begin MEASUREMENT vfLIMEX_R#2 "After F/C, LSOSQ release start flag" UBYTE COMP_0283 1 100 0 255 ECU_ADDRESS 0xFFFF2D6F /begin FUNCTION_LIST /end FUNCTION_LIST /end MEASUREMENT
/begin MEASUREMENT vfLIMEX2 "Rich-ization start flag" UBYTE COMP_0283 1 100 0 255 ECU_ADDRESS 0xFFFF2D70 /begin FUNCTION_LIST /end FUNCTION_LIST /end MEASUREMENT
/begin MEASUREMENT vfLIMEX2_R#1 "Rich-ization start flag" UBYTE COMP_0283 1 100 0 255 ECU_ADDRESS 0xFFFF2D70 /begin FUNCTION_LIST /end FUNCTION_LIST /end MEASUREMENT
/begin MEASUREMENT vfLIMEX2_R#2 "Rich-ization start flag" UBYTE COMP_0283 1 100 0 255 ECU_ADDRESS 0xFFFF2D71 /begin FUNCTION_LIST /end FUNCTION_LIST /end MEASUREMENT
/begin MEASUREMENT vfLJUGEZ "Lean judgement flag (0 : It is 1:Lean which is not Lean.) previous value" UBYTE COMP_0283 1 100 0 255 ECU_ADDRESS 0xFFFF3D71 /begin FUNCTION_LIST /end FUNCTION_LIST /end MEASUREMENT
/begin MEASUREMENT vfLJUGEZ_R#1 "Lean judgement flag (0 : It is 1:Lean which is not Lean.) previous value" UBYTE COMP_0283 1 100 0 255 ECU_ADDRESS 0xFFFF3D71 /begin FUNCTION_LIST /end FUNCTION_LIST /end MEASUREMENT
/begin MEASUREMENT vfLJUGEZ_R#2 "Lean judgement flag (0 : It is 1:Lean which is not Lean.) previous value" UBYTE COMP_0283 1 100 0 255 ECU_ADDRESS 0xFFFF3D72 /begin FUNCTION_LIST /end FUNCTION_LIST /end MEASUREMENT
/begin MEASUREMENT vfLNRSETE "Lean side reset flag" UBYTE COMP_0283 1 100 0 255 ECU_ADDRESS 0xFFFF2D74 /begin FUNCTION_LIST /end FUNCTION_LIST /end MEASUREMENT
/begin MEASUREMENT vfLNRSETE_R#1 "Lean side reset flag" UBYTE COMP_0283 1 100 0 255 ECU_ADDRESS 0xFFFF2D74 /begin FUNCTION_LIST /end FUNCTION_LIST /end MEASUREMENT
/begin MEASUREMENT vfLNRSETE_R#2 "Lean side reset flag" UBYTE COMP_0283 1 100 0 255 ECU_ADDRESS 0xFFFF2D75 /begin FUNCTION_LIST /end FUNCTION_LIST /end MEASUREMENT
/begin MEASUREMENT vfMCLPEKBE "Non-monitor clamp-> monitor clamp judgement (for the KBLRCB operation) (0: non-monitor clamp-> monitor clamp failure 1: monitor clamp-> monitor clamp formation)" UBYTE COMP_0068 1 100 0 255 ECU_ADDRESS 0xFFFF2D7C /begin FUNCTION_LIST /end FUNCTION_LIST /end MEASUREMENT
/begin MEASUREMENT vfMCLPEKBE_R#1 "Non-monitor clamp-> monitor clamp judgement (for the KBLRCB operation) (0: non-monitor clamp-> monitor clamp failure 1: monitor clamp-> monitor clamp formation)" UBYTE COMP_0068 1 100 0 255 ECU_ADDRESS 0xFFFF2D7C /begin FUNCTION_LIST /end FUNCTION_LIST /end MEASUREMENT
/begin MEASUREMENT vfMCLPEKBE_R#2 "Non-monitor clamp-> monitor clamp judgement (for the KBLRCB operation) (0: non-monitor clamp-> monitor clamp failure 1: monitor clamp-> monitor clamp formation)" UBYTE COMP_0068 1 100 0 255 ECU_ADDRESS 0xFFFF2D7D /begin FUNCTION_LIST /end FUNCTION_LIST /end MEASUREMENT
/begin MEASUREMENT vfMONCLP1E "Monitor clamp flag" UBYTE COMP_0283 1 100 0 255 ECU_ADDRESS 0xFFFF2D7F /begin FUNCTION_LIST /end FUNCTION_LIST /end MEASUREMENT
/begin MEASUREMENT vfMONCLP1E_R#1 "Monitor clamp flag" UBYTE COMP_0283 1 100 0 255 ECU_ADDRESS 0xFFFF2D7F /begin FUNCTION_LIST /end FUNCTION_LIST /end MEASUREMENT
/begin MEASUREMENT vfMONCLP1E_R#2 "Monitor clamp flag" UBYTE COMP_0283 1 100 0 255 ECU_ADDRESS 0xFFFF2D80 /begin FUNCTION_LIST /end FUNCTION_LIST /end MEASUREMENT
/begin MEASUREMENT vfNEUTE "Neutral switch (0: off    1:0 N)" UBYTE COMP_0068 1 100 0 255 ECU_ADDRESS 0xFFFF2D81 /begin FUNCTION_LIST /end FUNCTION_LIST /end MEASUREMENT
/begin MEASUREMENT vfOSCONE "OSC control-in-progress judgement flag (0 : 1:OSC control-in-progress which is not OSC control-in-progress)" UBYTE COMP_0283 1 100 0 255 ECU_ADDRESS 0xFFFF2D9B /begin FUNCTION_LIST /end FUNCTION_LIST /end MEASUREMENT
/begin MEASUREMENT vfOSCONE_R#1 "OSC control-in-progress judgement flag (0 : 1:OSC control-in-progress which is not OSC control-in-progress)" UBYTE COMP_0283 1 100 0 255 ECU_ADDRESS 0xFFFF2D9B /begin FUNCTION_LIST /end FUNCTION_LIST /end MEASUREMENT
/begin MEASUREMENT vfOSCONE_R#2 "OSC control-in-progress judgement flag (0 : 1:OSC control-in-progress which is not OSC control-in-progress)" UBYTE COMP_0283 1 100 0 255 ECU_ADDRESS 0xFFFF2D9C /begin FUNCTION_LIST /end FUNCTION_LIST /end MEASUREMENT
/begin MEASUREMENT vfOSQRSTE "A flag (0: time measuring 1: measure time reset) for catalyst diagnosis parameter measuring" UBYTE COMP_0283 1 100 0 255 ECU_ADDRESS 0xFFFF2D9D /begin FUNCTION_LIST /end FUNCTION_LIST /end MEASUREMENT
/begin MEASUREMENT vfOSQRSTE_R#1 "A flag (0: time measuring 1: measure time reset) for catalyst diagnosis parameter measuring" UBYTE COMP_0283 1 100 0 255 ECU_ADDRESS 0xFFFF2D9D /begin FUNCTION_LIST /end FUNCTION_LIST /end MEASUREMENT
/begin MEASUREMENT vfOSQRSTE_R#2 "A flag (0: time measuring 1: measure time reset) for catalyst diagnosis parameter measuring" UBYTE COMP_0283 1 100 0 255 ECU_ADDRESS 0xFFFF2D9E /begin FUNCTION_LIST /end FUNCTION_LIST /end MEASUREMENT
/begin MEASUREMENT vfOSREL1E "Lean side O2 storage ability operation flag (0: the 1: calculation which does nothing)" UBYTE COMP_0283 1 100 0 255 ECU_ADDRESS 0xFFFF2D9F /begin FUNCTION_LIST /end FUNCTION_LIST /end MEASUREMENT
/begin MEASUREMENT vfOSREL1E_R#1 "Lean side O2 storage ability operation flag (0: the 1: calculation which does nothing)" UBYTE COMP_0283 1 100 0 255 ECU_ADDRESS 0xFFFF2D9F /begin FUNCTION_LIST /end FUNCTION_LIST /end MEASUREMENT
/begin MEASUREMENT vfOSREL1E_R#2 "Lean side O2 storage ability operation flag (0: the 1: calculation which does nothing)" UBYTE COMP_0283 1 100 0 255 ECU_ADDRESS 0xFFFF2DA0 /begin FUNCTION_LIST /end FUNCTION_LIST /end MEASUREMENT
/begin MEASUREMENT vfOSRER1E "Rich side O2 storage ability operation flag (0: the 1: calculation which does nothing)" UBYTE COMP_0283 1 100 0 255 ECU_ADDRESS 0xFFFF2DA1 /begin FUNCTION_LIST /end FUNCTION_LIST /end MEASUREMENT
/begin MEASUREMENT vfOSRER1E_R#1 "Rich side O2 storage ability operation flag (0: the 1: calculation which does nothing)" UBYTE COMP_0283 1 100 0 255 ECU_ADDRESS 0xFFFF2DA1 /begin FUNCTION_LIST /end FUNCTION_LIST /end MEASUREMENT
/begin MEASUREMENT vfOSRER1E_R#2 "Rich side O2 storage ability operation flag (0: the 1: calculation which does nothing)" UBYTE COMP_0283 1 100 0 255 ECU_ADDRESS 0xFFFF2DA2 /begin FUNCTION_LIST /end FUNCTION_LIST /end MEASUREMENT
/begin MEASUREMENT vfRCRSETE "Rich side reset flag" UBYTE COMP_0283 1 100 0 255 ECU_ADDRESS 0xFFFF2DA5 /begin FUNCTION_LIST /end FUNCTION_LIST /end MEASUREMENT
/begin MEASUREMENT vfRCRSETE_R#1 "Rich side reset flag" UBYTE COMP_0283 1 100 0 255 ECU_ADDRESS 0xFFFF2DA5 /begin FUNCTION_LIST /end FUNCTION_LIST /end MEASUREMENT
/begin MEASUREMENT vfRCRSETE_R#2 "Rich side reset flag" UBYTE COMP_0283 1 100 0 255 ECU_ADDRESS 0xFFFF2DA6 /begin FUNCTION_LIST /end FUNCTION_LIST /end MEASUREMENT
/begin MEASUREMENT vfRJUGEZ "Rich judgement flag (0 : It is 1:Rich which is not Rich.) previous value" UBYTE COMP_0283 1 100 0 255 ECU_ADDRESS 0xFFFF3D8A /begin FUNCTION_LIST /end FUNCTION_LIST /end MEASUREMENT
/begin MEASUREMENT vfRJUGEZ_R#1 "Rich judgement flag (0 : It is 1:Rich which is not Rich.) previous value" UBYTE COMP_0283 1 100 0 255 ECU_ADDRESS 0xFFFF3D8A /begin FUNCTION_LIST /end FUNCTION_LIST /end MEASUREMENT
/begin MEASUREMENT vfRJUGEZ_R#2 "Rich judgement flag (0 : It is 1:Rich which is not Rich.) previous value" UBYTE COMP_0283 1 100 0 255 ECU_ADDRESS 0xFFFF3D8B /begin FUNCTION_LIST /end FUNCTION_LIST /end MEASUREMENT
/begin MEASUREMENT vfRLTGT "Rich/lean switching flag" UBYTE COMP_0068 1 100 0 255 ECU_ADDRESS 0xFFFF2DAB /begin FUNCTION_LIST /end FUNCTION_LIST /end MEASUREMENT
/begin MEASUREMENT vfRLTGT_R#1 "Rich/lean switching flag" UBYTE COMP_0068 1 100 0 255 ECU_ADDRESS 0xFFFF2DAB /begin FUNCTION_LIST /end FUNCTION_LIST /end MEASUREMENT
/begin MEASUREMENT vfRLTGT_R#2 "Rich/lean switching flag" UBYTE COMP_0068 1 100 0 255 ECU_ADDRESS 0xFFFF2DAC /begin FUNCTION_LIST /end FUNCTION_LIST /end MEASUREMENT
/begin MEASUREMENT vfRO2HONE "Rest O2 heater ON/ off" UBYTE COMP_0068 1 100 0 255 ECU_ADDRESS 0xFFFF13A4 /begin FUNCTION_LIST /end FUNCTION_LIST /end MEASUREMENT
/begin MEASUREMENT vfRO2HONE_R#1 "Rest O2 heater ON/ off" UBYTE COMP_0068 1 100 0 255 ECU_ADDRESS 0xFFFF13A4 /begin FUNCTION_LIST /end FUNCTION_LIST /end MEASUREMENT
/begin MEASUREMENT vfRO2HONE_R#2 "Rest O2 heater ON/ off" UBYTE COMP_0068 1 100 0 255 ECU_ADDRESS 0xFFFF13A5 /begin FUNCTION_LIST /end FUNCTION_LIST /end MEASUREMENT
/begin MEASUREMENT vfRO2INTE "RrO2 activated flag (0: un-activation 1: activation)" UBYTE COMP_0283 1 100 0 255 ECU_ADDRESS 0xFFFF2DB0 /begin FUNCTION_LIST /end FUNCTION_LIST /end MEASUREMENT
/begin MEASUREMENT vfRO2INTE_R#1 "RrO2 activated flag (0: un-activation 1: activation)" UBYTE COMP_0283 1 100 0 255 ECU_ADDRESS 0xFFFF2DB0 /begin FUNCTION_LIST /end FUNCTION_LIST /end MEASUREMENT
/begin MEASUREMENT vfRO2INTE_R#2 "RrO2 activated flag (0: un-activation 1: activation)" UBYTE COMP_0283 1 100 0 255 ECU_ADDRESS 0xFFFF2DB1 /begin FUNCTION_LIST /end FUNCTION_LIST /end MEASUREMENT
/begin MEASUREMENT vfRRLEAN "Last time, lean judgement flag" UBYTE COMP_0283 1 100 0 255 ECU_ADDRESS 0xFFFF2DB6 /begin FUNCTION_LIST /end FUNCTION_LIST /end MEASUREMENT
/begin MEASUREMENT vfRRLEAN_R#1 "Last time, lean judgement flag" UBYTE COMP_0283 1 100 0 255 ECU_ADDRESS 0xFFFF2DB6 /begin FUNCTION_LIST /end FUNCTION_LIST /end MEASUREMENT
/begin MEASUREMENT vfRRLEAN_R#2 "Last time, lean judgement flag" UBYTE COMP_0283 1 100 0 255 ECU_ADDRESS 0xFFFF2DB7 /begin FUNCTION_LIST /end FUNCTION_LIST /end MEASUREMENT
/begin MEASUREMENT vfRRRICH "Last time, rich judgement flag" UBYTE COMP_0283 1 100 0 255 ECU_ADDRESS 0xFFFF2DB8 /begin FUNCTION_LIST /end FUNCTION_LIST /end MEASUREMENT
/begin MEASUREMENT vfRRRICH_R#1 "Last time, rich judgement flag" UBYTE COMP_0283 1 100 0 255 ECU_ADDRESS 0xFFFF2DB8 /begin FUNCTION_LIST /end FUNCTION_LIST /end MEASUREMENT
/begin MEASUREMENT vfRRRICH_R#2 "Last time, rich judgement flag" UBYTE COMP_0283 1 100 0 255 ECU_ADDRESS 0xFFFF2DB9 /begin FUNCTION_LIST /end FUNCTION_LIST /end MEASUREMENT
/begin MEASUREMENT vfRSPKRPME "Rich spike P-gain addition (0: failure 1: formation) due to the high air quantity F/C éû speed decline" UBYTE COMP_0283 1 100 0 255 ECU_ADDRESS 0xFFFF2DBA /begin FUNCTION_LIST /end FUNCTION_LIST /end MEASUREMENT
/begin MEASUREMENT vfRSPKRPME_R#1 "Rich spike P-gain addition (0: failure 1: formation) due to the high air quantity F/C éû speed decline" UBYTE COMP_0283 1 100 0 255 ECU_ADDRESS 0xFFFF2DBA /begin FUNCTION_LIST /end FUNCTION_LIST /end MEASUREMENT
/begin MEASUREMENT vfRSPKRPME_R#2 "Rich spike P-gain addition (0: failure 1: formation) due to the high air quantity F/C éû speed decline" UBYTE COMP_0283 1 100 0 255 ECU_ADDRESS 0xFFFF2DBB /begin FUNCTION_LIST /end FUNCTION_LIST /end MEASUREMENT
/begin MEASUREMENT vfSTATFLG "-" UBYTE COMP_0283 1 100 0 255 ECU_ADDRESS 0xFFFF2DF1 /begin FUNCTION_LIST /end FUNCTION_LIST /end MEASUREMENT
/begin MEASUREMENT vfSTPFLG "Target A/F I-gain stop flag" UBYTE COMP_0068 1 100 0 255 ECU_ADDRESS 0xFFFF2DF2 /begin FUNCTION_LIST /end FUNCTION_LIST /end MEASUREMENT
/begin MEASUREMENT vfSTPFLG_R#1 "Target A/F I-gain stop flag" UBYTE COMP_0068 1 100 0 255 ECU_ADDRESS 0xFFFF2DF2 /begin FUNCTION_LIST /end FUNCTION_LIST /end MEASUREMENT
/begin MEASUREMENT vfSTPFLG_R#2 "Target A/F I-gain stop flag" UBYTE COMP_0068 1 100 0 255 ECU_ADDRESS 0xFFFF2DF3 /begin FUNCTION_LIST /end FUNCTION_LIST /end MEASUREMENT
/begin MEASUREMENT vfSTPFLG2 "ALPHA I-gain stop flag" UBYTE COMP_0283 1 100 0 255 ECU_ADDRESS 0xFFFF2DF4 /begin FUNCTION_LIST /end FUNCTION_LIST /end MEASUREMENT
/begin MEASUREMENT vfSTPFLG2_R#1 "ALPHA I-gain stop flag" UBYTE COMP_0283 1 100 0 255 ECU_ADDRESS 0xFFFF2DF4 /begin FUNCTION_LIST /end FUNCTION_LIST /end MEASUREMENT
/begin MEASUREMENT vfSTPFLG2_R#2 "ALPHA I-gain stop flag" UBYTE COMP_0283 1 100 0 255 ECU_ADDRESS 0xFFFF2DF5 /begin FUNCTION_LIST /end FUNCTION_LIST /end MEASUREMENT
/begin MEASUREMENT vfTABFCPLE "Lean side the second slice target A/F fixed flag" UBYTE COMP_0283 1 100 0 255 ECU_ADDRESS 0xFFFF2DF7 /begin FUNCTION_LIST /end FUNCTION_LIST /end MEASUREMENT
/begin MEASUREMENT vfTABFCPLE_R#1 "Lean side the second slice target A/F fixed flag" UBYTE COMP_0283 1 100 0 255 ECU_ADDRESS 0xFFFF2DF7 /begin FUNCTION_LIST /end FUNCTION_LIST /end MEASUREMENT
/begin MEASUREMENT vfTABFCPLE_R#2 "Lean side the second slice target A/F fixed flag" UBYTE COMP_0283 1 100 0 255 ECU_ADDRESS 0xFFFF2DF8 /begin FUNCTION_LIST /end FUNCTION_LIST /end MEASUREMENT
/begin MEASUREMENT vfTABFCPRE "Rich side the second slice target A/F fixed flag" UBYTE COMP_0283 1 100 0 255 ECU_ADDRESS 0xFFFF2DF9 /begin FUNCTION_LIST /end FUNCTION_LIST /end MEASUREMENT
/begin MEASUREMENT vfTABFCPRE_R#1 "Rich side the second slice target A/F fixed flag" UBYTE COMP_0283 1 100 0 255 ECU_ADDRESS 0xFFFF2DF9 /begin FUNCTION_LIST /end FUNCTION_LIST /end MEASUREMENT
/begin MEASUREMENT vfTABFCPRE_R#2 "Rich side the second slice target A/F fixed flag" UBYTE COMP_0283 1 100 0 255 ECU_ADDRESS 0xFFFF2DFA /begin FUNCTION_LIST /end FUNCTION_LIST /end MEASUREMENT
/begin MEASUREMENT vfTECLPE "As soon as possible, ÉNÉâÉìÉvÉtÉâÉN" UBYTE COMP_0283 1 100 0 255 ECU_ADDRESS 0xFFFF2DFB /begin FUNCTION_LIST /end FUNCTION_LIST /end MEASUREMENT
/begin MEASUREMENT vfTECLPE_R#1 "As soon as possible, ÉNÉâÉìÉvÉtÉâÉN" UBYTE COMP_0283 1 100 0 255 ECU_ADDRESS 0xFFFF2DFB /begin FUNCTION_LIST /end FUNCTION_LIST /end MEASUREMENT
/begin MEASUREMENT vfTECLPE_R#2 "As soon as possible, ÉNÉâÉìÉvÉtÉâÉN" UBYTE COMP_0283 1 100 0 255 ECU_ADDRESS 0xFFFF2DFC /begin FUNCTION_LIST /end FUNCTION_LIST /end MEASUREMENT
/begin MEASUREMENT vfTEMINE "(TP*TFBYA+KATHOS) *MKINJ<=TEMIN# judgement (0: failure    1: formation)" UBYTE COMP_0068 1 100 0 255 ECU_ADDRESS 0xFFFF2DFD /begin FUNCTION_LIST /end FUNCTION_LIST /end MEASUREMENT
/begin MEASUREMENT vfYKLOK "The bottom lean judgement OK flag of the floor" UBYTE COMP_0068 1 100 0 255 ECU_ADDRESS 0xFFFF2E02 /begin FUNCTION_LIST /end FUNCTION_LIST /end MEASUREMENT
/begin MEASUREMENT vfYKLOK_R#1 "The bottom lean judgement OK flag of the floor" UBYTE COMP_0068 1 100 0 255 ECU_ADDRESS 0xFFFF2E02 /begin FUNCTION_LIST /end FUNCTION_LIST /end MEASUREMENT
/begin MEASUREMENT vfYKLOK_R#2 "The bottom lean judgement OK flag of the floor" UBYTE COMP_0068 1 100 0 255 ECU_ADDRESS 0xFFFF2E03 /begin FUNCTION_LIST /end FUNCTION_LIST /end MEASUREMENT
/begin MEASUREMENT vmessage_p "RAM value vmessage_p" UBYTE COMP_0004 1 100 0 255 ECU_ADDRESS 0xFFFF2F80 /begin FUNCTION_LIST /end FUNCTION_LIST /end MEASUREMENT
/begin MEASUREMENT vtCLPTMR "-" UWORD COMP_0014 1 100 0 655350 ECU_ADDRESS 0xFFFF32C6 /begin FUNCTION_LIST /end FUNCTION_LIST /end MEASUREMENT
/begin MEASUREMENT vtCLPTMR2 "-" UWORD COMP_0014 1 100 0 655350 ECU_ADDRESS 0xFFFF32C8 /begin FUNCTION_LIST /end FUNCTION_LIST /end MEASUREMENT
/begin MEASUREMENT vtJISOTMR "-" UWORD COMP_0014 1 100 0 655350 ECU_ADDRESS 0xFFFF3334 /begin FUNCTION_LIST /end FUNCTION_LIST /end MEASUREMENT
/begin MEASUREMENT vtLRCOUNT "-" UBYTE COMP_0014 1 100 0 2550 ECU_ADDRESS 0xFFFF3339 /begin FUNCTION_LIST /end FUNCTION_LIST /end MEASUREMENT
/begin MEASUREMENT vtRLCOUNT "-" UBYTE COMP_0283 1 100 0 255 ECU_ADDRESS 0xFFFF33C2 /begin FUNCTION_LIST /end FUNCTION_LIST /end MEASUREMENT
/begin MEASUREMENT vtSTATTMR "-" UWORD COMP_0014 1 100 0 655350 ECU_ADDRESS 0xFFFF33FC /begin FUNCTION_LIST /end FUNCTION_LIST /end MEASUREMENT
/begin MEASUREMENT vtTROINTL "RrO2 lean side activated judgement timer" UWORD COMP_0014 1 100 0 655350 ECU_ADDRESS 0xFFFF3412 /begin FUNCTION_LIST /end FUNCTION_LIST /end MEASUREMENT
/begin MEASUREMENT vtTROINTL_R#1 "RrO2 lean side activated judgement timer" UWORD COMP_0014 1 100 0 655350 ECU_ADDRESS 0xFFFF3412 /begin FUNCTION_LIST /end FUNCTION_LIST /end MEASUREMENT
/begin MEASUREMENT vtTROINTL_R#2 "RrO2 lean side activated judgement timer" UWORD COMP_0014 1 100 0 655350 ECU_ADDRESS 0xFFFF3414 /begin FUNCTION_LIST /end FUNCTION_LIST /end MEASUREMENT
/begin MEASUREMENT vtTROINTR "RrO2 rich side activated judgement timer" UWORD COMP_0014 1 100 0 655350 ECU_ADDRESS 0xFFFF3416 /begin FUNCTION_LIST /end FUNCTION_LIST /end MEASUREMENT
/begin MEASUREMENT vtTROINTR_R#1 "RrO2 rich side activated judgement timer" UWORD COMP_0014 1 100 0 655350 ECU_ADDRESS 0xFFFF3416 /begin FUNCTION_LIST /end FUNCTION_LIST /end MEASUREMENT
/begin MEASUREMENT vtTROINTR_R#2 "RrO2 rich side activated judgement timer" UWORD COMP_0014 1 100 0 655350 ECU_ADDRESS 0xFFFF3418 /begin FUNCTION_LIST /end FUNCTION_LIST /end MEASUREMENT
/begin MEASUREMENT vtfbya0 "Target air-fuel ratio basic value (lean/stoichiometric)" UWORD COMP_0217 1 100 0 3.999941832 ECU_ADDRESS 0xFFFF18AE /begin FUNCTION_LIST /end FUNCTION_LIST /end MEASUREMENT
/begin MEASUREMENT vwfSTSWE "Starter switch (0: off 1: on)" UBYTE COMP_0068 1 100 0 255 ECU_ADDRESS 0xFFFF34C1 /begin FUNCTION_LIST /end FUNCTION_LIST /end MEASUREMENT
/begin MEASUREMENT wvACMNISR "Idle speed set-point requested by the air conditioning from the CAN network" UBYTE COMP_0542_S 1 100 500 13250 ECU_ADDRESS 0xFFFF47A4 /begin FUNCTION_LIST /end FUNCTION_LIST /end MEASUREMENT
/begin MEASUREMENT wvACSEGR1 "ST drive output value for the diagnosis" UBYTE COMP_0068 1 100 0 255 ECU_ADDRESS 0xFFFF88D6 /begin FUNCTION_LIST /end FUNCTION_LIST /end MEASUREMENT
/begin MEASUREMENT wvACSEGR2 "ST drive output value for the diagnosis" UBYTE COMP_0068 1 100 0 255 ECU_ADDRESS 0xFFFF88D7 /begin FUNCTION_LIST /end FUNCTION_LIST /end MEASUREMENT
/begin MEASUREMENT wvACSEGR3 "ST drive output value for the diagnosis" UBYTE COMP_0068 1 100 0 255 ECU_ADDRESS 0xFFFF88D8 /begin FUNCTION_LIST /end FUNCTION_LIST /end MEASUREMENT
/begin MEASUREMENT wvACSEGR4 "ST drive output value for the diagnosis" UBYTE COMP_0068 1 100 0 255 ECU_ADDRESS 0xFFFF88D9 /begin FUNCTION_LIST /end FUNCTION_LIST /end MEASUREMENT
/begin MEASUREMENT wvADSTRSW "Input of the cruise control and speed limiter steering wheel push buttons" UWORD COMP_0023 1 100 0 327675 ECU_ADDRESS 0xFFFF47A6 /begin FUNCTION_LIST /end FUNCTION_LIST /end MEASUREMENT
/begin MEASUREMENT wvADTF "Fuel temperature sensor" UWORD COMP_0023 1 100 0 327675 ECU_ADDRESS 0xFFFF8840 /begin FUNCTION_LIST /end FUNCTION_LIST /end MEASUREMENT
/begin MEASUREMENT wvAFHCONTf "A/F sensor heater-control control permission condition" UBYTE COMP_0004 1 100 0 255 ECU_ADDRESS 0xFFFF88DE /begin FUNCTION_LIST /end FUNCTION_LIST /end MEASUREMENT
/begin MEASUREMENT wvAFHONf "A/F sensor heater on flag" UBYTE COMP_0068 1 100 0 255 ECU_ADDRESS 0xFFFF47A8 /begin FUNCTION_LIST /end FUNCTION_LIST /end MEASUREMENT
/begin MEASUREMENT wvAGBDLCLK "AGB clock difference value" UBYTE COMP_0068 1 100 0 255 ECU_ADDRESS 0xFFFF47B2 /begin FUNCTION_LIST /end FUNCTION_LIST /end MEASUREMENT
/begin MEASUREMENT wvAGBGEAR "AGB Gear ratio engaged (-1 0 1 2 3 4 5 6)" SBYTE COMP_0263 1 100 -128 127 ECU_ADDRESS 0xFFFF47B3 /begin FUNCTION_LIST /end FUNCTION_LIST /end MEASUREMENT
/begin MEASUREMENT wvAGBTQLIM "AGB engine torque limitation" UWORD COMP_0345_S 1 100 -400 1647.96875 ECU_ADDRESS 0xFFFF47B4 /begin FUNCTION_LIST /end FUNCTION_LIST /end MEASUREMENT
/begin MEASUREMENT wvALTPWMUX "Instant InstantMecanicalPowerByAlt" UBYTE COMP_0360_S 1 100 0 10200 ECU_ADDRESS 0xFFFF47B6 /begin FUNCTION_LIST /end FUNCTION_LIST /end MEASUREMENT
/begin MEASUREMENT wvAM1DATA2 "RAM value wvAM1DATA2" UBYTE COMP_0068 1 100 0 255 ECU_ADDRESS 0xFFFF47B7 /begin FUNCTION_LIST /end FUNCTION_LIST /end MEASUREMENT
/begin MEASUREMENT wvAM1DATA2_1 "RAM value wvAM1DATA2" UBYTE COMP_0068 1 100 0 255 ECU_ADDRESS 0xFFFF47B8 /begin FUNCTION_LIST /end FUNCTION_LIST /end MEASUREMENT
/begin MEASUREMENT wvAM1DATA3_1 "RAM value wvAM1DATA3" UBYTE COMP_0068 1 100 0 255 ECU_ADDRESS 0xFFFF47B9 /begin FUNCTION_LIST /end FUNCTION_LIST /end MEASUREMENT
/begin MEASUREMENT wvAM1DATA3_2 "RAM value wvAM1DATA3" UBYTE COMP_0068 1 100 0 255 ECU_ADDRESS 0xFFFF47BA /begin FUNCTION_LIST /end FUNCTION_LIST /end MEASUREMENT
/begin MEASUREMENT wvAM1DATA3 "RAM value wvAM1DATA3" UBYTE COMP_0068 1 100 0 255 ECU_ADDRESS 0xFFFF47BB /begin FUNCTION_LIST /end FUNCTION_LIST /end MEASUREMENT
/begin MEASUREMENT wvAM1DATA4 "RAM value wvAM1DATA4" UBYTE COMP_0068 1 100 0 255 ECU_ADDRESS 0xFFFF47BC /begin FUNCTION_LIST /end FUNCTION_LIST /end MEASUREMENT
/begin MEASUREMENT wvAM1DATA4_2 "RAM value wvAM1DATA4" UBYTE COMP_0068 1 100 0 255 ECU_ADDRESS 0xFFFF47BD /begin FUNCTION_LIST /end FUNCTION_LIST /end MEASUREMENT
/begin MEASUREMENT wvAM1DATA4_1 "RAM value wvAM1DATA4" UBYTE COMP_0068 1 100 0 255 ECU_ADDRESS 0xFFFF47BE /begin FUNCTION_LIST /end FUNCTION_LIST /end MEASUREMENT
/begin MEASUREMENT wvAM1DATA5_2 "RAM value wvAM1DATA5" UBYTE COMP_0068 1 100 0 255 ECU_ADDRESS 0xFFFF47BF /begin FUNCTION_LIST /end FUNCTION_LIST /end MEASUREMENT
/begin MEASUREMENT wvAM1DATA5_1 "RAM value wvAM1DATA5" UBYTE COMP_0068 1 100 0 255 ECU_ADDRESS 0xFFFF47C0 /begin FUNCTION_LIST /end FUNCTION_LIST /end MEASUREMENT
/begin MEASUREMENT wvAM1DATA5_3 "RAM value wvAM1DATA5" UBYTE COMP_0068 1 100 0 255 ECU_ADDRESS 0xFFFF47C1 /begin FUNCTION_LIST /end FUNCTION_LIST /end MEASUREMENT
/begin MEASUREMENT wvAM1DATA5 "RAM value wvAM1DATA5" UBYTE COMP_0068 1 100 0 255 ECU_ADDRESS 0xFFFF47C2 /begin FUNCTION_LIST /end FUNCTION_LIST /end MEASUREMENT
/begin MEASUREMENT wvAPSENSV "Accelerator pedal sensor output voltage (= Upot1 or Upot2)" UWORD COMP_0359_S 1 100 0 63.999056205 ECU_ADDRESS 0xFFFF47D4 /begin FUNCTION_LIST /end FUNCTION_LIST /end MEASUREMENT
/begin MEASUREMENT wvAPSSFV0 "Accelerator pedal sensor output voltage    (for the connection with integration of APS slope limitation)" UWORD COMP_0359_S 1 100 0 63.999056205 ECU_ADDRESS 0xFFFF47D6 /begin FUNCTION_LIST /end FUNCTION_LIST /end MEASUREMENT
/begin MEASUREMENT wvASRDTQRQ "ASR Dynamic requested torque" UBYTE COMP_0021_S 1 100 -100 410 ECU_ADDRESS 0xFFFF47D8 /begin FUNCTION_LIST /end FUNCTION_LIST /end MEASUREMENT
/begin MEASUREMENT wvASRSTQRQ "ASR Static requested torque" UBYTE COMP_0021_S 1 100 -100 410 ECU_ADDRESS 0xFFFF47D9 /begin FUNCTION_LIST /end FUNCTION_LIST /end MEASUREMENT
/begin MEASUREMENT wvASRTRQF "ASR setpoint torque acquired on the MUX" UWORD COMP_0345_S 1 100 -400 1647.96875 ECU_ADDRESS 0xFFFF47DA /begin FUNCTION_LIST /end FUNCTION_LIST /end MEASUREMENT
/begin MEASUREMENT wvASRTRQFR "ASR setpoint torque acquired on the MUX (unscaled)" UWORD COMP_0068 1 100 0 65535 ECU_ADDRESS 0xFFFF47DC /begin FUNCTION_LIST /end FUNCTION_LIST /end MEASUREMENT
/begin MEASUREMENT wvASRTRQS "ASR target torque acquired on the MUX" UWORD COMP_0345_S 1 100 -400 1647.96875 ECU_ADDRESS 0xFFFF47DE /begin FUNCTION_LIST /end FUNCTION_LIST /end MEASUREMENT
/begin MEASUREMENT wvASRTRQSR "ASR target torque acquired on the MUX" UWORD COMP_0068 1 100 0 65535 ECU_ADDRESS 0xFFFF47E0 /begin FUNCTION_LIST /end FUNCTION_LIST /end MEASUREMENT
/begin MEASUREMENT wvATMSG1T "ATMSG1 reception interval counter" UBYTE COMP_0014 1 100 0 2550 ECU_ADDRESS 0xFFFF47E3 /begin FUNCTION_LIST /end FUNCTION_LIST /end MEASUREMENT
/begin MEASUREMENT wvATMSG2T "ATMSG2 reception interval counter" UBYTE COMP_0014 1 100 0 2550 ECU_ADDRESS 0xFFFF47E4 /begin FUNCTION_LIST /end FUNCTION_LIST /end MEASUREMENT
/begin MEASUREMENT wvATTQCT1T "AT_TorqueControl_RN1 reception interval counter" UBYTE COMP_0014 1 100 0 2550 ECU_ADDRESS 0xFFFF47EA /begin FUNCTION_LIST /end FUNCTION_LIST /end MEASUREMENT
/begin MEASUREMENT wvATTQCT2T "AT_TorqueControl_RN2 reception interval counter" UBYTE COMP_0014 1 100 0 2550 ECU_ADDRESS 0xFFFF47EB /begin FUNCTION_LIST /end FUNCTION_LIST /end MEASUREMENT
/begin MEASUREMENT wvAUHCDCV1 "ST drive output value for the UH diagnosis" UBYTE COMP_0068 1 100 0 255 ECU_ADDRESS 0xFFFF88DF /begin FUNCTION_LIST /end FUNCTION_LIST /end MEASUREMENT
/begin MEASUREMENT wvAUHCDCV2 "ST drive output value for the UH diagnosis" UBYTE COMP_0068 1 100 0 255 ECU_ADDRESS 0xFFFF88E0 /begin FUNCTION_LIST /end FUNCTION_LIST /end MEASUREMENT
/begin MEASUREMENT wvAUHCV1_1 "ST drive output value for the UH diagnosis" UBYTE COMP_0068 1 100 0 255 ECU_ADDRESS 0xFFFF88E1 /begin FUNCTION_LIST /end FUNCTION_LIST /end MEASUREMENT
/begin MEASUREMENT wvAUHCV1_2 "ST drive output value for the UH diagnosis" UBYTE COMP_0068 1 100 0 255 ECU_ADDRESS 0xFFFF88E2 /begin FUNCTION_LIST /end FUNCTION_LIST /end MEASUREMENT
/begin MEASUREMENT wvAUHCV2_1 "ST drive output value for the UH diagnosis" UBYTE COMP_0068 1 100 0 255 ECU_ADDRESS 0xFFFF88E3 /begin FUNCTION_LIST /end FUNCTION_LIST /end MEASUREMENT
/begin MEASUREMENT wvAUHCV2_2 "ST drive output value for the UH diagnosis" UBYTE COMP_0068 1 100 0 255 ECU_ADDRESS 0xFFFF88E4 /begin FUNCTION_LIST /end FUNCTION_LIST /end MEASUREMENT
/begin MEASUREMENT wvAUHEV1_1 "ST drive output value for the UH diagnosis" UBYTE COMP_0068 1 100 0 255 ECU_ADDRESS 0xFFFF88E5 /begin FUNCTION_LIST /end FUNCTION_LIST /end MEASUREMENT
/begin MEASUREMENT wvAUHEV1_2 "ST drive output value for the UH diagnosis" UBYTE COMP_0068 1 100 0 255 ECU_ADDRESS 0xFFFF88E6 /begin FUNCTION_LIST /end FUNCTION_LIST /end MEASUREMENT
/begin MEASUREMENT wvAUHEV2_1 "ST drive output value for the UH diagnosis" UBYTE COMP_0068 1 100 0 255 ECU_ADDRESS 0xFFFF88E7 /begin FUNCTION_LIST /end FUNCTION_LIST /end MEASUREMENT
/begin MEASUREMENT wvAUHEV2_2 "ST drive output value for the UH diagnosis" UBYTE COMP_0068 1 100 0 255 ECU_ADDRESS 0xFFFF88E8 /begin FUNCTION_LIST /end FUNCTION_LIST /end MEASUREMENT
/begin MEASUREMENT wvAUHVIAS1 "ST drive output value for the UH diagnosis" UBYTE COMP_0068 1 100 0 255 ECU_ADDRESS 0xFFFF88E9 /begin FUNCTION_LIST /end FUNCTION_LIST /end MEASUREMENT
/begin MEASUREMENT wvBATSENK "Battery electric current sensor output voltage weighted average value" UWORD COMP_0023 1 100 0 327675 ECU_ADDRESS 0xFFFF8898 /begin FUNCTION_LIST /end FUNCTION_LIST /end MEASUREMENT
/begin MEASUREMENT wvBRKPDMX "Brake pedal states" UBYTE COMP_0068 1 100 0 255 ECU_ADDRESS 0xFFFF47F2 /begin FUNCTION_LIST /end FUNCTION_LIST /end MEASUREMENT
/begin MEASUREMENT wvBRSTBCTT "The counter which hasn't received Brake_Stability_Control" UBYTE COMP_0014 1 100 0 2550 ECU_ADDRESS 0xFFFF47F3 /begin FUNCTION_LIST /end FUNCTION_LIST /end MEASUREMENT
/begin MEASUREMENT wvCABSENT "Array of volatile counters accounting for current failures  Absent unit " UBYTE COMP_0068 1 100 0 255 ECU_ADDRESS 0xFFFF47F4 /begin FUNCTION_LIST /end FUNCTION_LIST /end MEASUREMENT
/begin MEASUREMENT wvCABSENT_C#1_R#1 "Array of volatile counters accounting for current failures  Absent unit " UBYTE COMP_0068 1 100 0 255 ECU_ADDRESS 0xFFFF47F4 /begin FUNCTION_LIST /end FUNCTION_LIST /end MEASUREMENT
/begin MEASUREMENT wvCABSENT_C#2_R#1 "Array of volatile counters accounting for current failures  Absent unit " UBYTE COMP_0068 1 100 0 255 ECU_ADDRESS 0xFFFF47F5 /begin FUNCTION_LIST /end FUNCTION_LIST /end MEASUREMENT
/begin MEASUREMENT wvCABSENT_C#3_R#1 "Array of volatile counters accounting for current failures  Absent unit " UBYTE COMP_0068 1 100 0 255 ECU_ADDRESS 0xFFFF47F6 /begin FUNCTION_LIST /end FUNCTION_LIST /end MEASUREMENT
/begin MEASUREMENT wvCABSENT_C#4_R#1 "Array of volatile counters accounting for current failures  Absent unit " UBYTE COMP_0068 1 100 0 255 ECU_ADDRESS 0xFFFF47F7 /begin FUNCTION_LIST /end FUNCTION_LIST /end MEASUREMENT
/begin MEASUREMENT wvCABSENT_C#5_R#1 "Array of volatile counters accounting for current failures  Absent unit " UBYTE COMP_0068 1 100 0 255 ECU_ADDRESS 0xFFFF47F8 /begin FUNCTION_LIST /end FUNCTION_LIST /end MEASUREMENT
/begin MEASUREMENT wvCABSENT_C#6_R#1 "Array of volatile counters accounting for current failures  Absent unit " UBYTE COMP_0068 1 100 0 255 ECU_ADDRESS 0xFFFF47F9 /begin FUNCTION_LIST /end FUNCTION_LIST /end MEASUREMENT
/begin MEASUREMENT wvCABSENT_C#7_R#1 "Array of volatile counters accounting for current failures  Absent unit " UBYTE COMP_0068 1 100 0 255 ECU_ADDRESS 0xFFFF47FA /begin FUNCTION_LIST /end FUNCTION_LIST /end MEASUREMENT
/begin MEASUREMENT wvCABSENT_C#8_R#1 "Array of volatile counters accounting for current failures  Absent unit " UBYTE COMP_0068 1 100 0 255 ECU_ADDRESS 0xFFFF47FB /begin FUNCTION_LIST /end FUNCTION_LIST /end MEASUREMENT
/begin MEASUREMENT wvCABSENT_C#9_R#1 "Array of volatile counters accounting for current failures  Absent unit " UBYTE COMP_0068 1 100 0 255 ECU_ADDRESS 0xFFFF47FC /begin FUNCTION_LIST /end FUNCTION_LIST /end MEASUREMENT
/begin MEASUREMENT wvCABSENT_C#10_R#1 "Array of volatile counters accounting for current failures  Absent unit " UBYTE COMP_0068 1 100 0 255 ECU_ADDRESS 0xFFFF47FD /begin FUNCTION_LIST /end FUNCTION_LIST /end MEASUREMENT
/begin MEASUREMENT wvCABSENT_C#11_R#1 "Array of volatile counters accounting for current failures  Absent unit " UBYTE COMP_0068 1 100 0 255 ECU_ADDRESS 0xFFFF47FE /begin FUNCTION_LIST /end FUNCTION_LIST /end MEASUREMENT
/begin MEASUREMENT wvCABSENT_C#12_R#1 "Array of volatile counters accounting for current failures  Absent unit " UBYTE COMP_0068 1 100 0 255 ECU_ADDRESS 0xFFFF47FF /begin FUNCTION_LIST /end FUNCTION_LIST /end MEASUREMENT
/begin COMPU_METHOD COMP_0068 "1-" RAT_FUNC "%8.2" "-" COEFFS 0 1 0 0 0 1 /end COMPU_METHOD
/begin COMPU_METHOD COMP_0004 "1Å|" RAT_FUNC "%8.2" "Å|" COEFFS 0 1 0 0 0 1 /end COMPU_METHOD
/begin COMPU_METHOD COMP_0023 "5mV" RAT_FUNC "%8.2" "mV" COEFFS 0 1 0 0 0 5 /end COMPU_METHOD
/begin COMPU_METHOD COMP_0429 "1km/h" RAT_FUNC "%8.2" "km/h" COEFFS 0 1 0 0 0 1 /end COMPU_METHOD
/begin COMPU_METHOD COMP_0001 "1/8ms" RAT_FUNC "%8.2" "ms" COEFFS 0 1 0 0 0 0.125 /end COMPU_METHOD
/begin COMPU_METHOD COMP_0002 "0.35deg" RAT_FUNC "%8.2" "deg" COEFFS 0 1 0 0 0 0.35 /end COMPU_METHOD
/begin COMPU_METHOD COMP_0014 "10ms" RAT_FUNC "%8.2" "ms" COEFFS 0 1 0 0 0 10 /end COMPU_METHOD
/begin COMPU_METHOD COMP_0008 "100ms" RAT_FUNC "%8.2" "ms" COEFFS 0 1 0 0 0 100 /end COMPU_METHOD
/begin COMPU_METHOD COMP_0013 "1s" RAT_FUNC "%8.2" "s" COEFFS 0 1 0 0 0 1 /end COMPU_METHOD
/begin COMPU_METHOD COMP_0047 "0.5%" RAT_FUNC "%8.2" "%" COEFFS 0 1 0 0 0 0.5 /end COMPU_METHOD
/begin COMPU_METHOD COMP_0007 "2km/h" RAT_FUNC "%8.2" "km/h" COEFFS 0 1 0 0 0 2 /end COMPU_METHOD
/begin COMPU_METHOD COMP_0021 "100/256%" RAT_FUNC "%8.2" "%" COEFFS 0 1 0 0 0 0.390625 /end COMPU_METHOD
/begin COMPU_METHOD COMP_0217 "1/16384-" RAT_FUNC "%8.6" "-" COEFFS 0 1 0 0 0 0.0000610352 /end COMPU_METHOD
/begin COMPU_METHOD COMP_0033 "80mV" RAT_FUNC "%8.2" "mV" COEFFS 0 1 0 0 0 80 /end COMPU_METHOD
/begin COMPU_METHOD COMP_0027 "1%" RAT_FUNC "%8.2" "%" COEFFS 0 1 0 0 0 1 /end COMPU_METHOD
/begin COMPU_METHOD COMP_0049 "1sec" RAT_FUNC "%8.2" "sec" COEFFS 0 1 0 0 0 1 /end COMPU_METHOD
/begin COMPU_METHOD COMP_0015 "0.125Å|" RAT_FUNC "%8.2" "Å|" COEFFS 0 1 0 0 0 0.125 /end COMPU_METHOD
/begin COMPU_METHOD COMP_0030 "1âÒ" RAT_FUNC "%8.2" "âÒ" COEFFS 0 1 0 0 0 1 /end COMPU_METHOD
/begin COMPU_METHOD COMP_0345_S "1/32Nm" RAT_FUNC "%8.3" "Nm" COEFFS 0 1 400 0 0 0.03125 /end COMPU_METHOD
/begin COMPU_METHOD COMP_0359_S "1/1024Uref rat" RAT_FUNC "%8.5" "Uref rat" COEFFS 0 1 0 0 0 0.000976563 /end COMPU_METHOD
/begin COMPU_METHOD COMP_0005 "0.11deg" RAT_FUNC "%8.2" "deg" COEFFS 0 1 0 0 0 0.11 /end COMPU_METHOD
/begin COMPU_METHOD COMP_0360_S "40W" RAT_FUNC "%8.2" "W" COEFFS 0 1 0 0 0 40 /end COMPU_METHOD
/begin COMPU_METHOD COMP_0048 "64/128degCA" RAT_FUNC "%8.2" "degCA" COEFFS 0 1 0 0 0 0.5 /end COMPU_METHOD
/begin COMPU_METHOD COMP_0016 "1count" RAT_FUNC "%8.2" "count" COEFFS 0 1 0 0 0 1 /end COMPU_METHOD
/begin COMPU_METHOD COMP_0054 "20mV" RAT_FUNC "%8.2" "mV" COEFFS 0 1 0 0 0 20 /end COMPU_METHOD
/begin COMPU_METHOD COMP_0050 "5/64mV" RAT_FUNC "%8.3" "mV" COEFFS 0 1 0 0 0 0.078125 /end COMPU_METHOD
/begin COMPU_METHOD COMP_0035 "X-50Åé" RAT_FUNC "%8.2" "Åé" COEFFS 0 1 50 0 0 1 /end COMPU_METHOD
/begin COMPU_METHOD COMP_0375_S "0.01km/h" RAT_FUNC "%8.3" "km/h" COEFFS 0 1 0 0 0 0.01 /end COMPU_METHOD
/begin COMPU_METHOD COMP_0228 "0.1Nm" RAT_FUNC "%8.2" "Nm" COEFFS 0 1 0 0 0 0.1 /end COMPU_METHOD
/begin COMPU_METHOD COMP_0425 "100/255%" RAT_FUNC "%8.2" "%" COEFFS 0 1 0 0 0 0.392156862 /end COMPU_METHOD
/begin COMPU_METHOD COMP_0104 "10mV" RAT_FUNC "%8.2" "mV" COEFFS 0 1 0 0 0 10 /end COMPU_METHOD
/begin COMPU_METHOD COMP_0256 "64/128degCA" RAT_FUNC "%8.2" "degCA" COEFFS 0 1 64 0 0 0.5 /end COMPU_METHOD
/begin COMPU_METHOD COMP_0420_S "0.1Bar" RAT_FUNC "%8.2" "Bar" COEFFS 0 1 0 0 0 0.1 /end COMPU_METHOD
/begin COMPU_METHOD COMP_0139_S "É sÉ s" RAT_FUNC "%8.3" "É s" COEFFS 0 1 0 0 0 0.025 /end COMPU_METHOD
/begin COMPU_METHOD COMP_0263 "1-" RAT_FUNC "%8.2" "-" COEFFS 0 1 0 0 0 1 /end COMPU_METHOD
/begin COMPU_METHOD COMP_0022 "20mv" RAT_FUNC "%8.2" "mv" COEFFS 0 1 0 0 0 20 /end COMPU_METHOD
/begin COMPU_METHOD COMP_0356 "0.625X-40Åé" RAT_FUNC "%8.2" "Åé" COEFFS 0 1 40 0 0 0.625 /end COMPU_METHOD
/begin COMPU_METHOD COMP_0092 "1bit" RAT_FUNC "%8.2" "bit" COEFFS 0 1 0 0 0 1 /end COMPU_METHOD
/begin COMPU_METHOD COMP_0470_S "1/32Nm" RAT_FUNC "%8.3" "Nm" COEFFS 0 1 0 0 0 0.03125 /end COMPU_METHOD
/begin COMPU_METHOD COMP_0476_S "20/256mV/100ms" RAT_FUNC "%8.3" "mV/100ms" COEFFS 0 1 0 0 0 0.078125 /end COMPU_METHOD
/begin COMPU_METHOD COMP_0491_S "1mbar" RAT_FUNC "%8.2" "mbar" COEFFS 0 1 0 0 0 1 /end COMPU_METHOD
/begin COMPU_METHOD COMP_0283 "1flag" RAT_FUNC "%8.2" "flag" COEFFS 0 1 0 0 0 1 /end COMPU_METHOD
/begin COMPU_METHOD COMP_0537_S "VV" RAT_FUNC "%8.4" "V" COEFFS 0 1 0 0 0 0.001 /end COMPU_METHOD
/begin COMPU_METHOD COMP_0001_S "km/hkm/h" RAT_FUNC "%8.6" "km/h" COEFFS 0 1 0 0 0 0.000000858 /end COMPU_METHOD
/begin COMPU_METHOD COMP_0265 "1/4096%" RAT_FUNC "%8.5" "%" COEFFS 0 1 8.000012288 0 0 0.000244141 /end COMPU_METHOD
/begin COMPU_METHOD COMP_0209_S "3.6*2^-22km/h" RAT_FUNC "%8.6" "km/h" COEFFS 0 1 0 0 0 0.000000858307 /end COMPU_METHOD
/begin COMPU_METHOD COMP_0542_S "rpmrpm" RAT_FUNC "%8.2" "rpm" COEFFS 0 1 -500 0 0 50 /end COMPU_METHOD
/begin COMPU_METHOD COMP_0021_S "NmNm" RAT_FUNC "%8.2" "Nm" COEFFS 0 1 100 0 0 2 /end COMPU_METHOD
/begin COMPU_METHOD COMP_0257 "128/128degCA" RAT_FUNC "%8.2" "degCA" COEFFS 0 1 128 0 0 1 /end COMPU_METHOD
/begin COMPU_METHOD COMP_0038_S "%%" RAT_FUNC "%8.3" "%" COEFFS 0 1 3200 0 0 0.09765625 /end COMPU_METHOD
/begin COMPU_METHOD COMP_0573_S "ÅéÅé" RAT_FUNC "%8.2" "Åé" COEFFS 0 1 273 0 0 0.1 /end COMPU_METHOD
/begin COMPU_METHOD COMP_0575_S "%%" RAT_FUNC "%8.3" "%" COEFFS 0 1 327.67 0 0 0.01 /end COMPU_METHOD
/begin COMPU_METHOD COMP_0578_S "É sÉ s" RAT_FUNC "%8.2" "É s" COEFFS 0 1 0 0 0 4 /end COMPU_METHOD
/begin COMPU_METHOD COMP_0026_S "degdeg" RAT_FUNC "%8.2" "deg" COEFFS 0 1 0 0 0 0.1 /end COMPU_METHOD
/begin COMPU_METHOD COMP_0595_S "ÅãCrSÅãCrS" RAT_FUNC "%8.3" "ÅãCrS" COEFFS 0 1 655.34 0 0 0.02 /end COMPU_METHOD
/begin COMPU_METHOD COMP_0178_S "Å|Å|" RAT_FUNC "%8.6" "Å|" COEFFS 0 1 0 0 0 0.000003815 /end COMPU_METHOD
/begin COMPU_METHOD COMP_0174_S "degCAdegCA" RAT_FUNC "%8.4" "degCA" COEFFS 0 1 0 0 0 0.001953125 /end COMPU_METHOD
/begin COMPU_METHOD COMP_0179_S "degdeg" RAT_FUNC "%8.6" "deg" COEFFS 0 1 0 0 0 0.000000954 /end COMPU_METHOD
/begin COMPU_METHOD COMP_0181_S "É sÉ s" RAT_FUNC "%8.2" "É s" COEFFS 0 1 0 0 0 0.1 /end COMPU_METHOD
/begin COMPU_METHOD COMP_0522 "0.5/256%" RAT_FUNC "%8.4" "%" COEFFS 0 1 64 0 0 0.001953125 /end COMPU_METHOD
/begin COMPU_METHOD COMP_0644_S "mvmv" RAT_FUNC "%8.2" "mv" COEFFS 0 1 0 0 0 2.5 /end COMPU_METHOD
/begin COMPU_METHOD COMP_0524 "5/64mV" RAT_FUNC "%8.3" "mV" COEFFS 0 1 0 0 0 0.07813 /end COMPU_METHOD
/begin COMPU_METHOD COMP_0646_S "km/hkm/h" RAT_FUNC "%8.6" "km/h" COEFFS 0 1 0 0 0 0.00000171661 /end COMPU_METHOD
/begin COMPU_METHOD COMP_0648_S "--" RAT_FUNC "%8.6" "-" COEFFS 0 1 0 0 0 0.00000858307 /end COMPU_METHOD
/begin COMPU_METHOD COMP_0649_S "%%" RAT_FUNC "%8.6" "%" COEFFS 0 1 200.00052084736 0 0 0.00000149012 /end COMPU_METHOD
/begin COMPU_METHOD COMP_0650_S "%%" RAT_FUNC "%8.6" "%" COEFFS 0 1 0 0 0 0.00000149012 /end COMPU_METHOD
/begin COMPU_METHOD COMP_0447 "100/1024%" RAT_FUNC "%8.3" "%" COEFFS 0 1 0 0 0 0.09765625 /end COMPU_METHOD
/begin COMPU_METHOD COMP_0526 "64/(128Å~256Å~256)degCA" RAT_FUNC "%8.6" "degCA" COEFFS 0 1 63.99996198912 0 0 0.00000762939 /end COMPU_METHOD
/begin COMPU_METHOD COMP_0527 "128/(128Å~256Å~256)degCA" RAT_FUNC "%8.6" "degCA" COEFFS 0 1 128.0000917504 0 0 0.0000152588 /end COMPU_METHOD
/begin COMPU_METHOD COMP_0651_S "AA" RAT_FUNC "%8.6" "A" COEFFS 0 1 2.0000014336 0 0 0.0000610352 /end COMPU_METHOD
/begin COMPU_METHOD COMP_0652_S "AA" RAT_FUNC "%8.6" "A" COEFFS 0 1 131072.09395241 0 0 0.0000610352 /end COMPU_METHOD
/begin COMPU_METHOD COMP_0529 "128/(128*256)degCA" RAT_FUNC "%8.4" "degCA" COEFFS 0 1 128 0 0 0.00390625 /end COMPU_METHOD
/begin COMPU_METHOD COMP_0528 "64/(128*256)degCA" RAT_FUNC "%8.4" "degCA" COEFFS 0 1 64 0 0 0.001953125 /end COMPU_METHOD
/begin COMPU_METHOD COMP_0266 "64/128deg" RAT_FUNC "%8.2" "deg" COEFFS 0 1 0 0 0 0.5 /end COMPU_METHOD
/begin COMPU_METHOD COMP_0654_S "AA" RAT_FUNC "%8.6" "A" COEFFS 0 1 0 0 0 0.0000610352 /end COMPU_METHOD
/begin COMPU_METHOD COMP_0198_S "deg/sdeg/s" RAT_FUNC "%8.2" "deg/s" COEFFS 0 1 838860800 0 0 0.390625 /end COMPU_METHOD
/begin COMPU_METHOD COMP_0199_S "deg/sdeg/s" RAT_FUNC "%8.2" "deg/s" COEFFS 0 1 12800 0 0 0.390625 /end COMPU_METHOD
/end MODULE
/end PROJECT
