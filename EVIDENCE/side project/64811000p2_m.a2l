ASAP2_VERSION 1 3_BETA
/begin PROJECT TK_X91_EUR_VC ""
/begin HEADER "" /* key HEADER ++ "comment" Ç… Par.scomment */ PROJECT_NO TK_X91_EUR_VC /* key PROJECT_NO ++ project number Ç… car_eng_desti_lot */ VERSION "7V4YHZEB2" /* key VERSION ++ version number Ç… mProgver */ /end HEADER
/begin MODULE DIM ""
/begin MOD_COMMON "" DEPOSIT ABSOLUTE BYTE_ORDER MSB_FIRST /* ﬁ≤ƒµ∞¿ﬁ∞Ç™ÿÃﬂ⁄∞ΩÇ≥ÇÍÇÈ */ /end MOD_COMMON
/begin MEASUREMENT vPHAFOT_R#1 "Former O2/S output reversal judgement time to prohibit PHOSA operation" UBYTE COMP_0008 1 100 0 25500 ECU_ADDRESS 0xFFFF166D /begin FUNCTION_LIST /end FUNCTION_LIST /end MEASUREMENT
/begin MEASUREMENT vPHAFOT_R#2 "Former O2/S output reversal judgement time to prohibit PHOSA operation" UBYTE COMP_0008 1 100 0 25500 ECU_ADDRESS 0xFFFF166E /begin FUNCTION_LIST /end FUNCTION_LIST /end MEASUREMENT
/begin MEASUREMENT vPHAINTf "PHOSAZ clear condition judgement" UBYTE COMP_0004 1 100 0 255 ECU_ADDRESS 0xFFFF166F /begin FUNCTION_LIST /end FUNCTION_LIST /end MEASUREMENT
/begin MEASUREMENT vPHASEC "Between REFs, the number of PHASEs" UBYTE COMP_0004 1 100 0 255 ECU_ADDRESS 0xFFFF21E6 /begin FUNCTION_LIST /end FUNCTION_LIST /end MEASUREMENT
/begin MEASUREMENT vPHASTOPf "PHOSAZ learning prohibition judgement flag" UBYTE COMP_0004 1 100 0 255 ECU_ADDRESS 0xFFFF1670 /begin FUNCTION_LIST /end FUNCTION_LIST /end MEASUREMENT
/begin MEASUREMENT vPHKFOTf "Fr.O2/S reversal period >=PHKFOT# judgement flag" UBYTE COMP_0004 1 100 0 255 ECU_ADDRESS 0xFFFF1671 /begin FUNCTION_LIST /end FUNCTION_LIST /end MEASUREMENT
/begin MEASUREMENT vPHNG1f "FrO2/SÉ… point shift diagnosis NG the first time judgement distinction" UBYTE COMP_0004 1 100 0 255 ECU_ADDRESS 0xFFFFAEAC /begin FUNCTION_LIST /end FUNCTION_LIST /end MEASUREMENT
/begin MEASUREMENT vPHNG2f "FrO2/SÉ… point shift diagnosis NG the second time judgement distinction" UBYTE COMP_0004 1 100 0 255 ECU_ADDRESS 0xFFFFAEAD /begin FUNCTION_LIST /end FUNCTION_LIST /end MEASUREMENT
/begin MEASUREMENT vPHOS0 "PHOS1 center value maintenance value" UWORD COMP_0265 1 100 -8.000012288 7.999768147 ECU_ADDRESS 0xFFFF3082 /begin FUNCTION_LIST /end FUNCTION_LIST /end MEASUREMENT
/begin MEASUREMENT vPHOS0_R#1 "PHOS1 center value maintenance value" UWORD COMP_0265 1 100 -8.000012288 7.999768147 ECU_ADDRESS 0xFFFF3082 /begin FUNCTION_LIST /end FUNCTION_LIST /end MEASUREMENT
/begin MEASUREMENT vPHOS0_R#2 "PHOS1 center value maintenance value" UWORD COMP_0265 1 100 -8.000012288 7.999768147 ECU_ADDRESS 0xFFFF3084 /begin FUNCTION_LIST /end FUNCTION_LIST /end MEASUREMENT
/begin MEASUREMENT vPHOS1OKf "PHOS1 operation permission condition judgement" UBYTE COMP_0004 1 100 0 255 ECU_ADDRESS 0xFFFF1029 /begin FUNCTION_LIST /end FUNCTION_LIST /end MEASUREMENT
/begin MEASUREMENT vPHOS1ST2f "PHOS I-gain initial value operation completion judgement flag" UBYTE COMP_0004 1 100 0 255 ECU_ADDRESS 0xFFFF1676 /begin FUNCTION_LIST /end FUNCTION_LIST /end MEASUREMENT
/begin MEASUREMENT vPHOS1STf "Beginning PHOS operation completion judgement flag" UBYTE COMP_0004 1 100 0 255 ECU_ADDRESS 0xFFFF1677 /begin FUNCTION_LIST /end FUNCTION_LIST /end MEASUREMENT
/begin MEASUREMENT vPHOSAOKf "PHOSA operation condition judgement" UBYTE COMP_0004 1 100 0 255 ECU_ADDRESS 0xFFFF102A /begin FUNCTION_LIST /end FUNCTION_LIST /end MEASUREMENT
/begin MEASUREMENT vPHOSB "PHOS learning value" UWORD COMP_0265 1 100 -8.000012288 7.999768147 ECU_ADDRESS 0xFFFFAEB2 /begin FUNCTION_LIST /end FUNCTION_LIST /end MEASUREMENT
/begin MEASUREMENT vPHOSB_R#1 "PHOS learning value" UWORD COMP_0265 1 100 -8.000012288 7.999768147 ECU_ADDRESS 0xFFFFAEB2 /begin FUNCTION_LIST /end FUNCTION_LIST /end MEASUREMENT
/begin MEASUREMENT vPHOSB_R#2 "PHOS learning value" UWORD COMP_0265 1 100 -8.000012288 7.999768147 ECU_ADDRESS 0xFFFFAEB4 /begin FUNCTION_LIST /end FUNCTION_LIST /end MEASUREMENT
/begin MEASUREMENT vPHOSBZ "PHOSAZ conversion value" UWORD COMP_0265 1 100 -8.000012288 7.999768147 ECU_ADDRESS 0xFFFF1678 /begin FUNCTION_LIST /end FUNCTION_LIST /end MEASUREMENT
/begin MEASUREMENT vPHOSBZ_R#1 "PHOSAZ conversion value" UWORD COMP_0265 1 100 -8.000012288 7.999768147 ECU_ADDRESS 0xFFFF1678 /begin FUNCTION_LIST /end FUNCTION_LIST /end MEASUREMENT
/begin MEASUREMENT vPHOSBZ_R#2 "PHOSAZ conversion value" UWORD COMP_0265 1 100 -8.000012288 7.999768147 ECU_ADDRESS 0xFFFF167A /begin FUNCTION_LIST /end FUNCTION_LIST /end MEASUREMENT
/begin MEASUREMENT vPHOSZOKf "PHOS addition condition formation judgement flag" UBYTE COMP_0004 1 100 0 255 ECU_ADDRESS 0xFFFF167C /begin FUNCTION_LIST /end FUNCTION_LIST /end MEASUREMENT
/begin MEASUREMENT vPHS1OKf "A PHOS1 operation condition judgement for the high exhaust temperature lambda control trawl control" UBYTE COMP_0004 1 100 0 255 ECU_ADDRESS 0xFFFF167D /begin FUNCTION_LIST /end FUNCTION_LIST /end MEASUREMENT
/begin MEASUREMENT vPHSDRV "At the time of the operation countermeasure lambda control, PHOS" UWORD COMP_0265 1 100 -8.000012288 7.999768147 ECU_ADDRESS 0xFFFF167E /begin FUNCTION_LIST /end FUNCTION_LIST /end MEASUREMENT
/begin MEASUREMENT vPHSDRV_R#1 "At the time of the operation countermeasure lambda control, PHOS" UWORD COMP_0265 1 100 -8.000012288 7.999768147 ECU_ADDRESS 0xFFFF167E /begin FUNCTION_LIST /end FUNCTION_LIST /end MEASUREMENT
/begin MEASUREMENT vPHSDRV_R#2 "At the time of the operation countermeasure lambda control, PHOS" UWORD COMP_0265 1 100 -8.000012288 7.999768147 ECU_ADDRESS 0xFFFF1680 /begin FUNCTION_LIST /end FUNCTION_LIST /end MEASUREMENT
/begin MEASUREMENT vPHSIDL "At the time of the idle, PHOS reflection value" UWORD COMP_0265 1 100 -8.000012288 7.999768147 ECU_ADDRESS 0xFFFF1682 /begin FUNCTION_LIST /end FUNCTION_LIST /end MEASUREMENT
/begin MEASUREMENT vPHSIDL_R#1 "At the time of the idle, PHOS reflection value" UWORD COMP_0265 1 100 -8.000012288 7.999768147 ECU_ADDRESS 0xFFFF1682 /begin FUNCTION_LIST /end FUNCTION_LIST /end MEASUREMENT
/begin MEASUREMENT vPHSIDL_R#2 "At the time of the idle, PHOS reflection value" UWORD COMP_0265 1 100 -8.000012288 7.999768147 ECU_ADDRESS 0xFFFF1684 /begin FUNCTION_LIST /end FUNCTION_LIST /end MEASUREMENT
/begin MEASUREMENT vPHVL "Phase number of the Verlog automaton" UBYTE COMP_0068 1 100 0 255 ECU_ADDRESS 0xFFFF3E2D /begin FUNCTION_LIST /end FUNCTION_LIST /end MEASUREMENT
/begin MEASUREMENT vPIADMR "Idle stabilization Pi compensation value (total)" UBYTE COMP_0009 1 100 0 199.21875 ECU_ADDRESS 0xFFFF21E7 /begin FUNCTION_LIST /end FUNCTION_LIST /end MEASUREMENT
/begin MEASUREMENT vPIFC "At the time of the fuel cut, torque compensation value" UWORD COMP_0271 1 100 0 199.99696053 ECU_ADDRESS 0xFFFF21E8 /begin FUNCTION_LIST /end FUNCTION_LIST /end MEASUREMENT
/begin MEASUREMENT vPIISCADL "Idle stabilization Pi compensation value (for the ignition timing equivalent after the limiter treatment)" UBYTE COMP_0009 1 100 0 199.21875 ECU_ADDRESS 0xFFFF21EA /begin FUNCTION_LIST /end FUNCTION_LIST /end MEASUREMENT
/begin MEASUREMENT vPIMCNT "The monitor number of times for the PI-M check" UBYTE COMP_0030 1 100 0 255 ECU_ADDRESS 0xFFFF308A /begin FUNCTION_LIST /end FUNCTION_LIST /end MEASUREMENT
/begin MEASUREMENT vPIPER "High response torque air-fuel ratio operation quantity (1)" UBYTE COMP_0009 1 100 0 199.21875 ECU_ADDRESS 0xFFFF407A /begin FUNCTION_LIST /end FUNCTION_LIST /end MEASUREMENT
/begin MEASUREMENT vPIPERAD "Torque compensation quantity (at the time of the stratified, for the air-fuel ratio)" UBYTE COMP_0009 1 100 0 199.21875 ECU_ADDRESS 0xFFFF21EB /begin FUNCTION_LIST /end FUNCTION_LIST /end MEASUREMENT
/begin MEASUREMENT vPIPERMR "Torque compensation quantity (at the time of the homogeneous/stratified, for the air-fuel ratio)" UBYTE COMP_0009 1 100 0 199.21875 ECU_ADDRESS 0xFFFF21EC /begin FUNCTION_LIST /end FUNCTION_LIST /end MEASUREMENT
/begin MEASUREMENT vPLSTIME "Group injection continuation counter" UBYTE COMP_0053 1 100 0 255 ECU_ADDRESS 0xFFFF1D1D /begin FUNCTION_LIST /end FUNCTION_LIST /end MEASUREMENT
/begin MEASUREMENT vPM1MIN "Negative pressure sensor voltage maximum value for the control" UWORD COMP_0050 1 100 0 5119.921875 ECU_ADDRESS 0xFFFFAEB6 /begin FUNCTION_LIST /end FUNCTION_LIST /end MEASUREMENT
/begin MEASUREMENT vPM2MIN "Negative pressure sensor voltage maximum value for the control" UWORD COMP_0050 1 100 0 5119.921875 ECU_ADDRESS 0xFFFFAEB8 /begin FUNCTION_LIST /end FUNCTION_LIST /end MEASUREMENT
/begin MEASUREMENT vPMCTHNG1 "Parameter monitor RAM" UBYTE COMP_0016 1 100 0 255 ECU_ADDRESS 0xFFFFAEBD /begin FUNCTION_LIST /end FUNCTION_LIST /end MEASUREMENT
/begin MEASUREMENT vPMDAPON "POWER mode judgement value" UWORD COMP_0140_S 1 100 0 7208.85 ECU_ADDRESS 0xFFFF308E /begin FUNCTION_LIST /end FUNCTION_LIST /end MEASUREMENT
/begin MEASUREMENT vPMDDLTAP "Accelerator open-degree change speed" UWORD COMP_0140_S 1 100 0 7208.85 ECU_ADDRESS 0xFFFF3090 /begin FUNCTION_LIST /end FUNCTION_LIST /end MEASUREMENT
/begin MEASUREMENT vPMDFAC "POWER mode pedal ratio gain" UWORD COMP_0614_S 1 100 0 199.996894995 ECU_ADDRESS 0xFFFF3092 /begin FUNCTION_LIST /end FUNCTION_LIST /end MEASUREMENT
/begin MEASUREMENT vPMDGTRN "POWER mode gain switchover rate" UBYTE COMP_0045 1 100 0 1.9921875 ECU_ADDRESS 0xFFFF3095 /begin FUNCTION_LIST /end FUNCTION_LIST /end MEASUREMENT
/begin MEASUREMENT vPMDMX "POWER mode pedal ratio gain slope value" UWORD COMP_0614_S 1 100 0 199.996894995 ECU_ADDRESS 0xFFFF3096 /begin FUNCTION_LIST /end FUNCTION_LIST /end MEASUREMENT
/begin MEASUREMENT vPMMAX1 "Negative pressure sensor voltage maximum value for the control" UWORD COMP_0050 1 100 0 5119.921875 ECU_ADDRESS 0xFFFF3E2E /begin FUNCTION_LIST /end FUNCTION_LIST /end MEASUREMENT
/begin MEASUREMENT vPMMIN1 "Negative pressure sensor voltage minimum value for the control" UWORD COMP_0050 1 100 0 5119.921875 ECU_ADDRESS 0xFFFF3E30 /begin FUNCTION_LIST /end FUNCTION_LIST /end MEASUREMENT
/begin MEASUREMENT vPMTFO2L1 "Parameter monitor RAM" UBYTE COMP_0013 1 100 0 255 ECU_ADDRESS 0xFFFFAEBF /begin FUNCTION_LIST /end FUNCTION_LIST /end MEASUREMENT
/begin MEASUREMENT vPMTFO2R1 "Parameter monitor RAM" UBYTE COMP_0013 1 100 0 255 ECU_ADDRESS 0xFFFFAEC0 /begin FUNCTION_LIST /end FUNCTION_LIST /end MEASUREMENT
/begin MEASUREMENT vPMTTHNG2 "Parameter monitor RAM" UBYTE COMP_0013 1 100 0 255 ECU_ADDRESS 0xFFFFAEC7 /begin FUNCTION_LIST /end FUNCTION_LIST /end MEASUREMENT
/begin MEASUREMENT vPORTM1 "Digital input previous value buffer" ULONG COMP_0004 1 100 0 4294967295 ECU_ADDRESS 0xFFFF3724 /begin FUNCTION_LIST /end FUNCTION_LIST /end MEASUREMENT
/begin MEASUREMENT vPOSIN "START/SW After OFF-> on, CAM input experience" UBYTE COMP_0068 1 100 0 255 ECU_ADDRESS 0xFFFF407B /begin FUNCTION_LIST /end FUNCTION_LIST /end MEASUREMENT
/begin MEASUREMENT vPOSINST "IRQPOS experience" UBYTE COMP_0068 1 100 0 255 ECU_ADDRESS 0xFFFF21EE /begin FUNCTION_LIST /end FUNCTION_LIST /end MEASUREMENT
/begin MEASUREMENT vPRATES "Computed purge rate" UBYTE COMP_0178 1 100 0 7.96875 ECU_ADDRESS 0xFFFF1694 /begin FUNCTION_LIST /end FUNCTION_LIST /end MEASUREMENT
/begin MEASUREMENT vPRATESW "Computed purge rate" UWORD COMP_0178 1 100 0 2047.96875 ECU_ADDRESS 0xFFFF1696 /begin FUNCTION_LIST /end FUNCTION_LIST /end MEASUREMENT
/begin MEASUREMENT vPRCLCTf "RFBRO2 reversed a PRCLCT time." UBYTE COMP_0004 1 100 0 255 ECU_ADDRESS 0xFFFF3098 /begin FUNCTION_LIST /end FUNCTION_LIST /end MEASUREMENT
/begin MEASUREMENT vPRCNT "Parameter counter" UBYTE COMP_0004 1 100 0 255 ECU_ADDRESS 0xFFFF3099 /begin FUNCTION_LIST /end FUNCTION_LIST /end MEASUREMENT
/begin MEASUREMENT vPRDLYf "In the public relations subtraction delay, judgement flag" UBYTE COMP_0004 1 100 0 255 ECU_ADDRESS 0xFFFF309A /begin FUNCTION_LIST /end FUNCTION_LIST /end MEASUREMENT
/begin MEASUREMENT vPREDSID "DiagSessionID previous value" UWORD COMP_0068 1 100 0 65535 ECU_ADDRESS 0xFFFF3E32 /begin FUNCTION_LIST /end FUNCTION_LIST /end MEASUREMENT
/begin MEASUREMENT vPRENSET0 "Idle speed temporary target previous value" UBYTE COMP_0006 1 100 0 3187.5 ECU_ADDRESS 0xFFFF169C /begin FUNCTION_LIST /end FUNCTION_LIST /end MEASUREMENT
/begin MEASUREMENT vPRSKON "At the time of the engine non-rotation, MAP pressure" UBYTE COMP_0054 1 100 0 5100 ECU_ADDRESS 0xFFFFAECA /begin FUNCTION_LIST /end FUNCTION_LIST /end MEASUREMENT
/begin MEASUREMENT vPRSLDE "At the time of the leak-down completion, atomospheric pressure" UWORD COMP_0050 1 100 0 5119.921875 ECU_ADDRESS 0xFFFF309C /begin FUNCTION_LIST /end FUNCTION_LIST /end MEASUREMENT
/begin MEASUREMENT vPRVO4 "VO24M Before 12mS, memory" UBYTE COMP_0104 1 100 0 2550 ECU_ADDRESS 0xFFFF37F8 /begin FUNCTION_LIST /end FUNCTION_LIST /end MEASUREMENT
/begin MEASUREMENT vPSFDCT "Reverse side FFD clear counter" UBYTE COMP_0016 1 100 0 255 ECU_ADDRESS 0xFFFF309E /begin FUNCTION_LIST /end FUNCTION_LIST /end MEASUREMENT
/begin MEASUREMENT vPSFDCT_S "Reverse side FFD clear counter (SUB)" UBYTE COMP_0016 1 100 0 255 ECU_ADDRESS 0xFFFF34FC /begin FUNCTION_LIST /end FUNCTION_LIST /end MEASUREMENT
/begin MEASUREMENT vPSFT "Shift P-gain" UWORD COMP_0265 1 100 -8.000012288 7.999768147 ECU_ADDRESS 0xFFFF169E /begin FUNCTION_LIST /end FUNCTION_LIST /end MEASUREMENT
/begin MEASUREMENT vPSFT_R#1 "Shift P-gain" UWORD COMP_0265 1 100 -8.000012288 7.999768147 ECU_ADDRESS 0xFFFF169E /begin FUNCTION_LIST /end FUNCTION_LIST /end MEASUREMENT
/begin MEASUREMENT vPSFT_R#2 "Shift P-gain" UWORD COMP_0265 1 100 -8.000012288 7.999768147 ECU_ADDRESS 0xFFFF16A0 /begin FUNCTION_LIST /end FUNCTION_LIST /end MEASUREMENT
/begin MEASUREMENT vPSLRNCLRf "Air-fuel ratio learning clear 1shot flag (DDL)" UBYTE COMP_0004 1 100 0 255 ECU_ADDRESS 0xFFFF309F /begin FUNCTION_LIST /end FUNCTION_LIST /end MEASUREMENT
/begin MEASUREMENT vPSRIMN "Fuel injection cylinder flag" UBYTE COMP_0091 1 100 0 255 ECU_ADDRESS 0xFFFF16A2 /begin FUNCTION_LIST /end FUNCTION_LIST /end MEASUREMENT
/begin MEASUREMENT vPSRIRQ "Interrupt injection prohibition cylinder flag" UBYTE COMP_0091 1 100 0 255 ECU_ADDRESS 0xFFFF16A3 /begin FUNCTION_LIST /end FUNCTION_LIST /end MEASUREMENT
/begin MEASUREMENT vPSSEQN "ETC learning value clear counter" UBYTE COMP_0016 1 100 0 255 ECU_ADDRESS 0xFFFF30A0 /begin FUNCTION_LIST /end FUNCTION_LIST /end MEASUREMENT
/begin MEASUREMENT vPSSEQN_S "ETC learning value clear counter (SUB)" UBYTE COMP_0016 1 100 0 255 ECU_ADDRESS 0xFFFF34FD /begin FUNCTION_LIST /end FUNCTION_LIST /end MEASUREMENT
/begin MEASUREMENT vPST1AV "Pre-pressure check value" SWORD COMP_0491 1 100 -2560 2559.921875 ECU_ADDRESS 0xFFFFAECC /begin FUNCTION_LIST /end FUNCTION_LIST /end MEASUREMENT
/begin MEASUREMENT vPST1MN "Stage 1 judgement line pressure minimum value" UWORD COMP_0050 1 100 0 5119.921875 ECU_ADDRESS 0xFFFFAECE /begin FUNCTION_LIST /end FUNCTION_LIST /end MEASUREMENT
/begin MEASUREMENT vPST1MX "Stage 1 judgement line pressure maximum value" UWORD COMP_0050 1 100 0 5119.921875 ECU_ADDRESS 0xFFFFAED0 /begin FUNCTION_LIST /end FUNCTION_LIST /end MEASUREMENT
/begin MEASUREMENT vPST1NM "Stage 1 judgement line pressure integration number of times" UWORD COMP_0492 1 100 0 65535 ECU_ADDRESS 0xFFFFAED2 /begin FUNCTION_LIST /end FUNCTION_LIST /end MEASUREMENT
/begin MEASUREMENT vPST1SM "Stage 1 judgement line pressure integration value" SLONG COMP_0491 1 100 -167772160 167772159.921875 ECU_ADDRESS 0xFFFFAED4 /begin FUNCTION_LIST /end FUNCTION_LIST /end MEASUREMENT
/begin MEASUREMENT vPST21FN "At the time of stage 21 OK, fuel temperature minimum value" UBYTE COMP_0371 1 100 0 510 ECU_ADDRESS 0xFFFFAED8 /begin FUNCTION_LIST /end FUNCTION_LIST /end MEASUREMENT
/begin MEASUREMENT vPST21PN "At the time of stage 21 OK, delta-PAMB minimum value" SWORD COMP_0491 1 100 -2560 2559.921875 ECU_ADDRESS 0xFFFFAEDA /begin FUNCTION_LIST /end FUNCTION_LIST /end MEASUREMENT
/begin MEASUREMENT vPST21PX "At the time of stage 21 OK, delta-PAMB maximum value" UWORD COMP_0050 1 100 0 5119.921875 ECU_ADDRESS 0xFFFFAEDC /begin FUNCTION_LIST /end FUNCTION_LIST /end MEASUREMENT
/begin MEASUREMENT vPST21TN "Stage 21 OK judgement time minimum value" UBYTE COMP_0096 1 100 0 2550 ECU_ADDRESS 0xFFFFAEDE /begin FUNCTION_LIST /end FUNCTION_LIST /end MEASUREMENT
/begin MEASUREMENT vPST22FN "At the time of stage 22 OK, fuel temperature minimum value" UBYTE COMP_0371 1 100 0 510 ECU_ADDRESS 0xFFFFAEDF /begin FUNCTION_LIST /end FUNCTION_LIST /end MEASUREMENT
/begin MEASUREMENT vPST22PN "At the time of stage 22 OK, delta-PAMB minimum value" SWORD COMP_0491 1 100 -2560 2559.921875 ECU_ADDRESS 0xFFFFAEE0 /begin FUNCTION_LIST /end FUNCTION_LIST /end MEASUREMENT
/begin MEASUREMENT vPST22PX "At the time of stage 22 OK, delta-PAMB maximum value" UWORD COMP_0050 1 100 0 5119.921875 ECU_ADDRESS 0xFFFFAEE2 /begin FUNCTION_LIST /end FUNCTION_LIST /end MEASUREMENT
/begin MEASUREMENT vPST22TN "Stage 22 OK judgement time minimum value" UBYTE COMP_0096 1 100 0 2550 ECU_ADDRESS 0xFFFFAEE4 /begin FUNCTION_LIST /end FUNCTION_LIST /end MEASUREMENT
/begin MEASUREMENT vPST23DN "At the time of the pull-down switchover, line pressure change 1 minimum value" UWORD COMP_0050 1 100 0 5119.921875 ECU_ADDRESS 0xFFFFAEE6 /begin FUNCTION_LIST /end FUNCTION_LIST /end MEASUREMENT
/begin MEASUREMENT vPST23JN "At the time of the pull-down switchover, line pressure change 2 minimum value" UWORD COMP_0050 1 100 0 5119.921875 ECU_ADDRESS 0xFFFFAEE8 /begin FUNCTION_LIST /end FUNCTION_LIST /end MEASUREMENT
/begin MEASUREMENT vPST23PN "At the time of the pull-down switchover, delta-PAMB minimum value" SWORD COMP_0491 1 100 -2560 2559.921875 ECU_ADDRESS 0xFFFFAEEA /begin FUNCTION_LIST /end FUNCTION_LIST /end MEASUREMENT
/begin MEASUREMENT vPST23PX "At the time of the pull-down switchover, delta-PAMB maximum value" UWORD COMP_0050 1 100 0 5119.921875 ECU_ADDRESS 0xFFFFAEEC /begin FUNCTION_LIST /end FUNCTION_LIST /end MEASUREMENT
/begin MEASUREMENT vPST2DY "At the time of the stage 2 judgement, after the start, time" UBYTE COMP_0096 1 100 0 2550 ECU_ADDRESS 0xFFFF30A1 /begin FUNCTION_LIST /end FUNCTION_LIST /end MEASUREMENT
/begin MEASUREMENT vPST2EV1 "At the time of the stage 2 judgement, line pressure change 1" UWORD COMP_0050 1 100 0 5119.921875 ECU_ADDRESS 0xFFFF30A2 /begin FUNCTION_LIST /end FUNCTION_LIST /end MEASUREMENT
/begin MEASUREMENT vPST2EV2 "At the time of the stage 2 judgement, line pressure change 2" UWORD COMP_0050 1 100 0 5119.921875 ECU_ADDRESS 0xFFFF30A4 /begin FUNCTION_LIST /end FUNCTION_LIST /end MEASUREMENT
/begin MEASUREMENT vPST2FL "At the time of the stage 2 judgement, the amount of fuel consumption" UBYTE COMP_0371 1 100 0 510 ECU_ADDRESS 0xFFFF30A6 /begin FUNCTION_LIST /end FUNCTION_LIST /end MEASUREMENT
/begin MEASUREMENT vPST2MT "At the time of the stage 2 judgement, fuel temperature change 2" UBYTE COMP_0054 1 100 0 5100 ECU_ADDRESS 0xFFFF30A7 /begin FUNCTION_LIST /end FUNCTION_LIST /end MEASUREMENT
/begin MEASUREMENT vPST2PM "At the time of the stage 2 judgement, a change in an atomospheric pressure" SWORD COMP_0491 1 100 -2560 2559.921875 ECU_ADDRESS 0xFFFF30A8 /begin FUNCTION_LIST /end FUNCTION_LIST /end MEASUREMENT
/begin MEASUREMENT vPSYSCN "Stage 1NG counter timer" UBYTE COMP_0016 1 100 0 255 ECU_ADDRESS 0xFFFF16A4 /begin FUNCTION_LIST /end FUNCTION_LIST /end MEASUREMENT
/begin MEASUREMENT vPSYSCNV "Imaginary stage 2 switchover condition judgement counter" UBYTE COMP_0016 1 100 0 255 ECU_ADDRESS 0xFFFF16A5 /begin FUNCTION_LIST /end FUNCTION_LIST /end MEASUREMENT
/begin MEASUREMENT vPTYHDTMP "The temporary RAM for the parity check of the ROM" ULONG COMP_0068 1 100 0 4294967295 ECU_ADDRESS 0xFFFF30B0 /begin FUNCTION_LIST /end FUNCTION_LIST /end MEASUREMENT
/begin MEASUREMENT vPTYTMP "For the PTY value operation" ULONG COMP_0068 1 100 0 4294967295 ECU_ADDRESS 0xFFFF30B4 /begin FUNCTION_LIST /end FUNCTION_LIST /end MEASUREMENT
/begin MEASUREMENT vPULS "Output pulse width by the cylinder" UWORD COMP_0231 1 100 0 655350 ECU_ADDRESS 0xFFFF21F2 /begin FUNCTION_LIST /end FUNCTION_LIST /end MEASUREMENT
/begin MEASUREMENT vPUSDGN2f "CAM target signal breakage, noise diagnosis condition formation" UBYTE COMP_0004 1 100 0 255 ECU_ADDRESS 0xFFFF30B8 /begin FUNCTION_LIST /end FUNCTION_LIST /end MEASUREMENT
/begin MEASUREMENT vPUSDGNf "CAM target diagnosis condition formation" UBYTE COMP_0004 1 100 0 255 ECU_ADDRESS 0xFFFF30B9 /begin FUNCTION_LIST /end FUNCTION_LIST /end MEASUREMENT
/begin MEASUREMENT vPVTCTRG2 "PS-VTC target angle 2" UBYTE COMP_0019 1 100 0 255 ECU_ADDRESS 0xFFFF16A9 /begin FUNCTION_LIST /end FUNCTION_LIST /end MEASUREMENT
/begin MEASUREMENT vPVTCTRGI "Electromagnetism VTC target angle (intake)" UBYTE COMP_0256 1 100 -64 63.5 ECU_ADDRESS 0xFFFF16AB /begin FUNCTION_LIST /end FUNCTION_LIST /end MEASUREMENT
/begin MEASUREMENT vQAGBCOR1 "ISC_Airflow_Correction_f (Torque consumed by AGB)" UWORD COMP_0499_S 1 100 0 6553.5 ECU_ADDRESS 0xFFFF30D2 /begin FUNCTION_LIST /end FUNCTION_LIST /end MEASUREMENT
/begin MEASUREMENT vQAGBCOR2 "ISC_Airflow_Correction_f (Torque consumed by AGB)" UWORD COMP_0499_S 1 100 0 6553.5 ECU_ADDRESS 0xFFFF30D4 /begin FUNCTION_LIST /end FUNCTION_LIST /end MEASUREMENT
/begin MEASUREMENT vQCISTS "QFBI calculation condition in OPEN" UBYTE COMP_0004 1 100 0 255 ECU_ADDRESS 0xFFFF16C6 /begin FUNCTION_LIST /end FUNCTION_LIST /end MEASUREMENT
/begin MEASUREMENT vQCK0 "(CK) Load change air flow-quantity basic table reference value" UBYTE COMP_0220 1 100 0 255 ECU_ADDRESS 0xFFFF1EFB /begin FUNCTION_LIST /end FUNCTION_LIST /end MEASUREMENT
/begin MEASUREMENT vQCK0N "(CK) Load change air flow-quantity target value" UBYTE COMP_0220 1 100 0 255 ECU_ADDRESS 0xFFFF1EFC /begin FUNCTION_LIST /end FUNCTION_LIST /end MEASUREMENT
/begin MEASUREMENT vQCK0NN "(CK) Load change air flow-quantity target value" UBYTE COMP_0220 1 100 0 255 ECU_ADDRESS 0xFFFF1EFD /begin FUNCTION_LIST /end FUNCTION_LIST /end MEASUREMENT
/begin MEASUREMENT vQCK0NZ "(CK) In front of the load change air flow-quantity, time target value" UBYTE COMP_0220 1 100 0 255 ECU_ADDRESS 0xFFFF1EFE /begin FUNCTION_LIST /end FUNCTION_LIST /end MEASUREMENT
/begin MEASUREMENT vQCK1 "(CK) For the load change advantage air flow-quantity basic table" UBYTE COMP_0220 1 100 0 255 ECU_ADDRESS 0xFFFF1EFF /begin FUNCTION_LIST /end FUNCTION_LIST /end MEASUREMENT
/begin MEASUREMENT vQCK2 "(CK) For load change advantage air flow-quantity triangle compensation" UBYTE COMP_0220 1 100 0 255 ECU_ADDRESS 0xFFFF1F00 /begin FUNCTION_LIST /end FUNCTION_LIST /end MEASUREMENT
/begin MEASUREMENT vQDJ100 "Inhalation air quantity (before 100mS)" UWORD COMP_0075_S 1 100 0 838.848 ECU_ADDRESS 0xFFFF3E36 /begin FUNCTION_LIST /end FUNCTION_LIST /end MEASUREMENT
/begin MEASUREMENT vQDJ40 "Inhalation air quantity (before 40mS)" UWORD COMP_0075_S 1 100 0 838.848 ECU_ADDRESS 0xFFFF3E38 /begin FUNCTION_LIST /end FUNCTION_LIST /end MEASUREMENT
/begin MEASUREMENT vQDJ60 "Inhalation air quantity (before 60mS)" UWORD COMP_0075_S 1 100 0 838.848 ECU_ADDRESS 0xFFFF3E3A /begin FUNCTION_LIST /end FUNCTION_LIST /end MEASUREMENT
/begin MEASUREMENT vQDJ80 "Inhalation air quantity (before 80mS)" UWORD COMP_0075_S 1 100 0 838.848 ECU_ADDRESS 0xFFFF3E3C /begin FUNCTION_LIST /end FUNCTION_LIST /end MEASUREMENT
/begin MEASUREMENT vQEGR "EGR quantity estimated value" UWORD COMP_0004 1 100 0 65535 ECU_ADDRESS 0xFFFF30DA /begin FUNCTION_LIST /end FUNCTION_LIST /end MEASUREMENT
/begin MEASUREMENT vQENG "Oil heat receiving quantity (for the engine)" UBYTE COMP_0003 1 100 0 255 ECU_ADDRESS 0xFFFF30DC /begin FUNCTION_LIST /end FUNCTION_LIST /end MEASUREMENT
/begin MEASUREMENT vQFBIADD "QFBI addition value" SLONG COMP_0277 1 100 -2147483648 2147483647 ECU_ADDRESS 0xFFFF16CC /begin FUNCTION_LIST /end FUNCTION_LIST /end MEASUREMENT
/begin MEASUREMENT vQLD0N "QLD steady state compensation (There is no one for power steering load compensation.)" UWORD COMP_0051 1 100 0 65535 ECU_ADDRESS 0xFFFF16E4 /begin FUNCTION_LIST /end FUNCTION_LIST /end MEASUREMENT
/begin MEASUREMENT vQPAGE "Computed purge flow-quantity equivalent area" UBYTE COMP_0042 1 100 0 0.204 ECU_ADDRESS 0xFFFF16FC /begin FUNCTION_LIST /end FUNCTION_LIST /end MEASUREMENT
/begin MEASUREMENT vQUPSATf "Quick-up start control flag" UBYTE COMP_0004 1 100 0 255 ECU_ADDRESS 0xFFFF1F01 /begin FUNCTION_LIST /end FUNCTION_LIST /end MEASUREMENT
/begin MEASUREMENT vQUPSCHKf "A delay judgement completion flag in the quick-up start control" UBYTE COMP_0004 1 100 0 255 ECU_ADDRESS 0xFFFF1F02 /begin FUNCTION_LIST /end FUNCTION_LIST /end MEASUREMENT
/begin MEASUREMENT vQUST8BF "A question data previous value from the watch IC" UBYTE COMP_0068 1 100 0 255 ECU_ADDRESS 0xFFFF30E1 /begin FUNCTION_LIST /end FUNCTION_LIST /end MEASUREMENT
/begin MEASUREMENT vR0 "Engine speed" UWORD COMP_0427 1 100 0 16383.75 ECU_ADDRESS 0xFFFF170E /begin FUNCTION_LIST /end FUNCTION_LIST /end MEASUREMENT
/begin MEASUREMENT vR1 "Engine speed" UWORD COMP_0427 1 100 0 16383.75 ECU_ADDRESS 0xFFFF1710 /begin FUNCTION_LIST /end FUNCTION_LIST /end MEASUREMENT
/begin MEASUREMENT vR2 "Engine speed" UWORD COMP_0427 1 100 0 16383.75 ECU_ADDRESS 0xFFFF1712 /begin FUNCTION_LIST /end FUNCTION_LIST /end MEASUREMENT
/begin MEASUREMENT vRARM "At the time of Miss step, EGR opening area" UBYTE COMP_0147 1 100 0 0.816 ECU_ADDRESS 0xFFFF30EE /begin FUNCTION_LIST /end FUNCTION_LIST /end MEASUREMENT
/begin MEASUREMENT vRATEWCNT "EEOROM writing counter" UBYTE COMP_0030 1 100 0 255 ECU_ADDRESS 0xFFFF30EF /begin FUNCTION_LIST /end FUNCTION_LIST /end MEASUREMENT
/begin MEASUREMENT vRATIOMT "MT ASCD gear ratio" UWORD COMP_0450 1 100 0 63.999056205 ECU_ADDRESS 0xFFFF4962 /begin FUNCTION_LIST /end FUNCTION_LIST /end MEASUREMENT
/begin MEASUREMENT vRBMXNEI "At the time of the response time maximum value, engine speed (retard side)" UBYTE COMP_0020 1 100 0 12750 ECU_ADDRESS 0xFFFFAEF8 /begin FUNCTION_LIST /end FUNCTION_LIST /end MEASUREMENT
/begin MEASUREMENT vRBMXNEI_R#1 "At the time of the response time maximum value, engine speed (retard side)" UBYTE COMP_0020 1 100 0 12750 ECU_ADDRESS 0xFFFFAEF8 /begin FUNCTION_LIST /end FUNCTION_LIST /end MEASUREMENT
/begin MEASUREMENT vRBMXNEI_R#2 "At the time of the response time maximum value, engine speed (retard side)" UBYTE COMP_0020 1 100 0 12750 ECU_ADDRESS 0xFFFFAEF9 /begin FUNCTION_LIST /end FUNCTION_LIST /end MEASUREMENT
/begin MEASUREMENT vRBMXOLI "At the time of the response time maximum value, oil temperature (retard side)" UBYTE COMP_0035 1 100 -50 205 ECU_ADDRESS 0xFFFFAEFA /begin FUNCTION_LIST /end FUNCTION_LIST /end MEASUREMENT
/begin MEASUREMENT vRBMXOLI_R#1 "At the time of the response time maximum value, oil temperature (retard side)" UBYTE COMP_0035 1 100 -50 205 ECU_ADDRESS 0xFFFFAEFA /begin FUNCTION_LIST /end FUNCTION_LIST /end MEASUREMENT
/begin MEASUREMENT vRBMXOLI_R#2 "At the time of the response time maximum value, oil temperature (retard side)" UBYTE COMP_0035 1 100 -50 205 ECU_ADDRESS 0xFFFFAEFB /begin FUNCTION_LIST /end FUNCTION_LIST /end MEASUREMENT
/begin MEASUREMENT vRCNTRIP "Mileage for the fuel level gauge diagnosis frequency" ULONG COMP_0389 1 100 0 1685624.33943218 ECU_ADDRESS 0xFFFFA084 /begin FUNCTION_LIST /end FUNCTION_LIST /end MEASUREMENT
/begin MEASUREMENT vRCRSETf "Rich side reset flag" UBYTE COMP_0004 1 100 0 255 ECU_ADDRESS 0xFFFF30F8 /begin FUNCTION_LIST /end FUNCTION_LIST /end MEASUREMENT
/begin MEASUREMENT vRCRSETzf "Rich side reset flag (previous value)" UBYTE COMP_0004 1 100 0 255 ECU_ADDRESS 0xFFFF30F9 /begin FUNCTION_LIST /end FUNCTION_LIST /end MEASUREMENT
/begin MEASUREMENT vRDR1M "Receiving data" UBYTE COMP_0004 1 100 0 255 ECU_ADDRESS 0xFFFF3100 /begin FUNCTION_LIST /end FUNCTION_LIST /end MEASUREMENT
/begin MEASUREMENT vRDTYOUT "Rear O2 heater duty output number of times" UBYTE COMP_0030 1 100 0 255 ECU_ADDRESS 0xFFFF171E /begin FUNCTION_LIST /end FUNCTION_LIST /end MEASUREMENT
/begin MEASUREMENT vRDVP4 "The square root of DVP4" UWORD COMP_0050 1 100 0 5119.921875 ECU_ADDRESS 0xFFFF310A /begin FUNCTION_LIST /end FUNCTION_LIST /end MEASUREMENT
/begin MEASUREMENT vRDVP5 "The square root of the DVP5 compensation value" UWORD COMP_0050 1 100 0 5119.921875 ECU_ADDRESS 0xFFFF310C /begin FUNCTION_LIST /end FUNCTION_LIST /end MEASUREMENT
/begin MEASUREMENT vREBMAXI "Retard side response time maximum value" UBYTE COMP_0183 1 100 0 5100 ECU_ADDRESS 0xFFFFAEFC /begin FUNCTION_LIST /end FUNCTION_LIST /end MEASUREMENT
/begin MEASUREMENT vREBMAXI_R#1 "Retard side response time maximum value" UBYTE COMP_0183 1 100 0 5100 ECU_ADDRESS 0xFFFFAEFC /begin FUNCTION_LIST /end FUNCTION_LIST /end MEASUREMENT
/begin MEASUREMENT vREBMAXI_R#2 "Retard side response time maximum value" UBYTE COMP_0183 1 100 0 5100 ECU_ADDRESS 0xFFFFAEFD /begin FUNCTION_LIST /end FUNCTION_LIST /end MEASUREMENT
/begin MEASUREMENT vREBOIL "At the time of response measuring, oil temperature (at the time of the retard)" UBYTE COMP_0035 1 100 -50 205 ECU_ADDRESS 0xFFFF1720 /begin FUNCTION_LIST /end FUNCTION_LIST /end MEASUREMENT
/begin MEASUREMENT vREBOIL_R#1 "At the time of response measuring, oil temperature (at the time of the retard)" UBYTE COMP_0035 1 100 -50 205 ECU_ADDRESS 0xFFFF1720 /begin FUNCTION_LIST /end FUNCTION_LIST /end MEASUREMENT
/begin MEASUREMENT vREBOIL_R#2 "At the time of response measuring, oil temperature (at the time of the retard)" UBYTE COMP_0035 1 100 -50 205 ECU_ADDRESS 0xFFFF1721 /begin FUNCTION_LIST /end FUNCTION_LIST /end MEASUREMENT
/begin MEASUREMENT vREBRPM "At the time of response measuring, engine speed (at the time of the retard)" UBYTE COMP_0020 1 100 0 12750 ECU_ADDRESS 0xFFFF1722 /begin FUNCTION_LIST /end FUNCTION_LIST /end MEASUREMENT
/begin MEASUREMENT vREBRPM_R#1 "At the time of response measuring, engine speed (at the time of the retard)" UBYTE COMP_0020 1 100 0 12750 ECU_ADDRESS 0xFFFF1722 /begin FUNCTION_LIST /end FUNCTION_LIST /end MEASUREMENT
/begin MEASUREMENT vREBRPM_R#2 "At the time of response measuring, engine speed (at the time of the retard)" UBYTE COMP_0020 1 100 0 12750 ECU_ADDRESS 0xFFFF1723 /begin FUNCTION_LIST /end FUNCTION_LIST /end MEASUREMENT
/begin MEASUREMENT vREBTIMI "Retard side response time" UBYTE COMP_0183 1 100 0 5100 ECU_ADDRESS 0xFFFF1724 /begin FUNCTION_LIST /end FUNCTION_LIST /end MEASUREMENT
/begin MEASUREMENT vREBTIMI_R#1 "Retard side response time" UBYTE COMP_0183 1 100 0 5100 ECU_ADDRESS 0xFFFF1724 /begin FUNCTION_LIST /end FUNCTION_LIST /end MEASUREMENT
/begin MEASUREMENT vREBTIMI_R#2 "Retard side response time" UBYTE COMP_0183 1 100 0 5100 ECU_ADDRESS 0xFFFF1725 /begin FUNCTION_LIST /end FUNCTION_LIST /end MEASUREMENT
/begin MEASUREMENT vREFCNT "REF number of times" UBYTE COMP_0030 1 100 0 255 ECU_ADDRESS 0xFFFF2202 /begin FUNCTION_LIST /end FUNCTION_LIST /end MEASUREMENT
/begin MEASUREMENT vREFCNTI "Cam accumulation speed" ULONG COMP_0146_S 1 100 0 2147483647.5 ECU_ADDRESS 0xFFFF3110 /begin FUNCTION_LIST /end FUNCTION_LIST /end MEASUREMENT
/begin MEASUREMENT vREFCNTI_R#1 "Cam accumulation speed" ULONG COMP_0146_S 1 100 0 2147483647.5 ECU_ADDRESS 0xFFFF3110 /begin FUNCTION_LIST /end FUNCTION_LIST /end MEASUREMENT
/begin MEASUREMENT vREFCNTI_R#2 "Cam accumulation speed" ULONG COMP_0146_S 1 100 0 2147483647.5 ECU_ADDRESS 0xFFFF3114 /begin FUNCTION_LIST /end FUNCTION_LIST /end MEASUREMENT
/begin MEASUREMENT vREFCT "Catalyst region 200Å~CATBAI# number of times counter" UWORD COMP_0191 1 100 0 65535 ECU_ADDRESS 0xFFFF409E /begin FUNCTION_LIST /end FUNCTION_LIST /end MEASUREMENT
/begin MEASUREMENT vREFEM "Emission region 1000 turns counter" UWORD COMP_0191 1 100 0 65535 ECU_ADDRESS 0xFFFF40A0 /begin FUNCTION_LIST /end FUNCTION_LIST /end MEASUREMENT
/begin MEASUREMENT vREFGAK2 "GAK2 addition REF counter" UBYTE COMP_0068 1 100 0 255 ECU_ADDRESS 0xFFFF2203 /begin FUNCTION_LIST /end FUNCTION_LIST /end MEASUREMENT
/begin MEASUREMENT vREFIA "Multiple cylinder misfire 200Å~FUKBAI# rotation counter" UWORD COMP_0191 1 100 0 65535 ECU_ADDRESS 0xFFFF40A2 /begin FUNCTION_LIST /end FUNCTION_LIST /end MEASUREMENT
/begin MEASUREMENT vREFIN "REF input experience" UBYTE COMP_0068 1 100 0 255 ECU_ADDRESS 0xFFFF407D /begin FUNCTION_LIST /end FUNCTION_LIST /end MEASUREMENT
/begin MEASUREMENT vREFINEC "REF input experience (engine stall clear)" UBYTE COMP_0068 1 100 0 255 ECU_ADDRESS 0xFFFF2204 /begin FUNCTION_LIST /end FUNCTION_LIST /end MEASUREMENT
/begin MEASUREMENT vREFLLC "REF counter" UBYTE COMP_0016 1 100 0 255 ECU_ADDRESS 0xFFFF2205 /begin FUNCTION_LIST /end FUNCTION_LIST /end MEASUREMENT
/begin MEASUREMENT vREFMAXI "Advance side response time maximum value" UBYTE COMP_0183 1 100 0 5100 ECU_ADDRESS 0xFFFFAEFE /begin FUNCTION_LIST /end FUNCTION_LIST /end MEASUREMENT
/begin MEASUREMENT vREFMAXI_R#1 "Advance side response time maximum value" UBYTE COMP_0183 1 100 0 5100 ECU_ADDRESS 0xFFFFAEFE /begin FUNCTION_LIST /end FUNCTION_LIST /end MEASUREMENT
/begin MEASUREMENT vREFMAXI_R#2 "Advance side response time maximum value" UBYTE COMP_0183 1 100 0 5100 ECU_ADDRESS 0xFFFFAEFF /begin FUNCTION_LIST /end FUNCTION_LIST /end MEASUREMENT
/begin MEASUREMENT vREFOIL "At the time of response measuring, oil temperature (at the time of the advance)" UBYTE COMP_0035 1 100 -50 205 ECU_ADDRESS 0xFFFF1728 /begin FUNCTION_LIST /end FUNCTION_LIST /end MEASUREMENT
/begin MEASUREMENT vREFOIL_R#1 "At the time of response measuring, oil temperature (at the time of the advance)" UBYTE COMP_0035 1 100 -50 205 ECU_ADDRESS 0xFFFF1728 /begin FUNCTION_LIST /end FUNCTION_LIST /end MEASUREMENT
/begin MEASUREMENT vREFOIL_R#2 "At the time of response measuring, oil temperature (at the time of the advance)" UBYTE COMP_0035 1 100 -50 205 ECU_ADDRESS 0xFFFF1729 /begin FUNCTION_LIST /end FUNCTION_LIST /end MEASUREMENT
/begin MEASUREMENT vREFPOS "REF position" UWORD COMP_0004 1 100 0 65535 ECU_ADDRESS 0xFFFF2206 /begin FUNCTION_LIST /end FUNCTION_LIST /end MEASUREMENT
/begin MEASUREMENT vREFRPM "At the time of response measuring, engine speed (at the time of the advance)" UBYTE COMP_0020 1 100 0 12750 ECU_ADDRESS 0xFFFF172A /begin FUNCTION_LIST /end FUNCTION_LIST /end MEASUREMENT
/begin MEASUREMENT vREFRPM_R#1 "At the time of response measuring, engine speed (at the time of the advance)" UBYTE COMP_0020 1 100 0 12750 ECU_ADDRESS 0xFFFF172A /begin FUNCTION_LIST /end FUNCTION_LIST /end MEASUREMENT
/begin MEASUREMENT vREFRPM_R#2 "At the time of response measuring, engine speed (at the time of the advance)" UBYTE COMP_0020 1 100 0 12750 ECU_ADDRESS 0xFFFF172B /begin FUNCTION_LIST /end FUNCTION_LIST /end MEASUREMENT
/begin MEASUREMENT vREFTIMI "Advance side response time" UBYTE COMP_0183 1 100 0 5100 ECU_ADDRESS 0xFFFF172C /begin FUNCTION_LIST /end FUNCTION_LIST /end MEASUREMENT
/begin MEASUREMENT vREFTIMI_R#1 "Advance side response time" UBYTE COMP_0183 1 100 0 5100 ECU_ADDRESS 0xFFFF172C /begin FUNCTION_LIST /end FUNCTION_LIST /end MEASUREMENT
/begin MEASUREMENT vREFTIMI_R#2 "Advance side response time" UBYTE COMP_0183 1 100 0 5100 ECU_ADDRESS 0xFFFF172D /begin FUNCTION_LIST /end FUNCTION_LIST /end MEASUREMENT
/begin MEASUREMENT vREGRALCAL "Target Idle Speed adjustment parameter" UBYTE COMP_0068 1 100 0 255 ECU_ADDRESS 0xFFFF1F03 /begin FUNCTION_LIST /end FUNCTION_LIST /end MEASUREMENT
/begin MEASUREMENT vREPNSCAL "ECM code result" ULONG COMP_0068 1 100 0 4294967295 ECU_ADDRESS 0xFFFF3E4C /begin FUNCTION_LIST /end FUNCTION_LIST /end MEASUREMENT
/begin MEASUREMENT vREPNSLU "BCM code result" ULONG COMP_0068 1 100 0 4294967295 ECU_ADDRESS 0xFFFF3E50 /begin FUNCTION_LIST /end FUNCTION_LIST /end MEASUREMENT
/begin MEASUREMENT vRES20MS "A counter for VTC response sex parameter measuring" UBYTE COMP_0068 1 100 0 255 ECU_ADDRESS 0xFFFF1730 /begin FUNCTION_LIST /end FUNCTION_LIST /end MEASUREMENT
/begin MEASUREMENT vRES20MS_R#1 "A counter for VTC response sex parameter measuring" UBYTE COMP_0068 1 100 0 255 ECU_ADDRESS 0xFFFF1730 /begin FUNCTION_LIST /end FUNCTION_LIST /end MEASUREMENT
/begin MEASUREMENT vRES20MS_R#2 "A counter for VTC response sex parameter measuring" UBYTE COMP_0068 1 100 0 255 ECU_ADDRESS 0xFFFF1731 /begin FUNCTION_LIST /end FUNCTION_LIST /end MEASUREMENT
/begin MEASUREMENT vRESCNTEND "RAM value vRESCNTEND" UBYTE COMP_0004 1 100 0 255 ECU_ADDRESS 0xFFFF3118 /begin FUNCTION_LIST /end FUNCTION_LIST /end MEASUREMENT
/begin MEASUREMENT vRESCNTLEN "RAM value vRESCNTLEN" UBYTE COMP_0004 1 100 0 255 ECU_ADDRESS 0xFFFF3119 /begin FUNCTION_LIST /end FUNCTION_LIST /end MEASUREMENT
/begin MEASUREMENT vRESCNTLOK "RAM value vRESCNTLOK" UBYTE COMP_0004 1 100 0 255 ECU_ADDRESS 0xFFFF311A /begin FUNCTION_LIST /end FUNCTION_LIST /end MEASUREMENT
/begin MEASUREMENT vRESCNTOKf "RESCNT (for the bank) count judgement flag" UBYTE COMP_0004 1 100 0 255 ECU_ADDRESS 0xFFFF4761 /begin FUNCTION_LIST /end FUNCTION_LIST /end MEASUREMENT
/begin MEASUREMENT vRESCNTREN "RAM value vRESCNTREN" UBYTE COMP_0004 1 100 0 255 ECU_ADDRESS 0xFFFF311B /begin FUNCTION_LIST /end FUNCTION_LIST /end MEASUREMENT
/begin MEASUREMENT vRESCNTROK "RAM value vRESCNTROK" UBYTE COMP_0004 1 100 0 255 ECU_ADDRESS 0xFFFF311C /begin FUNCTION_LIST /end FUNCTION_LIST /end MEASUREMENT
/begin MEASUREMENT vRESNOX "The amount of NOx remains" UWORD COMP_0617_S 1 100 0 3.999941832 ECU_ADDRESS 0xFFFF1738 /begin FUNCTION_LIST /end FUNCTION_LIST /end MEASUREMENT
/begin MEASUREMENT vRESNOX_R#1 "The amount of NOx remains" UWORD COMP_0617_S 1 100 0 3.999941832 ECU_ADDRESS 0xFFFF1738 /begin FUNCTION_LIST /end FUNCTION_LIST /end MEASUREMENT
/begin MEASUREMENT vRESNOX_R#2 "The amount of NOx remains" UWORD COMP_0617_S 1 100 0 3.999941832 ECU_ADDRESS 0xFFFF173A /begin FUNCTION_LIST /end FUNCTION_LIST /end MEASUREMENT
/begin MEASUREMENT vRESTCRMW "Previous value of memorized fuel Injection Mass correction factor for Re-Start" UBYTE COMP_0068 1 100 0 255 ECU_ADDRESS 0xFFFF3121 /begin FUNCTION_LIST /end FUNCTION_LIST /end MEASUREMENT
/begin MEASUREMENT vRESTIMI "Response time measuring timer" UBYTE COMP_0183 1 100 0 5100 ECU_ADDRESS 0xFFFF173C /begin FUNCTION_LIST /end FUNCTION_LIST /end MEASUREMENT
/begin MEASUREMENT vRESTIMI_R#1 "Response time measuring timer" UBYTE COMP_0183 1 100 0 5100 ECU_ADDRESS 0xFFFF173C /begin FUNCTION_LIST /end FUNCTION_LIST /end MEASUREMENT
/begin MEASUREMENT vRESTIMI_R#2 "Response time measuring timer" UBYTE COMP_0183 1 100 0 5100 ECU_ADDRESS 0xFFFF173D /begin FUNCTION_LIST /end FUNCTION_LIST /end MEASUREMENT
/begin MEASUREMENT vRESTTWKZ "Memorized engine coolant temperature" UBYTE COMP_0356 1 100 -40 119.375 ECU_ADDRESS 0xFFFF3124 /begin FUNCTION_LIST /end FUNCTION_LIST /end MEASUREMENT
/begin MEASUREMENT vREVCNTI "Cam accumulation speed (1000 times)" ULONG COMP_0148_S 1 100 0 4294967295000 ECU_ADDRESS 0xFFFFAF0C /begin FUNCTION_LIST /end FUNCTION_LIST /end MEASUREMENT
/begin MEASUREMENT vREVCNTI_R#1 "Cam accumulation speed (1000 times)" ULONG COMP_0148_S 1 100 0 4294967295000 ECU_ADDRESS 0xFFFFAF0C /begin FUNCTION_LIST /end FUNCTION_LIST /end MEASUREMENT
/begin MEASUREMENT vREVCNTI_R#2 "Cam accumulation speed (1000 times)" ULONG COMP_0148_S 1 100 0 4294967295000 ECU_ADDRESS 0xFFFFAF10 /begin FUNCTION_LIST /end FUNCTION_LIST /end MEASUREMENT
/begin MEASUREMENT vREVGZN "Speed for the GZTP renewal" UBYTE COMP_0071 1 100 0 255 ECU_ADDRESS 0xFFFF8A71 /begin FUNCTION_LIST /end FUNCTION_LIST /end MEASUREMENT
/begin MEASUREMENT vREVSMX2 "Purge valve open-degree limitation rate" UWORD COMP_0456 1 100 0 1.999970916 ECU_ADDRESS 0xFFFF1744 /begin FUNCTION_LIST /end FUNCTION_LIST /end MEASUREMENT
/begin MEASUREMENT vRF110PS "REF110 position" UWORD COMP_0004 1 100 0 65535 ECU_ADDRESS 0xFFFF2208 /begin FUNCTION_LIST /end FUNCTION_LIST /end MEASUREMENT
/begin MEASUREMENT vRF110PSZ "REF110 position (previous value)" UWORD COMP_0004 1 100 0 65535 ECU_ADDRESS 0xFFFF220A /begin FUNCTION_LIST /end FUNCTION_LIST /end MEASUREMENT
/begin MEASUREMENT vRFBSTf "RFBRO2 operation beginning" UBYTE COMP_0004 1 100 0 255 ECU_ADDRESS 0xFFFF312E /begin FUNCTION_LIST /end FUNCTION_LIST /end MEASUREMENT
/begin MEASUREMENT vRFCNTAL "A REF counter (all half-cylinders cut cylinder recover) for the KGZ1 addition" UBYTE COMP_0068 1 100 0 255 ECU_ADDRESS 0xFFFF220C /begin FUNCTION_LIST /end FUNCTION_LIST /end MEASUREMENT
/begin MEASUREMENT vRFCNTHF "A REF counter (all the cylinder cut half-cylinder recovers) for the KGZ1 addition" UBYTE COMP_0068 1 100 0 255 ECU_ADDRESS 0xFFFF220D /begin FUNCTION_LIST /end FUNCTION_LIST /end MEASUREMENT
/begin MEASUREMENT vRFMXNEI "At the time of the response time maximum value, engine speed (advance side)" UBYTE COMP_0020 1 100 0 12750 ECU_ADDRESS 0xFFFFAF14 /begin FUNCTION_LIST /end FUNCTION_LIST /end MEASUREMENT
/begin MEASUREMENT vRFMXNEI_R#1 "At the time of the response time maximum value, engine speed (advance side)" UBYTE COMP_0020 1 100 0 12750 ECU_ADDRESS 0xFFFFAF14 /begin FUNCTION_LIST /end FUNCTION_LIST /end MEASUREMENT
/begin MEASUREMENT vRFMXNEI_R#2 "At the time of the response time maximum value, engine speed (advance side)" UBYTE COMP_0020 1 100 0 12750 ECU_ADDRESS 0xFFFFAF15 /begin FUNCTION_LIST /end FUNCTION_LIST /end MEASUREMENT
/begin MEASUREMENT vRFMXOLI "At the time of the response time maximum value, oil temperature (advance side)" UBYTE COMP_0035 1 100 -50 205 ECU_ADDRESS 0xFFFFAF16 /begin FUNCTION_LIST /end FUNCTION_LIST /end MEASUREMENT
/begin MEASUREMENT vRFMXOLI_R#1 "At the time of the response time maximum value, oil temperature (advance side)" UBYTE COMP_0035 1 100 -50 205 ECU_ADDRESS 0xFFFFAF16 /begin FUNCTION_LIST /end FUNCTION_LIST /end MEASUREMENT
/begin MEASUREMENT vRFMXOLI_R#2 "At the time of the response time maximum value, oil temperature (advance side)" UBYTE COMP_0035 1 100 -50 205 ECU_ADDRESS 0xFFFFAF17 /begin FUNCTION_LIST /end FUNCTION_LIST /end MEASUREMENT
/begin MEASUREMENT vRFNCHG "Condition variable" UBYTE COMP_0004 1 100 0 255 ECU_ADDRESS 0xFFFF1747 /begin FUNCTION_LIST /end FUNCTION_LIST /end MEASUREMENT
/begin MEASUREMENT vRFNSTS "Condition variable" UBYTE COMP_0004 1 100 0 255 ECU_ADDRESS 0xFFFF1749 /begin FUNCTION_LIST /end FUNCTION_LIST /end MEASUREMENT
/begin MEASUREMENT vRFNSW2 "Radiator fan switching control requirement value before following" UBYTE COMP_0004 1 100 0 255 ECU_ADDRESS 0xFFFF174B /begin FUNCTION_LIST /end FUNCTION_LIST /end MEASUREMENT
/begin MEASUREMENT vRFOEVPTf "A canister purge cut requirement by the 3rdO2 sensor diagnosis" UBYTE COMP_0004 1 100 0 255 ECU_ADDRESS 0xFFFF3134 /begin FUNCTION_LIST /end FUNCTION_LIST /end MEASUREMENT
/begin MEASUREMENT vRFOEVPf "A canister purge cut requirement by the rest O2 sensor diagnosis" UBYTE COMP_0004 1 100 0 255 ECU_ADDRESS 0xFFFF3133 /begin FUNCTION_LIST /end FUNCTION_LIST /end MEASUREMENT
/begin MEASUREMENT vRGPHCT "TINT reset number of times" UBYTE COMP_0016 1 100 0 255 ECU_ADDRESS 0xFFFF407E /begin FUNCTION_LIST /end FUNCTION_LIST /end MEASUREMENT
/begin MEASUREMENT vRHBCNT1 "Rear O2 sensor parameter store counter (bank1)" UBYTE COMP_0016 1 100 0 255 ECU_ADDRESS 0xFFFFAF2E /begin FUNCTION_LIST /end FUNCTION_LIST /end MEASUREMENT
/begin MEASUREMENT vRHBCNT2 "Rear O2 sensor parameter store counter (bank2)" UBYTE COMP_0016 1 100 0 255 ECU_ADDRESS 0xFFFFAF2F /begin FUNCTION_LIST /end FUNCTION_LIST /end MEASUREMENT
/begin MEASUREMENT vRICHf "REF timing rich lean condition" UBYTE COMP_0004 1 100 0 255 ECU_ADDRESS 0xFFFF220E /begin FUNCTION_LIST /end FUNCTION_LIST /end MEASUREMENT
/begin MEASUREMENT vRJUDGEf "AFSHOS renewal permission flag" UBYTE COMP_0004 1 100 0 255 ECU_ADDRESS 0xFFFF313E /begin FUNCTION_LIST /end FUNCTION_LIST /end MEASUREMENT
/begin MEASUREMENT vRJUONEf "A/F sensor learning renewal flag" UBYTE COMP_0004 1 100 0 255 ECU_ADDRESS 0xFFFF313F /begin FUNCTION_LIST /end FUNCTION_LIST /end MEASUREMENT
/begin MEASUREMENT vRJUONHf "HOSCMAX learning renewal flag (rich)" UBYTE COMP_0004 1 100 0 255 ECU_ADDRESS 0xFFFF3140 /begin FUNCTION_LIST /end FUNCTION_LIST /end MEASUREMENT
/begin MEASUREMENT vRLDNGZf "Rich lean diagnosis NG flag previous value" UBYTE COMP_0004 1 100 0 255 ECU_ADDRESS 0xFFFF3146 /begin FUNCTION_LIST /end FUNCTION_LIST /end MEASUREMENT
/begin MEASUREMENT vRLDOKZf "Rich lean diagnosis OK flag previous value" UBYTE COMP_0004 1 100 0 255 ECU_ADDRESS 0xFFFF3147 /begin FUNCTION_LIST /end FUNCTION_LIST /end MEASUREMENT
/begin MEASUREMENT vRLFO2f "It changed from the lean to the rich." UBYTE COMP_0004 1 100 0 255 ECU_ADDRESS 0xFFFF3150 /begin FUNCTION_LIST /end FUNCTION_LIST /end MEASUREMENT
/begin MEASUREMENT vRLIDPRCS "RDBLID service EEPROM reading status" UBYTE COMP_0004 1 100 0 255 ECU_ADDRESS 0xFFFF3E55 /begin FUNCTION_LIST /end FUNCTION_LIST /end MEASUREMENT
/begin MEASUREMENT vRLNOKTf "An unusual voltage diagnosis (minimum value) OK completion distinction" UBYTE COMP_0004 1 100 0 255 ECU_ADDRESS 0xFFFF3155 /begin FUNCTION_LIST /end FUNCTION_LIST /end MEASUREMENT
/begin MEASUREMENT vRLNOKf "An unusual voltage diagnosis (minimum value) OK completion distinction" UBYTE COMP_0004 1 100 0 255 ECU_ADDRESS 0xFFFF3154 /begin FUNCTION_LIST /end FUNCTION_LIST /end MEASUREMENT
/begin MEASUREMENT vRLOCIDM "RLOCID memory" UBYTE COMP_0004 1 100 0 255 ECU_ADDRESS 0xFFFF3E56 /begin FUNCTION_LIST /end FUNCTION_LIST /end MEASUREMENT
/begin MEASUREMENT vRM "ECU Reset mode" UBYTE COMP_0004 1 100 0 255 ECU_ADDRESS 0xFFFF3E57 /begin FUNCTION_LIST /end FUNCTION_LIST /end MEASUREMENT
/begin MEASUREMENT vRMBAADDR "RMBA service EEPROM reading address" UWORD COMP_0004 1 100 0 65535 ECU_ADDRESS 0xFFFF3E58 /begin FUNCTION_LIST /end FUNCTION_LIST /end MEASUREMENT
/begin MEASUREMENT vRMBAARRY "RMBA service EEPROM reading data storage arrangement" UBYTE COMP_0004 1 100 0 255 ECU_ADDRESS 0xFFFF3E5A /begin FUNCTION_LIST /end FUNCTION_LIST /end MEASUREMENT
/begin MEASUREMENT vRMBAARRY_R#1 "RMBA service EEPROM reading data storage arrangement" UBYTE COMP_0004 1 100 0 255 ECU_ADDRESS 0xFFFF3E5A /begin FUNCTION_LIST /end FUNCTION_LIST /end MEASUREMENT
/begin MEASUREMENT vRMBAARRY_R#2 "RMBA service EEPROM reading data storage arrangement" UBYTE COMP_0004 1 100 0 255 ECU_ADDRESS 0xFFFF3E5B /begin FUNCTION_LIST /end FUNCTION_LIST /end MEASUREMENT
/begin MEASUREMENT vRMBAARRY_R#3 "RMBA service EEPROM reading data storage arrangement" UBYTE COMP_0004 1 100 0 255 ECU_ADDRESS 0xFFFF3E5C /begin FUNCTION_LIST /end FUNCTION_LIST /end MEASUREMENT
/begin MEASUREMENT vRMBAARRY_R#4 "RMBA service EEPROM reading data storage arrangement" UBYTE COMP_0004 1 100 0 255 ECU_ADDRESS 0xFFFF3E5D /begin FUNCTION_LIST /end FUNCTION_LIST /end MEASUREMENT
/begin MEASUREMENT vRMBAARRY_R#5 "RMBA service EEPROM reading data storage arrangement" UBYTE COMP_0004 1 100 0 255 ECU_ADDRESS 0xFFFF3E5E /begin FUNCTION_LIST /end FUNCTION_LIST /end MEASUREMENT
/begin MEASUREMENT vRMBAARRY_R#6 "RMBA service EEPROM reading data storage arrangement" UBYTE COMP_0004 1 100 0 255 ECU_ADDRESS 0xFFFF3E5F /begin FUNCTION_LIST /end FUNCTION_LIST /end MEASUREMENT
/begin MEASUREMENT vRMBAARRY_R#7 "RMBA service EEPROM reading data storage arrangement" UBYTE COMP_0004 1 100 0 255 ECU_ADDRESS 0xFFFF3E60 /begin FUNCTION_LIST /end FUNCTION_LIST /end MEASUREMENT
/begin MEASUREMENT vRMBAARRY_R#8 "RMBA service EEPROM reading data storage arrangement" UBYTE COMP_0004 1 100 0 255 ECU_ADDRESS 0xFFFF3E61 /begin FUNCTION_LIST /end FUNCTION_LIST /end MEASUREMENT
/begin MEASUREMENT vRMBAARRY_R#9 "RMBA service EEPROM reading data storage arrangement" UBYTE COMP_0004 1 100 0 255 ECU_ADDRESS 0xFFFF3E62 /begin FUNCTION_LIST /end FUNCTION_LIST /end MEASUREMENT
/begin MEASUREMENT vRMBAARRY_R#10 "RMBA service EEPROM reading data storage arrangement" UBYTE COMP_0004 1 100 0 255 ECU_ADDRESS 0xFFFF3E63 /begin FUNCTION_LIST /end FUNCTION_LIST /end MEASUREMENT
/begin MEASUREMENT vRMBAARRY_R#11 "RMBA service EEPROM reading data storage arrangement" UBYTE COMP_0004 1 100 0 255 ECU_ADDRESS 0xFFFF3E64 /begin FUNCTION_LIST /end FUNCTION_LIST /end MEASUREMENT
/begin MEASUREMENT vRMBAARRY_R#12 "RMBA service EEPROM reading data storage arrangement" UBYTE COMP_0004 1 100 0 255 ECU_ADDRESS 0xFFFF3E65 /begin FUNCTION_LIST /end FUNCTION_LIST /end MEASUREMENT
/begin MEASUREMENT vRMBAARRY_R#13 "RMBA service EEPROM reading data storage arrangement" UBYTE COMP_0004 1 100 0 255 ECU_ADDRESS 0xFFFF3E66 /begin FUNCTION_LIST /end FUNCTION_LIST /end MEASUREMENT
/begin MEASUREMENT vRMBAARRY_R#14 "RMBA service EEPROM reading data storage arrangement" UBYTE COMP_0004 1 100 0 255 ECU_ADDRESS 0xFFFF3E67 /begin FUNCTION_LIST /end FUNCTION_LIST /end MEASUREMENT
/begin MEASUREMENT vRMBAARRY_R#15 "RMBA service EEPROM reading data storage arrangement" UBYTE COMP_0004 1 100 0 255 ECU_ADDRESS 0xFFFF3E68 /begin FUNCTION_LIST /end FUNCTION_LIST /end MEASUREMENT
/begin MEASUREMENT vRMBAARRY_R#16 "RMBA service EEPROM reading data storage arrangement" UBYTE COMP_0004 1 100 0 255 ECU_ADDRESS 0xFFFF3E69 /begin FUNCTION_LIST /end FUNCTION_LIST /end MEASUREMENT
/begin MEASUREMENT vRMBAARRY_R#17 "RMBA service EEPROM reading data storage arrangement" UBYTE COMP_0004 1 100 0 255 ECU_ADDRESS 0xFFFF3E6A /begin FUNCTION_LIST /end FUNCTION_LIST /end MEASUREMENT
/begin MEASUREMENT vRMBAARRY_R#18 "RMBA service EEPROM reading data storage arrangement" UBYTE COMP_0004 1 100 0 255 ECU_ADDRESS 0xFFFF3E6B /begin FUNCTION_LIST /end FUNCTION_LIST /end MEASUREMENT
/begin MEASUREMENT vRMBAARRY_R#19 "RMBA service EEPROM reading data storage arrangement" UBYTE COMP_0004 1 100 0 255 ECU_ADDRESS 0xFFFF3E6C /begin FUNCTION_LIST /end FUNCTION_LIST /end MEASUREMENT
/begin MEASUREMENT vRMBAARRY_R#20 "RMBA service EEPROM reading data storage arrangement" UBYTE COMP_0004 1 100 0 255 ECU_ADDRESS 0xFFFF3E6D /begin FUNCTION_LIST /end FUNCTION_LIST /end MEASUREMENT
/begin MEASUREMENT vRMBAARRY_R#21 "RMBA service EEPROM reading data storage arrangement" UBYTE COMP_0004 1 100 0 255 ECU_ADDRESS 0xFFFF3E6E /begin FUNCTION_LIST /end FUNCTION_LIST /end MEASUREMENT
/begin MEASUREMENT vRMBAARRY_R#22 "RMBA service EEPROM reading data storage arrangement" UBYTE COMP_0004 1 100 0 255 ECU_ADDRESS 0xFFFF3E6F /begin FUNCTION_LIST /end FUNCTION_LIST /end MEASUREMENT
/begin MEASUREMENT vRMBAARRY_R#23 "RMBA service EEPROM reading data storage arrangement" UBYTE COMP_0004 1 100 0 255 ECU_ADDRESS 0xFFFF3E70 /begin FUNCTION_LIST /end FUNCTION_LIST /end MEASUREMENT
/begin MEASUREMENT vRMBAARRY_R#24 "RMBA service EEPROM reading data storage arrangement" UBYTE COMP_0004 1 100 0 255 ECU_ADDRESS 0xFFFF3E71 /begin FUNCTION_LIST /end FUNCTION_LIST /end MEASUREMENT
/begin MEASUREMENT vRMBAARRY_R#25 "RMBA service EEPROM reading data storage arrangement" UBYTE COMP_0004 1 100 0 255 ECU_ADDRESS 0xFFFF3E72 /begin FUNCTION_LIST /end FUNCTION_LIST /end MEASUREMENT
/begin MEASUREMENT vRMBAARRY_R#26 "RMBA service EEPROM reading data storage arrangement" UBYTE COMP_0004 1 100 0 255 ECU_ADDRESS 0xFFFF3E73 /begin FUNCTION_LIST /end FUNCTION_LIST /end MEASUREMENT
/begin MEASUREMENT vRMBAARRY_R#27 "RMBA service EEPROM reading data storage arrangement" UBYTE COMP_0004 1 100 0 255 ECU_ADDRESS 0xFFFF3E74 /begin FUNCTION_LIST /end FUNCTION_LIST /end MEASUREMENT
/begin MEASUREMENT vRMBAARRY_R#28 "RMBA service EEPROM reading data storage arrangement" UBYTE COMP_0004 1 100 0 255 ECU_ADDRESS 0xFFFF3E75 /begin FUNCTION_LIST /end FUNCTION_LIST /end MEASUREMENT
/begin MEASUREMENT vRMBAARRY_R#29 "RMBA service EEPROM reading data storage arrangement" UBYTE COMP_0004 1 100 0 255 ECU_ADDRESS 0xFFFF3E76 /begin FUNCTION_LIST /end FUNCTION_LIST /end MEASUREMENT
/begin MEASUREMENT vRMBAARRY_R#30 "RMBA service EEPROM reading data storage arrangement" UBYTE COMP_0004 1 100 0 255 ECU_ADDRESS 0xFFFF3E77 /begin FUNCTION_LIST /end FUNCTION_LIST /end MEASUREMENT
/begin MEASUREMENT vRMBAARRY_R#31 "RMBA service EEPROM reading data storage arrangement" UBYTE COMP_0004 1 100 0 255 ECU_ADDRESS 0xFFFF3E78 /begin FUNCTION_LIST /end FUNCTION_LIST /end MEASUREMENT
/begin MEASUREMENT vRMBAARRY_R#32 "RMBA service EEPROM reading data storage arrangement" UBYTE COMP_0004 1 100 0 255 ECU_ADDRESS 0xFFFF3E79 /begin FUNCTION_LIST /end FUNCTION_LIST /end MEASUREMENT
/begin MEASUREMENT vRMBAARRY_R#33 "RMBA service EEPROM reading data storage arrangement" UBYTE COMP_0004 1 100 0 255 ECU_ADDRESS 0xFFFF3E7A /begin FUNCTION_LIST /end FUNCTION_LIST /end MEASUREMENT
/begin MEASUREMENT vRMBAARRY_R#34 "RMBA service EEPROM reading data storage arrangement" UBYTE COMP_0004 1 100 0 255 ECU_ADDRESS 0xFFFF3E7B /begin FUNCTION_LIST /end FUNCTION_LIST /end MEASUREMENT
/begin MEASUREMENT vRMBAARRY_R#35 "RMBA service EEPROM reading data storage arrangement" UBYTE COMP_0004 1 100 0 255 ECU_ADDRESS 0xFFFF3E7C /begin FUNCTION_LIST /end FUNCTION_LIST /end MEASUREMENT
/begin MEASUREMENT vRMBAARRY_R#36 "RMBA service EEPROM reading data storage arrangement" UBYTE COMP_0004 1 100 0 255 ECU_ADDRESS 0xFFFF3E7D /begin FUNCTION_LIST /end FUNCTION_LIST /end MEASUREMENT
/begin MEASUREMENT vRMBAARRY_R#37 "RMBA service EEPROM reading data storage arrangement" UBYTE COMP_0004 1 100 0 255 ECU_ADDRESS 0xFFFF3E7E /begin FUNCTION_LIST /end FUNCTION_LIST /end MEASUREMENT
/begin MEASUREMENT vRMBAARRY_R#38 "RMBA service EEPROM reading data storage arrangement" UBYTE COMP_0004 1 100 0 255 ECU_ADDRESS 0xFFFF3E7F /begin FUNCTION_LIST /end FUNCTION_LIST /end MEASUREMENT
/begin MEASUREMENT vRMBAARRY_R#39 "RMBA service EEPROM reading data storage arrangement" UBYTE COMP_0004 1 100 0 255 ECU_ADDRESS 0xFFFF3E80 /begin FUNCTION_LIST /end FUNCTION_LIST /end MEASUREMENT
/begin MEASUREMENT vRMBAARRY_R#40 "RMBA service EEPROM reading data storage arrangement" UBYTE COMP_0004 1 100 0 255 ECU_ADDRESS 0xFFFF3E81 /begin FUNCTION_LIST /end FUNCTION_LIST /end MEASUREMENT
/begin MEASUREMENT vRMBAARRY_R#41 "RMBA service EEPROM reading data storage arrangement" UBYTE COMP_0004 1 100 0 255 ECU_ADDRESS 0xFFFF3E82 /begin FUNCTION_LIST /end FUNCTION_LIST /end MEASUREMENT
/begin MEASUREMENT vRMBAARRY_R#42 "RMBA service EEPROM reading data storage arrangement" UBYTE COMP_0004 1 100 0 255 ECU_ADDRESS 0xFFFF3E83 /begin FUNCTION_LIST /end FUNCTION_LIST /end MEASUREMENT
/begin MEASUREMENT vRMBAARRY_R#43 "RMBA service EEPROM reading data storage arrangement" UBYTE COMP_0004 1 100 0 255 ECU_ADDRESS 0xFFFF3E84 /begin FUNCTION_LIST /end FUNCTION_LIST /end MEASUREMENT
/begin MEASUREMENT vRMBAARRY_R#44 "RMBA service EEPROM reading data storage arrangement" UBYTE COMP_0004 1 100 0 255 ECU_ADDRESS 0xFFFF3E85 /begin FUNCTION_LIST /end FUNCTION_LIST /end MEASUREMENT
/begin MEASUREMENT vRMBAARRY_R#45 "RMBA service EEPROM reading data storage arrangement" UBYTE COMP_0004 1 100 0 255 ECU_ADDRESS 0xFFFF3E86 /begin FUNCTION_LIST /end FUNCTION_LIST /end MEASUREMENT
/begin MEASUREMENT vRMBAARRY_R#46 "RMBA service EEPROM reading data storage arrangement" UBYTE COMP_0004 1 100 0 255 ECU_ADDRESS 0xFFFF3E87 /begin FUNCTION_LIST /end FUNCTION_LIST /end MEASUREMENT
/begin MEASUREMENT vRMBAARRY_R#47 "RMBA service EEPROM reading data storage arrangement" UBYTE COMP_0004 1 100 0 255 ECU_ADDRESS 0xFFFF3E88 /begin FUNCTION_LIST /end FUNCTION_LIST /end MEASUREMENT
/begin MEASUREMENT vRMBAARRY_R#48 "RMBA service EEPROM reading data storage arrangement" UBYTE COMP_0004 1 100 0 255 ECU_ADDRESS 0xFFFF3E89 /begin FUNCTION_LIST /end FUNCTION_LIST /end MEASUREMENT
/begin MEASUREMENT vRMBAARRY_R#49 "RMBA service EEPROM reading data storage arrangement" UBYTE COMP_0004 1 100 0 255 ECU_ADDRESS 0xFFFF3E8A /begin FUNCTION_LIST /end FUNCTION_LIST /end MEASUREMENT
/begin MEASUREMENT vRMBAARRY_R#50 "RMBA service EEPROM reading data storage arrangement" UBYTE COMP_0004 1 100 0 255 ECU_ADDRESS 0xFFFF3E8B /begin FUNCTION_LIST /end FUNCTION_LIST /end MEASUREMENT
/begin MEASUREMENT vRMBAARRY_R#51 "RMBA service EEPROM reading data storage arrangement" UBYTE COMP_0004 1 100 0 255 ECU_ADDRESS 0xFFFF3E8C /begin FUNCTION_LIST /end FUNCTION_LIST /end MEASUREMENT
/begin MEASUREMENT vRMBAARRY_R#52 "RMBA service EEPROM reading data storage arrangement" UBYTE COMP_0004 1 100 0 255 ECU_ADDRESS 0xFFFF3E8D /begin FUNCTION_LIST /end FUNCTION_LIST /end MEASUREMENT
/begin MEASUREMENT vRMBAARRY_R#53 "RMBA service EEPROM reading data storage arrangement" UBYTE COMP_0004 1 100 0 255 ECU_ADDRESS 0xFFFF3E8E /begin FUNCTION_LIST /end FUNCTION_LIST /end MEASUREMENT
/begin MEASUREMENT vRMBAARRY_R#54 "RMBA service EEPROM reading data storage arrangement" UBYTE COMP_0004 1 100 0 255 ECU_ADDRESS 0xFFFF3E8F /begin FUNCTION_LIST /end FUNCTION_LIST /end MEASUREMENT
/begin MEASUREMENT vRMBAARRY_R#55 "RMBA service EEPROM reading data storage arrangement" UBYTE COMP_0004 1 100 0 255 ECU_ADDRESS 0xFFFF3E90 /begin FUNCTION_LIST /end FUNCTION_LIST /end MEASUREMENT
/begin MEASUREMENT vRMBAARRY_R#56 "RMBA service EEPROM reading data storage arrangement" UBYTE COMP_0004 1 100 0 255 ECU_ADDRESS 0xFFFF3E91 /begin FUNCTION_LIST /end FUNCTION_LIST /end MEASUREMENT
/begin MEASUREMENT vRMBAARRY_R#57 "RMBA service EEPROM reading data storage arrangement" UBYTE COMP_0004 1 100 0 255 ECU_ADDRESS 0xFFFF3E92 /begin FUNCTION_LIST /end FUNCTION_LIST /end MEASUREMENT
/begin MEASUREMENT vRMBAARRY_R#58 "RMBA service EEPROM reading data storage arrangement" UBYTE COMP_0004 1 100 0 255 ECU_ADDRESS 0xFFFF3E93 /begin FUNCTION_LIST /end FUNCTION_LIST /end MEASUREMENT
/begin MEASUREMENT vRMBAARRY_R#59 "RMBA service EEPROM reading data storage arrangement" UBYTE COMP_0004 1 100 0 255 ECU_ADDRESS 0xFFFF3E94 /begin FUNCTION_LIST /end FUNCTION_LIST /end MEASUREMENT
/begin MEASUREMENT vRMBAARRY_R#60 "RMBA service EEPROM reading data storage arrangement" UBYTE COMP_0004 1 100 0 255 ECU_ADDRESS 0xFFFF3E95 /begin FUNCTION_LIST /end FUNCTION_LIST /end MEASUREMENT
/begin MEASUREMENT vRMBAARRY_R#61 "RMBA service EEPROM reading data storage arrangement" UBYTE COMP_0004 1 100 0 255 ECU_ADDRESS 0xFFFF3E96 /begin FUNCTION_LIST /end FUNCTION_LIST /end MEASUREMENT
/begin MEASUREMENT vRMBAARRY_R#62 "RMBA service EEPROM reading data storage arrangement" UBYTE COMP_0004 1 100 0 255 ECU_ADDRESS 0xFFFF3E97 /begin FUNCTION_LIST /end FUNCTION_LIST /end MEASUREMENT
/begin MEASUREMENT vRMBAARRY_R#63 "RMBA service EEPROM reading data storage arrangement" UBYTE COMP_0004 1 100 0 255 ECU_ADDRESS 0xFFFF3E98 /begin FUNCTION_LIST /end FUNCTION_LIST /end MEASUREMENT
/begin MEASUREMENT vRMBACNT "RMBA service EEPROM reading data number counter" UWORD COMP_0004 1 100 0 65535 ECU_ADDRESS 0xFFFF3E9A /begin FUNCTION_LIST /end FUNCTION_LIST /end MEASUREMENT
/begin MEASUREMENT vRMBAKEY "RMBA service EEPROM reading data storage arrangement ìY letter" UWORD COMP_0004 1 100 0 65535 ECU_ADDRESS 0xFFFF3E9C /begin FUNCTION_LIST /end FUNCTION_LIST /end MEASUREMENT
/begin MEASUREMENT vRMBAPRCS "RMBA service EEPROM reading status" UBYTE COMP_0004 1 100 0 255 ECU_ADDRESS 0xFFFF3E9E /begin FUNCTION_LIST /end FUNCTION_LIST /end MEASUREMENT
/begin MEASUREMENT vRNDSD "Imombilizer random value count" UWORD COMP_0068 1 100 0 65535 ECU_ADDRESS 0xFFFF3EA0 /begin FUNCTION_LIST /end FUNCTION_LIST /end MEASUREMENT
/begin MEASUREMENT vRO2DCNTED "RAM value vRO2DCNTED" UBYTE COMP_0004 1 100 0 255 ECU_ADDRESS 0xFFFF3165 /begin FUNCTION_LIST /end FUNCTION_LIST /end MEASUREMENT
/begin MEASUREMENT vRO2DOSOKf "A DOS condition flag for the RrO2/S diagnosis" UBYTE COMP_0004 1 100 0 255 ECU_ADDRESS 0xFFFF1760 /begin FUNCTION_LIST /end FUNCTION_LIST /end MEASUREMENT
/begin MEASUREMENT vRO2DTCLf "The rest O2/S parameter clear requirement distinction" UBYTE COMP_0004 1 100 0 255 ECU_ADDRESS 0xFFFF3166 /begin FUNCTION_LIST /end FUNCTION_LIST /end MEASUREMENT
/begin MEASUREMENT vRO2DYMX2f "Rear O2 sensor duty upper limit value 2 output flag" UBYTE COMP_0004 1 100 0 255 ECU_ADDRESS 0xFFFF1761 /begin FUNCTION_LIST /end FUNCTION_LIST /end MEASUREMENT
/begin MEASUREMENT vRO2FBALPf "Diagnosis completion judgement flag" UBYTE COMP_0004 1 100 0 255 ECU_ADDRESS 0xFFFF3167 /begin FUNCTION_LIST /end FUNCTION_LIST /end MEASUREMENT
/begin MEASUREMENT vRO2FBALZf "Diagnosis completion judgement flag (previous value)" UBYTE COMP_0004 1 100 0 255 ECU_ADDRESS 0xFFFF3168 /begin FUNCTION_LIST /end FUNCTION_LIST /end MEASUREMENT
/begin MEASUREMENT vRO2FBCLPf "The inside of the rest O2F/B" UBYTE COMP_0004 1 100 0 255 ECU_ADDRESS 0xFFFF26E7 /begin FUNCTION_LIST /end FUNCTION_LIST /end MEASUREMENT
/begin MEASUREMENT vRO2FBRALP "RAM value vRO2FBRALP" UBYTE COMP_0004 1 100 0 255 ECU_ADDRESS 0xFFFF316A /begin FUNCTION_LIST /end FUNCTION_LIST /end MEASUREMENT
/begin MEASUREMENT vRO2FBRALZ "RAM value vRO2FBRALZ" UBYTE COMP_0004 1 100 0 255 ECU_ADDRESS 0xFFFF316B /begin FUNCTION_LIST /end FUNCTION_LIST /end MEASUREMENT
/begin MEASUREMENT vRO2FBRTAL "RAM value vRO2FBRTAL" UBYTE COMP_0004 1 100 0 255 ECU_ADDRESS 0xFFFF316D /begin FUNCTION_LIST /end FUNCTION_LIST /end MEASUREMENT
/begin MEASUREMENT vRO2FBRTAL_1 "RAM value vRO2FBRTAL" UBYTE COMP_0004 1 100 0 255 ECU_ADDRESS 0xFFFF316E /begin FUNCTION_LIST /end FUNCTION_LIST /end MEASUREMENT
/begin MEASUREMENT vRO2FBRTf "3rdO2/S diagnosis 3rdO2/S F/B control requirement judgement" UBYTE COMP_0004 1 100 0 255 ECU_ADDRESS 0xFFFF316F /begin FUNCTION_LIST /end FUNCTION_LIST /end MEASUREMENT
/begin MEASUREMENT vRO2FBRf "RrO2/S diagnosis RrO2/S F/B control requirement judgement" UBYTE COMP_0004 1 100 0 255 ECU_ADDRESS 0xFFFF316C /begin FUNCTION_LIST /end FUNCTION_LIST /end MEASUREMENT
/begin MEASUREMENT vRO2FBf "The rest O2 sensor" UBYTE COMP_0004 1 100 0 255 ECU_ADDRESS 0xFFFF3169 /begin FUNCTION_LIST /end FUNCTION_LIST /end MEASUREMENT
/begin MEASUREMENT vRO2HDCNT "100mS counter for the rear O2 sensor heater duty operation" UBYTE COMP_0030 1 100 0 255 ECU_ADDRESS 0xFFFF1762 /begin FUNCTION_LIST /end FUNCTION_LIST /end MEASUREMENT
/begin MEASUREMENT vRO2HDONf "Rear O2 heater duty output flag" UBYTE COMP_0004 1 100 0 255 ECU_ADDRESS 0xFFFF2400 /begin FUNCTION_LIST /end FUNCTION_LIST /end MEASUREMENT
/begin MEASUREMENT vRO2HMf "The rest O2 heater CPU input signal" UBYTE COMP_0004 1 100 0 255 ECU_ADDRESS 0xFFFF89C6 /begin FUNCTION_LIST /end FUNCTION_LIST /end MEASUREMENT
/begin MEASUREMENT vRO2HOKf "Rear O2 heater breakage judgement flag" UBYTE COMP_0004 1 100 0 255 ECU_ADDRESS 0xFFFF1764 /begin FUNCTION_LIST /end FUNCTION_LIST /end MEASUREMENT
/begin MEASUREMENT vRO2HON1f "The rest O2 heater first on judgement" UBYTE COMP_0004 1 100 0 255 ECU_ADDRESS 0xFFFF3EA2 /begin FUNCTION_LIST /end FUNCTION_LIST /end MEASUREMENT
/begin MEASUREMENT vRO2HONf "Rest O2 heater ON/ off" UBYTE COMP_0004 1 100 0 255 ECU_ADDRESS 0xFFFF2406 /begin FUNCTION_LIST /end FUNCTION_LIST /end MEASUREMENT
/begin MEASUREMENT vRO2HPREND "RAM value vRO2HPREND" UBYTE COMP_0004 1 100 0 255 ECU_ADDRESS 0xFFFF1765 /begin FUNCTION_LIST /end FUNCTION_LIST /end MEASUREMENT
/begin MEASUREMENT vRO2INTf "Rr.O2/S initialization judgement flag" UBYTE COMP_0004 1 100 0 255 ECU_ADDRESS 0xFFFF1766 /begin FUNCTION_LIST /end FUNCTION_LIST /end MEASUREMENT
/begin MEASUREMENT vRO2MLOKf "The rest O2/S diagnosis OK completion distinction" UBYTE COMP_0004 1 100 0 255 ECU_ADDRESS 0xFFFF3170 /begin FUNCTION_LIST /end FUNCTION_LIST /end MEASUREMENT
/begin MEASUREMENT vRO2OK2f "The rest O2/S diagnosis OK completion distinction" UBYTE COMP_0004 1 100 0 255 ECU_ADDRESS 0xFFFFAFFC /begin FUNCTION_LIST /end FUNCTION_LIST /end MEASUREMENT
/begin MEASUREMENT vRO2PHSDf "A PHOS condition judgement with the RO2/S diagnosis delay" UBYTE COMP_0004 1 100 0 255 ECU_ADDRESS 0xFFFF3171 /begin FUNCTION_LIST /end FUNCTION_LIST /end MEASUREMENT
/begin MEASUREMENT vRO2PJUGf "RO2/S diagnosis stage 2 region condition judgement" UBYTE COMP_0004 1 100 0 255 ECU_ADDRESS 0xFFFF3172 /begin FUNCTION_LIST /end FUNCTION_LIST /end MEASUREMENT
/begin MEASUREMENT vRO2RCHOf "Rr.O2/S slice level judgement flag (before the last time, at the time of the O2 reversal)" UBYTE COMP_0004 1 100 0 255 ECU_ADDRESS 0xFFFF1767 /begin FUNCTION_LIST /end FUNCTION_LIST /end MEASUREMENT
/begin MEASUREMENT vRO2RCHf "Rr.O2/S slice level judgement flag" UBYTE COMP_0004 1 100 0 255 ECU_ADDRESS 0xFFFF1035 /begin FUNCTION_LIST /end FUNCTION_LIST /end MEASUREMENT
/begin MEASUREMENT vRO2RLf "The rest O2 rich lean judgement for the catalyst diagnosis" UBYTE COMP_0004 1 100 0 255 ECU_ADDRESS 0xFFFF26E8 /begin FUNCTION_LIST /end FUNCTION_LIST /end MEASUREMENT
/begin MEASUREMENT vRO2STG2Ef "RO2/S diagnosis stage 2 result judgement" UBYTE COMP_0004 1 100 0 255 ECU_ADDRESS 0xFFFF3173 /begin FUNCTION_LIST /end FUNCTION_LIST /end MEASUREMENT
/begin MEASUREMENT vRO2STG2Jf "RO2/S diagnosis stage 2NG treatment requirement judgement" UBYTE COMP_0004 1 100 0 255 ECU_ADDRESS 0xFFFF1769 /begin FUNCTION_LIST /end FUNCTION_LIST /end MEASUREMENT
/begin MEASUREMENT vRO2STG2Vf "RO2/S diagnosis imaginary stage 2 switchover condition judgement" UBYTE COMP_0004 1 100 0 255 ECU_ADDRESS 0xFFFF3174 /begin FUNCTION_LIST /end FUNCTION_LIST /end MEASUREMENT
/begin MEASUREMENT vRO2STG2f "RO2/S diagnosis stage 2 switchover condition judgement" UBYTE COMP_0004 1 100 0 255 ECU_ADDRESS 0xFFFF1768 /begin FUNCTION_LIST /end FUNCTION_LIST /end MEASUREMENT
/begin MEASUREMENT vROAVCNf "An unusual voltage 2 diagnosis TRIP completion distinction" UBYTE COMP_0004 1 100 0 255 ECU_ADDRESS 0xFFFF3175 /begin FUNCTION_LIST /end FUNCTION_LIST /end MEASUREMENT
/begin MEASUREMENT vROAVNG1f "An unusual voltage 2 diagnosis NG 1TRIP completion distinction" UBYTE COMP_0004 1 100 0 255 ECU_ADDRESS 0xFFFFAFFD /begin FUNCTION_LIST /end FUNCTION_LIST /end MEASUREMENT
/begin MEASUREMENT vROAVNG2f "An unusual voltage 2 diagnosis NG 2TRIP completion distinction" UBYTE COMP_0004 1 100 0 255 ECU_ADDRESS 0xFFFFAFFE /begin FUNCTION_LIST /end FUNCTION_LIST /end MEASUREMENT
/begin MEASUREMENT vROHCANf "The completion distinction that the rest O2/S diagnosis is unusual" UBYTE COMP_0004 1 100 0 255 ECU_ADDRESS 0xFFFF3176 /begin FUNCTION_LIST /end FUNCTION_LIST /end MEASUREMENT
/begin MEASUREMENT vROHMLOKf "The rest O2/S diagnosis normality completion distinction" UBYTE COMP_0004 1 100 0 255 ECU_ADDRESS 0xFFFF3177 /begin FUNCTION_LIST /end FUNCTION_LIST /end MEASUREMENT
/begin MEASUREMENT vROHNG1f "The completion 1TRIP distinction that the rest O2/S diagnosis is unusual" UBYTE COMP_0004 1 100 0 255 ECU_ADDRESS 0xFFFFB008 /begin FUNCTION_LIST /end FUNCTION_LIST /end MEASUREMENT
/begin MEASUREMENT vROHNG2f "The completion 2TRIP distinction that the rest O2/S diagnosis is unusual" UBYTE COMP_0004 1 100 0 255 ECU_ADDRESS 0xFFFFB009 /begin FUNCTION_LIST /end FUNCTION_LIST /end MEASUREMENT
/begin MEASUREMENT vROHOK2f "The rest O2/S diagnosis normality completion distinction" UBYTE COMP_0004 1 100 0 255 ECU_ADDRESS 0xFFFFB00A /begin FUNCTION_LIST /end FUNCTION_LIST /end MEASUREMENT
/begin MEASUREMENT vROHONTf "RO2H On condition" UBYTE COMP_0004 1 100 0 255 ECU_ADDRESS 0xFFFF3178 /begin FUNCTION_LIST /end FUNCTION_LIST /end MEASUREMENT
/begin MEASUREMENT vROJFCTf "A fuel cut time progress flag for the RrO2 sensor diagnosis permission condition" UBYTE COMP_0004 1 100 0 255 ECU_ADDRESS 0xFFFF317B /begin FUNCTION_LIST /end FUNCTION_LIST /end MEASUREMENT
/begin MEASUREMENT vROMNCNTf "An unusual voltage (minimum value) diagnosis TRIP completion distinction" UBYTE COMP_0004 1 100 0 255 ECU_ADDRESS 0xFFFF317D /begin FUNCTION_LIST /end FUNCTION_LIST /end MEASUREMENT
/begin MEASUREMENT vROMNCNf "An unusual voltage (minimum value) diagnosis TRIP completion distinction" UBYTE COMP_0004 1 100 0 255 ECU_ADDRESS 0xFFFF317C /begin FUNCTION_LIST /end FUNCTION_LIST /end MEASUREMENT
/begin MEASUREMENT vROMNNG1f "An unusual voltage (minimum value) diagnosis NG 1TRIP completion distinction" UBYTE COMP_0004 1 100 0 255 ECU_ADDRESS 0xFFFFB00B /begin FUNCTION_LIST /end FUNCTION_LIST /end MEASUREMENT
/begin MEASUREMENT vROMNNG2f "An unusual voltage (minimum value) diagnosis NG 2TRIP completion distinction" UBYTE COMP_0004 1 100 0 255 ECU_ADDRESS 0xFFFFB00C /begin FUNCTION_LIST /end FUNCTION_LIST /end MEASUREMENT
/begin MEASUREMENT vROMXCNTf "An unusual voltage (maximum value) diagnosis TRIP completion distinction" UBYTE COMP_0004 1 100 0 255 ECU_ADDRESS 0xFFFF317F /begin FUNCTION_LIST /end FUNCTION_LIST /end MEASUREMENT
/begin MEASUREMENT vROMXCNf "An unusual voltage (maximum value) diagnosis TRIP completion distinction" UBYTE COMP_0004 1 100 0 255 ECU_ADDRESS 0xFFFF317E /begin FUNCTION_LIST /end FUNCTION_LIST /end MEASUREMENT
/begin MEASUREMENT vROMXNG1f "An unusual voltage (maximum value) diagnosis NG 1TRIP completion distinction" UBYTE COMP_0004 1 100 0 255 ECU_ADDRESS 0xFFFFB00D /begin FUNCTION_LIST /end FUNCTION_LIST /end MEASUREMENT
/begin MEASUREMENT vROMXNG2f "An unusual voltage (maximum value) diagnosis NG 2TRIP completion distinction" UBYTE COMP_0004 1 100 0 255 ECU_ADDRESS 0xFFFFB00E /begin FUNCTION_LIST /end FUNCTION_LIST /end MEASUREMENT
/begin MEASUREMENT vRON1STf "Rr.O2/H_ON_ROHONT# progress" UBYTE COMP_0004 1 100 0 255 ECU_ADDRESS 0xFFFF3180 /begin FUNCTION_LIST /end FUNCTION_LIST /end MEASUREMENT
/begin MEASUREMENT vRORSCNTf "Response time diagnosis TRIP completion distinction" UBYTE COMP_0004 1 100 0 255 ECU_ADDRESS 0xFFFF3182 /begin FUNCTION_LIST /end FUNCTION_LIST /end MEASUREMENT
/begin MEASUREMENT vRORSCNf "Response time diagnosis TRIP completion distinction" UBYTE COMP_0004 1 100 0 255 ECU_ADDRESS 0xFFFF3181 /begin FUNCTION_LIST /end FUNCTION_LIST /end MEASUREMENT
/begin MEASUREMENT vRORSNG1f "Response time diagnosis NG 1TRIP completion distinction" UBYTE COMP_0004 1 100 0 255 ECU_ADDRESS 0xFFFFB00F /begin FUNCTION_LIST /end FUNCTION_LIST /end MEASUREMENT
/begin MEASUREMENT vRORSNG2f "Response time diagnosis NG 2TRIP completion distinction" UBYTE COMP_0004 1 100 0 255 ECU_ADDRESS 0xFFFFB010 /begin FUNCTION_LIST /end FUNCTION_LIST /end MEASUREMENT
/begin MEASUREMENT vRPIPER "Torque compensation quantity (the amount of fuel injection)" UBYTE COMP_0009 1 100 0 199.21875 ECU_ADDRESS 0xFFFF2230 /begin FUNCTION_LIST /end FUNCTION_LIST /end MEASUREMENT
/begin MEASUREMENT vRPISET "A TISET renewal judgement for the high response compensation control" UBYTE COMP_0068 1 100 0 255 ECU_ADDRESS 0xFFFF2231 /begin FUNCTION_LIST /end FUNCTION_LIST /end MEASUREMENT
/begin MEASUREMENT vRRCOKTf "An unusual voltage diagnosis (maximum value) OK completion distinction" UBYTE COMP_0004 1 100 0 255 ECU_ADDRESS 0xFFFF318C /begin FUNCTION_LIST /end FUNCTION_LIST /end MEASUREMENT
/begin MEASUREMENT vRRCOKf "An unusual voltage diagnosis (maximum value) OK completion distinction" UBYTE COMP_0004 1 100 0 255 ECU_ADDRESS 0xFFFF318B /begin FUNCTION_LIST /end FUNCTION_LIST /end MEASUREMENT
/begin MEASUREMENT vRRPSOKTf "Response time diagnosis OK completion distinction" UBYTE COMP_0004 1 100 0 255 ECU_ADDRESS 0xFFFF3195 /begin FUNCTION_LIST /end FUNCTION_LIST /end MEASUREMENT
/begin MEASUREMENT vRRPSOKf "Response time diagnosis OK completion distinction" UBYTE COMP_0004 1 100 0 255 ECU_ADDRESS 0xFFFF3194 /begin FUNCTION_LIST /end FUNCTION_LIST /end MEASUREMENT
/begin MEASUREMENT vRSEDRFf "After the rich spike control, I-gain control flag" UBYTE COMP_0004 1 100 0 255 ECU_ADDRESS 0xFFFF1771 /begin FUNCTION_LIST /end FUNCTION_LIST /end MEASUREMENT
/begin MEASUREMENT vRSIDLTM "After the lean operation, a tIDLTM previous value for the rich spike" UBYTE COMP_0008 1 100 0 25500 ECU_ADDRESS 0xFFFF1772 /begin FUNCTION_LIST /end FUNCTION_LIST /end MEASUREMENT
/begin MEASUREMENT vRSNOXf "Rich spike requirement judgement" UBYTE COMP_0004 1 100 0 255 ECU_ADDRESS 0xFFFF1773 /begin FUNCTION_LIST /end FUNCTION_LIST /end MEASUREMENT
/begin MEASUREMENT vRSNXNOWf "Rich spike control-in-progress judgement" UBYTE COMP_0004 1 100 0 255 ECU_ADDRESS 0xFFFF1036 /begin FUNCTION_LIST /end FUNCTION_LIST /end MEASUREMENT
/begin MEASUREMENT vRSPIKEIf "After the rich spike, I-gain IRICH region judgement" UBYTE COMP_0004 1 100 0 255 ECU_ADDRESS 0xFFFF1037 /begin FUNCTION_LIST /end FUNCTION_LIST /end MEASUREMENT
/begin MEASUREMENT vRSPIKEPf "Rich spike P-gain addition judgement" UBYTE COMP_0004 1 100 0 255 ECU_ADDRESS 0xFFFF1774 /begin FUNCTION_LIST /end FUNCTION_LIST /end MEASUREMENT
/begin MEASUREMENT vRSPKRPMf "Rich spike P-gain addition due to the high air quantity F/C éû speed decline" UBYTE COMP_0004 1 100 0 255 ECU_ADDRESS 0xFFFF1775 /begin FUNCTION_LIST /end FUNCTION_LIST /end MEASUREMENT
/begin MEASUREMENT vRST2ARAVf "The rest O2 sensor diagnosis imaginary stage 2 diagnosis region condition" UBYTE COMP_0004 1 100 0 255 ECU_ADDRESS 0xFFFF319B /begin FUNCTION_LIST /end FUNCTION_LIST /end MEASUREMENT
/begin MEASUREMENT vRST2ARAf "Stage 2 region condition" UBYTE COMP_0004 1 100 0 255 ECU_ADDRESS 0xFFFF319A /begin FUNCTION_LIST /end FUNCTION_LIST /end MEASUREMENT
/begin MEASUREMENT vRST2GOf "RrO2/S diagnosis RrO2/S F/B control requirement permission judgement" UBYTE COMP_0004 1 100 0 255 ECU_ADDRESS 0xFFFF319C /begin FUNCTION_LIST /end FUNCTION_LIST /end MEASUREMENT
/begin MEASUREMENT vRTCRRMX "Rotor current" UBYTE COMP_0622_S 1 100 0 12.036 ECU_ADDRESS 0xFFFF3EA3 /begin FUNCTION_LIST /end FUNCTION_LIST /end MEASUREMENT
/begin MEASUREMENT vRTEGR "Actual EGR rate estimated value (the compensated front)" UBYTE COMP_0141 1 100 0 49.8046875 ECU_ADDRESS 0xFFFF1776 /begin FUNCTION_LIST /end FUNCTION_LIST /end MEASUREMENT
/begin MEASUREMENT vRTPOS10 "POS10 signal period (There is no rate adjusting.)" UWORD COMP_0150_S 1 100 0 65535 ECU_ADDRESS 0xFFFF2232 /begin FUNCTION_LIST /end FUNCTION_LIST /end MEASUREMENT
/begin MEASUREMENT vRTQAFPRC "RequestedTorqueAfterProc" UBYTE COMP_0021_S 1 100 -100 410 ECU_ADDRESS 0xFFFF3EA4 /begin FUNCTION_LIST /end FUNCTION_LIST /end MEASUREMENT
/begin MEASUREMENT vRTREF10 "Crank angle 10deg period (There is no rate adjusting.)" UWORD COMP_0150_S 1 100 0 65535 ECU_ADDRESS 0xFFFF2234 /begin FUNCTION_LIST /end FUNCTION_LIST /end MEASUREMENT
/begin MEASUREMENT vRUNTIME "Engine operating time" UBYTE COMP_0013 1 100 0 255 ECU_ADDRESS 0xFFFF3EA5 /begin FUNCTION_LIST /end FUNCTION_LIST /end MEASUREMENT
/begin MEASUREMENT vRVRFAC "At the time of the reverse, pedal ratio gain" UWORD COMP_0614_S 1 100 0 199.996894995 ECU_ADDRESS 0xFFFF31B8 /begin FUNCTION_LIST /end FUNCTION_LIST /end MEASUREMENT
/begin MEASUREMENT vRVRFAC_S "At the time of the reverse, pedal ratio gain (vice-operation part)" UWORD COMP_0614_S 1 100 0 199.996894995 ECU_ADDRESS 0xFFFF3520 /begin FUNCTION_LIST /end FUNCTION_LIST /end MEASUREMENT
/begin MEASUREMENT vRXCANID "A label for the reception CANID judgement" UBYTE COMP_0068 1 100 0 255 ECU_ADDRESS 0xFFFF35C6 /begin FUNCTION_LIST /end FUNCTION_LIST /end MEASUREMENT
/begin MEASUREMENT vSAMN "SUMAMA minimum value region A" UBYTE COMP_0054 1 100 0 5100 ECU_ADDRESS 0xFFFFB011 /begin FUNCTION_LIST /end FUNCTION_LIST /end MEASUREMENT
/begin MEASUREMENT vSAMN_R#1 "SUMAMA minimum value region A" UBYTE COMP_0054 1 100 0 5100 ECU_ADDRESS 0xFFFFB011 /begin FUNCTION_LIST /end FUNCTION_LIST /end MEASUREMENT
/begin MEASUREMENT vSAMN_R#2 "SUMAMA minimum value region A" UBYTE COMP_0054 1 100 0 5100 ECU_ADDRESS 0xFFFFB012 /begin FUNCTION_LIST /end FUNCTION_LIST /end MEASUREMENT
/begin MEASUREMENT vSAMN_R#3 "SUMAMA minimum value region A" UBYTE COMP_0054 1 100 0 5100 ECU_ADDRESS 0xFFFFB013 /begin FUNCTION_LIST /end FUNCTION_LIST /end MEASUREMENT
/begin MEASUREMENT vSAMN_R#4 "SUMAMA minimum value region A" UBYTE COMP_0054 1 100 0 5100 ECU_ADDRESS 0xFFFFB014 /begin FUNCTION_LIST /end FUNCTION_LIST /end MEASUREMENT
/begin MEASUREMENT vSCHED10 "10mS counter" UBYTE COMP_0068 1 100 0 255 ECU_ADDRESS 0xFFFF3EA6 /begin FUNCTION_LIST /end FUNCTION_LIST /end MEASUREMENT
/begin MEASUREMENT vSCI1MAX "SCING1 counter MAX value" UBYTE COMP_0030 1 100 0 255 ECU_ADDRESS 0xFFFFB015 /begin FUNCTION_LIST /end FUNCTION_LIST /end MEASUREMENT
/begin MEASUREMENT vSCI2MAX "SCING2 counter MAX value" UBYTE COMP_0030 1 100 0 255 ECU_ADDRESS 0xFFFFB016 /begin FUNCTION_LIST /end FUNCTION_LIST /end MEASUREMENT
/begin MEASUREMENT vSCI3MAX "SCING3 counter MAX value" UBYTE COMP_0030 1 100 0 255 ECU_ADDRESS 0xFFFFB017 /begin FUNCTION_LIST /end FUNCTION_LIST /end MEASUREMENT
/begin MEASUREMENT vSCINGC1 "The first time NG count value" UBYTE COMP_0030 1 100 0 255 ECU_ADDRESS 0xFFFF3EA7 /begin FUNCTION_LIST /end FUNCTION_LIST /end MEASUREMENT
/begin MEASUREMENT vSCINGC2 "The second time NG count value" UBYTE COMP_0030 1 100 0 255 ECU_ADDRESS 0xFFFF3EA8 /begin FUNCTION_LIST /end FUNCTION_LIST /end MEASUREMENT
/begin MEASUREMENT vSCINGC3 "The third time NG count value" UBYTE COMP_0030 1 100 0 255 ECU_ADDRESS 0xFFFF3EA9 /begin FUNCTION_LIST /end FUNCTION_LIST /end MEASUREMENT
/begin MEASUREMENT vSDCRbuf "Control registor buffer" UWORD COMP_0004 1 100 0 65535 ECU_ADDRESS 0xFFFF3EAA /begin FUNCTION_LIST /end FUNCTION_LIST /end MEASUREMENT
/begin MEASUREMENT vSDPRES "DPRES integration value" UWORD COMP_0050 1 100 0 5119.921875 ECU_ADDRESS 0xFFFF31C6 /begin FUNCTION_LIST /end FUNCTION_LIST /end MEASUREMENT
/begin MEASUREMENT vSENDGM "Sensors diagnostic" UBYTE COMP_0283 1 100 0 255 ECU_ADDRESS 0xFFFF3EAC /begin FUNCTION_LIST /end FUNCTION_LIST /end MEASUREMENT
/begin MEASUREMENT vSEQINJ "After the sequential injection start, injection number of times" UBYTE COMP_0016 1 100 0 255 ECU_ADDRESS 0xFFFF2236 /begin FUNCTION_LIST /end FUNCTION_LIST /end MEASUREMENT
/begin MEASUREMENT vSFTVCTR "Gear shift pattern signal" UBYTE COMP_0068 1 100 0 255 ECU_ADDRESS 0xFFFF496D /begin FUNCTION_LIST /end FUNCTION_LIST /end MEASUREMENT
/begin MEASUREMENT vSIGMAE "Switching function" UBYTE COMP_0151_S 1 100 -1.28 1.27 ECU_ADDRESS 0xFFFF1784 /begin FUNCTION_LIST /end FUNCTION_LIST /end MEASUREMENT
/begin MEASUREMENT vSIGMAE_R#1 "Switching function" UBYTE COMP_0151_S 1 100 -1.28 1.27 ECU_ADDRESS 0xFFFF1784 /begin FUNCTION_LIST /end FUNCTION_LIST /end MEASUREMENT
/begin MEASUREMENT vSIGMAE_R#2 "Switching function" UBYTE COMP_0151_S 1 100 -1.28 1.27 ECU_ADDRESS 0xFFFF1785 /begin FUNCTION_LIST /end FUNCTION_LIST /end MEASUREMENT
/begin MEASUREMENT vSIGMAE3 "Switching function" ULONG COMP_0152_S 1 100 -21474.83648 21474.83647 ECU_ADDRESS 0xFFFF1788 /begin FUNCTION_LIST /end FUNCTION_LIST /end MEASUREMENT
/begin MEASUREMENT vSIGMAE3_R#1 "Switching function" ULONG COMP_0152_S 1 100 -21474.83648 21474.83647 ECU_ADDRESS 0xFFFF1788 /begin FUNCTION_LIST /end FUNCTION_LIST /end MEASUREMENT
/begin MEASUREMENT vSIGMAE3_R#2 "Switching function" ULONG COMP_0152_S 1 100 -21474.83648 21474.83647 ECU_ADDRESS 0xFFFF178C /begin FUNCTION_LIST /end FUNCTION_LIST /end MEASUREMENT
/begin MEASUREMENT vSIGMAI "Switching function" UBYTE COMP_0151_S 1 100 -1.28 1.27 ECU_ADDRESS 0xFFFF1790 /begin FUNCTION_LIST /end FUNCTION_LIST /end MEASUREMENT
/begin MEASUREMENT vSIGMAI_R#1 "Switching function" UBYTE COMP_0151_S 1 100 -1.28 1.27 ECU_ADDRESS 0xFFFF1790 /begin FUNCTION_LIST /end FUNCTION_LIST /end MEASUREMENT
/begin MEASUREMENT vSIGMAI_R#2 "Switching function" UBYTE COMP_0151_S 1 100 -1.28 1.27 ECU_ADDRESS 0xFFFF1791 /begin FUNCTION_LIST /end FUNCTION_LIST /end MEASUREMENT
/begin MEASUREMENT vSIGMAI3 "Switching function" ULONG COMP_0152_S 1 100 -21474.83648 21474.83647 ECU_ADDRESS 0xFFFF1794 /begin FUNCTION_LIST /end FUNCTION_LIST /end MEASUREMENT
/begin MEASUREMENT vSIGMAI3_R#1 "Switching function" ULONG COMP_0152_S 1 100 -21474.83648 21474.83647 ECU_ADDRESS 0xFFFF1794 /begin FUNCTION_LIST /end FUNCTION_LIST /end MEASUREMENT
/begin MEASUREMENT vSIGMAI3_R#2 "Switching function" ULONG COMP_0152_S 1 100 -21474.83648 21474.83647 ECU_ADDRESS 0xFFFF1798 /begin FUNCTION_LIST /end FUNCTION_LIST /end MEASUREMENT
/begin MEASUREMENT vSIGNATUR "signature" UWORD COMP_0068 1 100 0 65535 ECU_ADDRESS 0xFFFF3EAE /begin FUNCTION_LIST /end FUNCTION_LIST /end MEASUREMENT
/begin MEASUREMENT vSKEYBKHW "Value of the secret key. it is saved in EEPROM area (high part)" UWORD COMP_0068 1 100 0 65535 ECU_ADDRESS 0xFFFF3EB0 /begin FUNCTION_LIST /end FUNCTION_LIST /end MEASUREMENT
/begin MEASUREMENT vSKEYBKLW "Value of the secret key. it is saved in EEPROM area (low part)" ULONG COMP_0068 1 100 0 4294967295 ECU_ADDRESS 0xFFFF3EB4 /begin FUNCTION_LIST /end FUNCTION_LIST /end MEASUREMENT
/begin MEASUREMENT vSKEYLUH "Imombilizer strategy" UWORD COMP_0068 1 100 0 65535 ECU_ADDRESS 0xFFFF3EC8 /begin FUNCTION_LIST /end FUNCTION_LIST /end MEASUREMENT
/begin MEASUREMENT vSKEYLUL "Imombilizer strategy" ULONG COMP_0068 1 100 0 4294967295 ECU_ADDRESS 0xFFFF3ECC /begin FUNCTION_LIST /end FUNCTION_LIST /end MEASUREMENT
/begin MEASUREMENT vSKEYSTAT "SKEY backup area" UBYTE COMP_0068 1 100 0 255 ECU_ADDRESS 0xFFFF3ED8 /begin FUNCTION_LIST /end FUNCTION_LIST /end MEASUREMENT
/begin MEASUREMENT vSKEYSTHW "Value of the secret key. it is saved in a not erasable area even by reprogramming (high part)" UWORD COMP_0068 1 100 0 65535 ECU_ADDRESS 0xFFFF3EE0 /begin FUNCTION_LIST /end FUNCTION_LIST /end MEASUREMENT
/begin MEASUREMENT vSKEYSTLW "Value of the secret key. it is saved in a not erasable area even by reprogramming (low part)" ULONG COMP_0068 1 100 0 4294967295 ECU_ADDRESS 0xFFFF3EE4 /begin FUNCTION_LIST /end FUNCTION_LIST /end MEASUREMENT
/begin MEASUREMENT vSLICNT "1sJOB Counter" UBYTE COMP_0068 1 100 0 255 ECU_ADDRESS 0xFFFF3EE8 /begin FUNCTION_LIST /end FUNCTION_LIST /end MEASUREMENT
/begin MEASUREMENT vSLREQCNT "Transmitted CAN parameter" UBYTE COMP_0068 1 100 0 255 ECU_ADDRESS 0xFFFF3EE9 /begin FUNCTION_LIST /end FUNCTION_LIST /end MEASUREMENT
/begin MEASUREMENT vSLREQH "Transmitted CAN parameter (high part)" UWORD COMP_0068 1 100 0 65535 ECU_ADDRESS 0xFFFF3EEA /begin FUNCTION_LIST /end FUNCTION_LIST /end MEASUREMENT
/begin MEASUREMENT vSLREQL "Transmitted CAN parameter (low part)" ULONG COMP_0068 1 100 0 4294967295 ECU_ADDRESS 0xFFFF3EEC /begin FUNCTION_LIST /end FUNCTION_LIST /end MEASUREMENT
/begin MEASUREMENT vSLRNOKf "Transient state region estimated learning control condition flag" UBYTE COMP_0004 1 100 0 255 ECU_ADDRESS 0xFFFF17A4 /begin FUNCTION_LIST /end FUNCTION_LIST /end MEASUREMENT
/begin MEASUREMENT vSLSETf "The first slice level setup flag" UBYTE COMP_0004 1 100 0 255 ECU_ADDRESS 0xFFFF2237 /begin FUNCTION_LIST /end FUNCTION_LIST /end MEASUREMENT
/begin MEASUREMENT vSLVAL "Received CAN parameter" ULONG COMP_0068 1 100 0 4294967295 ECU_ADDRESS 0xFFFF3EF0 /begin FUNCTION_LIST /end FUNCTION_LIST /end MEASUREMENT
/begin MEASUREMENT vSLVALCNT "Received CAN parameter" UBYTE COMP_0068 1 100 0 255 ECU_ADDRESS 0xFFFF3EF4 /begin FUNCTION_LIST /end FUNCTION_LIST /end MEASUREMENT
/begin MEASUREMENT vSMAL3 "LEKAL3 integration value" UWORD COMP_0232 1 100 0 511.9921875 ECU_ADDRESS 0xFFFFB118 /begin FUNCTION_LIST /end FUNCTION_LIST /end MEASUREMENT
/begin MEASUREMENT vSMAL32 "At the time of the 0.04inch leak-down, LEKAL3 integration value" UWORD COMP_0232 1 100 0 511.9921875 ECU_ADDRESS 0xFFFFB11A /begin FUNCTION_LIST /end FUNCTION_LIST /end MEASUREMENT
/begin MEASUREMENT vSMDLTP2 "DLTP2 integration value" ULONG COMP_0050 1 100 0 335544319.921875 ECU_ADDRESS 0xFFFF31E0 /begin FUNCTION_LIST /end FUNCTION_LIST /end MEASUREMENT
/begin MEASUREMENT vSMDLTPI2 "DLTPI2 integration value" ULONG COMP_0050 1 100 0 335544319.921875 ECU_ADDRESS 0xFFFF31E4 /begin FUNCTION_LIST /end FUNCTION_LIST /end MEASUREMENT
/begin MEASUREMENT vSMDLTPX "DLTPX integration value" ULONG COMP_0050 1 100 0 335544319.921875 ECU_ADDRESS 0xFFFF31E8 /begin FUNCTION_LIST /end FUNCTION_LIST /end MEASUREMENT
/begin MEASUREMENT vSMHOSE "VTC maximum-retard degree diagnosis reference position deviation quantity integration value" UWORD COMP_0154_S 1 100 -16384 16383.5 ECU_ADDRESS 0xFFFF17A6 /begin FUNCTION_LIST /end FUNCTION_LIST /end MEASUREMENT
/begin MEASUREMENT vSMHOSE_R#1 "VTC maximum-retard degree diagnosis reference position deviation quantity integration value" UWORD COMP_0154_S 1 100 -16384 16383.5 ECU_ADDRESS 0xFFFF17A6 /begin FUNCTION_LIST /end FUNCTION_LIST /end MEASUREMENT
/begin MEASUREMENT vSMHOSE_R#2 "VTC maximum-retard degree diagnosis reference position deviation quantity integration value" UWORD COMP_0154_S 1 100 -16384 16383.5 ECU_ADDRESS 0xFFFF17A8 /begin FUNCTION_LIST /end FUNCTION_LIST /end MEASUREMENT
/begin MEASUREMENT vSMHOSI "VTC maximum-retard degree diagnosis reference position deviation quantity integration value" UWORD COMP_0154_S 1 100 -16384 16383.5 ECU_ADDRESS 0xFFFF17AA /begin FUNCTION_LIST /end FUNCTION_LIST /end MEASUREMENT
/begin MEASUREMENT vSMHOSI_R#1 "VTC maximum-retard degree diagnosis reference position deviation quantity integration value" UWORD COMP_0154_S 1 100 -16384 16383.5 ECU_ADDRESS 0xFFFF17AA /begin FUNCTION_LIST /end FUNCTION_LIST /end MEASUREMENT
/begin MEASUREMENT vSMHOSI_R#2 "VTC maximum-retard degree diagnosis reference position deviation quantity integration value" UWORD COMP_0154_S 1 100 -16384 16383.5 ECU_ADDRESS 0xFFFF17AC /begin FUNCTION_LIST /end FUNCTION_LIST /end MEASUREMENT
/begin MEASUREMENT vSMIGL2 "At the time of the 0.04inch leak-down, slosh compensation value integration" ULONG COMP_0050 1 100 0 335544319.921875 ECU_ADDRESS 0xFFFFB19C /begin FUNCTION_LIST /end FUNCTION_LIST /end MEASUREMENT
/begin MEASUREMENT vSMIGLX "At the time of the 0.02inch leak-down, slosh compensation value integration" ULONG COMP_0050 1 100 0 335544319.921875 ECU_ADDRESS 0xFFFFB1A0 /begin FUNCTION_LIST /end FUNCTION_LIST /end MEASUREMENT
/begin MEASUREMENT vSMILI2 "Parameter integration value for the line pressure sensor function diagnosis" ULONG COMP_0050 1 100 0 335544319.921875 ECU_ADDRESS 0xFFFFB1A4 /begin FUNCTION_LIST /end FUNCTION_LIST /end MEASUREMENT
/begin MEASUREMENT vSMPDC "Pull-down number of times integration value" UWORD COMP_0380 1 100 0 4095.9375 ECU_ADDRESS 0xFFFFB1E8 /begin FUNCTION_LIST /end FUNCTION_LIST /end MEASUREMENT
/begin MEASUREMENT vSMPINT "Parameter monitor BACKUP interval" ULONG COMP_0125_S 1 100 0 4294967295 ECU_ADDRESS 0xFFFF17B0 /begin FUNCTION_LIST /end FUNCTION_LIST /end MEASUREMENT
/begin MEASUREMENT vSOKUTf "A periodic measuring cancellation condition 2" UBYTE COMP_0004 1 100 0 255 ECU_ADDRESS 0xFFFF37FA /begin FUNCTION_LIST /end FUNCTION_LIST /end MEASUREMENT
/begin MEASUREMENT vSOLDGNf "Solenoid breakage trouble diagnosis condition formation" UBYTE COMP_0004 1 100 0 255 ECU_ADDRESS 0xFFFF31EC /begin FUNCTION_LIST /end FUNCTION_LIST /end MEASUREMENT
/begin MEASUREMENT vSPDIDLTM "Speed control coast continuation time" UBYTE COMP_0014 1 100 0 2550 ECU_ADDRESS 0xFFFF31ED /begin FUNCTION_LIST /end FUNCTION_LIST /end MEASUREMENT
/begin MEASUREMENT vSPDNEDIF "Speed control speed difference value" SWORD COMP_0626_S 1 100 -25600 25599.21875 ECU_ADDRESS 0xFFFF31EE /begin FUNCTION_LIST /end FUNCTION_LIST /end MEASUREMENT
/begin MEASUREMENT vSPDNEFLT "The rest of speed control filters" UWORD COMP_0454_S 1 100 0 51199.21875 ECU_ADDRESS 0xFFFF26EA /begin FUNCTION_LIST /end FUNCTION_LIST /end MEASUREMENT
/begin MEASUREMENT vSPDPGAIN "Speed control P-gain gain" UWORD COMP_0453_S 1 100 0 65.535 ECU_ADDRESS 0xFFFF31F0 /begin FUNCTION_LIST /end FUNCTION_LIST /end MEASUREMENT
/begin MEASUREMENT vSPDTGREV "Speed control target speed" UWORD COMP_0454_S 1 100 0 51199.21875 ECU_ADDRESS 0xFFFF31F2 /begin FUNCTION_LIST /end FUNCTION_LIST /end MEASUREMENT
/begin MEASUREMENT vSPFRC "Purge concentration change integration quantity final value" SBYTE COMP_0407 1 100 -32 31.75 ECU_ADDRESS 0xFFFF17B5 /begin FUNCTION_LIST /end FUNCTION_LIST /end MEASUREMENT
/begin MEASUREMENT vSPFRC_R#1 "Purge concentration change integration quantity final value" SBYTE COMP_0407 1 100 -32 31.75 ECU_ADDRESS 0xFFFF17B5 /begin FUNCTION_LIST /end FUNCTION_LIST /end MEASUREMENT
/begin MEASUREMENT vSPFRC_R#2 "Purge concentration change integration quantity final value" SBYTE COMP_0407 1 100 -32 31.75 ECU_ADDRESS 0xFFFF17B6 /begin FUNCTION_LIST /end FUNCTION_LIST /end MEASUREMENT
/begin MEASUREMENT vSPFRCM "The amount of purge concentration change integration" SBYTE COMP_0407 1 100 -32 31.75 ECU_ADDRESS 0xFFFF17B7 /begin FUNCTION_LIST /end FUNCTION_LIST /end MEASUREMENT
/begin MEASUREMENT vSPFRCM_R#1 "The amount of purge concentration change integration" SBYTE COMP_0407 1 100 -32 31.75 ECU_ADDRESS 0xFFFF17B7 /begin FUNCTION_LIST /end FUNCTION_LIST /end MEASUREMENT
/begin MEASUREMENT vSPFRCM_R#2 "The amount of purge concentration change integration" SBYTE COMP_0407 1 100 -32 31.75 ECU_ADDRESS 0xFFFF17B8 /begin FUNCTION_LIST /end FUNCTION_LIST /end MEASUREMENT
/begin MEASUREMENT vSPRLIDTBL "DIAGCAN The ID data that RemoteActivation is local" UBYTE COMP_0004 1 100 0 255 ECU_ADDRESS 0xFFFF3EF5 /begin FUNCTION_LIST /end FUNCTION_LIST /end MEASUREMENT
/begin MEASUREMENT vSPRLIDTBL_R#1 "DIAGCAN The ID data that RemoteActivation is local" UBYTE COMP_0004 1 100 0 255 ECU_ADDRESS 0xFFFF3EF5 /begin FUNCTION_LIST /end FUNCTION_LIST /end MEASUREMENT
/begin MEASUREMENT vSPRLIDTBL_R#2 "DIAGCAN The ID data that RemoteActivation is local" UBYTE COMP_0004 1 100 0 255 ECU_ADDRESS 0xFFFF3EF6 /begin FUNCTION_LIST /end FUNCTION_LIST /end MEASUREMENT
/begin MEASUREMENT vSPRLIDTBL_R#3 "DIAGCAN The ID data that RemoteActivation is local" UBYTE COMP_0004 1 100 0 255 ECU_ADDRESS 0xFFFF3EF7 /begin FUNCTION_LIST /end FUNCTION_LIST /end MEASUREMENT
/begin MEASUREMENT vSPRLIDTBL_R#4 "DIAGCAN The ID data that RemoteActivation is local" UBYTE COMP_0004 1 100 0 255 ECU_ADDRESS 0xFFFF3EF8 /begin FUNCTION_LIST /end FUNCTION_LIST /end MEASUREMENT
/begin MEASUREMENT vSPRLIDTBL_R#5 "DIAGCAN The ID data that RemoteActivation is local" UBYTE COMP_0004 1 100 0 255 ECU_ADDRESS 0xFFFF3EF9 /begin FUNCTION_LIST /end FUNCTION_LIST /end MEASUREMENT
/begin MEASUREMENT vSPRLIDTBL_R#6 "DIAGCAN The ID data that RemoteActivation is local" UBYTE COMP_0004 1 100 0 255 ECU_ADDRESS 0xFFFF3EFA /begin FUNCTION_LIST /end FUNCTION_LIST /end MEASUREMENT
/begin MEASUREMENT vSPRLIDTBL_R#7 "DIAGCAN The ID data that RemoteActivation is local" UBYTE COMP_0004 1 100 0 255 ECU_ADDRESS 0xFFFF3EFB /begin FUNCTION_LIST /end FUNCTION_LIST /end MEASUREMENT
/begin MEASUREMENT vSPRLIDTBL_R#8 "DIAGCAN The ID data that RemoteActivation is local" UBYTE COMP_0004 1 100 0 255 ECU_ADDRESS 0xFFFF3EFC /begin FUNCTION_LIST /end FUNCTION_LIST /end MEASUREMENT
/begin MEASUREMENT vSPRLIDTBL_R#9 "DIAGCAN The ID data that RemoteActivation is local" UBYTE COMP_0004 1 100 0 255 ECU_ADDRESS 0xFFFF3EFD /begin FUNCTION_LIST /end FUNCTION_LIST /end MEASUREMENT
/begin MEASUREMENT vSPRLIDTBL_R#10 "DIAGCAN The ID data that RemoteActivation is local" UBYTE COMP_0004 1 100 0 255 ECU_ADDRESS 0xFFFF3EFE /begin FUNCTION_LIST /end FUNCTION_LIST /end MEASUREMENT
/begin MEASUREMENT vSPRLIDTBL_R#11 "DIAGCAN The ID data that RemoteActivation is local" UBYTE COMP_0004 1 100 0 255 ECU_ADDRESS 0xFFFF3EFF /begin FUNCTION_LIST /end FUNCTION_LIST /end MEASUREMENT
/begin MEASUREMENT vSPRLIDTBL_R#12 "DIAGCAN The ID data that RemoteActivation is local" UBYTE COMP_0004 1 100 0 255 ECU_ADDRESS 0xFFFF3F00 /begin FUNCTION_LIST /end FUNCTION_LIST /end MEASUREMENT
/begin MEASUREMENT vSRLIDTBL "DIAGCAN The ID data that RemoteActivation is local" UBYTE COMP_0004 1 100 0 255 ECU_ADDRESS 0xFFFF3F01 /begin FUNCTION_LIST /end FUNCTION_LIST /end MEASUREMENT
/begin MEASUREMENT vSRLIDTBL_R#1 "DIAGCAN The ID data that RemoteActivation is local" UBYTE COMP_0004 1 100 0 255 ECU_ADDRESS 0xFFFF3F01 /begin FUNCTION_LIST /end FUNCTION_LIST /end MEASUREMENT
/begin MEASUREMENT vSRLIDTBL_R#2 "DIAGCAN The ID data that RemoteActivation is local" UBYTE COMP_0004 1 100 0 255 ECU_ADDRESS 0xFFFF3F02 /begin FUNCTION_LIST /end FUNCTION_LIST /end MEASUREMENT
/begin MEASUREMENT vSRLIDTBL_R#3 "DIAGCAN The ID data that RemoteActivation is local" UBYTE COMP_0004 1 100 0 255 ECU_ADDRESS 0xFFFF3F03 /begin FUNCTION_LIST /end FUNCTION_LIST /end MEASUREMENT
/begin MEASUREMENT vSRLIDTBL_R#4 "DIAGCAN The ID data that RemoteActivation is local" UBYTE COMP_0004 1 100 0 255 ECU_ADDRESS 0xFFFF3F04 /begin FUNCTION_LIST /end FUNCTION_LIST /end MEASUREMENT
/begin MEASUREMENT vSRLIDTBL_R#5 "DIAGCAN The ID data that RemoteActivation is local" UBYTE COMP_0004 1 100 0 255 ECU_ADDRESS 0xFFFF3F05 /begin FUNCTION_LIST /end FUNCTION_LIST /end MEASUREMENT
/begin MEASUREMENT vSRLIDTBL_R#6 "DIAGCAN The ID data that RemoteActivation is local" UBYTE COMP_0004 1 100 0 255 ECU_ADDRESS 0xFFFF3F06 /begin FUNCTION_LIST /end FUNCTION_LIST /end MEASUREMENT
/begin MEASUREMENT vSRLIDTBL_R#7 "DIAGCAN The ID data that RemoteActivation is local" UBYTE COMP_0004 1 100 0 255 ECU_ADDRESS 0xFFFF3F07 /begin FUNCTION_LIST /end FUNCTION_LIST /end MEASUREMENT
/begin MEASUREMENT vSRLIDTBL_R#8 "DIAGCAN The ID data that RemoteActivation is local" UBYTE COMP_0004 1 100 0 255 ECU_ADDRESS 0xFFFF3F08 /begin FUNCTION_LIST /end FUNCTION_LIST /end MEASUREMENT
/begin MEASUREMENT vSRLIDTBL_R#9 "DIAGCAN The ID data that RemoteActivation is local" UBYTE COMP_0004 1 100 0 255 ECU_ADDRESS 0xFFFF3F09 /begin FUNCTION_LIST /end FUNCTION_LIST /end MEASUREMENT
/begin MEASUREMENT vSRLIDTBL_R#10 "DIAGCAN The ID data that RemoteActivation is local" UBYTE COMP_0004 1 100 0 255 ECU_ADDRESS 0xFFFF3F0A /begin FUNCTION_LIST /end FUNCTION_LIST /end MEASUREMENT
/begin MEASUREMENT vSRLIDTBL_R#11 "DIAGCAN The ID data that RemoteActivation is local" UBYTE COMP_0004 1 100 0 255 ECU_ADDRESS 0xFFFF3F0B /begin FUNCTION_LIST /end FUNCTION_LIST /end MEASUREMENT
/begin MEASUREMENT vSRLIDTBL_R#12 "DIAGCAN The ID data that RemoteActivation is local" UBYTE COMP_0004 1 100 0 255 ECU_ADDRESS 0xFFFF3F0C /begin FUNCTION_LIST /end FUNCTION_LIST /end MEASUREMENT
/begin MEASUREMENT vSRTOPT2 "SRBLID OPT2 previous value" UBYTE COMP_0004 1 100 0 255 ECU_ADDRESS 0xFFFF3F0D /begin FUNCTION_LIST /end FUNCTION_LIST /end MEASUREMENT
/begin MEASUREMENT vSRTOPT3 "SRBLID OPT3 previous value" UBYTE COMP_0004 1 100 0 255 ECU_ADDRESS 0xFFFF3F0E /begin FUNCTION_LIST /end FUNCTION_LIST /end MEASUREMENT
/begin MEASUREMENT vSSOFT1B "Condition formation time" UBYTE COMP_0250 1 100 0 1020 ECU_ADDRESS 0xFFFF37FC /begin FUNCTION_LIST /end FUNCTION_LIST /end MEASUREMENT
/begin MEASUREMENT vST2ARAVf "Imaginary stage 2 region condition" UBYTE COMP_0004 1 100 0 255 ECU_ADDRESS 0xFFFF31F9 /begin FUNCTION_LIST /end FUNCTION_LIST /end MEASUREMENT
/begin MEASUREMENT vST2ARAf "Stage 2 region condition" UBYTE COMP_0004 1 100 0 255 ECU_ADDRESS 0xFFFF31F8 /begin FUNCTION_LIST /end FUNCTION_LIST /end MEASUREMENT
/begin MEASUREMENT vST2GOVf "Imaginary stage 2 diagnosis operation start" UBYTE COMP_0004 1 100 0 255 ECU_ADDRESS 0xFFFF31FB /begin FUNCTION_LIST /end FUNCTION_LIST /end MEASUREMENT
/begin MEASUREMENT vST2GOWf "Imaginary stage 2 judgement switchover flag" UBYTE COMP_0004 1 100 0 255 ECU_ADDRESS 0xFFFF31FC /begin FUNCTION_LIST /end FUNCTION_LIST /end MEASUREMENT
/begin MEASUREMENT vST2GOf "Stage 2 diagnosis operation start" UBYTE COMP_0004 1 100 0 255 ECU_ADDRESS 0xFFFF31FA /begin FUNCTION_LIST /end FUNCTION_LIST /end MEASUREMENT
/begin MEASUREMENT vST2JDGOKf "NUMSTG>=ST2JDGOK#" UBYTE COMP_0004 1 100 0 255 ECU_ADDRESS 0xFFFF31FE /begin FUNCTION_LIST /end FUNCTION_LIST /end MEASUREMENT
/begin MEASUREMENT vST2JDGf "NUMSTG>=ST2JDG#" UBYTE COMP_0004 1 100 0 255 ECU_ADDRESS 0xFFFF31FD /begin FUNCTION_LIST /end FUNCTION_LIST /end MEASUREMENT
/begin MEASUREMENT vSTACAT "When a catalyst diagnosis starts, mileage" UWORD COMP_0385 1 100 0 105380.28 ECU_ADDRESS 0xFFFFB230 /begin FUNCTION_LIST /end FUNCTION_LIST /end MEASUREMENT
/begin MEASUREMENT vSTAEGR "When an EGR diagnosis starts, mileage" UWORD COMP_0385 1 100 0 105380.28 ECU_ADDRESS 0xFFFFB232 /begin FUNCTION_LIST /end FUNCTION_LIST /end MEASUREMENT
/begin MEASUREMENT vSTAERCNT "The counter whose CPU movement time is unusual" UBYTE COMP_0068 1 100 0 255 ECU_ADDRESS 0xFFFFB234 /begin FUNCTION_LIST /end FUNCTION_LIST /end MEASUREMENT
/begin MEASUREMENT vSTAETIM "Program executive time measuring RAM" UWORD COMP_0494 1 100 0 6553500 ECU_ADDRESS 0xFFFF3200 /begin FUNCTION_LIST /end FUNCTION_LIST /end MEASUREMENT
/begin MEASUREMENT vSTARTSID "DiagOnCAN SRBLID practice SID" UBYTE COMP_0004 1 100 0 255 ECU_ADDRESS 0xFFFF3F0F /begin FUNCTION_LIST /end FUNCTION_LIST /end MEASUREMENT
/begin MEASUREMENT vSTARTSTS "DiagOnCAN SRBLID executive status" UBYTE COMP_0004 1 100 0 255 ECU_ADDRESS 0xFFFF3F10 /begin FUNCTION_LIST /end FUNCTION_LIST /end MEASUREMENT
/begin MEASUREMENT vSTATUACC "ACC states received from ACC ECU" UBYTE COMP_0068 1 100 0 255 ECU_ADDRESS 0xFFFF3F11 /begin FUNCTION_LIST /end FUNCTION_LIST /end MEASUREMENT
/begin MEASUREMENT vSTDINI "When it usually starts, DUTY value" UBYTE COMP_0047 1 100 0 127.5 ECU_ADDRESS 0xFFFF3F13 /begin FUNCTION_LIST /end FUNCTION_LIST /end MEASUREMENT
/begin MEASUREMENT vSTEGNG1 "EGR#1NG counter (for the ST, driver)" UWORD COMP_0016 1 100 0 65535 ECU_ADDRESS 0xFFFF3204 /begin FUNCTION_LIST /end FUNCTION_LIST /end MEASUREMENT
/begin MEASUREMENT vSTEGNG2 "EGR#2NG counter (for the ST, driver)" UWORD COMP_0016 1 100 0 65535 ECU_ADDRESS 0xFFFF3206 /begin FUNCTION_LIST /end FUNCTION_LIST /end MEASUREMENT
/begin MEASUREMENT vSTEGNG3 "EGR#3NG counter (for the ST, driver)" UWORD COMP_0016 1 100 0 65535 ECU_ADDRESS 0xFFFF3208 /begin FUNCTION_LIST /end FUNCTION_LIST /end MEASUREMENT
/begin MEASUREMENT vSTEGNG4 "EGR#4NG counter (for the ST, driver)" UWORD COMP_0016 1 100 0 65535 ECU_ADDRESS 0xFFFF320A /begin FUNCTION_LIST /end FUNCTION_LIST /end MEASUREMENT
/begin MEASUREMENT vSTEGSTP "EGR memory NG step number (for the ST, driver)" UWORD COMP_0140 1 100 0 32767.5 ECU_ADDRESS 0xFFFF320C /begin FUNCTION_LIST /end FUNCTION_LIST /end MEASUREMENT
/begin MEASUREMENT vSTEGTD10 "EGR energizing flag (for the ST, driver)" UBYTE COMP_0068 1 100 0 255 ECU_ADDRESS 0xFFFF3F15 /begin FUNCTION_LIST /end FUNCTION_LIST /end MEASUREMENT
/begin MEASUREMENT vSTEGTDN "EGR energizing flag (for the ST, driver)" UBYTE COMP_0068 1 100 0 255 ECU_ADDRESS 0xFFFF3800 /begin FUNCTION_LIST /end FUNCTION_LIST /end MEASUREMENT
/begin MEASUREMENT vSTEGWND "A window timer flag (for the ST, driver) for the NG detection" UBYTE COMP_0068 1 100 0 255 ECU_ADDRESS 0xFFFF320E /begin FUNCTION_LIST /end FUNCTION_LIST /end MEASUREMENT
/begin MEASUREMENT vSTEVPCNT "Duty output timing counter (10mS mode)" UBYTE COMP_0014 1 100 0 2550 ECU_ADDRESS 0xFFFF3F16 /begin FUNCTION_LIST /end FUNCTION_LIST /end MEASUREMENT
/begin MEASUREMENT vSTEVPCYC "Canister purge valve cycle count to Active test (10mS mode)" UBYTE COMP_0468_S 1 100 0 255 ECU_ADDRESS 0xFFFF3F17 /begin FUNCTION_LIST /end FUNCTION_LIST /end MEASUREMENT
/begin MEASUREMENT vSTICMX "At the time of the compression operation start, a maximum pulse" UWORD COMP_0394 1 100 0 838848 ECU_ADDRESS 0xFFFF3210 /begin FUNCTION_LIST /end FUNCTION_LIST /end MEASUREMENT
/begin MEASUREMENT vSTIMAX "At the time of the intake operation start, a maximum pulse" UWORD COMP_0394 1 100 0 838848 ECU_ADDRESS 0xFFFF3212 /begin FUNCTION_LIST /end FUNCTION_LIST /end MEASUREMENT
/begin MEASUREMENT vSTLRPMz1 "A LNRPM previous value for the soft starter SW on control" UBYTE COMP_0006 1 100 0 3187.5 ECU_ADDRESS 0xFFFF2239 /begin FUNCTION_LIST /end FUNCTION_LIST /end MEASUREMENT
/begin MEASUREMENT vSTLRPMz2 "LNRPM last but one value for the soft starter SW on control" UBYTE COMP_0006 1 100 0 3187.5 ECU_ADDRESS 0xFFFF223A /begin FUNCTION_LIST /end FUNCTION_LIST /end MEASUREMENT
/begin MEASUREMENT vSTPCNTI "Stopper collision number of times" UWORD COMP_0030 1 100 0 65535 ECU_ADDRESS 0xFFFFB238 /begin FUNCTION_LIST /end FUNCTION_LIST /end MEASUREMENT
/begin MEASUREMENT vSTPCNTI_R#1 "Stopper collision number of times" UWORD COMP_0030 1 100 0 65535 ECU_ADDRESS 0xFFFFB238 /begin FUNCTION_LIST /end FUNCTION_LIST /end MEASUREMENT
/begin MEASUREMENT vSTPCNTI_R#2 "Stopper collision number of times" UWORD COMP_0030 1 100 0 65535 ECU_ADDRESS 0xFFFFB23A /begin FUNCTION_LIST /end FUNCTION_LIST /end MEASUREMENT
/begin MEASUREMENT vSTPCNTIEf "Collision count permission flag" UBYTE COMP_0004 1 100 0 255 ECU_ADDRESS 0xFFFF17BC /begin FUNCTION_LIST /end FUNCTION_LIST /end MEASUREMENT
/begin MEASUREMENT vSTPCYL "Injection compulsory completion requirement cylinder" UBYTE COMP_0004 1 100 0 255 ECU_ADDRESS 0xFFFF223B /begin FUNCTION_LIST /end FUNCTION_LIST /end MEASUREMENT
/begin MEASUREMENT vSTPOINT "Counter value" ULONG COMP_0068 1 100 0 4294967295 ECU_ADDRESS 0xFFFF17C0 /begin FUNCTION_LIST /end FUNCTION_LIST /end MEASUREMENT
/begin MEASUREMENT vSTRTTIME "Engine initial time" ULONG COMP_0053 1 100 0 4294967295 ECU_ADDRESS 0xFFFF1F14 /begin FUNCTION_LIST /end FUNCTION_LIST /end MEASUREMENT
/begin MEASUREMENT vSTSWTR2 "Under the condition that a condition (a) (b) (g) - (i) come into being, after ST SW on off, more than accumulation 600 seconds" UWORD COMP_0049 1 100 0 65535 ECU_ADDRESS 0xFFFF321A /begin FUNCTION_LIST /end FUNCTION_LIST /end MEASUREMENT
/begin MEASUREMENT vSTSWTRP "Under the condition that a condition (a) - (c) come into being, after ST SW on off, more than accumulation 600 seconds" UWORD COMP_0049 1 100 0 65535 ECU_ADDRESS 0xFFFF321C /begin FUNCTION_LIST /end FUNCTION_LIST /end MEASUREMENT
/begin MEASUREMENT vSUMALP "ALCAT 100% convergent operation RAM" SLONG COMP_0438 1 100 -8388608 8388607.99609375 ECU_ADDRESS 0xFFFF3224 /begin FUNCTION_LIST /end FUNCTION_LIST /end MEASUREMENT
/begin MEASUREMENT vSUMALP_R#1 "ALCAT 100% convergent operation RAM" SLONG COMP_0438 1 100 -8388608 8388607.99609375 ECU_ADDRESS 0xFFFF3224 /begin FUNCTION_LIST /end FUNCTION_LIST /end MEASUREMENT
/begin MEASUREMENT vSUMALP_R#2 "ALCAT 100% convergent operation RAM" SLONG COMP_0438 1 100 -8388608 8388607.99609375 ECU_ADDRESS 0xFFFF3228 /begin FUNCTION_LIST /end FUNCTION_LIST /end MEASUREMENT
/begin MEASUREMENT vSUMDRV "Integration value for the DRV mean computation" UWORD COMP_0118 1 100 0 2621400 ECU_ADDRESS 0xFFFF3234 /begin FUNCTION_LIST /end FUNCTION_LIST /end MEASUREMENT
/begin MEASUREMENT vSUMHDTMP "The temporary RAM for the SUM check of the ROM" ULONG COMP_0068 1 100 0 4294967295 ECU_ADDRESS 0xFFFF3238 /begin FUNCTION_LIST /end FUNCTION_LIST /end MEASUREMENT
/begin MEASUREMENT vSUMOSLf "Lean side O2 storage ability operation judgement flag" UBYTE COMP_0004 1 100 0 255 ECU_ADDRESS 0xFFFF323C /begin FUNCTION_LIST /end FUNCTION_LIST /end MEASUREMENT
/begin MEASUREMENT vSUMOSRf "Rich side O2 storage ability operation judgement flag" UBYTE COMP_0004 1 100 0 255 ECU_ADDRESS 0xFFFF323D /begin FUNCTION_LIST /end FUNCTION_LIST /end MEASUREMENT
/begin MEASUREMENT vSUMTMP "For the SUM value operation" ULONG COMP_0068 1 100 0 4294967295 ECU_ADDRESS 0xFFFF3250 /begin FUNCTION_LIST /end FUNCTION_LIST /end MEASUREMENT
/begin MEASUREMENT vSUPLINI1 "Init value to generate the first noise byte of the ECM_VERLOG frame" UBYTE COMP_0068 1 100 0 255 ECU_ADDRESS 0xFFFF3F1A /begin FUNCTION_LIST /end FUNCTION_LIST /end MEASUREMENT
/begin MEASUREMENT vSUPLINI2 "Init value to generate the second noise byte of the ECM_VERLOG frame" UBYTE COMP_0068 1 100 0 255 ECU_ADDRESS 0xFFFF3F1B /begin FUNCTION_LIST /end FUNCTION_LIST /end MEASUREMENT
/begin MEASUREMENT vSUPLINI3 "Init value to generate the third noise byte of the ECM_VERLOG frame" UBYTE COMP_0068 1 100 0 255 ECU_ADDRESS 0xFFFF3F1C /begin FUNCTION_LIST /end FUNCTION_LIST /end MEASUREMENT
/begin MEASUREMENT vSUPLINI4 "Init value to generate the forth noise byte of the ECM_VERLOG frame" UBYTE COMP_0068 1 100 0 255 ECU_ADDRESS 0xFFFF3F1D /begin FUNCTION_LIST /end FUNCTION_LIST /end MEASUREMENT
/begin MEASUREMENT vSUPLINI5 "Init value to generate the fifth noise byte of the ECM_VERLOG frame" UBYTE COMP_0068 1 100 0 255 ECU_ADDRESS 0xFFFF3F1E /begin FUNCTION_LIST /end FUNCTION_LIST /end MEASUREMENT
/begin MEASUREMENT vSUPLINI6 "Init value to generate the sixth noise byte of the ECM_VERLOG frame" UBYTE COMP_0068 1 100 0 255 ECU_ADDRESS 0xFFFF3F1F /begin FUNCTION_LIST /end FUNCTION_LIST /end MEASUREMENT
/begin MEASUREMENT vSVABSNT "supervsion set" UBYTE COMP_0068 1 100 0 255 ECU_ADDRESS 0xFFFF3816 /begin FUNCTION_LIST /end FUNCTION_LIST /end MEASUREMENT
/begin MEASUREMENT vSVABSNT_C#1_R#1 "supervsion set" UBYTE COMP_0068 1 100 0 255 ECU_ADDRESS 0xFFFF3816 /begin FUNCTION_LIST /end FUNCTION_LIST /end MEASUREMENT
/begin MEASUREMENT vSVABSNT_C#2_R#1 "supervsion set" UBYTE COMP_0068 1 100 0 255 ECU_ADDRESS 0xFFFF3817 /begin FUNCTION_LIST /end FUNCTION_LIST /end MEASUREMENT
/begin MEASUREMENT vSVABSNT_C#3_R#1 "supervsion set" UBYTE COMP_0068 1 100 0 255 ECU_ADDRESS 0xFFFF3818 /begin FUNCTION_LIST /end FUNCTION_LIST /end MEASUREMENT
/begin MEASUREMENT vSVABSNT_C#4_R#1 "supervsion set" UBYTE COMP_0068 1 100 0 255 ECU_ADDRESS 0xFFFF3819 /begin FUNCTION_LIST /end FUNCTION_LIST /end MEASUREMENT
/begin MEASUREMENT vSVABSNT_C#5_R#1 "supervsion set" UBYTE COMP_0068 1 100 0 255 ECU_ADDRESS 0xFFFF381A /begin FUNCTION_LIST /end FUNCTION_LIST /end MEASUREMENT
/begin MEASUREMENT vSVABSNT_C#6_R#1 "supervsion set" UBYTE COMP_0068 1 100 0 255 ECU_ADDRESS 0xFFFF381B /begin FUNCTION_LIST /end FUNCTION_LIST /end MEASUREMENT
/begin MEASUREMENT vSVABSNT_C#7_R#1 "supervsion set" UBYTE COMP_0068 1 100 0 255 ECU_ADDRESS 0xFFFF381C /begin FUNCTION_LIST /end FUNCTION_LIST /end MEASUREMENT
/begin MEASUREMENT vSVABSNT_C#8_R#1 "supervsion set" UBYTE COMP_0068 1 100 0 255 ECU_ADDRESS 0xFFFF381D /begin FUNCTION_LIST /end FUNCTION_LIST /end MEASUREMENT
/begin MEASUREMENT vSVABSNT_C#9_R#1 "supervsion set" UBYTE COMP_0068 1 100 0 255 ECU_ADDRESS 0xFFFF381E /begin FUNCTION_LIST /end FUNCTION_LIST /end MEASUREMENT
/begin MEASUREMENT vSVABSNT_C#10_R#1 "supervsion set" UBYTE COMP_0068 1 100 0 255 ECU_ADDRESS 0xFFFF381F /begin FUNCTION_LIST /end FUNCTION_LIST /end MEASUREMENT
/begin MEASUREMENT vSVABSNT_C#11_R#1 "supervsion set" UBYTE COMP_0068 1 100 0 255 ECU_ADDRESS 0xFFFF3820 /begin FUNCTION_LIST /end FUNCTION_LIST /end MEASUREMENT
/begin MEASUREMENT vSVABSNT_C#12_R#1 "supervsion set" UBYTE COMP_0068 1 100 0 255 ECU_ADDRESS 0xFFFF3821 /begin FUNCTION_LIST /end FUNCTION_LIST /end MEASUREMENT
/begin MEASUREMENT vSVABSNT_C#13_R#1 "supervsion set" UBYTE COMP_0068 1 100 0 255 ECU_ADDRESS 0xFFFF3822 /begin FUNCTION_LIST /end FUNCTION_LIST /end MEASUREMENT
/begin MEASUREMENT vSVABSNT_C#14_R#1 "supervsion set" UBYTE COMP_0068 1 100 0 255 ECU_ADDRESS 0xFFFF3823 /begin FUNCTION_LIST /end FUNCTION_LIST /end MEASUREMENT
/begin MEASUREMENT vSVABSNT_C#15_R#1 "supervsion set" UBYTE COMP_0068 1 100 0 255 ECU_ADDRESS 0xFFFF3824 /begin FUNCTION_LIST /end FUNCTION_LIST /end MEASUREMENT
/begin MEASUREMENT vSVABSNT_C#16_R#1 "supervsion set" UBYTE COMP_0068 1 100 0 255 ECU_ADDRESS 0xFFFF3825 /begin FUNCTION_LIST /end FUNCTION_LIST /end MEASUREMENT
/begin MEASUREMENT vSVABSNT_C#17_R#1 "supervsion set" UBYTE COMP_0068 1 100 0 255 ECU_ADDRESS 0xFFFF3826 /begin FUNCTION_LIST /end FUNCTION_LIST /end MEASUREMENT
/begin MEASUREMENT vSVABSNT_C#18_R#1 "supervsion set" UBYTE COMP_0068 1 100 0 255 ECU_ADDRESS 0xFFFF3827 /begin FUNCTION_LIST /end FUNCTION_LIST /end MEASUREMENT
/begin MEASUREMENT vSVABSNT_C#19_R#1 "supervsion set" UBYTE COMP_0068 1 100 0 255 ECU_ADDRESS 0xFFFF3828 /begin FUNCTION_LIST /end FUNCTION_LIST /end MEASUREMENT
/begin MEASUREMENT vSVABSNT_C#20_R#1 "supervsion set" UBYTE COMP_0068 1 100 0 255 ECU_ADDRESS 0xFFFF3829 /begin FUNCTION_LIST /end FUNCTION_LIST /end MEASUREMENT
/begin MEASUREMENT vSVABSNT_C#21_R#1 "supervsion set" UBYTE COMP_0068 1 100 0 255 ECU_ADDRESS 0xFFFF382A /begin FUNCTION_LIST /end FUNCTION_LIST /end MEASUREMENT
/begin MEASUREMENT vSVABSNT_C#22_R#1 "supervsion set" UBYTE COMP_0068 1 100 0 255 ECU_ADDRESS 0xFFFF382B /begin FUNCTION_LIST /end FUNCTION_LIST /end MEASUREMENT
/begin MEASUREMENT vSVABSNT_C#23_R#1 "supervsion set" UBYTE COMP_0068 1 100 0 255 ECU_ADDRESS 0xFFFF382C /begin FUNCTION_LIST /end FUNCTION_LIST /end MEASUREMENT
/begin MEASUREMENT vSVABSNT_C#24_R#1 "supervsion set" UBYTE COMP_0068 1 100 0 255 ECU_ADDRESS 0xFFFF382D /begin FUNCTION_LIST /end FUNCTION_LIST /end MEASUREMENT
/begin MEASUREMENT vSVABSNT_C#25_R#1 "supervsion set" UBYTE COMP_0068 1 100 0 255 ECU_ADDRESS 0xFFFF382E /begin FUNCTION_LIST /end FUNCTION_LIST /end MEASUREMENT
/begin MEASUREMENT vSVABSNT_C#26_R#1 "supervsion set" UBYTE COMP_0068 1 100 0 255 ECU_ADDRESS 0xFFFF382F /begin FUNCTION_LIST /end FUNCTION_LIST /end MEASUREMENT
/begin MEASUREMENT vSVABSNT_C#27_R#1 "supervsion set" UBYTE COMP_0068 1 100 0 255 ECU_ADDRESS 0xFFFF3830 /begin FUNCTION_LIST /end FUNCTION_LIST /end MEASUREMENT
/begin MEASUREMENT vSVABSNT_C#28_R#1 "supervsion set" UBYTE COMP_0068 1 100 0 255 ECU_ADDRESS 0xFFFF3831 /begin FUNCTION_LIST /end FUNCTION_LIST /end MEASUREMENT
/begin MEASUREMENT vSVABSNT_C#29_R#1 "supervsion set" UBYTE COMP_0068 1 100 0 255 ECU_ADDRESS 0xFFFF3832 /begin FUNCTION_LIST /end FUNCTION_LIST /end MEASUREMENT
/begin MEASUREMENT vSVABSNT_C#30_R#1 "supervsion set" UBYTE COMP_0068 1 100 0 255 ECU_ADDRESS 0xFFFF3833 /begin FUNCTION_LIST /end FUNCTION_LIST /end MEASUREMENT
/begin MEASUREMENT vSVINTC "save IPRx data" UWORD COMP_0068 1 100 0 65535 ECU_ADDRESS 0xFFFF3F20 /begin FUNCTION_LIST /end FUNCTION_LIST /end MEASUREMENT
/begin MEASUREMENT vSVINTC_R#1 "save IPRx data" UWORD COMP_0068 1 100 0 65535 ECU_ADDRESS 0xFFFF3F20 /begin FUNCTION_LIST /end FUNCTION_LIST /end MEASUREMENT
/begin MEASUREMENT vSVINTC_R#2 "save IPRx data" UWORD COMP_0068 1 100 0 65535 ECU_ADDRESS 0xFFFF3F22 /begin FUNCTION_LIST /end FUNCTION_LIST /end MEASUREMENT
/begin MEASUREMENT vSVINTC_R#3 "save IPRx data" UWORD COMP_0068 1 100 0 65535 ECU_ADDRESS 0xFFFF3F24 /begin FUNCTION_LIST /end FUNCTION_LIST /end MEASUREMENT
/begin MEASUREMENT vSVINTC_R#4 "save IPRx data" UWORD COMP_0068 1 100 0 65535 ECU_ADDRESS 0xFFFF3F26 /begin FUNCTION_LIST /end FUNCTION_LIST /end MEASUREMENT
/begin MEASUREMENT vSVINTC_R#5 "save IPRx data" UWORD COMP_0068 1 100 0 65535 ECU_ADDRESS 0xFFFF3F28 /begin FUNCTION_LIST /end FUNCTION_LIST /end MEASUREMENT
/begin MEASUREMENT vSVINTC_R#6 "save IPRx data" UWORD COMP_0068 1 100 0 65535 ECU_ADDRESS 0xFFFF3F2A /begin FUNCTION_LIST /end FUNCTION_LIST /end MEASUREMENT
/begin MEASUREMENT vSVINTC_R#7 "save IPRx data" UWORD COMP_0068 1 100 0 65535 ECU_ADDRESS 0xFFFF3F2C /begin FUNCTION_LIST /end FUNCTION_LIST /end MEASUREMENT
/begin MEASUREMENT vSVINTC_R#8 "save IPRx data" UWORD COMP_0068 1 100 0 65535 ECU_ADDRESS 0xFFFF3F2E /begin FUNCTION_LIST /end FUNCTION_LIST /end MEASUREMENT
/begin MEASUREMENT vSVINTC_R#9 "save IPRx data" UWORD COMP_0068 1 100 0 65535 ECU_ADDRESS 0xFFFF3F30 /begin FUNCTION_LIST /end FUNCTION_LIST /end MEASUREMENT
/begin MEASUREMENT vSVINTC_R#10 "save IPRx data" UWORD COMP_0068 1 100 0 65535 ECU_ADDRESS 0xFFFF3F32 /begin FUNCTION_LIST /end FUNCTION_LIST /end MEASUREMENT
/begin MEASUREMENT vSVINTC_R#11 "save IPRx data" UWORD COMP_0068 1 100 0 65535 ECU_ADDRESS 0xFFFF3F34 /begin FUNCTION_LIST /end FUNCTION_LIST /end MEASUREMENT
/begin MEASUREMENT vSVINTC_R#12 "save IPRx data" UWORD COMP_0068 1 100 0 65535 ECU_ADDRESS 0xFFFF3F36 /begin FUNCTION_LIST /end FUNCTION_LIST /end MEASUREMENT
/begin MEASUREMENT vSVMUTE "supervsion set" UBYTE COMP_0068 1 100 0 255 ECU_ADDRESS 0xFFFF3834 /begin FUNCTION_LIST /end FUNCTION_LIST /end MEASUREMENT
/begin MEASUREMENT vT2MJOB "2mS JOB counter" UBYTE COMP_0030 1 100 0 255 ECU_ADDRESS 0xFFFF1D2D /begin FUNCTION_LIST /end FUNCTION_LIST /end MEASUREMENT
/begin MEASUREMENT vT4MJOB "4mS JOB counter" UBYTE COMP_0030 1 100 0 255 ECU_ADDRESS 0xFFFF1DCD /begin FUNCTION_LIST /end FUNCTION_LIST /end MEASUREMENT
/begin MEASUREMENT vTADVMK "TADVM right after P control switching" SBYTE COMP_0018 1 100 -128 127 ECU_ADDRESS 0xFFFF223C /begin FUNCTION_LIST /end FUNCTION_LIST /end MEASUREMENT
/begin MEASUREMENT vTAN1 "Before 10mS, TAN" UBYTE COMP_0035 1 100 -50 205 ECU_ADDRESS 0xFFFF3F38 /begin FUNCTION_LIST /end FUNCTION_LIST /end MEASUREMENT
/begin MEASUREMENT vTAN2 "Before 20mS, TAN" UBYTE COMP_0035 1 100 -50 205 ECU_ADDRESS 0xFFFF3F39 /begin FUNCTION_LIST /end FUNCTION_LIST /end MEASUREMENT
/begin MEASUREMENT vTAN3 "Before 30mS, TAN" UBYTE COMP_0035 1 100 -50 205 ECU_ADDRESS 0xFFFF3F3A /begin FUNCTION_LIST /end FUNCTION_LIST /end MEASUREMENT
/begin MEASUREMENT vTAN4 "Before 40mS, TAN" UBYTE COMP_0035 1 100 -50 205 ECU_ADDRESS 0xFFFF3F3B /begin FUNCTION_LIST /end FUNCTION_LIST /end MEASUREMENT
/begin MEASUREMENT vTAN5 "Before 50mS, TAN" UBYTE COMP_0035 1 100 -50 205 ECU_ADDRESS 0xFFFF3F3C /begin FUNCTION_LIST /end FUNCTION_LIST /end MEASUREMENT
/begin MEASUREMENT vTAN6 "Before 60mS, TAN" UBYTE COMP_0035 1 100 -50 205 ECU_ADDRESS 0xFFFF3F3D /begin FUNCTION_LIST /end FUNCTION_LIST /end MEASUREMENT
/begin MEASUREMENT vTAN7 "Before 70mS, TAN" UBYTE COMP_0035 1 100 -50 205 ECU_ADDRESS 0xFFFF3F3E /begin FUNCTION_LIST /end FUNCTION_LIST /end MEASUREMENT
/begin MEASUREMENT vTANST4 "TANST 1Åé 1/at 64Åé conversion" UWORD COMP_0499 1 100 0 102.3984375 ECU_ADDRESS 0xFFFF32B2 /begin FUNCTION_LIST /end FUNCTION_LIST /end MEASUREMENT
/begin MEASUREMENT vTAPOMIN "APS un-adjustment precaution continuation timer MAX value" UBYTE COMP_0014 1 100 0 2550 ECU_ADDRESS 0xFFFFB23E /begin FUNCTION_LIST /end FUNCTION_LIST /end MEASUREMENT
/begin MEASUREMENT vTARCNTE "Cam target signal input counter (exhaust side)" UBYTE COMP_0016 1 100 0 255 ECU_ADDRESS 0xFFFF4081 /begin FUNCTION_LIST /end FUNCTION_LIST /end MEASUREMENT
/begin MEASUREMENT vTARCNTE_R#1 "Cam target signal input counter (exhaust side)" UBYTE COMP_0016 1 100 0 255 ECU_ADDRESS 0xFFFF4081 /begin FUNCTION_LIST /end FUNCTION_LIST /end MEASUREMENT
/begin MEASUREMENT vTARCNTE_R#2 "Cam target signal input counter (exhaust side)" UBYTE COMP_0016 1 100 0 255 ECU_ADDRESS 0xFFFF4082 /begin FUNCTION_LIST /end FUNCTION_LIST /end MEASUREMENT
/begin MEASUREMENT vTASISCQ "A requirement to the ISC control" UBYTE COMP_0068 1 100 0 255 ECU_ADDRESS 0xFFFF1805 /begin FUNCTION_LIST /end FUNCTION_LIST /end MEASUREMENT
/begin MEASUREMENT vTASKNG "Task executive period/order diagnosis result" UBYTE COMP_0004 1 100 0 255 ECU_ADDRESS 0xFFFF1D2E /begin FUNCTION_LIST /end FUNCTION_LIST /end MEASUREMENT
/begin MEASUREMENT vTASLRCQ "A requirement to ISC learning" UBYTE COMP_0068 1 100 0 255 ECU_ADDRESS 0xFFFF1806 /begin FUNCTION_LIST /end FUNCTION_LIST /end MEASUREMENT
/begin MEASUREMENT vTAVB "ALTV target generating electricity voltage" UBYTE COMP_0033 1 100 0 20400 ECU_ADDRESS 0xFFFF180B /begin FUNCTION_LIST /end FUNCTION_LIST /end MEASUREMENT
/begin MEASUREMENT vTBLDFST "At the time of the NSET00D computation, Work RAM" UBYTE COMP_0006 1 100 0 3187.5 ECU_ADDRESS 0xFFFF180C /begin FUNCTION_LIST /end FUNCTION_LIST /end MEASUREMENT
/begin MEASUREMENT vTBLT "(CK) After the dealing with the belt slide is controlled, torque" SWORD COMP_0228 1 100 -3276.8 3276.7 ECU_ADDRESS 0xFFFF180E /begin FUNCTION_LIST /end FUNCTION_LIST /end MEASUREMENT
/begin MEASUREMENT vTBSVP1 "After the reference pressure progress, time" UWORD COMP_0008 1 100 0 6553500 ECU_ADDRESS 0xFFFF32B6 /begin FUNCTION_LIST /end FUNCTION_LIST /end MEASUREMENT
/begin MEASUREMENT vTCAMCNT "The input number of times for the TCAM input decision" UBYTE COMP_0068 1 100 0 255 ECU_ADDRESS 0xFFFF224C /begin FUNCTION_LIST /end FUNCTION_LIST /end MEASUREMENT
/begin MEASUREMENT vTCANDYT "OK judgement counter" UBYTE COMP_0049 1 100 0 255 ECU_ADDRESS 0xFFFF1810 /begin FUNCTION_LIST /end FUNCTION_LIST /end MEASUREMENT
/begin MEASUREMENT vTCHHL "Lean upper limit/stoichiometric lower limit TTC" SWORD COMP_0228 1 100 -3276.8 3276.7 ECU_ADDRESS 0xFFFF32C0 /begin FUNCTION_LIST /end FUNCTION_LIST /end MEASUREMENT
/begin MEASUREMENT vTCHISL "Idle stratified lean upper limit/idle stoichiometric lower limit TCC" SWORD COMP_0228 1 100 -3276.8 3276.7 ECU_ADDRESS 0xFFFF32C2 /begin FUNCTION_LIST /end FUNCTION_LIST /end MEASUREMENT
/begin MEASUREMENT vTCHSL "Slowdown lean upper limit/homogeneous lean lower limit TTC" SWORD COMP_0228 1 100 -3276.8 3276.7 ECU_ADDRESS 0xFFFF32C4 /begin FUNCTION_LIST /end FUNCTION_LIST /end MEASUREMENT
/begin MEASUREMENT vTCLRf "Judgement condition (3) formation flag" UBYTE COMP_0004 1 100 0 255 ECU_ADDRESS 0xFFFF32CA /begin FUNCTION_LIST /end FUNCTION_LIST /end MEASUREMENT
/begin MEASUREMENT vTCLSL "Slowdown lean lower limit/slowdown stoichiometric upper limit TTC" SWORD COMP_0228 1 100 -3276.8 3276.7 ECU_ADDRESS 0xFFFF32CC /begin FUNCTION_LIST /end FUNCTION_LIST /end MEASUREMENT
/begin MEASUREMENT vTCNT0 "At the time of the POS10 signal interruption, micro-computer timer value (timer0)" ULONG COMP_0494 1 100 0 429496729500 ECU_ADDRESS 0xFFFF1824 /begin FUNCTION_LIST /end FUNCTION_LIST /end MEASUREMENT
/begin MEASUREMENT vTCONECT "Timer for 100mS job" UBYTE COMP_0014 1 100 0 2550 ECU_ADDRESS 0xFFFF3F44 /begin FUNCTION_LIST /end FUNCTION_LIST /end MEASUREMENT
/begin MEASUREMENT vTCSMODMX "Fuel cut requirement cylinder number maximum value" UBYTE COMP_0071_S 1 100 0 84.999999915 ECU_ADDRESS 0xFFFF32D2 /begin FUNCTION_LIST /end FUNCTION_LIST /end MEASUREMENT
/begin MEASUREMENT vTCSNGCD "TCS At the time of the unusual judgement, TCSCMD" UBYTE COMP_0247 1 100 0 63.75 ECU_ADDRESS 0xFFFF32D3 /begin FUNCTION_LIST /end FUNCTION_LIST /end MEASUREMENT
/begin MEASUREMENT vTDABF50 "For delta-A/F computed periodic measuring" UBYTE COMP_0014 1 100 0 2550 ECU_ADDRESS 0xFFFF32D4 /begin FUNCTION_LIST /end FUNCTION_LIST /end MEASUREMENT
/begin MEASUREMENT vTDCVC2 "Reference pressure measuring progress timer" UBYTE COMP_0049 1 100 0 255 ECU_ADDRESS 0xFFFF32D6 /begin FUNCTION_LIST /end FUNCTION_LIST /end MEASUREMENT
/begin MEASUREMENT vTDCVCL "Reference pressure measuring timer" UBYTE COMP_0049 1 100 0 255 ECU_ADDRESS 0xFFFF32D7 /begin FUNCTION_LIST /end FUNCTION_LIST /end MEASUREMENT
/begin MEASUREMENT vTDEPRS "100mS judgement counter of the evapo line pressure sensor function diagnosis" UBYTE COMP_0014 1 100 0 2550 ECU_ADDRESS 0xFFFF32D8 /begin FUNCTION_LIST /end FUNCTION_LIST /end MEASUREMENT
/begin MEASUREMENT vTDQCI "The movement condition of the timer DQCI" UBYTE COMP_0004 1 100 0 255 ECU_ADDRESS 0xFFFF182C /begin FUNCTION_LIST /end FUNCTION_LIST /end MEASUREMENT
/begin MEASUREMENT vTDSTAF1f "A START SW ONOFF experience flag for the A/F sensor activated judgement" UBYTE COMP_0004 1 100 0 255 ECU_ADDRESS 0xFFFF1F1E /begin FUNCTION_LIST /end FUNCTION_LIST /end MEASUREMENT
/begin MEASUREMENT vTDVPIL "The 2.1/10.1sec judgement counter of the evapo line pressure sensor function diagnosis" UBYTE COMP_0014 1 100 0 2550 ECU_ADDRESS 0xFFFF32DC /begin FUNCTION_LIST /end FUNCTION_LIST /end MEASUREMENT
/begin MEASUREMENT vTE1INVSz2 "The sign of TE1INV" UBYTE COMP_0004 1 100 0 255 ECU_ADDRESS 0xFFFF184E /begin FUNCTION_LIST /end FUNCTION_LIST /end MEASUREMENT
/begin MEASUREMENT vTE1INVz2 "Inverse filter input torque" ULONG COMP_0630_S 1 100 0 512.007346204245 ECU_ADDRESS 0xFFFF1854 /begin FUNCTION_LIST /end FUNCTION_LIST /end MEASUREMENT
/begin MEASUREMENT vTE2INVSz2 "The sign of TE2INV" UBYTE COMP_0004 1 100 0 255 ECU_ADDRESS 0xFFFF1882 /begin FUNCTION_LIST /end FUNCTION_LIST /end MEASUREMENT
/begin MEASUREMENT vTE2INV_1 "tmp" ULONG COMP_0501 1 100 0 8388758.3219022 ECU_ADDRESS 0xFFFF1860 /begin FUNCTION_LIST /end FUNCTION_LIST /end MEASUREMENT
/begin MEASUREMENT vTE2INV_2 "tmp" ULONG COMP_0501 1 100 0 8388758.3219022 ECU_ADDRESS 0xFFFF1864 /begin FUNCTION_LIST /end FUNCTION_LIST /end MEASUREMENT
/begin MEASUREMENT vTE2INV_3 "tmp" ULONG COMP_0501 1 100 0 8388758.3219022 ECU_ADDRESS 0xFFFF1868 /begin FUNCTION_LIST /end FUNCTION_LIST /end MEASUREMENT
/begin MEASUREMENT vTE2INV_4 "tmp" ULONG COMP_0501 1 100 0 8388758.3219022 ECU_ADDRESS 0xFFFF186C /begin FUNCTION_LIST /end FUNCTION_LIST /end MEASUREMENT
/begin MEASUREMENT vTE2INV_5 "tmp" ULONG COMP_0501 1 100 0 8388758.3219022 ECU_ADDRESS 0xFFFF1870 /begin FUNCTION_LIST /end FUNCTION_LIST /end MEASUREMENT
/begin MEASUREMENT vTE2INV_6 "tmp" ULONG COMP_0501 1 100 0 8388758.3219022 ECU_ADDRESS 0xFFFF1874 /begin FUNCTION_LIST /end FUNCTION_LIST /end MEASUREMENT
/begin MEASUREMENT vTE2INV_7 "tmp" ULONG COMP_0501 1 100 0 8388758.3219022 ECU_ADDRESS 0xFFFF1878 /begin FUNCTION_LIST /end FUNCTION_LIST /end MEASUREMENT
/begin MEASUREMENT vTE2INV_8 "tmp" ULONG COMP_0501 1 100 0 8388758.3219022 ECU_ADDRESS 0xFFFF187C /begin FUNCTION_LIST /end FUNCTION_LIST /end MEASUREMENT
/begin MEASUREMENT vTE2INV_S__6 "RAM value vTE2INV_S_" UBYTE COMP_0004 1 100 0 255 ECU_ADDRESS 0xFFFF1C68 /begin FUNCTION_LIST /end FUNCTION_LIST /end MEASUREMENT
/begin MEASUREMENT vTE2INV_S__5 "RAM value vTE2INV_S_" UBYTE COMP_0004 1 100 0 255 ECU_ADDRESS 0xFFFF1C69 /begin FUNCTION_LIST /end FUNCTION_LIST /end MEASUREMENT
/begin MEASUREMENT vTE2INV_S_ "RAM value vTE2INV_S_" UBYTE COMP_0004 1 100 0 255 ECU_ADDRESS 0xFFFF1C6A /begin FUNCTION_LIST /end FUNCTION_LIST /end MEASUREMENT
/begin MEASUREMENT vTE2INV_S__7 "RAM value vTE2INV_S_" UBYTE COMP_0004 1 100 0 255 ECU_ADDRESS 0xFFFF1C6B /begin FUNCTION_LIST /end FUNCTION_LIST /end MEASUREMENT
/begin MEASUREMENT vTE2INV_S__2 "RAM value vTE2INV_S_" UBYTE COMP_0004 1 100 0 255 ECU_ADDRESS 0xFFFF1C6C /begin FUNCTION_LIST /end FUNCTION_LIST /end MEASUREMENT
/begin MEASUREMENT vTE2INV_S__1 "RAM value vTE2INV_S_" UBYTE COMP_0004 1 100 0 255 ECU_ADDRESS 0xFFFF1C6D /begin FUNCTION_LIST /end FUNCTION_LIST /end MEASUREMENT
/begin MEASUREMENT vTE2INV_S__4 "RAM value vTE2INV_S_" UBYTE COMP_0004 1 100 0 255 ECU_ADDRESS 0xFFFF1C6E /begin FUNCTION_LIST /end FUNCTION_LIST /end MEASUREMENT
/begin MEASUREMENT vTE2INV_S__3 "RAM value vTE2INV_S_" UBYTE COMP_0004 1 100 0 255 ECU_ADDRESS 0xFFFF1C6F /begin FUNCTION_LIST /end FUNCTION_LIST /end MEASUREMENT
/begin MEASUREMENT vTE2INVz2 "Inverse filter output torque" ULONG COMP_0630_S 1 100 0 512.007346204245 ECU_ADDRESS 0xFFFF1888 /begin FUNCTION_LIST /end FUNCTION_LIST /end MEASUREMENT
/begin MEASUREMENT vTEB "Effective pulse width" UWORD COMP_0125 1 100 0 255.99609375 ECU_ADDRESS 0xFFFF188C /begin FUNCTION_LIST /end FUNCTION_LIST /end MEASUREMENT
/begin MEASUREMENT vTEB_R#1 "Effective pulse width" UWORD COMP_0125 1 100 0 255.99609375 ECU_ADDRESS 0xFFFF188C /begin FUNCTION_LIST /end FUNCTION_LIST /end MEASUREMENT
/begin MEASUREMENT vTEB_R#2 "Effective pulse width" UWORD COMP_0125 1 100 0 255.99609375 ECU_ADDRESS 0xFFFF188E /begin FUNCTION_LIST /end FUNCTION_LIST /end MEASUREMENT
/begin MEASUREMENT vTEGRAR "An opening area for ignition timing compensation" UWORD COMP_0345 1 100 0 209.712 ECU_ADDRESS 0xFFFF1894 /begin FUNCTION_LIST /end FUNCTION_LIST /end MEASUREMENT
/begin MEASUREMENT vTEGRMX "EGR temperature maximum value" UBYTE COMP_0035 1 100 -50 205 ECU_ADDRESS 0xFFFF32DD /begin FUNCTION_LIST /end FUNCTION_LIST /end MEASUREMENT
/begin MEASUREMENT vTEGRO02 "In front of 2s, TEGR" UBYTE COMP_0035 1 100 -50 205 ECU_ADDRESS 0xFFFF3F47 /begin FUNCTION_LIST /end FUNCTION_LIST /end MEASUREMENT
/begin MEASUREMENT vTEGRO04 "In front of 4s, TEGR" UBYTE COMP_0035 1 100 -50 205 ECU_ADDRESS 0xFFFF3F48 /begin FUNCTION_LIST /end FUNCTION_LIST /end MEASUREMENT
/begin MEASUREMENT vTEGRO06 "In front of 6s, TEGR" UBYTE COMP_0035 1 100 -50 205 ECU_ADDRESS 0xFFFF3F49 /begin FUNCTION_LIST /end FUNCTION_LIST /end MEASUREMENT
/begin MEASUREMENT vTEGRO08 "In front of 8s, TEGR" UBYTE COMP_0035 1 100 -50 205 ECU_ADDRESS 0xFFFF3F4A /begin FUNCTION_LIST /end FUNCTION_LIST /end MEASUREMENT
/begin MEASUREMENT vTEGRO1 "In front of EGRTM1#, EGRT" UBYTE COMP_0035 1 100 -50 205 ECU_ADDRESS 0xFFFF32DE /begin FUNCTION_LIST /end FUNCTION_LIST /end MEASUREMENT
/begin MEASUREMENT vTEGRO10 "In front of 10s, TEGR" UBYTE COMP_0035 1 100 -50 205 ECU_ADDRESS 0xFFFF3F4B /begin FUNCTION_LIST /end FUNCTION_LIST /end MEASUREMENT
/begin MEASUREMENT vTEGRO2 "In front of EGRTM2#, EGRT" UBYTE COMP_0035 1 100 -50 205 ECU_ADDRESS 0xFFFF32DF /begin FUNCTION_LIST /end FUNCTION_LIST /end MEASUREMENT
/begin MEASUREMENT vTEGROK "TEGRMX- OK judgement value" UBYTE COMP_0035 1 100 -50 205 ECU_ADDRESS 0xFFFF32E0 /begin FUNCTION_LIST /end FUNCTION_LIST /end MEASUREMENT
/begin MEASUREMENT vTEPDID_S "Inverse filter input PTD torque (FAST)" SWORD COMP_0228 1 100 -3276.8 3276.7 ECU_ADDRESS 0xFFFF1C70 /begin FUNCTION_LIST /end FUNCTION_LIST /end MEASUREMENT
/begin MEASUREMENT vTESMO2 "O2 sensor element estimated temperature" UBYTE COMP_0062 1 100 0 1020 ECU_ADDRESS 0xFFFF32E4 /begin FUNCTION_LIST /end FUNCTION_LIST /end MEASUREMENT
/begin MEASUREMENT vTF "Fuel temperature sensor voltage" UBYTE COMP_0054 1 100 0 5100 ECU_ADDRESS 0xFFFF89C9 /begin FUNCTION_LIST /end FUNCTION_LIST /end MEASUREMENT
/begin MEASUREMENT vTFBYA1 "Target air-fuel ratio (1)" UWORD COMP_0057 1 100 0 3.999941832 ECU_ADDRESS 0xFFFF18B2 /begin FUNCTION_LIST /end FUNCTION_LIST /end MEASUREMENT
/begin MEASUREMENT vTFBYA2 "Target air-fuel ratio (2)" UWORD COMP_0057 1 100 0 3.999941832 ECU_ADDRESS 0xFFFF18B4 /begin FUNCTION_LIST /end FUNCTION_LIST /end MEASUREMENT
/begin MEASUREMENT vTFBYA2N "Target air-fuel ratio (2), one after another, arrangement" UWORD COMP_0057 1 100 0 3.999941832 ECU_ADDRESS 0xFFFF18B6 /begin FUNCTION_LIST /end FUNCTION_LIST /end MEASUREMENT
/begin MEASUREMENT vTFBYA2N_R#1 "Target air-fuel ratio (2), one after another, arrangement" UWORD COMP_0057 1 100 0 3.999941832 ECU_ADDRESS 0xFFFF18B6 /begin FUNCTION_LIST /end FUNCTION_LIST /end MEASUREMENT
/begin MEASUREMENT vTFBYA2N_R#2 "Target air-fuel ratio (2), one after another, arrangement" UWORD COMP_0057 1 100 0 3.999941832 ECU_ADDRESS 0xFFFF18B8 /begin FUNCTION_LIST /end FUNCTION_LIST /end MEASUREMENT
/begin MEASUREMENT vTFBYA2N_R#3 "Target air-fuel ratio (2), one after another, arrangement" UWORD COMP_0057 1 100 0 3.999941832 ECU_ADDRESS 0xFFFF18BA /begin FUNCTION_LIST /end FUNCTION_LIST /end MEASUREMENT
/begin MEASUREMENT vTFBYA2N_R#4 "Target air-fuel ratio (2), one after another, arrangement" UWORD COMP_0057 1 100 0 3.999941832 ECU_ADDRESS 0xFFFF18BC /begin FUNCTION_LIST /end FUNCTION_LIST /end MEASUREMENT
/begin MEASUREMENT vTFBYA2N_R#5 "Target air-fuel ratio (2), one after another, arrangement" UWORD COMP_0057 1 100 0 3.999941832 ECU_ADDRESS 0xFFFF18BE /begin FUNCTION_LIST /end FUNCTION_LIST /end MEASUREMENT
/begin MEASUREMENT vTFBYA2N_R#6 "Target air-fuel ratio (2), one after another, arrangement" UWORD COMP_0057 1 100 0 3.999941832 ECU_ADDRESS 0xFFFF18C0 /begin FUNCTION_LIST /end FUNCTION_LIST /end MEASUREMENT
/begin MEASUREMENT vTFBYA2N_R#7 "Target air-fuel ratio (2), one after another, arrangement" UWORD COMP_0057 1 100 0 3.999941832 ECU_ADDRESS 0xFFFF18C2 /begin FUNCTION_LIST /end FUNCTION_LIST /end MEASUREMENT
/begin MEASUREMENT vTFBYA2N_R#8 "Target air-fuel ratio (2), one after another, arrangement" UWORD COMP_0057 1 100 0 3.999941832 ECU_ADDRESS 0xFFFF18C4 /begin FUNCTION_LIST /end FUNCTION_LIST /end MEASUREMENT
/begin MEASUREMENT vTFBYA2N_R#9 "Target air-fuel ratio (2), one after another, arrangement" UWORD COMP_0057 1 100 0 3.999941832 ECU_ADDRESS 0xFFFF18C6 /begin FUNCTION_LIST /end FUNCTION_LIST /end MEASUREMENT
/begin MEASUREMENT vTFBYA2N_R#10 "Target air-fuel ratio (2), one after another, arrangement" UWORD COMP_0057 1 100 0 3.999941832 ECU_ADDRESS 0xFFFF18C8 /begin FUNCTION_LIST /end FUNCTION_LIST /end MEASUREMENT
/begin MEASUREMENT vTFBYA3 "Target air-fuel ratio (3)" UWORD COMP_0057 1 100 0 3.999941832 ECU_ADDRESS 0xFFFF103A /begin FUNCTION_LIST /end FUNCTION_LIST /end MEASUREMENT
/begin MEASUREMENT vTFBYA4 "Target air-fuel ratio (4)" UWORD COMP_0057 1 100 0 3.999941832 ECU_ADDRESS 0xFFFF103C /begin FUNCTION_LIST /end FUNCTION_LIST /end MEASUREMENT
/begin MEASUREMENT vTFBYADH "Target air-fuel ratio phase compensation (The one for the high response torque has been added.)" UWORD COMP_0057 1 100 0 3.999941832 ECU_ADDRESS 0xFFFF18CE /begin FUNCTION_LIST /end FUNCTION_LIST /end MEASUREMENT
/begin MEASUREMENT vTFBYADR "Target air-fuel ratio limiter treatment value" UWORD COMP_0057 1 100 0 3.999941832 ECU_ADDRESS 0xFFFF18D0 /begin FUNCTION_LIST /end FUNCTION_LIST /end MEASUREMENT
/begin MEASUREMENT vTFBYANB "At the time of the stratified, after the F/C limiter, TFBYA" UWORD COMP_0057 1 100 0 3.999941832 ECU_ADDRESS 0xFFFF18D2 /begin FUNCTION_LIST /end FUNCTION_LIST /end MEASUREMENT
/begin MEASUREMENT vTFDACC "ACC drive power order value" SWORD COMP_0030_S 1 100 -32768 32767 ECU_ADDRESS 0xFFFF32EE /begin FUNCTION_LIST /end FUNCTION_LIST /end MEASUREMENT
/begin MEASUREMENT vTFDCC "ASCD drive power order value" SWORD COMP_0030_S 1 100 -32768 32767 ECU_ADDRESS 0xFFFF4248 /begin FUNCTION_LIST /end FUNCTION_LIST /end MEASUREMENT
/begin MEASUREMENT vTFDCOMB "Drive power reference value" SWORD COMP_0030_S 1 100 -32768 32767 ECU_ADDRESS 0xFFFF32F2 /begin FUNCTION_LIST /end FUNCTION_LIST /end MEASUREMENT
/begin MEASUREMENT vTFDSL "Speed limiter drive power order value" SWORD COMP_0030_S 1 100 -32768 32767 ECU_ADDRESS 0xFFFF424A /begin FUNCTION_LIST /end FUNCTION_LIST /end MEASUREMENT
/begin MEASUREMENT vTFEND "At the time of the key off, fuel temperature" UBYTE COMP_0035 1 100 -50 205 ECU_ADDRESS 0xFFFFA089 /begin FUNCTION_LIST /end FUNCTION_LIST /end MEASUREMENT
/begin MEASUREMENT vTFEX "TF Unusual value judgement counter" UBYTE COMP_0004 1 100 0 255 ECU_ADDRESS 0xFFFF1F1F /begin FUNCTION_LIST /end FUNCTION_LIST /end MEASUREMENT
/begin MEASUREMENT vTFK "A fuel temperature for the table reference" UBYTE COMP_0356 1 100 -40 119.375 ECU_ADDRESS 0xFFFF89CB /begin FUNCTION_LIST /end FUNCTION_LIST /end MEASUREMENT
/begin MEASUREMENT vTFKINT "At the time of the start for the table reference, fuel temperature" UBYTE COMP_0356 1 100 -40 119.375 ECU_ADDRESS 0xFFFF1F20 /begin FUNCTION_LIST /end FUNCTION_LIST /end MEASUREMENT
/begin MEASUREMENT vTFNNEW "Fuel temperature, this time, value" UBYTE COMP_0035 1 100 -50 205 ECU_ADDRESS 0xFFFF1F21 /begin FUNCTION_LIST /end FUNCTION_LIST /end MEASUREMENT
/begin MEASUREMENT vTFSETH "Injection output pulse width by the homogeneous cylinder" ULONG COMP_0320 1 100 0 6871947672 ECU_ADDRESS 0xFFFF18E8 /begin FUNCTION_LIST /end FUNCTION_LIST /end MEASUREMENT
/begin MEASUREMENT vTFSETS "Injection output pulse width by the stratified cylinder" ULONG COMP_0320 1 100 0 6871947672 ECU_ADDRESS 0xFFFF1900 /begin FUNCTION_LIST /end FUNCTION_LIST /end MEASUREMENT
/begin MEASUREMENT vTFST1 "Pre-pressure check start judgement fuel temperature decline fee" UBYTE COMP_0003 1 100 0 255 ECU_ADDRESS 0xFFFF1918 /begin FUNCTION_LIST /end FUNCTION_LIST /end MEASUREMENT
/begin MEASUREMENT vTGADNVCM "Normalized opening area basic value (common torque)" UWORD COMP_0303_S 1 100 0 2.5599609375E-06 ECU_ADDRESS 0xFFFF32FA /begin FUNCTION_LIST /end FUNCTION_LIST /end MEASUREMENT
/begin MEASUREMENT vTGAFCMPf "Target A/F fixed control flag" UBYTE COMP_0004 1 100 0 255 ECU_ADDRESS 0xFFFF32FC /begin FUNCTION_LIST /end FUNCTION_LIST /end MEASUREMENT
/begin MEASUREMENT vTGALPRL "Gain learning table (the left bank)" UBYTE COMP_0015 1 100 0 31.875 ECU_ADDRESS 0xFFFFB244 /begin FUNCTION_LIST /end FUNCTION_LIST /end MEASUREMENT
/begin MEASUREMENT vTGALPRL_R#1 "Gain learning table (the left bank)" UBYTE COMP_0015 1 100 0 31.875 ECU_ADDRESS 0xFFFFB244 /begin FUNCTION_LIST /end FUNCTION_LIST /end MEASUREMENT
/begin MEASUREMENT vTGALPRL_R#2 "Gain learning table (the left bank)" UBYTE COMP_0015 1 100 0 31.875 ECU_ADDRESS 0xFFFFB245 /begin FUNCTION_LIST /end FUNCTION_LIST /end MEASUREMENT
/begin MEASUREMENT vTGALPRL_R#3 "Gain learning table (the left bank)" UBYTE COMP_0015 1 100 0 31.875 ECU_ADDRESS 0xFFFFB246 /begin FUNCTION_LIST /end FUNCTION_LIST /end MEASUREMENT
/begin MEASUREMENT vTGALPRL_R#4 "Gain learning table (the left bank)" UBYTE COMP_0015 1 100 0 31.875 ECU_ADDRESS 0xFFFFB247 /begin FUNCTION_LIST /end FUNCTION_LIST /end MEASUREMENT
/begin MEASUREMENT vTGALPRL_R#5 "Gain learning table (the left bank)" UBYTE COMP_0015 1 100 0 31.875 ECU_ADDRESS 0xFFFFB248 /begin FUNCTION_LIST /end FUNCTION_LIST /end MEASUREMENT
/begin MEASUREMENT vTGALPRL_R#6 "Gain learning table (the left bank)" UBYTE COMP_0015 1 100 0 31.875 ECU_ADDRESS 0xFFFFB249 /begin FUNCTION_LIST /end FUNCTION_LIST /end MEASUREMENT
/begin MEASUREMENT vTGALPRL_R#7 "Gain learning table (the left bank)" UBYTE COMP_0015 1 100 0 31.875 ECU_ADDRESS 0xFFFFB24A /begin FUNCTION_LIST /end FUNCTION_LIST /end MEASUREMENT
/begin MEASUREMENT vTGALPRL_R#8 "Gain learning table (the left bank)" UBYTE COMP_0015 1 100 0 31.875 ECU_ADDRESS 0xFFFFB24B /begin FUNCTION_LIST /end FUNCTION_LIST /end MEASUREMENT
/begin MEASUREMENT vTGALPRNL "Gain learning table (the left bank)" UBYTE COMP_0425_S 1 100 -1 30.875 ECU_ADDRESS 0xFFFFB24C /begin FUNCTION_LIST /end FUNCTION_LIST /end MEASUREMENT
/begin MEASUREMENT vTGALPRNL_R#1 "Gain learning table (the left bank)" UBYTE COMP_0425_S 1 100 -1 30.875 ECU_ADDRESS 0xFFFFB24C /begin FUNCTION_LIST /end FUNCTION_LIST /end MEASUREMENT
/begin MEASUREMENT vTGALPRNL_R#2 "Gain learning table (the left bank)" UBYTE COMP_0425_S 1 100 -1 30.875 ECU_ADDRESS 0xFFFFB24D /begin FUNCTION_LIST /end FUNCTION_LIST /end MEASUREMENT
/begin MEASUREMENT vTGALPRNL_R#3 "Gain learning table (the left bank)" UBYTE COMP_0425_S 1 100 -1 30.875 ECU_ADDRESS 0xFFFFB24E /begin FUNCTION_LIST /end FUNCTION_LIST /end MEASUREMENT
/begin MEASUREMENT vTGALPRNL_R#4 "Gain learning table (the left bank)" UBYTE COMP_0425_S 1 100 -1 30.875 ECU_ADDRESS 0xFFFFB24F /begin FUNCTION_LIST /end FUNCTION_LIST /end MEASUREMENT
/begin MEASUREMENT vTGALPRNL_R#5 "Gain learning table (the left bank)" UBYTE COMP_0425_S 1 100 -1 30.875 ECU_ADDRESS 0xFFFFB250 /begin FUNCTION_LIST /end FUNCTION_LIST /end MEASUREMENT
/begin MEASUREMENT vTGALPRNL_R#6 "Gain learning table (the left bank)" UBYTE COMP_0425_S 1 100 -1 30.875 ECU_ADDRESS 0xFFFFB251 /begin FUNCTION_LIST /end FUNCTION_LIST /end MEASUREMENT
/begin MEASUREMENT vTGALPRNL_R#7 "Gain learning table (the left bank)" UBYTE COMP_0425_S 1 100 -1 30.875 ECU_ADDRESS 0xFFFFB252 /begin FUNCTION_LIST /end FUNCTION_LIST /end MEASUREMENT
/begin MEASUREMENT vTGALPRNL_R#8 "Gain learning table (the left bank)" UBYTE COMP_0425_S 1 100 -1 30.875 ECU_ADDRESS 0xFFFFB253 /begin FUNCTION_LIST /end FUNCTION_LIST /end MEASUREMENT
/begin MEASUREMENT vTGALPRNR "Gain learning table (the right bank)" UBYTE COMP_0425_S 1 100 -1 30.875 ECU_ADDRESS 0xFFFFB254 /begin FUNCTION_LIST /end FUNCTION_LIST /end MEASUREMENT
/begin MEASUREMENT vTGALPRNR_R#1 "Gain learning table (the right bank)" UBYTE COMP_0425_S 1 100 -1 30.875 ECU_ADDRESS 0xFFFFB254 /begin FUNCTION_LIST /end FUNCTION_LIST /end MEASUREMENT
/begin MEASUREMENT vTGALPRNR_R#2 "Gain learning table (the right bank)" UBYTE COMP_0425_S 1 100 -1 30.875 ECU_ADDRESS 0xFFFFB255 /begin FUNCTION_LIST /end FUNCTION_LIST /end MEASUREMENT
/begin MEASUREMENT vTGALPRNR_R#3 "Gain learning table (the right bank)" UBYTE COMP_0425_S 1 100 -1 30.875 ECU_ADDRESS 0xFFFFB256 /begin FUNCTION_LIST /end FUNCTION_LIST /end MEASUREMENT
/begin MEASUREMENT vTGALPRNR_R#4 "Gain learning table (the right bank)" UBYTE COMP_0425_S 1 100 -1 30.875 ECU_ADDRESS 0xFFFFB257 /begin FUNCTION_LIST /end FUNCTION_LIST /end MEASUREMENT
/begin MEASUREMENT vTGALPRNR_R#5 "Gain learning table (the right bank)" UBYTE COMP_0425_S 1 100 -1 30.875 ECU_ADDRESS 0xFFFFB258 /begin FUNCTION_LIST /end FUNCTION_LIST /end MEASUREMENT
/begin MEASUREMENT vTGALPRNR_R#6 "Gain learning table (the right bank)" UBYTE COMP_0425_S 1 100 -1 30.875 ECU_ADDRESS 0xFFFFB259 /begin FUNCTION_LIST /end FUNCTION_LIST /end MEASUREMENT
/begin MEASUREMENT vTGALPRNR_R#7 "Gain learning table (the right bank)" UBYTE COMP_0425_S 1 100 -1 30.875 ECU_ADDRESS 0xFFFFB25A /begin FUNCTION_LIST /end FUNCTION_LIST /end MEASUREMENT
/begin MEASUREMENT vTGALPRNR_R#8 "Gain learning table (the right bank)" UBYTE COMP_0425_S 1 100 -1 30.875 ECU_ADDRESS 0xFFFFB25B /begin FUNCTION_LIST /end FUNCTION_LIST /end MEASUREMENT
/begin MEASUREMENT vTGALPRR "Gain learning table (the right bank)" UBYTE COMP_0015 1 100 0 31.875 ECU_ADDRESS 0xFFFFB25C /begin FUNCTION_LIST /end FUNCTION_LIST /end MEASUREMENT
/begin MEASUREMENT vTGALPRR_R#1 "Gain learning table (the right bank)" UBYTE COMP_0015 1 100 0 31.875 ECU_ADDRESS 0xFFFFB25C /begin FUNCTION_LIST /end FUNCTION_LIST /end MEASUREMENT
/begin MEASUREMENT vTGALPRR_R#2 "Gain learning table (the right bank)" UBYTE COMP_0015 1 100 0 31.875 ECU_ADDRESS 0xFFFFB25D /begin FUNCTION_LIST /end FUNCTION_LIST /end MEASUREMENT
/begin MEASUREMENT vTGALPRR_R#3 "Gain learning table (the right bank)" UBYTE COMP_0015 1 100 0 31.875 ECU_ADDRESS 0xFFFFB25E /begin FUNCTION_LIST /end FUNCTION_LIST /end MEASUREMENT
/begin MEASUREMENT vTGALPRR_R#4 "Gain learning table (the right bank)" UBYTE COMP_0015 1 100 0 31.875 ECU_ADDRESS 0xFFFFB25F /begin FUNCTION_LIST /end FUNCTION_LIST /end MEASUREMENT
/begin MEASUREMENT vTGALPRR_R#5 "Gain learning table (the right bank)" UBYTE COMP_0015 1 100 0 31.875 ECU_ADDRESS 0xFFFFB260 /begin FUNCTION_LIST /end FUNCTION_LIST /end MEASUREMENT
/begin MEASUREMENT vTGALPRR_R#6 "Gain learning table (the right bank)" UBYTE COMP_0015 1 100 0 31.875 ECU_ADDRESS 0xFFFFB261 /begin FUNCTION_LIST /end FUNCTION_LIST /end MEASUREMENT
/begin MEASUREMENT vTGALPRR_R#7 "Gain learning table (the right bank)" UBYTE COMP_0015 1 100 0 31.875 ECU_ADDRESS 0xFFFFB262 /begin FUNCTION_LIST /end FUNCTION_LIST /end MEASUREMENT
/begin MEASUREMENT vTGALPRR_R#8 "Gain learning table (the right bank)" UBYTE COMP_0015 1 100 0 31.875 ECU_ADDRESS 0xFFFFB263 /begin FUNCTION_LIST /end FUNCTION_LIST /end MEASUREMENT
/begin MEASUREMENT vTGALTV0 "Alternator target generating electricity voltage" UBYTE COMP_0033 1 100 0 20400 ECU_ADDRESS 0xFFFF1921 /begin FUNCTION_LIST /end FUNCTION_LIST /end MEASUREMENT
/begin MEASUREMENT vTGALTVZ "The voltage (after the change rate limitation) that alternator virtual is directed, last time, (before 1sec) value" UBYTE COMP_0033 1 100 0 20400 ECU_ADDRESS 0xFFFF1922 /begin FUNCTION_LIST /end FUNCTION_LIST /end MEASUREMENT
/begin MEASUREMENT vTGM8E "Evapo test executive timer" UBYTE COMP_0096 1 100 0 2550 ECU_ADDRESS 0xFFFF3304 /begin FUNCTION_LIST /end FUNCTION_LIST /end MEASUREMENT
/begin MEASUREMENT vTGRTO1 "Actual gear ratio estimated value 1" UWORD COMP_0450 1 100 0 63.999056205 ECU_ADDRESS 0xFFFF1924 /begin FUNCTION_LIST /end FUNCTION_LIST /end MEASUREMENT
/begin MEASUREMENT vTGRTO2 "Actual gear ratio estimated value 2" UWORD COMP_0450 1 100 0 63.999056205 ECU_ADDRESS 0xFFFF1926 /begin FUNCTION_LIST /end FUNCTION_LIST /end MEASUREMENT
/begin MEASUREMENT vTGTVODG "After the diagnosis, target throttle open-degree" UWORD COMP_0130 1 100 0 1802.2125 ECU_ADDRESS 0xFFFF330C /begin FUNCTION_LIST /end FUNCTION_LIST /end MEASUREMENT
/begin MEASUREMENT vTGTVOZ "TGTVO previous value" UWORD COMP_0130 1 100 0 1802.2125 ECU_ADDRESS 0xFFFF330E /begin FUNCTION_LIST /end FUNCTION_LIST /end MEASUREMENT
/begin MEASUREMENT vTGTVOZ_R#1 "TGTVO previous value" UWORD COMP_0130 1 100 0 1802.2125 ECU_ADDRESS 0xFFFF330E /begin FUNCTION_LIST /end FUNCTION_LIST /end MEASUREMENT
/begin MEASUREMENT vTGTVOZ_R#2 "TGTVO previous value" UWORD COMP_0130 1 100 0 1802.2125 ECU_ADDRESS 0xFFFF3310 /begin FUNCTION_LIST /end FUNCTION_LIST /end MEASUREMENT
/begin MEASUREMENT vTGTVOZ_R#3 "TGTVO previous value" UWORD COMP_0130 1 100 0 1802.2125 ECU_ADDRESS 0xFFFF3312 /begin FUNCTION_LIST /end FUNCTION_LIST /end MEASUREMENT
/begin MEASUREMENT vTGTVOZ_R#4 "TGTVO previous value" UWORD COMP_0130 1 100 0 1802.2125 ECU_ADDRESS 0xFFFF3314 /begin FUNCTION_LIST /end FUNCTION_LIST /end MEASUREMENT
/begin MEASUREMENT vTGTVOZ_R#5 "TGTVO previous value" UWORD COMP_0130 1 100 0 1802.2125 ECU_ADDRESS 0xFFFF3316 /begin FUNCTION_LIST /end FUNCTION_LIST /end MEASUREMENT
/begin MEASUREMENT vTGTVOZ_R#6 "TGTVO previous value" UWORD COMP_0130 1 100 0 1802.2125 ECU_ADDRESS 0xFFFF3318 /begin FUNCTION_LIST /end FUNCTION_LIST /end MEASUREMENT
/begin MEASUREMENT vTGTVOZ_R#7 "TGTVO previous value" UWORD COMP_0130 1 100 0 1802.2125 ECU_ADDRESS 0xFFFF331A /begin FUNCTION_LIST /end FUNCTION_LIST /end MEASUREMENT
/begin MEASUREMENT vTGTVOZ_R#8 "TGTVO previous value" UWORD COMP_0130 1 100 0 1802.2125 ECU_ADDRESS 0xFFFF331C /begin FUNCTION_LIST /end FUNCTION_LIST /end MEASUREMENT
/begin MEASUREMENT vTGTVOZ_R#9 "TGTVO previous value" UWORD COMP_0130 1 100 0 1802.2125 ECU_ADDRESS 0xFFFF331E /begin FUNCTION_LIST /end FUNCTION_LIST /end MEASUREMENT
/begin MEASUREMENT vTGTVOZ_R#10 "TGTVO previous value" UWORD COMP_0130 1 100 0 1802.2125 ECU_ADDRESS 0xFFFF3320 /begin FUNCTION_LIST /end FUNCTION_LIST /end MEASUREMENT
/begin MEASUREMENT vTGTVOZ_R#11 "TGTVO previous value" UWORD COMP_0130 1 100 0 1802.2125 ECU_ADDRESS 0xFFFF3322 /begin FUNCTION_LIST /end FUNCTION_LIST /end MEASUREMENT
/begin MEASUREMENT vTHTWLMT "High coolant temperature limit torque table work RAM" UWORD COMP_0226 1 100 -3276.8 3276.7 ECU_ADDRESS 0xFFFF192C /begin FUNCTION_LIST /end FUNCTION_LIST /end MEASUREMENT
/begin MEASUREMENT vTHVO2Tf "Parameter monitor RAM renewal judgement" UBYTE COMP_0004 1 100 0 255 ECU_ADDRESS 0xFFFF3328 /begin FUNCTION_LIST /end FUNCTION_LIST /end MEASUREMENT
/begin MEASUREMENT vTIM40MS "A counter for 200mS JOB formation" UBYTE COMP_0016 1 100 0 255 ECU_ADDRESS 0xFFFF332A /begin FUNCTION_LIST /end FUNCTION_LIST /end MEASUREMENT
/begin MEASUREMENT vTIMCLK "There is IC3 output clock profit çûÇ›, no distinction RAM" UBYTE COMP_0068 1 100 0 255 ECU_ADDRESS 0xFFFF3F4E /begin FUNCTION_LIST /end FUNCTION_LIST /end MEASUREMENT
/begin MEASUREMENT vTIMDOS "DOS feedback (bank1 side) experience integration time for the option F.F. data buffer" UBYTE COMP_0013 1 100 0 255 ECU_ADDRESS 0xFFFF332B /begin FUNCTION_LIST /end FUNCTION_LIST /end MEASUREMENT
/begin MEASUREMENT vTIMECF "CF receiving timer (N_Cr)" UWORD COMP_0053 1 100 0 65535 ECU_ADDRESS 0xFFFF35C8 /begin FUNCTION_LIST /end FUNCTION_LIST /end MEASUREMENT
/begin MEASUREMENT vTIMECONF "ACK receiving timer (N_As/N_Ar)" UWORD COMP_0053 1 100 0 65535 ECU_ADDRESS 0xFFFF35CA /begin FUNCTION_LIST /end FUNCTION_LIST /end MEASUREMENT
/begin MEASUREMENT vTIMEFC "FC receiving timer (N_Bs)" UWORD COMP_0053 1 100 0 65535 ECU_ADDRESS 0xFFFF35CC /begin FUNCTION_LIST /end FUNCTION_LIST /end MEASUREMENT
/begin MEASUREMENT vTIMING "40mS JOB preparation counter" UBYTE COMP_0053 1 100 0 255 ECU_ADDRESS 0xFFFF3F4F /begin FUNCTION_LIST /end FUNCTION_LIST /end MEASUREMENT
/begin MEASUREMENT vTIMINT "After the start for the option F.F. data buffer, time" UBYTE COMP_0096 1 100 0 2550 ECU_ADDRESS 0xFFFF332C /begin FUNCTION_LIST /end FUNCTION_LIST /end MEASUREMENT
/begin MEASUREMENT vTIMPV1 "10mS counter for the coolant temperature monitor time" UBYTE COMP_0014 1 100 0 2550 ECU_ADDRESS 0xFFFF332D /begin FUNCTION_LIST /end FUNCTION_LIST /end MEASUREMENT
/begin MEASUREMENT vTIMPV2 "10mS counter for the mailbox ventilation time" UBYTE COMP_0014 1 100 0 2550 ECU_ADDRESS 0xFFFF332E /begin FUNCTION_LIST /end FUNCTION_LIST /end MEASUREMENT
/begin MEASUREMENT vTIN3 "MISx denominator" ULONG COMP_0068 1 100 0 4294967295 ECU_ADDRESS 0xFFFF3748 /begin FUNCTION_LIST /end FUNCTION_LIST /end MEASUREMENT
/begin MEASUREMENT vTIST5 "At the time of the initial injection, output pulse width #5" UWORD COMP_0192 1 100 0 655350 ECU_ADDRESS 0xFFFF2426 /begin FUNCTION_LIST /end FUNCTION_LIST /end MEASUREMENT
/begin MEASUREMENT vTISTF5 "After initial injection ZD-ization compensation, pulse width #5" UWORD COMP_0192 1 100 0 655350 ECU_ADDRESS 0xFFFF2432 /begin FUNCTION_LIST /end FUNCTION_LIST /end MEASUREMENT
/begin MEASUREMENT vTKTEXD "KTEXDY measuring timer" UBYTE COMP_0096 1 100 0 2550 ECU_ADDRESS 0xFFFF3336 /begin FUNCTION_LIST /end FUNCTION_LIST /end MEASUREMENT
/begin MEASUREMENT vTM2CONT "At the time of the engine rotation, ÉÇÅ[Ég 2 control time measuring timer" UBYTE COMP_0014 1 100 0 2550 ECU_ADDRESS 0xFFFF3F50 /begin FUNCTION_LIST /end FUNCTION_LIST /end MEASUREMENT
/begin MEASUREMENT vTM500ms "500mS fixed time treatment timer" UBYTE COMP_0008 1 100 0 25500 ECU_ADDRESS 0xFFFF3F51 /begin FUNCTION_LIST /end FUNCTION_LIST /end MEASUREMENT
/begin MEASUREMENT vTMADJM1f "TMADJM1 measuring condition" UBYTE COMP_0004 1 100 0 255 ECU_ADDRESS 0xFFFF3F53 /begin FUNCTION_LIST /end FUNCTION_LIST /end MEASUREMENT
/begin MEASUREMENT vTMBLRE "VTC maximum-retard degree diagnosis reference position initial deviation quantity computed counter" UBYTE COMP_0008 1 100 0 25500 ECU_ADDRESS 0xFFFF193C /begin FUNCTION_LIST /end FUNCTION_LIST /end MEASUREMENT
/begin MEASUREMENT vTMBLRE_R#1 "VTC maximum-retard degree diagnosis reference position initial deviation quantity computed counter" UBYTE COMP_0008 1 100 0 25500 ECU_ADDRESS 0xFFFF193C /begin FUNCTION_LIST /end FUNCTION_LIST /end MEASUREMENT
/begin MEASUREMENT vTMBLRE_R#2 "VTC maximum-retard degree diagnosis reference position initial deviation quantity computed counter" UBYTE COMP_0008 1 100 0 25500 ECU_ADDRESS 0xFFFF193D /begin FUNCTION_LIST /end FUNCTION_LIST /end MEASUREMENT
/begin MEASUREMENT vTMBMIN "Negative pressure sensor OPEN/SHORT judgement delay time MIN value" UBYTE COMP_0008 1 100 0 25500 ECU_ADDRESS 0xFFFFB654 /begin FUNCTION_LIST /end FUNCTION_LIST /end MEASUREMENT
/begin MEASUREMENT vTMCDC2NG "Drain-cut /V function diagnosis 2 judgement delay timer" UBYTE COMP_0008 1 100 0 25500 ECU_ADDRESS 0xFFFF333A /begin FUNCTION_LIST /end FUNCTION_LIST /end MEASUREMENT
/begin MEASUREMENT vTMCDLS1 "After the purge control valve open, delay timer" UBYTE COMP_0008 1 100 0 25500 ECU_ADDRESS 0xFFFF333B /begin FUNCTION_LIST /end FUNCTION_LIST /end MEASUREMENT
/begin MEASUREMENT vTMCDLS2 "After the purge control valve open, delay timer" UBYTE COMP_0008 1 100 0 25500 ECU_ADDRESS 0xFFFF333C /begin FUNCTION_LIST /end FUNCTION_LIST /end MEASUREMENT
/begin MEASUREMENT vTMCNT "Timer counter" UWORD COMP_0068 1 100 0 65535 ECU_ADDRESS 0xFFFF3F56 /begin FUNCTION_LIST /end FUNCTION_LIST /end MEASUREMENT
/begin MEASUREMENT vTMDCVPDD "Diagnosis condition failure delay timer" UBYTE COMP_0008 1 100 0 25500 ECU_ADDRESS 0xFFFF333D /begin FUNCTION_LIST /end FUNCTION_LIST /end MEASUREMENT
/begin MEASUREMENT vTMDIRE182 "0.02inch leak atomospheric pressure re-measuring delay" UBYTE COMP_0008 1 100 0 25500 ECU_ADDRESS 0xFFFF333E /begin FUNCTION_LIST /end FUNCTION_LIST /end MEASUREMENT
/begin MEASUREMENT vTMDIRE184 "0.04inch leak atomospheric pressure re-measuring delay" UBYTE COMP_0008 1 100 0 25500 ECU_ADDRESS 0xFFFF333F /begin FUNCTION_LIST /end FUNCTION_LIST /end MEASUREMENT
/begin MEASUREMENT vTMDIREI "Inside" UBYTE COMP_0008 1 100 0 25500 ECU_ADDRESS 0xFFFF3340 /begin FUNCTION_LIST /end FUNCTION_LIST /end MEASUREMENT
/begin MEASUREMENT vTMDIREI8 "Inside" UBYTE COMP_0013 1 100 0 255 ECU_ADDRESS 0xFFFF3341 /begin FUNCTION_LIST /end FUNCTION_LIST /end MEASUREMENT
/begin MEASUREMENT vTMECN2 "Diagnosis prohibition timer" UBYTE COMP_0013 1 100 0 255 ECU_ADDRESS 0xFFFF3342 /begin FUNCTION_LIST /end FUNCTION_LIST /end MEASUREMENT
/begin MEASUREMENT vTMFCUT "Fuel injection prohibition cylinder flag" UBYTE COMP_0091 1 100 0 255 ECU_ADDRESS 0xFFFF1947 /begin FUNCTION_LIST /end FUNCTION_LIST /end MEASUREMENT
/begin MEASUREMENT vTMFIMN "Fuel injection cylinder flag" UBYTE COMP_0091 1 100 0 255 ECU_ADDRESS 0xFFFF194A /begin FUNCTION_LIST /end FUNCTION_LIST /end MEASUREMENT
/begin MEASUREMENT vTMFMIL "A MIL flashing time measure timer for the misfire diagnosis" UBYTE COMP_0014 1 100 0 2550 ECU_ADDRESS 0xFFFF3F58 /begin FUNCTION_LIST /end FUNCTION_LIST /end MEASUREMENT
/begin MEASUREMENT vTMKRET "A variable for the KDADV subtraction" UBYTE COMP_0004 1 100 0 255 ECU_ADDRESS 0xFFFF1952 /begin FUNCTION_LIST /end FUNCTION_LIST /end MEASUREMENT
/begin MEASUREMENT vTMLFAT "Lean prohibition judgement counter" UWORD COMP_0016 1 100 0 65535 ECU_ADDRESS 0xFFFF195A /begin FUNCTION_LIST /end FUNCTION_LIST /end MEASUREMENT
/begin MEASUREMENT vTMLINT "At the time of the overcoat lean, LLDML initialization delay" UBYTE COMP_0016 1 100 0 255 ECU_ADDRESS 0xFFFF195C /begin FUNCTION_LIST /end FUNCTION_LIST /end MEASUREMENT
/begin MEASUREMENT vTMLNTC "The judgement time when LAN communication TCS is unusual" UBYTE COMP_0014 1 100 0 2550 ECU_ADDRESS 0xFFFF475B /begin FUNCTION_LIST /end FUNCTION_LIST /end MEASUREMENT
/begin MEASUREMENT vTMOK "Lean prohibition release judgement delay" UBYTE COMP_0016 1 100 0 255 ECU_ADDRESS 0xFFFF195D /begin FUNCTION_LIST /end FUNCTION_LIST /end MEASUREMENT
/begin MEASUREMENT vTMPALP "Taking shelter F.F. data buffer short periodic fuel compensation value" UBYTE COMP_0072_S 1 100 -1 0.9921875 ECU_ADDRESS 0xFFFF3346 /begin FUNCTION_LIST /end FUNCTION_LIST /end MEASUREMENT
/begin MEASUREMENT vTMPALP_R#1 "Taking shelter F.F. data buffer short periodic fuel compensation value" UBYTE COMP_0072_S 1 100 -1 0.9921875 ECU_ADDRESS 0xFFFF3346 /begin FUNCTION_LIST /end FUNCTION_LIST /end MEASUREMENT
/begin MEASUREMENT vTMPALP_R#2 "Taking shelter F.F. data buffer short periodic fuel compensation value" UBYTE COMP_0072_S 1 100 -1 0.9921875 ECU_ADDRESS 0xFFFF3347 /begin FUNCTION_LIST /end FUNCTION_LIST /end MEASUREMENT
/begin MEASUREMENT vTMPBST "Taking shelter F.F. data buffer intake manifold absolute pressure" UBYTE COMP_0424 1 100 0 255 ECU_ADDRESS 0xFFFF3348 /begin FUNCTION_LIST /end FUNCTION_LIST /end MEASUREMENT
/begin MEASUREMENT vTMPCLV "Taking shelter F.F. data buffer logic operation load value" UBYTE COMP_0425 1 100 0 99.99999981 ECU_ADDRESS 0xFFFF334A /begin FUNCTION_LIST /end FUNCTION_LIST /end MEASUREMENT
/begin MEASUREMENT vTMPCODE "Evacuation F.F. data buffer self-diagnosis details distinction code" UWORD COMP_0426 1 100 0 65535 ECU_ADDRESS 0xFFFF334C /begin FUNCTION_LIST /end FUNCTION_LIST /end MEASUREMENT
/begin MEASUREMENT vTMPFSS "Taking shelter F.F. data buffer fuel control condition distinction flag" UBYTE COMP_0091 1 100 0 255 ECU_ADDRESS 0xFFFF334E /begin FUNCTION_LIST /end FUNCTION_LIST /end MEASUREMENT
/begin MEASUREMENT vTMPFSS_R#1 "Taking shelter F.F. data buffer fuel control condition distinction flag" UBYTE COMP_0091 1 100 0 255 ECU_ADDRESS 0xFFFF334E /begin FUNCTION_LIST /end FUNCTION_LIST /end MEASUREMENT
/begin MEASUREMENT vTMPFSS_R#2 "Taking shelter F.F. data buffer fuel control condition distinction flag" UBYTE COMP_0091 1 100 0 255 ECU_ADDRESS 0xFFFF334F /begin FUNCTION_LIST /end FUNCTION_LIST /end MEASUREMENT
/begin MEASUREMENT vTMPIMASK "save imask data" UBYTE COMP_0068 1 100 0 255 ECU_ADDRESS 0xFFFF3F59 /begin FUNCTION_LIST /end FUNCTION_LIST /end MEASUREMENT
/begin MEASUREMENT vTMPKBL "Taking shelter F.F. data buffer head periodic fuel compensation value" UBYTE COMP_0072_S 1 100 -1 0.9921875 ECU_ADDRESS 0xFFFF3350 /begin FUNCTION_LIST /end FUNCTION_LIST /end MEASUREMENT
/begin MEASUREMENT vTMPKBL_R#1 "Taking shelter F.F. data buffer head periodic fuel compensation value" UBYTE COMP_0072_S 1 100 -1 0.9921875 ECU_ADDRESS 0xFFFF3350 /begin FUNCTION_LIST /end FUNCTION_LIST /end MEASUREMENT
/begin MEASUREMENT vTMPKBL_R#2 "Taking shelter F.F. data buffer head periodic fuel compensation value" UBYTE COMP_0072_S 1 100 -1 0.9921875 ECU_ADDRESS 0xFFFF3351 /begin FUNCTION_LIST /end FUNCTION_LIST /end MEASUREMENT
/begin MEASUREMENT vTMPNGC "Taking shelter F.F. data buffer NG code" UWORD COMP_0426 1 100 0 65535 ECU_ADDRESS 0xFFFF3352 /begin FUNCTION_LIST /end FUNCTION_LIST /end MEASUREMENT
/begin MEASUREMENT vTMPOPFD "Taking shelter option F.F. data buffer" UBYTE COMP_0068 1 100 0 255 ECU_ADDRESS 0xFFFF3354 /begin FUNCTION_LIST /end FUNCTION_LIST /end MEASUREMENT
/begin MEASUREMENT vTMPOPFD_R#1 "Taking shelter option F.F. data buffer" UBYTE COMP_0068 1 100 0 255 ECU_ADDRESS 0xFFFF3354 /begin FUNCTION_LIST /end FUNCTION_LIST /end MEASUREMENT
/begin MEASUREMENT vTMPOPFD_R#2 "Taking shelter option F.F. data buffer" UBYTE COMP_0068 1 100 0 255 ECU_ADDRESS 0xFFFF3355 /begin FUNCTION_LIST /end FUNCTION_LIST /end MEASUREMENT
/begin MEASUREMENT vTMPOPFD_R#3 "Taking shelter option F.F. data buffer" UBYTE COMP_0068 1 100 0 255 ECU_ADDRESS 0xFFFF3356 /begin FUNCTION_LIST /end FUNCTION_LIST /end MEASUREMENT
/begin MEASUREMENT vTMPOPFD_R#4 "Taking shelter option F.F. data buffer" UBYTE COMP_0068 1 100 0 255 ECU_ADDRESS 0xFFFF3357 /begin FUNCTION_LIST /end FUNCTION_LIST /end MEASUREMENT
/begin MEASUREMENT vTMPOPFD_R#5 "Taking shelter option F.F. data buffer" UBYTE COMP_0068 1 100 0 255 ECU_ADDRESS 0xFFFF3358 /begin FUNCTION_LIST /end FUNCTION_LIST /end MEASUREMENT
/begin MEASUREMENT vTMPOPFD_R#6 "Taking shelter option F.F. data buffer" UBYTE COMP_0068 1 100 0 255 ECU_ADDRESS 0xFFFF3359 /begin FUNCTION_LIST /end FUNCTION_LIST /end MEASUREMENT
/begin MEASUREMENT vTMPOPFD_R#7 "Taking shelter option F.F. data buffer" UBYTE COMP_0068 1 100 0 255 ECU_ADDRESS 0xFFFF335A /begin FUNCTION_LIST /end FUNCTION_LIST /end MEASUREMENT
/begin MEASUREMENT vTMPOPFD_R#8 "Taking shelter option F.F. data buffer" UBYTE COMP_0068 1 100 0 255 ECU_ADDRESS 0xFFFF335B /begin FUNCTION_LIST /end FUNCTION_LIST /end MEASUREMENT
/begin MEASUREMENT vTMPOPFD_R#9 "Taking shelter option F.F. data buffer" UBYTE COMP_0068 1 100 0 255 ECU_ADDRESS 0xFFFF335C /begin FUNCTION_LIST /end FUNCTION_LIST /end MEASUREMENT
/begin MEASUREMENT vTMPOPFD_R#10 "Taking shelter option F.F. data buffer" UBYTE COMP_0068 1 100 0 255 ECU_ADDRESS 0xFFFF335D /begin FUNCTION_LIST /end FUNCTION_LIST /end MEASUREMENT
/begin MEASUREMENT vTMPRNGC "F.F. data buffer NG code (an edition for a DTC 3 bytes-ization)" ULONG COMP_0426 1 100 0 4294967295 ECU_ADDRESS 0xFFFF3360 /begin FUNCTION_LIST /end FUNCTION_LIST /end MEASUREMENT
/begin MEASUREMENT vTMPRPM "Taking shelter F.F. data buffer engine speed" UWORD COMP_0427 1 100 0 16383.75 ECU_ADDRESS 0xFFFF3364 /begin FUNCTION_LIST /end FUNCTION_LIST /end MEASUREMENT
/begin MEASUREMENT vTMPSUMB "(BOOT) for the SUM value operation" UWORD COMP_0068 1 100 0 65535 ECU_ADDRESS 0xFFFF3366 /begin FUNCTION_LIST /end FUNCTION_LIST /end MEASUREMENT
/begin MEASUREMENT vTMPSUMC "(CALIB) for the SUM value operation" UWORD COMP_0068 1 100 0 65535 ECU_ADDRESS 0xFFFF3368 /begin FUNCTION_LIST /end FUNCTION_LIST /end MEASUREMENT
/begin MEASUREMENT vTMPSUMP "(PROG) for the SUM value operation" UWORD COMP_0068 1 100 0 65535 ECU_ADDRESS 0xFFFF336A /begin FUNCTION_LIST /end FUNCTION_LIST /end MEASUREMENT
/begin MEASUREMENT vTMPTAN "Taking shelter F.F. data buffer intake air temperature" UBYTE COMP_0035 1 100 -50 205 ECU_ADDRESS 0xFFFF336C /begin FUNCTION_LIST /end FUNCTION_LIST /end MEASUREMENT
/begin MEASUREMENT vTMPTPH "Taking shelter F.F. buffer cylinder air quantity equivalent pulse width (high rank)" UBYTE COMP_0001 1 100 0 31.875 ECU_ADDRESS 0xFFFF336D /begin FUNCTION_LIST /end FUNCTION_LIST /end MEASUREMENT
/begin MEASUREMENT vTMPTVO "Taking shelter F.F. buffer throttle open-degree" UBYTE COMP_0002 1 100 0 89.25 ECU_ADDRESS 0xFFFF336E /begin FUNCTION_LIST /end FUNCTION_LIST /end MEASUREMENT
/begin MEASUREMENT vTMPTWN "Taking shelter F.F. data buffer engine cool coolant temperature" UBYTE COMP_0428 1 100 -40 215 ECU_ADDRESS 0xFFFF336F /begin FUNCTION_LIST /end FUNCTION_LIST /end MEASUREMENT
/begin MEASUREMENT vTMPVBR "save vbr data" ULONG COMP_0068 1 100 0 4294967295 ECU_ADDRESS 0xFFFF3F5C /begin FUNCTION_LIST /end FUNCTION_LIST /end MEASUREMENT
/begin MEASUREMENT vTMPVSP "A degree of a taking shelter F.F. data buffer vehicle speed" UBYTE COMP_0429 1 100 0 255 ECU_ADDRESS 0xFFFF3370 /begin FUNCTION_LIST /end FUNCTION_LIST /end MEASUREMENT
/begin MEASUREMENT vTMQFBI "A variable for the ISCLRC computation" UBYTE COMP_0030 1 100 0 255 ECU_ADDRESS 0xFFFF1961 /begin FUNCTION_LIST /end FUNCTION_LIST /end MEASUREMENT
/begin MEASUREMENT vTMRCNT "Timer counter" UWORD COMP_0068 1 100 0 65535 ECU_ADDRESS 0xFFFF3F60 /begin FUNCTION_LIST /end FUNCTION_LIST /end MEASUREMENT
/begin MEASUREMENT vTMRCNT20 "Timer counter" UWORD COMP_0366_S 1 100 0 1310.7 ECU_ADDRESS 0xFFFF3F62 /begin FUNCTION_LIST /end FUNCTION_LIST /end MEASUREMENT
/begin MEASUREMENT vTMREQREV "The early days of rotation synchronism blow, control setup timer" UBYTE COMP_0014 1 100 0 2550 ECU_ADDRESS 0xFFFF3371 /begin FUNCTION_LIST /end FUNCTION_LIST /end MEASUREMENT
/begin MEASUREMENT vTMRLED "At the time of the engine stall, ÉÇÅ[Ég 2 control time measuring timer" UBYTE COMP_0014 1 100 0 2550 ECU_ADDRESS 0xFFFF3F64 /begin FUNCTION_LIST /end FUNCTION_LIST /end MEASUREMENT
/begin MEASUREMENT vTMSLP1NG "STAGE#1 diagnosis NG judgement time" UBYTE COMP_0008 1 100 0 25500 ECU_ADDRESS 0xFFFF3376 /begin FUNCTION_LIST /end FUNCTION_LIST /end MEASUREMENT
/begin MEASUREMENT vTMSTPINJ "For the injection compulsory completion timing time" UBYTE COMP_0017 1 100 0 255 ECU_ADDRESS 0xFFFF2250 /begin FUNCTION_LIST /end FUNCTION_LIST /end MEASUREMENT
/begin MEASUREMENT vTMTRP6 "Trip 6 rush time measuring timer (subtraction)" ULONG COMP_0008 1 100 0 429496729500 ECU_ADDRESS 0xFFFF1964 /begin FUNCTION_LIST /end FUNCTION_LIST /end MEASUREMENT
/begin MEASUREMENT vTMTRP6A "Trip 6 rush time measuring timer (100mS counter work)" UBYTE COMP_0030 1 100 0 255 ECU_ADDRESS 0xFFFF1968 /begin FUNCTION_LIST /end FUNCTION_LIST /end MEASUREMENT
/begin MEASUREMENT vTMVTAC "Soft landing control time (the right bank)" UBYTE COMP_0014 1 100 0 2550 ECU_ADDRESS 0xFFFF1969 /begin FUNCTION_LIST /end FUNCTION_LIST /end MEASUREMENT
/begin MEASUREMENT vTMVTACE "Soft landing control time (the right bank)" UBYTE COMP_0014 1 100 0 2550 ECU_ADDRESS 0xFFFF196A /begin FUNCTION_LIST /end FUNCTION_LIST /end MEASUREMENT
/begin MEASUREMENT vTMVTACEL "Soft landing control time (the left bank)" UBYTE COMP_0014 1 100 0 2550 ECU_ADDRESS 0xFFFF196B /begin FUNCTION_LIST /end FUNCTION_LIST /end MEASUREMENT
/begin MEASUREMENT vTMVTACL "Soft landing control time (the left bank)" UBYTE COMP_0014 1 100 0 2550 ECU_ADDRESS 0xFFFF196C /begin FUNCTION_LIST /end FUNCTION_LIST /end MEASUREMENT
/begin MEASUREMENT vTMVTFBE "VTC F/B counter" UBYTE COMP_0014 1 100 0 2550 ECU_ADDRESS 0xFFFF196D /begin FUNCTION_LIST /end FUNCTION_LIST /end MEASUREMENT
/begin MEASUREMENT vTMVTFBI "VTC F/B counter" UBYTE COMP_0014 1 100 0 2550 ECU_ADDRESS 0xFFFF196E /begin FUNCTION_LIST /end FUNCTION_LIST /end MEASUREMENT
/begin MEASUREMENT vTMVTMXE "VTC target angle maintenance counter" UBYTE COMP_0014 1 100 0 2550 ECU_ADDRESS 0xFFFF196F /begin FUNCTION_LIST /end FUNCTION_LIST /end MEASUREMENT
/begin MEASUREMENT vTMVTMXI "VTC target angle maintenance counter" UBYTE COMP_0014 1 100 0 2550 ECU_ADDRESS 0xFFFF1970 /begin FUNCTION_LIST /end FUNCTION_LIST /end MEASUREMENT
/begin MEASUREMENT vTNINIR "CVT input rotation pulse period" ULONG COMP_0139_S 1 100 0 107374182.375 ECU_ADDRESS 0xFFFF2254 /begin FUNCTION_LIST /end FUNCTION_LIST /end MEASUREMENT
/begin MEASUREMENT vTNIRCNT "CVT input rotation sensor pulse periodic measuring pulse input counter" UBYTE COMP_0016 1 100 0 255 ECU_ADDRESS 0xFFFF2258 /begin FUNCTION_LIST /end FUNCTION_LIST /end MEASUREMENT
/begin MEASUREMENT vTO "Oil temperature sensor output voltage" UBYTE COMP_0054 1 100 0 5100 ECU_ADDRESS 0xFFFF89CC /begin FUNCTION_LIST /end FUNCTION_LIST /end MEASUREMENT
/begin MEASUREMENT vTO2CNG "At the time of the engine rotation, a timer for the bank switching timing distinction" UBYTE COMP_0014 1 100 0 2550 ECU_ADDRESS 0xFFFF3F65 /begin FUNCTION_LIST /end FUNCTION_LIST /end MEASUREMENT
/begin MEASUREMENT vTO2DSP "At the time of the engine rotation, bank switching indication MIL flash period measure timer" UBYTE COMP_0014 1 100 0 2550 ECU_ADDRESS 0xFFFF3F66 /begin FUNCTION_LIST /end FUNCTION_LIST /end MEASUREMENT
/begin MEASUREMENT vTOEX "Oil temperature sensor output voltage unusual value judgement counter" UBYTE COMP_0004 1 100 0 255 ECU_ADDRESS 0xFFFF1F26 /begin FUNCTION_LIST /end FUNCTION_LIST /end MEASUREMENT
/begin MEASUREMENT vTOF "After the unusual value cut, oil temperature sensor output voltage" UWORD COMP_0023 1 100 0 327675 ECU_ADDRESS 0xFFFF1F28 /begin FUNCTION_LIST /end FUNCTION_LIST /end MEASUREMENT
/begin MEASUREMENT vTOILNEW "Oil temperature (this time, value)" UBYTE COMP_0035 1 100 -50 205 ECU_ADDRESS 0xFFFF1F2A /begin FUNCTION_LIST /end FUNCTION_LIST /end MEASUREMENT
/begin MEASUREMENT vTOMMN "AVTO MIN" UWORD COMP_0250 1 100 0 262140 ECU_ADDRESS 0xFFFFB554 /begin FUNCTION_LIST /end FUNCTION_LIST /end MEASUREMENT
/begin MEASUREMENT vTOPAT "AT starter authorization or stop" UBYTE COMP_0068 1 100 0 255 ECU_ADDRESS 0xFFFF3F69 /begin FUNCTION_LIST /end FUNCTION_LIST /end MEASUREMENT
/begin MEASUREMENT vTOSMN "AVTOS MIN" UWORD COMP_0250 1 100 0 262140 ECU_ADDRESS 0xFFFFB558 /begin FUNCTION_LIST /end FUNCTION_LIST /end MEASUREMENT
/begin MEASUREMENT vTP1R "Cylinder intake quantity equivalent pulse width with the lambda control Job in front of one time" UWORD COMP_0144 1 100 0 31.999495335 ECU_ADDRESS 0xFFFF1974 /begin FUNCTION_LIST /end FUNCTION_LIST /end MEASUREMENT
/begin MEASUREMENT vTP1R_R#1 "Cylinder intake quantity equivalent pulse width with the lambda control Job in front of one time" UWORD COMP_0144 1 100 0 31.999495335 ECU_ADDRESS 0xFFFF1974 /begin FUNCTION_LIST /end FUNCTION_LIST /end MEASUREMENT
/begin MEASUREMENT vTP1R_R#2 "Cylinder intake quantity equivalent pulse width with the lambda control Job in front of one time" UWORD COMP_0144 1 100 0 31.999495335 ECU_ADDRESS 0xFFFF1976 /begin FUNCTION_LIST /end FUNCTION_LIST /end MEASUREMENT
/begin MEASUREMENT vTP2SCAN "P2*CAN timer counter" UWORD COMP_0016 1 100 0 65535 ECU_ADDRESS 0xFFFF35CE /begin FUNCTION_LIST /end FUNCTION_LIST /end MEASUREMENT
/begin MEASUREMENT vTPASSf "TPASS reference judgement" UBYTE COMP_0004 1 100 0 255 ECU_ADDRESS 0xFFFF1978 /begin FUNCTION_LIST /end FUNCTION_LIST /end MEASUREMENT
/begin MEASUREMENT vTPDL1 "Pedal characteristic table 1 reference value" UWORD COMP_0362_S 1 100 0 8191.875 ECU_ADDRESS 0xFFFF3384 /begin FUNCTION_LIST /end FUNCTION_LIST /end MEASUREMENT
/begin MEASUREMENT vTPDL2 "Pedal characteristic table 2 reference value" UWORD COMP_0362_S 1 100 0 8191.875 ECU_ADDRESS 0xFFFF3386 /begin FUNCTION_LIST /end FUNCTION_LIST /end MEASUREMENT
/begin MEASUREMENT vTPFBAN "This time, at the time of the injection, use TPÅ~TFBYA" UWORD COMP_0166_S 1 100 0 63.999056205 ECU_ADDRESS 0xFFFF2434 /begin FUNCTION_LIST /end FUNCTION_LIST /end MEASUREMENT
/begin MEASUREMENT vTPLMIN "TPUL maximum value" UWORD COMP_0008 1 100 0 6553500 ECU_ADDRESS 0xFFFFB2A8 /begin FUNCTION_LIST /end FUNCTION_LIST /end MEASUREMENT
/begin MEASUREMENT vTPMDFAC "Power mode gain table reference value" UWORD COMP_0614_S 1 100 0 199.996894995 ECU_ADDRESS 0xFFFF3388 /begin FUNCTION_LIST /end FUNCTION_LIST /end MEASUREMENT
/begin MEASUREMENT vTPOLD "TP old value table" UBYTE COMP_0001 1 100 0 31.875 ECU_ADDRESS 0xFFFF1988 /begin FUNCTION_LIST /end FUNCTION_LIST /end MEASUREMENT
/begin MEASUREMENT vTPOLD_R#1 "TP old value table" UBYTE COMP_0001 1 100 0 31.875 ECU_ADDRESS 0xFFFF1988 /begin FUNCTION_LIST /end FUNCTION_LIST /end MEASUREMENT
/begin MEASUREMENT vTPOLD_R#2 "TP old value table" UBYTE COMP_0001 1 100 0 31.875 ECU_ADDRESS 0xFFFF1989 /begin FUNCTION_LIST /end FUNCTION_LIST /end MEASUREMENT
/begin MEASUREMENT vTPOLD_R#3 "TP old value table" UBYTE COMP_0001 1 100 0 31.875 ECU_ADDRESS 0xFFFF198A /begin FUNCTION_LIST /end FUNCTION_LIST /end MEASUREMENT
/begin MEASUREMENT vTPOLD_R#4 "TP old value table" UBYTE COMP_0001 1 100 0 31.875 ECU_ADDRESS 0xFFFF198B /begin FUNCTION_LIST /end FUNCTION_LIST /end MEASUREMENT
/begin MEASUREMENT vTPOLD_R#5 "TP old value table" UBYTE COMP_0001 1 100 0 31.875 ECU_ADDRESS 0xFFFF198C /begin FUNCTION_LIST /end FUNCTION_LIST /end MEASUREMENT
/begin MEASUREMENT vTPRESNGH "Absolute pressure sensor diagnosis NG timer" UBYTE COMP_0008 1 100 0 25500 ECU_ADDRESS 0xFFFF338C /begin FUNCTION_LIST /end FUNCTION_LIST /end MEASUREMENT
/begin MEASUREMENT vTPRESNGL "Absolute pressure sensor diagnosis NG timer" UBYTE COMP_0008 1 100 0 25500 ECU_ADDRESS 0xFFFF338D /begin FUNCTION_LIST /end FUNCTION_LIST /end MEASUREMENT
/begin MEASUREMENT vTPS1AVBUF "Learning failure counter" ULONG COMP_0061 1 100 0 21474836475 ECU_ADDRESS 0xFFFF3754 /begin FUNCTION_LIST /end FUNCTION_LIST /end MEASUREMENT
/begin MEASUREMENT vTPS1MAX "At the time of the sampling, TPS1V minimum value" UWORD COMP_0023 1 100 0 327675 ECU_ADDRESS 0xFFFF375C /begin FUNCTION_LIST /end FUNCTION_LIST /end MEASUREMENT
/begin MEASUREMENT vTPS1MIN "At the time of the sampling, TPS1V maximum value" UWORD COMP_0023 1 100 0 327675 ECU_ADDRESS 0xFFFF375E /begin FUNCTION_LIST /end FUNCTION_LIST /end MEASUREMENT
/begin MEASUREMENT vTPS1OF_S "(SubCPU) Throttle open-degree 1" SWORD COMP_0377 1 100 -3604.48 3604.37 ECU_ADDRESS 0xFFFF4036 /begin FUNCTION_LIST /end FUNCTION_LIST /end MEASUREMENT
/begin MEASUREMENT vTPS1SUM "At the time of the sampling, TPS1V total peace" ULONG COMP_0023 1 100 0 21474836475 ECU_ADDRESS 0xFFFF3764 /begin FUNCTION_LIST /end FUNCTION_LIST /end MEASUREMENT
/begin MEASUREMENT vTPS1VZ1 "Throttle sensor 1 voltage (value before 10mS)" UWORD COMP_0023 1 100 0 327675 ECU_ADDRESS 0xFFFF338E /begin FUNCTION_LIST /end FUNCTION_LIST /end MEASUREMENT
/begin MEASUREMENT vTPS1VZ2 "Throttle sensor 1 voltage (value before 20mS)" UWORD COMP_0023 1 100 0 327675 ECU_ADDRESS 0xFFFF3390 /begin FUNCTION_LIST /end FUNCTION_LIST /end MEASUREMENT
/begin MEASUREMENT vTPS1VZ3 "Throttle sensor 1 voltage (value before 30mS)" UWORD COMP_0023 1 100 0 327675 ECU_ADDRESS 0xFFFF3392 /begin FUNCTION_LIST /end FUNCTION_LIST /end MEASUREMENT
/begin MEASUREMENT vTPS1VZ4 "Throttle sensor 1 voltage (value before 40mS)" UWORD COMP_0023 1 100 0 327675 ECU_ADDRESS 0xFFFF3394 /begin FUNCTION_LIST /end FUNCTION_LIST /end MEASUREMENT
/begin MEASUREMENT vTPS2AVBUF "Learning failure counter" ULONG COMP_0061 1 100 0 21474836475 ECU_ADDRESS 0xFFFF376C /begin FUNCTION_LIST /end FUNCTION_LIST /end MEASUREMENT
/begin MEASUREMENT vTPS4BAVBU "RAM value vTPS4BAVBU" ULONG COMP_0061 1 100 0 21474836475 ECU_ADDRESS 0xFFFF3778 /begin FUNCTION_LIST /end FUNCTION_LIST /end MEASUREMENT
/begin MEASUREMENT vTPS4MAX "At the time of the sampling, TPS4BV minimum value" UWORD COMP_0023 1 100 0 327675 ECU_ADDRESS 0xFFFF3782 /begin FUNCTION_LIST /end FUNCTION_LIST /end MEASUREMENT
/begin MEASUREMENT vTPS4MIN "At the time of the sampling, TPS14BV maximum value" UWORD COMP_0023 1 100 0 327675 ECU_ADDRESS 0xFFFF3784 /begin FUNCTION_LIST /end FUNCTION_LIST /end MEASUREMENT
/begin MEASUREMENT vTPS4SUM "At the time of the sampling, TPS4BV total peace" ULONG COMP_0023 1 100 0 21474836475 ECU_ADDRESS 0xFFFF3788 /begin FUNCTION_LIST /end FUNCTION_LIST /end MEASUREMENT
/begin MEASUREMENT vTPSAVCNT "Mean operation counter" UBYTE COMP_0030 1 100 0 255 ECU_ADDRESS 0xFFFF378C /begin FUNCTION_LIST /end FUNCTION_LIST /end MEASUREMENT
/begin MEASUREMENT vTPSYDG1 "Purge system diagnosis permission delay timer" UBYTE COMP_0008 1 100 0 25500 ECU_ADDRESS 0xFFFF1990 /begin FUNCTION_LIST /end FUNCTION_LIST /end MEASUREMENT
/begin MEASUREMENT vTPSYDG1V "A purge system diagnosis permission delay timer for diagnosis frequency measuring" UBYTE COMP_0008 1 100 0 25500 ECU_ADDRESS 0xFFFF1991 /begin FUNCTION_LIST /end FUNCTION_LIST /end MEASUREMENT
/begin MEASUREMENT vTPSYDG2 "EPRS11 monitor permission delay timer" UBYTE COMP_0008 1 100 0 25500 ECU_ADDRESS 0xFFFF1992 /begin FUNCTION_LIST /end FUNCTION_LIST /end MEASUREMENT
/begin MEASUREMENT vTPSYDG2V "An EPRS11V monitor permission delay timer for diagnosis frequency measuring" UBYTE COMP_0008 1 100 0 25500 ECU_ADDRESS 0xFFFF1993 /begin FUNCTION_LIST /end FUNCTION_LIST /end MEASUREMENT
/begin MEASUREMENT vTPSYDG3 "EPRS12 monitor permission delay timer" UBYTE COMP_0008 1 100 0 25500 ECU_ADDRESS 0xFFFF1994 /begin FUNCTION_LIST /end FUNCTION_LIST /end MEASUREMENT
/begin MEASUREMENT vTPSYDG3V "An EPRS12V monitor permission delay timer for diagnosis frequency measuring" UBYTE COMP_0008 1 100 0 25500 ECU_ADDRESS 0xFFFF1995 /begin FUNCTION_LIST /end FUNCTION_LIST /end MEASUREMENT
/begin MEASUREMENT vTPSYDG4 "Stage 2 diagnosis permission delay timer" UBYTE COMP_0008 1 100 0 25500 ECU_ADDRESS 0xFFFF1996 /begin FUNCTION_LIST /end FUNCTION_LIST /end MEASUREMENT
/begin MEASUREMENT vTPUL "Pull-down time measuring timer" UWORD COMP_0008 1 100 0 6553500 ECU_ADDRESS 0xFFFF3396 /begin FUNCTION_LIST /end FUNCTION_LIST /end MEASUREMENT
/begin MEASUREMENT vTPUL2 "Pull-down F/B time measuring timer" UWORD COMP_0008 1 100 0 6553500 ECU_ADDRESS 0xFFFF3398 /begin FUNCTION_LIST /end FUNCTION_LIST /end MEASUREMENT
/begin MEASUREMENT vTPULM "Imaginary pull-down time integration timer" UWORD COMP_0295 1 100 0 6553500 ECU_ADDRESS 0xFFFF339A /begin FUNCTION_LIST /end FUNCTION_LIST /end MEASUREMENT
/begin MEASUREMENT vTPWACC "ACC power order value" UWORD COMP_0362_S 1 100 0 8191.875 ECU_ADDRESS 0xFFFF339C /begin FUNCTION_LIST /end FUNCTION_LIST /end MEASUREMENT
/begin MEASUREMENT vTPWACC_S "ACC power order value (vice-operation part)" UWORD COMP_0362_S 1 100 0 8191.875 ECU_ADDRESS 0xFFFF3524 /begin FUNCTION_LIST /end FUNCTION_LIST /end MEASUREMENT
/begin MEASUREMENT vTPWCC "ASCD power order value" UWORD COMP_0362_S 1 100 0 8191.875 ECU_ADDRESS 0xFFFF339E /begin FUNCTION_LIST /end FUNCTION_LIST /end MEASUREMENT
/begin MEASUREMENT vTPWCC_S "ASCD power order value (vice-operation part)" UWORD COMP_0362_S 1 100 0 8191.875 ECU_ADDRESS 0xFFFF3526 /begin FUNCTION_LIST /end FUNCTION_LIST /end MEASUREMENT
/begin MEASUREMENT vTPWSL "Speed limiter-power order value" UWORD COMP_0362_S 1 100 0 8191.875 ECU_ADDRESS 0xFFFF33A0 /begin FUNCTION_LIST /end FUNCTION_LIST /end MEASUREMENT
/begin MEASUREMENT vTPWSL_S "Speed limiter power order value (vice-operation part)" UWORD COMP_0362_S 1 100 0 8191.875 ECU_ADDRESS 0xFFFF3528 /begin FUNCTION_LIST /end FUNCTION_LIST /end MEASUREMENT
/begin MEASUREMENT vTPZ1 "Cylinder intake quantity equivalent pulse width (value before 10mS)" UWORD COMP_0144 1 100 0 31.999495335 ECU_ADDRESS 0xFFFF1998 /begin FUNCTION_LIST /end FUNCTION_LIST /end MEASUREMENT
/begin MEASUREMENT vTPZ10MS "Cylinder intake quantity equivalent pulse width (before 10mS)" UWORD COMP_0144 1 100 0 31.999495335 ECU_ADDRESS 0xFFFF1F40 /begin FUNCTION_LIST /end FUNCTION_LIST /end MEASUREMENT
/begin MEASUREMENT vTPZ2 "Cylinder intake quantity equivalent pulse width (value before 20mS)" UWORD COMP_0144 1 100 0 31.999495335 ECU_ADDRESS 0xFFFF199A /begin FUNCTION_LIST /end FUNCTION_LIST /end MEASUREMENT
/begin MEASUREMENT vTPZ3 "Cylinder intake quantity equivalent pulse width (value before 30mS)" UWORD COMP_0144 1 100 0 31.999495335 ECU_ADDRESS 0xFFFF199C /begin FUNCTION_LIST /end FUNCTION_LIST /end MEASUREMENT
/begin MEASUREMENT vTPZ4 "Cylinder intake quantity equivalent pulse width (value before 40mS)" UWORD COMP_0144 1 100 0 31.999495335 ECU_ADDRESS 0xFFFF199E /begin FUNCTION_LIST /end FUNCTION_LIST /end MEASUREMENT
/begin MEASUREMENT vTQ12ASRF "ASR requirement FAST torque" UWORD COMP_0636_S 1 100 -400 32367.5 ECU_ADDRESS 0xFFFF3F7C /begin FUNCTION_LIST /end FUNCTION_LIST /end MEASUREMENT
/begin MEASUREMENT vTQ12ASRS "ASR requirement SLOW torque" UWORD COMP_0636_S 1 100 -400 32367.5 ECU_ADDRESS 0xFFFF3F7E /begin FUNCTION_LIST /end FUNCTION_LIST /end MEASUREMENT
/begin MEASUREMENT vTQ12MSR "MSR requested torque" UWORD COMP_0636_S 1 100 -400 32367.5 ECU_ADDRESS 0xFFFF3F88 /begin FUNCTION_LIST /end FUNCTION_LIST /end MEASUREMENT
/begin MEASUREMENT vTQ8AGBF "AGB requirement FAST torque (8bit)" UBYTE COMP_0021_S 1 100 -100 410 ECU_ADDRESS 0xFFFF3F8C /begin FUNCTION_LIST /end FUNCTION_LIST /end MEASUREMENT
/begin MEASUREMENT vTQ8AGBS "AGB requirement SLOW torque (8bit)" UBYTE COMP_0021_S 1 100 -100 410 ECU_ADDRESS 0xFFFF3F8D /begin FUNCTION_LIST /end FUNCTION_LIST /end MEASUREMENT
/begin MEASUREMENT vTQAGBMNF "AGB requirement FAST-MIN torque" SWORD COMP_0228 1 100 -3276.8 3276.7 ECU_ADDRESS 0xFFFF33A2 /begin FUNCTION_LIST /end FUNCTION_LIST /end MEASUREMENT
/begin MEASUREMENT vTQAGBMNS "AGB requirement SLOW-MIN torque" SWORD COMP_0228 1 100 -3276.8 3276.7 ECU_ADDRESS 0xFFFF33A4 /begin FUNCTION_LIST /end FUNCTION_LIST /end MEASUREMENT
/begin MEASUREMENT vTQAGBMXF "AGB requirement FAST-MAX torque" SWORD COMP_0228 1 100 -3276.8 3276.7 ECU_ADDRESS 0xFFFF33A6 /begin FUNCTION_LIST /end FUNCTION_LIST /end MEASUREMENT
/begin MEASUREMENT vTQAGBMXS "AGB requirement SLOW-MAX torque" SWORD COMP_0228 1 100 -3276.8 3276.7 ECU_ADDRESS 0xFFFF33A8 /begin FUNCTION_LIST /end FUNCTION_LIST /end MEASUREMENT
/begin MEASUREMENT vTQASROUT "ASR requirement Slew_Rate output value torque" SWORD COMP_0228 1 100 -3276.8 3276.7 ECU_ADDRESS 0xFFFF33AA /begin FUNCTION_LIST /end FUNCTION_LIST /end MEASUREMENT
/begin MEASUREMENT vTQCTLTYP "Torque control type" UBYTE COMP_0068 1 100 0 255 ECU_ADDRESS 0xFFFF3F94 /begin FUNCTION_LIST /end FUNCTION_LIST /end MEASUREMENT
/begin MEASUREMENT vTQH0STCM "Target basic volume flow-quantity ratio (common torque)" UWORD COMP_0146 1 100 0 99.998480265 ECU_ADDRESS 0xFFFF33B4 /begin FUNCTION_LIST /end FUNCTION_LIST /end MEASUREMENT
/begin MEASUREMENT vTQLIMFST "Engine requirement upper limit FAST torque" SWORD COMP_0228 1 100 -3276.8 3276.7 ECU_ADDRESS 0xFFFF33B6 /begin FUNCTION_LIST /end FUNCTION_LIST /end MEASUREMENT
/begin MEASUREMENT vTQMOD1 "Fuel cut torque mode (after the hysteresis treatment)" UWORD COMP_0172_S 1 100 0 255.99609375 ECU_ADDRESS 0xFFFF19AC /begin FUNCTION_LIST /end FUNCTION_LIST /end MEASUREMENT
/begin MEASUREMENT vTQMOD2 "Fuel cut torque mode (after the hysteresis treatment)" UBYTE COMP_0173_S 1 100 0 255 ECU_ADDRESS 0xFFFF19AE /begin FUNCTION_LIST /end FUNCTION_LIST /end MEASUREMENT
/begin MEASUREMENT vTQRQASRF "ASR requirement FAST torque" SWORD COMP_0228 1 100 -3276.8 3276.7 ECU_ADDRESS 0xFFFF498A /begin FUNCTION_LIST /end FUNCTION_LIST /end MEASUREMENT
/begin MEASUREMENT vTQRQASRS "ASR requirement SLOW torque" SWORD COMP_0228 1 100 -3276.8 3276.7 ECU_ADDRESS 0xFFFF498C /begin FUNCTION_LIST /end FUNCTION_LIST /end MEASUREMENT
/begin MEASUREMENT vTQRQMSR "MSR requested torque" SWORD COMP_0228 1 100 -3276.8 3276.7 ECU_ADDRESS 0xFFFF498E /begin FUNCTION_LIST /end FUNCTION_LIST /end MEASUREMENT
/begin MEASUREMENT vTQUPFSTM "AGB torque rise permission time" UBYTE COMP_0014 1 100 0 2550 ECU_ADDRESS 0xFFFF33BC /begin FUNCTION_LIST /end FUNCTION_LIST /end MEASUREMENT
/begin MEASUREMENT vTQUPONTM "AGB torque rise permission time counter" UBYTE COMP_0014 1 100 0 2550 ECU_ADDRESS 0xFFFF33BD /begin FUNCTION_LIST /end FUNCTION_LIST /end MEASUREMENT
/begin MEASUREMENT vTQWOAGB0 "The former AGB engine torque target value which a T/M requirement reflects on" SWORD COMP_0228 1 100 -3276.8 3276.7 ECU_ADDRESS 0xFFFF33BE /begin FUNCTION_LIST /end FUNCTION_LIST /end MEASUREMENT
/begin MEASUREMENT vTREF15 "REF15_B period" ULONG COMP_0073 1 100 0 13743895344 ECU_ADDRESS 0xFFFF8A58 /begin FUNCTION_LIST /end FUNCTION_LIST /end MEASUREMENT
/begin MEASUREMENT vTREF15H "REF15_B period" ULONG COMP_0073 1 100 0 13743895344 ECU_ADDRESS 0xFFFF2260 /begin FUNCTION_LIST /end FUNCTION_LIST /end MEASUREMENT
/begin MEASUREMENT vTREFH "REF110 period" ULONG COMP_0073 1 100 0 13743895344 ECU_ADDRESS 0xFFFF2268 /begin FUNCTION_LIST /end FUNCTION_LIST /end MEASUREMENT
/begin MEASUREMENT vTREFM "TREF storage table" ULONG COMP_0189 1 100 0 13743895344 ECU_ADDRESS 0xFFFF226C /begin FUNCTION_LIST /end FUNCTION_LIST /end MEASUREMENT
/begin MEASUREMENT vTREFM_R#1 "TREF storage table" ULONG COMP_0189 1 100 0 13743895344 ECU_ADDRESS 0xFFFF226C /begin FUNCTION_LIST /end FUNCTION_LIST /end MEASUREMENT
/begin MEASUREMENT vTREFM_R#2 "TREF storage table" ULONG COMP_0189 1 100 0 13743895344 ECU_ADDRESS 0xFFFF2270 /begin FUNCTION_LIST /end FUNCTION_LIST /end MEASUREMENT
/begin MEASUREMENT vTREFM_R#3 "TREF storage table" ULONG COMP_0189 1 100 0 13743895344 ECU_ADDRESS 0xFFFF2274 /begin FUNCTION_LIST /end FUNCTION_LIST /end MEASUREMENT
/begin MEASUREMENT vTREFMEM "REF signal period" ULONG COMP_0073 1 100 0 13743895344 ECU_ADDRESS 0xFFFF2278 /begin FUNCTION_LIST /end FUNCTION_LIST /end MEASUREMENT
/begin MEASUREMENT vTRGCHGE "A target angle change rate for the drive abnormality diagnosis" UBYTE COMP_0048 1 100 0 127.5 ECU_ADDRESS 0xFFFF19B4 /begin FUNCTION_LIST /end FUNCTION_LIST /end MEASUREMENT
/begin MEASUREMENT vTRGCHGI "A target angle change rate for the drive abnormality diagnosis" UBYTE COMP_0048 1 100 0 127.5 ECU_ADDRESS 0xFFFF19B5 /begin FUNCTION_LIST /end FUNCTION_LIST /end MEASUREMENT
/begin MEASUREMENT vTRGLIME "Target angle change rate limitation value" UBYTE COMP_0048 1 100 0 127.5 ECU_ADDRESS 0xFFFF19B6 /begin FUNCTION_LIST /end FUNCTION_LIST /end MEASUREMENT
/begin MEASUREMENT vTRGLMI "Target angle change rate limitation value" UWORD COMP_0174_S 1 100 0 127.998046875 ECU_ADDRESS 0xFFFF19B8 /begin FUNCTION_LIST /end FUNCTION_LIST /end MEASUREMENT
/begin MEASUREMENT vTRGTIME "After a change in a target operation angle, progress time" UBYTE COMP_0008 1 100 0 25500 ECU_ADDRESS 0xFFFF19BC /begin FUNCTION_LIST /end FUNCTION_LIST /end MEASUREMENT
/begin MEASUREMENT vTRGTIME_R#1 "After a change in a target operation angle, progress time" UBYTE COMP_0008 1 100 0 25500 ECU_ADDRESS 0xFFFF19BC /begin FUNCTION_LIST /end FUNCTION_LIST /end MEASUREMENT
/begin MEASUREMENT vTRGTIME_R#2 "After a change in a target operation angle, progress time" UBYTE COMP_0008 1 100 0 25500 ECU_ADDRESS 0xFFFF19BD /begin FUNCTION_LIST /end FUNCTION_LIST /end MEASUREMENT
/begin MEASUREMENT vTRGTIMI "After a change in a target operation angle, progress time" UBYTE COMP_0008 1 100 0 25500 ECU_ADDRESS 0xFFFF19BE /begin FUNCTION_LIST /end FUNCTION_LIST /end MEASUREMENT
/begin MEASUREMENT vTRGTIMI_R#1 "After a change in a target operation angle, progress time" UBYTE COMP_0008 1 100 0 25500 ECU_ADDRESS 0xFFFF19BE /begin FUNCTION_LIST /end FUNCTION_LIST /end MEASUREMENT
/begin MEASUREMENT vTRGTIMI_R#2 "After a change in a target operation angle, progress time" UBYTE COMP_0008 1 100 0 25500 ECU_ADDRESS 0xFFFF19BF /begin FUNCTION_LIST /end FUNCTION_LIST /end MEASUREMENT
/begin MEASUREMENT vTROFMTf "The rest O2F/B control periodic monitor" UBYTE COMP_0004 1 100 0 255 ECU_ADDRESS 0xFFFF33C3 /begin FUNCTION_LIST /end FUNCTION_LIST /end MEASUREMENT
/begin MEASUREMENT vTRQAGBF "AGB requirement FAST torque" SWORD COMP_0228 1 100 -3276.8 3276.7 ECU_ADDRESS 0xFFFF4992 /begin FUNCTION_LIST /end FUNCTION_LIST /end MEASUREMENT
/begin MEASUREMENT vTRQAGBS "AGB requirement SLOW torque" SWORD COMP_0228 1 100 -3276.8 3276.7 ECU_ADDRESS 0xFFFF4994 /begin FUNCTION_LIST /end FUNCTION_LIST /end MEASUREMENT
/begin MEASUREMENT vTRQASRF "ASR FAST torque" SWORD COMP_0228 1 100 -3276.8 3276.7 ECU_ADDRESS 0xFFFF33D2 /begin FUNCTION_LIST /end FUNCTION_LIST /end MEASUREMENT
/begin MEASUREMENT vTRQASRS "ASR SLOW torque" SWORD COMP_0228 1 100 -3276.8 3276.7 ECU_ADDRESS 0xFFFF33D4 /begin FUNCTION_LIST /end FUNCTION_LIST /end MEASUREMENT
/begin MEASUREMENT vTRQMOD "Fuel cut torque mode" UWORD COMP_0172_S 1 100 0 255.99609375 ECU_ADDRESS 0xFFFF19C4 /begin FUNCTION_LIST /end FUNCTION_LIST /end MEASUREMENT
/begin MEASUREMENT vTRQMSR "MSR requested torque" SWORD COMP_0228 1 100 -3276.8 3276.7 ECU_ADDRESS 0xFFFF33E4 /begin FUNCTION_LIST /end FUNCTION_LIST /end MEASUREMENT
/begin MEASUREMENT vTRQNTUZ1 "Rotation synchronous control target torque (before 10mS)" SWORD COMP_0228 1 100 -3276.8 3276.7 ECU_ADDRESS 0xFFFF33EA /begin FUNCTION_LIST /end FUNCTION_LIST /end MEASUREMENT
/begin MEASUREMENT vTRQNTUZ2 "Rotation synchronous control target torque (before 20mS)" SWORD COMP_0228 1 100 -3276.8 3276.7 ECU_ADDRESS 0xFFFF33EC /begin FUNCTION_LIST /end FUNCTION_LIST /end MEASUREMENT
/begin MEASUREMENT vTRQSPDC0 "The early days of rotation synchronism blow, at the time of the control, torque" SWORD COMP_0228 1 100 -3276.8 3276.7 ECU_ADDRESS 0xFFFF33F4 /begin FUNCTION_LIST /end FUNCTION_LIST /end MEASUREMENT
/begin MEASUREMENT vTRQSPDCT "Speed control torque" SWORD COMP_0228 1 100 -3276.8 3276.7 ECU_ADDRESS 0xFFFF33F6 /begin FUNCTION_LIST /end FUNCTION_LIST /end MEASUREMENT
/begin MEASUREMENT vTRQTRG "Fuel cut torque mode reference point" UWORD COMP_0172_S 1 100 0 255.99609375 ECU_ADDRESS 0xFFFF19CA /begin FUNCTION_LIST /end FUNCTION_LIST /end MEASUREMENT
/begin MEASUREMENT vTRQUPGB0 "The former AGB requested torque which deals with a limit" SWORD COMP_0228 1 100 -3276.8 3276.7 ECU_ADDRESS 0xFFFF33F8 /begin FUNCTION_LIST /end FUNCTION_LIST /end MEASUREMENT
/begin MEASUREMENT vTRQUPGB1 "After the limit treatment, AGB requested torque" SWORD COMP_0228 1 100 -3276.8 3276.7 ECU_ADDRESS 0xFFFF33FA /begin FUNCTION_LIST /end FUNCTION_LIST /end MEASUREMENT
/begin MEASUREMENT vTSF "After the unusual value cut, TF" UWORD COMP_0023 1 100 0 327675 ECU_ADDRESS 0xFFFF1F42 /begin FUNCTION_LIST /end FUNCTION_LIST /end MEASUREMENT
/begin MEASUREMENT vTSLRNOKf "TS learning condition judgement flag" UBYTE COMP_0004 1 100 0 255 ECU_ADDRESS 0xFFFF19D0 /begin FUNCTION_LIST /end FUNCTION_LIST /end MEASUREMENT
/begin MEASUREMENT vTSTLMT "Starter on continuation time upper limit table reference value" UBYTE COMP_0013 1 100 0 255 ECU_ADDRESS 0xFFFF1F44 /begin FUNCTION_LIST /end FUNCTION_LIST /end MEASUREMENT
/begin MEASUREMENT vTSYSD1 "EPRS11 monitor progress timer" UBYTE COMP_0096 1 100 0 2550 ECU_ADDRESS 0xFFFF19D1 /begin FUNCTION_LIST /end FUNCTION_LIST /end MEASUREMENT
/begin MEASUREMENT vTSYSD1V "EPRS11V monitor progress timer" UBYTE COMP_0096 1 100 0 2550 ECU_ADDRESS 0xFFFF19D2 /begin FUNCTION_LIST /end FUNCTION_LIST /end MEASUREMENT
/begin MEASUREMENT vTSYSD2 "EPRS12 monitor progress timer" UBYTE COMP_0096 1 100 0 2550 ECU_ADDRESS 0xFFFF19D3 /begin FUNCTION_LIST /end FUNCTION_LIST /end MEASUREMENT
/begin MEASUREMENT vTSYSD2V "EPRS12V monitor progress timer" UBYTE COMP_0096 1 100 0 2550 ECU_ADDRESS 0xFFFF19D4 /begin FUNCTION_LIST /end FUNCTION_LIST /end MEASUREMENT
/begin MEASUREMENT vTSYSDL34 "Stage 2 diagnosis timer" UBYTE COMP_0008 1 100 0 25500 ECU_ADDRESS 0xFFFF19D5 /begin FUNCTION_LIST /end FUNCTION_LIST /end MEASUREMENT
/begin MEASUREMENT vTSYSDL4V "Imaginary stage 2 diagnosis timer for diagnosis frequency measuring" UWORD COMP_0008 1 100 0 6553500 ECU_ADDRESS 0xFFFF19D6 /begin FUNCTION_LIST /end FUNCTION_LIST /end MEASUREMENT
/begin MEASUREMENT vTTEAPF "At the time of the accelerator full-close, very, torque" SWORD COMP_0228 1 100 -3276.8 3276.7 ECU_ADDRESS 0xFFFF19DC /begin FUNCTION_LIST /end FUNCTION_LIST /end MEASUREMENT
/begin MEASUREMENT vTTEFC "Loss torque" SWORD COMP_0228 1 100 -3276.8 3276.7 ECU_ADDRESS 0xFFFF19E0 /begin FUNCTION_LIST /end FUNCTION_LIST /end MEASUREMENT
/begin MEASUREMENT vTTEP0 "ARBIT Input requested torque" SWORD COMP_0228 1 100 -3276.8 3276.7 ECU_ADDRESS 0xFFFF19EE /begin FUNCTION_LIST /end FUNCTION_LIST /end MEASUREMENT
/begin MEASUREMENT vTTEP0_S "ARBIT input requested torque (vice-operation part)" SWORD COMP_0228 1 100 -3276.8 3276.7 ECU_ADDRESS 0xFFFF1C9C /begin FUNCTION_LIST /end FUNCTION_LIST /end MEASUREMENT
/begin MEASUREMENT vTTER "Actual torque estimated value" SWORD COMP_0228 1 100 -3276.8 3276.7 ECU_ADDRESS 0xFFFF19FC /begin FUNCTION_LIST /end FUNCTION_LIST /end MEASUREMENT
/begin MEASUREMENT vTTETBL "After the change rate limiter treatment, target torque storage RAM" SWORD COMP_0228 1 100 -3276.8 3276.7 ECU_ADDRESS 0xFFFF1A08 /begin FUNCTION_LIST /end FUNCTION_LIST /end MEASUREMENT
/begin MEASUREMENT vTTETBL_R#1 "After the change rate limiter treatment, target torque storage RAM" SWORD COMP_0228 1 100 -3276.8 3276.7 ECU_ADDRESS 0xFFFF1A08 /begin FUNCTION_LIST /end FUNCTION_LIST /end MEASUREMENT
/begin MEASUREMENT vTTETBL_R#2 "After the change rate limiter treatment, target torque storage RAM" SWORD COMP_0228 1 100 -3276.8 3276.7 ECU_ADDRESS 0xFFFF1A0A /begin FUNCTION_LIST /end FUNCTION_LIST /end MEASUREMENT
/begin MEASUREMENT vTTETBL_R#3 "After the change rate limiter treatment, target torque storage RAM" SWORD COMP_0228 1 100 -3276.8 3276.7 ECU_ADDRESS 0xFFFF1A0C /begin FUNCTION_LIST /end FUNCTION_LIST /end MEASUREMENT
/begin MEASUREMENT vTTETBL_R#4 "After the change rate limiter treatment, target torque storage RAM" SWORD COMP_0228 1 100 -3276.8 3276.7 ECU_ADDRESS 0xFFFF1A0E /begin FUNCTION_LIST /end FUNCTION_LIST /end MEASUREMENT
/begin MEASUREMENT vTTETBL_R#5 "After the change rate limiter treatment, target torque storage RAM" SWORD COMP_0228 1 100 -3276.8 3276.7 ECU_ADDRESS 0xFFFF1A10 /begin FUNCTION_LIST /end FUNCTION_LIST /end MEASUREMENT
/begin MEASUREMENT vTTETBL_R#6 "After the change rate limiter treatment, target torque storage RAM" SWORD COMP_0228 1 100 -3276.8 3276.7 ECU_ADDRESS 0xFFFF1A12 /begin FUNCTION_LIST /end FUNCTION_LIST /end MEASUREMENT
/begin MEASUREMENT vTTETBL_R#7 "After the change rate limiter treatment, target torque storage RAM" SWORD COMP_0228 1 100 -3276.8 3276.7 ECU_ADDRESS 0xFFFF1A14 /begin FUNCTION_LIST /end FUNCTION_LIST /end MEASUREMENT
/begin MEASUREMENT vTTETBL_R#8 "After the change rate limiter treatment, target torque storage RAM" SWORD COMP_0228 1 100 -3276.8 3276.7 ECU_ADDRESS 0xFFFF1A16 /begin FUNCTION_LIST /end FUNCTION_LIST /end MEASUREMENT
/begin MEASUREMENT vTTETBL_R#9 "After the change rate limiter treatment, target torque storage RAM" SWORD COMP_0228 1 100 -3276.8 3276.7 ECU_ADDRESS 0xFFFF1A18 /begin FUNCTION_LIST /end FUNCTION_LIST /end MEASUREMENT
/begin MEASUREMENT vTTETBL_R#10 "After the change rate limiter treatment, target torque storage RAM" SWORD COMP_0228 1 100 -3276.8 3276.7 ECU_ADDRESS 0xFFFF1A1A /begin FUNCTION_LIST /end FUNCTION_LIST /end MEASUREMENT
/begin MEASUREMENT vTTETBL2 "After the change rate limiter treatment for the common FAST torque going down, target torque storage RAM" SWORD COMP_0228 1 100 -3276.8 3276.7 ECU_ADDRESS 0xFFFF1A1C /begin FUNCTION_LIST /end FUNCTION_LIST /end MEASUREMENT
/begin MEASUREMENT vTTETBL2_R#1 "After the change rate limiter treatment for the common FAST torque going down, target torque storage RAM" SWORD COMP_0228 1 100 -3276.8 3276.7 ECU_ADDRESS 0xFFFF1A1C /begin FUNCTION_LIST /end FUNCTION_LIST /end MEASUREMENT
/begin MEASUREMENT vTTETBL2_R#2 "After the change rate limiter treatment for the common FAST torque going down, target torque storage RAM" SWORD COMP_0228 1 100 -3276.8 3276.7 ECU_ADDRESS 0xFFFF1A1E /begin FUNCTION_LIST /end FUNCTION_LIST /end MEASUREMENT
/begin MEASUREMENT vTTETBL2_R#3 "After the change rate limiter treatment for the common FAST torque going down, target torque storage RAM" SWORD COMP_0228 1 100 -3276.8 3276.7 ECU_ADDRESS 0xFFFF1A20 /begin FUNCTION_LIST /end FUNCTION_LIST /end MEASUREMENT
/* COMPU_METHOD --------------------------------------------------------- */
/begin COMPU_METHOD COMP_0017 "1deg" RAT_FUNC "%8.2" "deg" COEFFS 0 1 0 0 0 1 /end COMPU_METHOD
/begin COMPU_METHOD COMP_0068 "1-" RAT_FUNC "%8.2" "-" COEFFS 0 1 0 0 0 1 /end COMPU_METHOD
/begin COMPU_METHOD COMP_0004 "1Å|" RAT_FUNC "%8.2" "Å|" COEFFS 0 1 0 0 0 1 /end COMPU_METHOD
/begin COMPU_METHOD COMP_0061 "5mv" RAT_FUNC "%8.2" "mv" COEFFS 0 1 0 0 0 5 /end COMPU_METHOD
/begin COMPU_METHOD COMP_0023 "5mV" RAT_FUNC "%8.2" "mV" COEFFS 0 1 0 0 0 5 /end COMPU_METHOD
/begin COMPU_METHOD COMP_0429 "1km/h" RAT_FUNC "%8.2" "km/h" COEFFS 0 1 0 0 0 1 /end COMPU_METHOD
/begin COMPU_METHOD COMP_0045 "1/128-" RAT_FUNC "%8.4" "-" COEFFS 0 1 0 0 0 0.0078125 /end COMPU_METHOD
/begin COMPU_METHOD COMP_0001 "1/8ms" RAT_FUNC "%8.2" "ms" COEFFS 0 1 0 0 0 0.125 /end COMPU_METHOD
/begin COMPU_METHOD COMP_0020 "50rpm" RAT_FUNC "%8.2" "rpm" COEFFS 0 1 0 0 0 50 /end COMPU_METHOD
/begin COMPU_METHOD COMP_0002 "0.35deg" RAT_FUNC "%8.2" "deg" COEFFS 0 1 0 0 0 0.35 /end COMPU_METHOD
/begin COMPU_METHOD COMP_0003 "1Åé" RAT_FUNC "%8.2" "Åé" COEFFS 0 1 0 0 0 1 /end COMPU_METHOD
/begin COMPU_METHOD COMP_0014 "10ms" RAT_FUNC "%8.2" "ms" COEFFS 0 1 0 0 0 10 /end COMPU_METHOD
/begin COMPU_METHOD COMP_0006 "12.5rpm" RAT_FUNC "%8.2" "rpm" COEFFS 0 1 0 0 0 12.5 /end COMPU_METHOD
/begin COMPU_METHOD COMP_0008 "100ms" RAT_FUNC "%8.2" "ms" COEFFS 0 1 0 0 0 100 /end COMPU_METHOD
/begin COMPU_METHOD COMP_0009 "100/128%" RAT_FUNC "%8.2" "%" COEFFS 0 1 0 0 0 0.78125 /end COMPU_METHOD
/begin COMPU_METHOD COMP_0013 "1s" RAT_FUNC "%8.2" "s" COEFFS 0 1 0 0 0 1 /end COMPU_METHOD
/begin COMPU_METHOD COMP_0047 "0.5%" RAT_FUNC "%8.2" "%" COEFFS 0 1 0 0 0 0.5 /end COMPU_METHOD
/begin COMPU_METHOD COMP_0018 "1deg" RAT_FUNC "%8.2" "deg" COEFFS 0 1 0 0 0 1 /end COMPU_METHOD
/begin COMPU_METHOD COMP_0019 "1degCA" RAT_FUNC "%8.2" "degCA" COEFFS 0 1 0 0 0 1 /end COMPU_METHOD
/begin COMPU_METHOD COMP_0250 "4ms" RAT_FUNC "%8.2" "ms" COEFFS 0 1 0 0 0 4 /end COMPU_METHOD
/begin COMPU_METHOD COMP_0033 "80mV" RAT_FUNC "%8.2" "mV" COEFFS 0 1 0 0 0 80 /end COMPU_METHOD
/begin COMPU_METHOD COMP_0049 "1sec" RAT_FUNC "%8.2" "sec" COEFFS 0 1 0 0 0 1 /end COMPU_METHOD
/begin COMPU_METHOD COMP_0130 "0.0275deg" RAT_FUNC "%8.3" "deg" COEFFS 0 1 0 0 0 0.0275 /end COMPU_METHOD
/begin COMPU_METHOD COMP_0015 "0.125Å|" RAT_FUNC "%8.2" "Å|" COEFFS 0 1 0 0 0 0.125 /end COMPU_METHOD
/begin COMPU_METHOD COMP_0030 "1âÒ" RAT_FUNC "%8.2" "âÒ" COEFFS 0 1 0 0 0 1 /end COMPU_METHOD
/begin COMPU_METHOD COMP_0362_S "0.125%" RAT_FUNC "%8.2" "%" COEFFS 0 1 0 0 0 0.125 /end COMPU_METHOD
/begin COMPU_METHOD COMP_0183 "20ms" RAT_FUNC "%8.2" "ms" COEFFS 0 1 0 0 0 20 /end COMPU_METHOD
/begin COMPU_METHOD COMP_0366_S "0.02s" RAT_FUNC "%8.3" "s" COEFFS 0 1 0 0 0 0.02 /end COMPU_METHOD
/begin COMPU_METHOD COMP_0048 "64/128degCA" RAT_FUNC "%8.2" "degCA" COEFFS 0 1 0 0 0 0.5 /end COMPU_METHOD
/begin COMPU_METHOD COMP_0016 "1count" RAT_FUNC "%8.2" "count" COEFFS 0 1 0 0 0 1 /end COMPU_METHOD
/begin COMPU_METHOD COMP_0054 "20mV" RAT_FUNC "%8.2" "mV" COEFFS 0 1 0 0 0 20 /end COMPU_METHOD
/begin COMPU_METHOD COMP_0050 "5/64mV" RAT_FUNC "%8.3" "mV" COEFFS 0 1 0 0 0 0.078125 /end COMPU_METHOD
/begin COMPU_METHOD COMP_0035 "X-50Åé" RAT_FUNC "%8.2" "Åé" COEFFS 0 1 50 0 0 1 /end COMPU_METHOD
/begin COMPU_METHOD COMP_0071 "1rev" RAT_FUNC "%8.2" "rev" COEFFS 0 1 0 0 0 1 /end COMPU_METHOD
/begin COMPU_METHOD COMP_0228 "0.1Nm" RAT_FUNC "%8.2" "Nm" COEFFS 0 1 0 0 0 0.1 /end COMPU_METHOD
/begin COMPU_METHOD COMP_0377 "0.11deg" RAT_FUNC "%8.2" "deg" COEFFS 0 1 0 0 0 0.11 /end COMPU_METHOD
/begin COMPU_METHOD COMP_0096 "10s" RAT_FUNC "%8.2" "s" COEFFS 0 1 0 0 0 10 /end COMPU_METHOD
/begin COMPU_METHOD COMP_0051 "1L/min" RAT_FUNC "%8.2" "L/min" COEFFS 0 1 0 0 0 1 /end COMPU_METHOD
/begin COMPU_METHOD COMP_0425 "100/255%" RAT_FUNC "%8.2" "%" COEFFS 0 1 0 0 0 0.392156862 /end COMPU_METHOD
/begin COMPU_METHOD COMP_0125 "1/256ms" RAT_FUNC "%8.4" "ms" COEFFS 0 1 0 0 0 0.00390625 /end COMPU_METHOD
/begin COMPU_METHOD COMP_0456 "1/(256Å~128)-" RAT_FUNC "%8.6" "-" COEFFS 0 1 0 0 0 0.0000305176 /end COMPU_METHOD
/begin COMPU_METHOD COMP_0104 "10mV" RAT_FUNC "%8.2" "mV" COEFFS 0 1 0 0 0 10 /end COMPU_METHOD
/begin COMPU_METHOD COMP_0256 "64/128degCA" RAT_FUNC "%8.2" "degCA" COEFFS 0 1 64 0 0 0.5 /end COMPU_METHOD
/begin COMPU_METHOD COMP_0277 "1L/min" RAT_FUNC "%8.2" "L/min" COEFFS 0 1 0 0 0 1 /end COMPU_METHOD
/begin COMPU_METHOD COMP_0450 "1/1024-" RAT_FUNC "%8.5" "-" COEFFS 0 1 0 0 0 0.000976563 /end COMPU_METHOD
/begin COMPU_METHOD COMP_0425_S "32/256-" RAT_FUNC "%8.2" "-" COEFFS 0 1 1 0 0 0.125 /end COMPU_METHOD
/begin COMPU_METHOD COMP_0073 "3.2us" RAT_FUNC "%8.2" "us" COEFFS 0 1 0 0 0 3.2 /end COMPU_METHOD
/begin COMPU_METHOD COMP_0191 "1REV" RAT_FUNC "%8.2" "REV" COEFFS 0 1 0 0 0 1 /end COMPU_METHOD
/begin COMPU_METHOD COMP_0062 "4Åé" RAT_FUNC "%8.2" "Åé" COEFFS 0 1 0 0 0 4 /end COMPU_METHOD
/begin COMPU_METHOD COMP_0220 "1l/min" RAT_FUNC "%8.2" "l/min" COEFFS 0 1 0 0 0 1 /end COMPU_METHOD
/begin COMPU_METHOD COMP_0146 "100/256/256%" RAT_FUNC "%8.4" "%" COEFFS 0 1 0 0 0 0.001525879 /end COMPU_METHOD
/begin COMPU_METHOD COMP_0139_S "É sÉ s" RAT_FUNC "%8.3" "É s" COEFFS 0 1 0 0 0 0.025 /end COMPU_METHOD
/begin COMPU_METHOD COMP_0232 "1/128mm^2" RAT_FUNC "%8.4" "mm^2" COEFFS 0 1 0 0 0 0.0078125 /end COMPU_METHOD
/begin COMPU_METHOD COMP_0492 "20/256mV" RAT_FUNC "%8.2" "mV" COEFFS 0 1 0 0 0 1 /end COMPU_METHOD
/begin COMPU_METHOD COMP_0356 "0.625X-40Åé" RAT_FUNC "%8.2" "Åé" COEFFS 0 1 40 0 0 0.625 /end COMPU_METHOD
/begin COMPU_METHOD COMP_0453_S "0.001Nm/rpm" RAT_FUNC "%8.4" "Nm/rpm" COEFFS 0 1 0 0 0 0.001 /end COMPU_METHOD
/begin COMPU_METHOD COMP_0454_S "0.78125rpm" RAT_FUNC "%8.2" "rpm" COEFFS 0 1 0 0 0 0.78125 /end COMPU_METHOD
/begin COMPU_METHOD COMP_0030_S "NN" RAT_FUNC "%8.2" "N" COEFFS 0 1 0 0 0 1 /end COMPU_METHOD
/begin COMPU_METHOD COMP_0468_S "1time" RAT_FUNC "%8.2" "time" COEFFS 0 1 0 0 0 1 /end COMPU_METHOD
/begin COMPU_METHOD COMP_0057 "1/16384Å|" RAT_FUNC "%8.6" "Å|" COEFFS 0 1 0 0 0 0.0000610352 /end COMPU_METHOD
/begin COMPU_METHOD COMP_0144 "1/2048ms" RAT_FUNC "%8.5" "ms" COEFFS 0 1 0 0 0 0.000488281 /end COMPU_METHOD
/begin COMPU_METHOD COMP_0295 "100msec" RAT_FUNC "%8.2" "msec" COEFFS 0 1 0 0 0 100 /end COMPU_METHOD
/begin COMPU_METHOD COMP_0231 "10É S" RAT_FUNC "%8.2" "É S" COEFFS 0 1 0 0 0 10 /end COMPU_METHOD
/begin COMPU_METHOD COMP_0053 "1ms" RAT_FUNC "%8.2" "ms" COEFFS 0 1 0 0 0 1 /end COMPU_METHOD
/begin COMPU_METHOD COMP_0226 "0.1Nm" RAT_FUNC "%8.2" "Nm" COEFFS 0 1 3276.8 0 0 0.1 /end COMPU_METHOD
/begin COMPU_METHOD COMP_0271 "100/128/256%" RAT_FUNC "%8.4" "%" COEFFS 0 1 0 0 0 0.003051758 /end COMPU_METHOD
/begin COMPU_METHOD COMP_0042 "0.0008cm**2" RAT_FUNC "%8.5" "cm**2" COEFFS 0 1 0 0 0 0.0008 /end COMPU_METHOD
/begin COMPU_METHOD COMP_0499_S "0.1L/m" RAT_FUNC "%8.2" "L/m" COEFFS 0 1 0 0 0 0.1 /end COMPU_METHOD
/begin COMPU_METHOD COMP_0303_S "3.90625E-11cm**2/rp" RAT_FUNC "%8.6" "cm**2/rp" COEFFS 0 1 0 0 0 3.90625E-11 /end COMPU_METHOD
/begin COMPU_METHOD COMP_0283 "1flag" RAT_FUNC "%8.2" "flag" COEFFS 0 1 0 0 0 1 /end COMPU_METHOD
/begin COMPU_METHOD COMP_0091 "Ã◊∏ﬁÃ◊∏ﬁ" RAT_FUNC "%8.2" "Ã◊∏ﬁ" COEFFS 0 1 0 0 0 1 /end COMPU_METHOD
/begin COMPU_METHOD COMP_0192 "10É s" RAT_FUNC "%8.2" "É s" COEFFS 0 1 0 0 0 10 /end COMPU_METHOD
/begin COMPU_METHOD COMP_0426 "Å|code" RAT_FUNC "%8.2" "code" COEFFS 0 1 0 0 0 1 /end COMPU_METHOD
/begin COMPU_METHOD COMP_0427 "0.25rpm" RAT_FUNC "%8.2" "rpm" COEFFS 0 1 0 0 0 0.25 /end COMPU_METHOD
/begin COMPU_METHOD COMP_0428 "X-40Åé" RAT_FUNC "%8.2" "Åé" COEFFS 0 1 40 0 0 1 /end COMPU_METHOD
/begin COMPU_METHOD COMP_0265 "1/4096%" RAT_FUNC "%8.5" "%" COEFFS 0 1 8.000012288 0 0 0.000244141 /end COMPU_METHOD
/begin COMPU_METHOD COMP_0166_S "msms" RAT_FUNC "%8.5" "ms" COEFFS 0 1 0 0 0 0.000976563 /end COMPU_METHOD
/begin COMPU_METHOD COMP_0407 "64/256%" RAT_FUNC "%8.2" "%" COEFFS 0 1 0 0 0 0.25 /end COMPU_METHOD
/begin COMPU_METHOD COMP_0140 "0.5STEP" RAT_FUNC "%8.2" "STEP" COEFFS 0 1 0 0 0 0.5 /end COMPU_METHOD
/begin COMPU_METHOD COMP_0141 "50/256%" RAT_FUNC "%8.2" "%" COEFFS 0 1 0 0 0 0.1953125 /end COMPU_METHOD
/begin COMPU_METHOD COMP_0371 "2cc" RAT_FUNC "%8.2" "cc" COEFFS 0 1 0 0 0 2 /end COMPU_METHOD
/begin COMPU_METHOD COMP_0491 "20/256mV" RAT_FUNC "%8.3" "mV" COEFFS 0 1 0 0 0 0.078125 /end COMPU_METHOD
/begin COMPU_METHOD COMP_0021_S "NmNm" RAT_FUNC "%8.2" "Nm" COEFFS 0 1 100 0 0 2 /end COMPU_METHOD
/begin COMPU_METHOD COMP_0118 "40mV" RAT_FUNC "%8.2" "mV" COEFFS 0 1 0 0 0 40 /end COMPU_METHOD
/begin COMPU_METHOD COMP_0380 "1/16count" RAT_FUNC "%8.3" "count" COEFFS 0 1 0 0 0 0.0625 /end COMPU_METHOD
/begin COMPU_METHOD COMP_0189 "3.2É S" RAT_FUNC "%8.2" "É S" COEFFS 0 1 0 0 0 3.2 /end COMPU_METHOD
/begin COMPU_METHOD COMP_0385 "1.608km" RAT_FUNC "%8.2" "km" COEFFS 0 1 0 0 0 1.608 /end COMPU_METHOD
/begin COMPU_METHOD COMP_0389 "1/2548km" RAT_FUNC "%8.5" "km" COEFFS 0 1 0 0 0 0.000392465 /end COMPU_METHOD
/begin COMPU_METHOD COMP_0394 "12.8É S" RAT_FUNC "%8.2" "É S" COEFFS 0 1 0 0 0 12.8 /end COMPU_METHOD
/begin COMPU_METHOD COMP_0438 "1/256%" RAT_FUNC "%8.4" "%" COEFFS 0 1 0 0 0 0.00390625 /end COMPU_METHOD
/begin COMPU_METHOD COMP_0345 "0.0032cm**2" RAT_FUNC "%8.4" "cm**2" COEFFS 0 1 0 0 0 0.0032 /end COMPU_METHOD
/begin COMPU_METHOD COMP_0071_S "cylcyl" RAT_FUNC "%8.2" "cyl" COEFFS 0 1 0 0 0 0.333333333 /end COMPU_METHOD
/begin COMPU_METHOD COMP_0072_S "%%" RAT_FUNC "%8.4" "%" COEFFS 0 1 1 0 0 0.0078125 /end COMPU_METHOD
/begin COMPU_METHOD COMP_0424 "1kpa" RAT_FUNC "%8.2" "kpa" COEFFS 0 1 0 0 0 1 /end COMPU_METHOD
/begin COMPU_METHOD COMP_0125_S "mm" RAT_FUNC "%8.2" "m" COEFFS 0 1 0 0 0 1 /end COMPU_METHOD
/begin COMPU_METHOD COMP_0614_S "%%" RAT_FUNC "%8.4" "%" COEFFS 0 1 0 0 0 0.003051757 /end COMPU_METHOD
/begin COMPU_METHOD COMP_0140_S "deg/80msdeg/80ms" RAT_FUNC "%8.2" "deg/80ms" COEFFS 0 1 0 0 0 0.11 /end COMPU_METHOD
/begin COMPU_METHOD COMP_0178 "1/32%" RAT_FUNC "%8.3" "%" COEFFS 0 1 0 0 0 0.03125 /end COMPU_METHOD
/begin COMPU_METHOD COMP_0075_S "kg/hkg/h" RAT_FUNC "%8.3" "kg/h" COEFFS 0 1 0 0 0 0.0128 /end COMPU_METHOD
/begin COMPU_METHOD COMP_0147 "0.0032cm^2" RAT_FUNC "%8.4" "cm^2" COEFFS 0 1 0 0 0 0.0032 /end COMPU_METHOD
/begin COMPU_METHOD COMP_0146_S "âÒâÒ" RAT_FUNC "%8.2" "âÒ" COEFFS 0 1 0 0 0 0.5 /end COMPU_METHOD
/begin COMPU_METHOD COMP_0617_S "gg" RAT_FUNC "%8.6" "g" COEFFS 0 1 0 0 0 0.0000610352 /end COMPU_METHOD
/begin COMPU_METHOD COMP_0148_S "âÒâÒ" RAT_FUNC "%8.2" "âÒ" COEFFS 0 1 0 0 0 1000 /end COMPU_METHOD
/begin COMPU_METHOD COMP_0622_S "AA" RAT_FUNC "%8.3" "A" COEFFS 0 1 0 0 0 0.0472 /end COMPU_METHOD
/begin COMPU_METHOD COMP_0150_S "É SÉ S" RAT_FUNC "%8.2" "É S" COEFFS 0 1 0 0 0 1 /end COMPU_METHOD
/begin COMPU_METHOD COMP_0151_S "--" RAT_FUNC "%8.3" "-" COEFFS 0 1 1.28 0 0 0.01 /end COMPU_METHOD
/begin COMPU_METHOD COMP_0152_S "--" RAT_FUNC "%8.6" "-" COEFFS 0 1 21474.83648 0 0 0.00001 /end COMPU_METHOD
/begin COMPU_METHOD COMP_0154_S "degCAdegCA" RAT_FUNC "%8.2" "degCA" COEFFS 0 1 16384 0 0 0.5 /end COMPU_METHOD
/begin COMPU_METHOD COMP_0626_S "rpmrpm" RAT_FUNC "%8.2" "rpm" COEFFS 0 1 0 0 0 0.78125 /end COMPU_METHOD
/begin COMPU_METHOD COMP_0494 "100ns" RAT_FUNC "%8.2" "ns" COEFFS 0 1 0 0 0 100 /end COMPU_METHOD
/begin COMPU_METHOD COMP_0499 "1/64Åé" RAT_FUNC "%8.4" "Åé" COEFFS 0 1 0 0 0 0.0015625 /end COMPU_METHOD
/begin COMPU_METHOD COMP_0247 "1/4cyl" RAT_FUNC "%8.2" "cyl" COEFFS 0 1 0 0 0 0.25 /end COMPU_METHOD
/begin COMPU_METHOD COMP_0630_S "Å|Å|" RAT_FUNC "%8.6" "Å|" COEFFS 0 1 0 0 0 0.000000119211 /end COMPU_METHOD
/begin COMPU_METHOD COMP_0501 "1/65535*128Å|" RAT_FUNC "%8.4" "Å|" COEFFS 0 1 0 0 0 0.00195316 /end COMPU_METHOD
/begin COMPU_METHOD COMP_0320 "1.6É S" RAT_FUNC "%8.2" "É S" COEFFS 0 1 0 0 0 1.6 /end COMPU_METHOD
/begin COMPU_METHOD COMP_0636_S "NmNm" RAT_FUNC "%8.2" "Nm" COEFFS 0 1 400 0 0 0.5 /end COMPU_METHOD
/begin COMPU_METHOD COMP_0172_S "”∞ƒﬁ”∞ƒﬁ" RAT_FUNC "%8.4" "”∞ƒﬁ" COEFFS 0 1 0 0 0 0.00390625 /end COMPU_METHOD
/begin COMPU_METHOD COMP_0173_S "”∞ƒﬁ”∞ƒﬁ" RAT_FUNC "%8.2" "”∞ƒﬁ" COEFFS 0 1 0 0 0 1 /end COMPU_METHOD
/begin COMPU_METHOD COMP_0174_S "degCAdegCA" RAT_FUNC "%8.4" "degCA" COEFFS 0 1 0 0 0 0.001953125 /end COMPU_METHOD
/end MODULE
/end PROJECT
