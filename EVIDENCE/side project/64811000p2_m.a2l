ASAP2_VERSION 1 3_BETA
/begin PROJECT TK_X91_EUR_VC ""
/begin HEADER "" /* key HEADER ++ "comment" Ç… Par.scomment */ PROJECT_NO TK_X91_EUR_VC /* key PROJECT_NO ++ project number Ç… car_eng_desti_lot */ VERSION "7V4YHZEB2" /* key VERSION ++ version number Ç… mProgver */ /end HEADER
/begin MODULE DIM ""
/begin MOD_COMMON "" DEPOSIT ABSOLUTE BYTE_ORDER MSB_FIRST /* ﬁ≤ƒµ∞¿ﬁ∞Ç™ÿÃﬂ⁄∞ΩÇ≥ÇÍÇÈ */ /end MOD_COMMON
/begin FUNCTION KF7-340.15[3] "Running resistance compensation control" /end FUNCTION
/begin FUNCTION KF7-340.16[4] "Area attribute compliant control-driving force compensation section" /end FUNCTION
/begin FUNCTION KF7-350.1M[5] "Target torque calculation (up to TTC) (main calculation section)" /end FUNCTION
/begin FUNCTION KF7-350.1P[4] "Target torque calculation (up to TTC) (sub calculation section)" /end FUNCTION
/begin FUNCTION KF7-350.4M[14] "Target throttle opening calculation (up to TTAAPO - TDTVO) (main calculation section)" /end FUNCTION
/begin FUNCTION KF7-350.4P[13] "Target throttle opening calculation (up to TTAAPO - TDTVO) (sub calculation section)" /end FUNCTION
/begin FUNCTION KF7-351.1[16] "Air flow rate learning control at off-line idle (rapid mode)" /end FUNCTION
/begin FUNCTION KF7-351.2[17] "Idle speed learning control" /end FUNCTION
/begin FUNCTION KF7-351.3[11] "Air rate learning control" /end FUNCTION
/begin FUNCTION KF7-360.1[12] "Throttle motor control (applicable to 1-CPU models)" /end FUNCTION
/begin FUNCTION KF7-360.2[N] "Motor relay control (only for 1CPU)" /end FUNCTION
/begin FUNCTION KF7-360.4[14] "Control flag process (applicable to 1-CPU models.)" /end FUNCTION
/begin FUNCTION KF7-360.7M[9] "Controllabity inprovement at vehicle start condition (main calculation part)" /end FUNCTION
/begin FUNCTION KF7-360.7P[8] "Controllabity inprovement at vehicle start condition (sub calculation part)" /end FUNCTION
/begin FUNCTION KF7-360.8A[N] "Inverse filter operation timer process for deceleration " /end FUNCTION
/begin FUNCTION KF7-360.8M[4] "Inverse filter type shaking control (main calculation section)" /end FUNCTION
/begin FUNCTION KF7-360.8P[3] "Inverse filter type shaking control (sub calculation section)" /end FUNCTION
/begin FUNCTION KF7-360.9M[43] "Drive protection control (main calculation section)" /end FUNCTION
/begin FUNCTION KF7-360.9P[22] "Drive protection control (sub calculation section)" /end FUNCTION
/begin FUNCTION KF7-360.11[1] "Control of high vehicle speed limiter" /end FUNCTION
/begin FUNCTION KF7-360.12[6] "Control of high engin speed limiter " /end FUNCTION
/begin FUNCTION KF7-371.1E[15] "Canister purge control (model based)" /end FUNCTION
/begin FUNCTION KF7-371B.2[5] "Model based purge control C source (for V bank engine)" /end FUNCTION
/begin FUNCTION KF7-373.1[1] "Fuel pump relay control" /end FUNCTION
/begin FUNCTION KF7-376.1[6] "Air Conditioner's relay output control" /end FUNCTION
/begin FUNCTION KF7-376.2[21] "Air conditioner cut control" /end FUNCTION
/begin FUNCTION KF7-376.3[2] "Air conditioner delay control" /end FUNCTION
/begin CHARACTERISTIC mACCUTN "Air-conditioning cut speed" VALUE 0x000081C3 REC_UBYTE_C 0 COMP_0006 0 3187.5 /begin FUNCTION_LIST KF7-376.2[21] /end FUNCTION_LIST /end CHARACTERISTIC
/begin CHARACTERISTIC mACCUTN2 "At the time of the running condition, air-conditioning cut speed" VALUE 0x000081C4 REC_UBYTE_C 0 COMP_0006 0 3187.5 /begin FUNCTION_LIST KF7-376.2[21] /end FUNCTION_LIST /end CHARACTERISTIC
/begin CHARACTERISTIC mACOFDY "At the time of air-conditioning off, delay" VALUE 0x000081D2 REC_UBYTE_C 0 COMP_0008 0 25500 /begin FUNCTION_LIST KF7-376.3[2] /end FUNCTION_LIST /end CHARACTERISTIC
/begin CHARACTERISTIC mACOKPD "A/C load stable distinction value" VALUE 0x000081D4 REC_UBYTE_C 0 COMP_0010 0 0.765 /begin FUNCTION_LIST KF7-351.2[17] /end FUNCTION_LIST /end CHARACTERISTIC
/begin CHARACTERISTIC mACRECN "Air-conditioning recover speed (hysteresis)" VALUE 0x000081DF REC_UBYTE_C 0 COMP_0006 0 3187.5 /begin FUNCTION_LIST KF7-376.2[21] KF7-385.1[32] /end FUNCTION_LIST /end CHARACTERISTIC
/begin CHARACTERISTIC mACRECN2 "At the time of the running condition, air-conditioning cut recover speed (hysteresis)" VALUE 0x000081E0 REC_UBYTE_C 0 COMP_0006 0 3187.5 /begin FUNCTION_LIST KF7-376.2[21] /end FUNCTION_LIST /end CHARACTERISTIC
/begin CHARACTERISTIC mACREDY "Air-conditioning recover delay" VALUE 0x000081E1 REC_UBYTE_C 0 COMP_0008 0 25500 /begin FUNCTION_LIST KF7-376.2[21] /end FUNCTION_LIST /end CHARACTERISTIC
/begin CHARACTERISTIC mACSTDY "AC After OFFON, delay" VALUE 0x000081E2 REC_UBYTE_C 0 COMP_0008 0 25500 /begin FUNCTION_LIST KF7-376.2[21] /end FUNCTION_LIST /end CHARACTERISTIC
/begin CHARACTERISTIC mADCGDALP "Purge cut switchover ALPHA limitation value for the purge-type judgement" VALUE 0x000081EC REC_UBYTE_C 0 COMP_0047 0 127.5 /begin FUNCTION_LIST KF7-371.1E[15] /end FUNCTION_LIST /end CHARACTERISTIC
/begin CHARACTERISTIC mADCGOKPR "Purge-type OK judgement purge rate" VALUE 0x000081ED REC_UBYTE_C 0 COMP_0163 0 15.9375 /begin FUNCTION_LIST KF7-371.1E[15] /end FUNCTION_LIST /end CHARACTERISTIC
/begin CHARACTERISTIC mADCGOKTM "Heat resisting OK judgement continuous time" VALUE 0x000081EE REC_UBYTE_C 0 COMP_0339_S 0 510 /begin FUNCTION_LIST KF7-371.1E[15] /end FUNCTION_LIST /end CHARACTERISTIC
/begin CHARACTERISTIC mADCGPMPR "At the time of the heat resisting, partial target purge rate" VALUE 0x000081EF REC_UBYTE_C 0 COMP_0163 0 15.9375 /begin FUNCTION_LIST KF7-371.1E[15] /end FUNCTION_LIST /end CHARACTERISTIC
/begin CHARACTERISTIC mADCGPRS "Canister drain-cut-type judgement pressure change threshold" VALUE 0x00008FA0 REC_UWORD_C 0 COMP_0486 0 5119.921875 /begin FUNCTION_LIST KF7-371.1E[15] /end FUNCTION_LIST /end CHARACTERISTIC
/begin CHARACTERISTIC mADDVSPLM "Compensation coefficient reset vehicle speed" VALUE 0x00008FA6 REC_UWORD_C 0 COMP_0436 0 6553.5 /begin FUNCTION_LIST KF7-340.15[3] /end FUNCTION_LIST /end CHARACTERISTIC
/begin CHARACTERISTIC mAFSOK "A/F deviation allowable value for the A/F enactment judgement" VALUE 0x00008235 REC_UBYTE_C 0 COMP_0343_S 0 5.1 /begin FUNCTION_LIST KF7-371.1E[15] /end FUNCTION_LIST /end CHARACTERISTIC
/begin CHARACTERISTIC mAFSOKTM "A/F deviation condition continuation time for the A/F enactment judgement" VALUE 0x00008236 REC_UBYTE_C 0 COMP_0267_S 0 25.5 /begin FUNCTION_LIST KF7-371.1E[15] /end FUNCTION_LIST /end CHARACTERISTIC
/begin CHARACTERISTIC mALCWAT "Activated charcoal total weight" VALUE 0x00008252 REC_UBYTE_C 0 COMP_0349_S 0 1020 /begin FUNCTION_LIST KF7-371.1E[15] /end FUNCTION_LIST /end CHARACTERISTIC
/begin CHARACTERISTIC mALINTDLY "ALPHA initialization delay" VALUE 0x00008265 REC_UBYTE_C 0 COMP_0165_S 0 2.55 /begin FUNCTION_LIST KF7-371.1E[15] /end FUNCTION_LIST /end CHARACTERISTIC
/begin CHARACTERISTIC mAPINVDEH "At the time of the slowdown, inverse operation condition open-degree" VALUE 0x00009026 REC_UWORD_C 0 COMP_0005 0 7208.85 /begin FUNCTION_LIST KF7-360.8A[N] /end FUNCTION_LIST /end CHARACTERISTIC
/begin CHARACTERISTIC mAPINVDEL "At the time of the slowdown, inverse operation start open-degree" VALUE 0x00009028 REC_UWORD_C 0 COMP_0005 0 7208.85 /begin FUNCTION_LIST KF7-360.8M[4] R301.8.Inverse_filter_1_1_3 /end FUNCTION_LIST /end CHARACTERISTIC
/begin CHARACTERISTIC mBMF "Model matching gain constant" VALUE 0x0000908C REC_UWORD_C 0 COMP_0068 0 65535 /begin FUNCTION_LIST KF7-360.1[12] /end FUNCTION_LIST /end CHARACTERISTIC
/begin CHARACTERISTIC mBSERCL "Base error judgement purge prohibition clear time" VALUE 0x00009090 REC_UWORD_C 0 COMP_0049 0 65535 /begin FUNCTION_LIST KF7-371.1E[15] /end FUNCTION_LIST /end CHARACTERISTIC
/begin CHARACTERISTIC mBSERTM "Target purge rate zero per cent accumulation time for the base error judgement" VALUE 0x00009092 REC_UWORD_C 0 COMP_0267_S 0 6553.5 /begin FUNCTION_LIST KF7-371.1E[15] /end FUNCTION_LIST /end CHARACTERISTIC
/begin CHARACTERISTIC mCADSCNDA "Calibration concentration condition air-fuel ratio limitation value" VALUE 0x000082D4 REC_UBYTE_C 0 COMP_0372_S 0 12.75 /begin FUNCTION_LIST KF7-371.1E[15] /end FUNCTION_LIST /end CHARACTERISTIC
/begin CHARACTERISTIC mCADSCNDB "Calibration concentration condition purge rate limitation value" VALUE 0x000082D5 REC_UBYTE_C 0 COMP_0419 0 25.5 /begin FUNCTION_LIST KF7-371.1E[15] /end FUNCTION_LIST /end CHARACTERISTIC
/begin CHARACTERISTIC mCADTYCND "Calibration duty limitation value" VALUE 0x000082D6 REC_UBYTE_C 0 COMP_0047 0 127.5 /begin FUNCTION_LIST KF7-371.1E[15] /end FUNCTION_LIST /end CHARACTERISTIC
/begin CHARACTERISTIC mCAQH0CND "Calibration QH0 limitation value" VALUE 0x000082E0 REC_UBYTE_C 0 COMP_0453 0 0.51 /begin FUNCTION_LIST KF7-371.1E[15] /end FUNCTION_LIST /end CHARACTERISTIC
/begin CHARACTERISTIC mCATGND "Calibration target A/F limitation value" VALUE 0x000082E4 REC_UBYTE_C 0 COMP_0373 0 2.55 /begin FUNCTION_LIST KF7-371.1E[15] /end FUNCTION_LIST /end CHARACTERISTIC
/begin CHARACTERISTIC mCKSTTM "After the start, time judgement value" VALUE 0x00008320 REC_UBYTE_C 0 COMP_0013 0 255 /begin FUNCTION_LIST KF7-360.9M[43] /end FUNCTION_LIST /end CHARACTERISTIC
/begin CHARACTERISTIC mCKTDTM "Torque limiter completion time" VALUE 0x00008322 REC_UBYTE_C 0 COMP_0008 0 25500 /begin FUNCTION_LIST KF7-360.9M[43] /end FUNCTION_LIST /end CHARACTERISTIC
/begin CHARACTERISTIC mCONNDTM "Delay time for the ND conclusion judgement" VALUE 0x00008352 REC_UBYTE_C 0 COMP_0014 0 2550 /begin FUNCTION_LIST KF7-360.9M[43] /end FUNCTION_LIST /end CHARACTERISTIC
/begin CHARACTERISTIC mCRIKIN1 "Calibration prohibition time 1" VALUE 0x00008365 REC_UBYTE_C 0 COMP_0267_S 0 25.5 /begin FUNCTION_LIST KF7-371.1E[15] /end FUNCTION_LIST /end CHARACTERISTIC
/begin CHARACTERISTIC mCRIKIN2 "Calibration prohibition time 2" VALUE 0x000090BA REC_UWORD_C 0 COMP_0267_S 0 6553.5 /begin FUNCTION_LIST KF7-371.1E[15] /end FUNCTION_LIST /end CHARACTERISTIC
/begin CHARACTERISTIC mCUTMSK "At the time of the re-acceleration, A/C cut prohibition time" VALUE 0x00008393 REC_UBYTE_C 0 COMP_0013 0 255 /begin FUNCTION_LIST KF7-376.2[21] R301.6.IscAirflow_1_4_5 /end FUNCTION_LIST /end CHARACTERISTIC
/begin CHARACTERISTIC mDAPINVDE "It steps, judgement value" VALUE 0x000090DE REC_UWORD_C 0 COMP_0038 0 7208.85 /begin FUNCTION_LIST KF7-360.8A[N] /end FUNCTION_LIST /end CHARACTERISTIC
/begin CHARACTERISTIC mDENTATUK "Canister heat transmission coefficient" VALUE 0x00008427 REC_UBYTE_C 0 COMP_0390_S 0 25.5 /begin FUNCTION_LIST KF7-371.1E[15] /end FUNCTION_LIST /end CHARACTERISTIC
/begin CHARACTERISTIC mDISCID "Subtraction side learning permission ISCI deviation" VALUE 0x00008448 REC_UBYTE_C 0 COMP_0051 0 255 /begin FUNCTION_LIST KF7-351.2[17] /end FUNCTION_LIST /end CHARACTERISTIC
/begin CHARACTERISTIC mDKEISUU "Canister model desorption coefficient" VALUE 0x00009102 REC_UWORD_C 0 COMP_0091_S 0 3276.75 /begin FUNCTION_LIST KF7-371.1E[15] /end FUNCTION_LIST /end CHARACTERISTIC
/begin CHARACTERISTIC mDLINVDEC "At the time of the slowdown, inverse operation time" VALUE 0x00008461 REC_UBYTE_C 0 COMP_0014 0 2550 /begin FUNCTION_LIST KF7-360.8A[N] R301.8.Inverse_filter_1_1_3 /end FUNCTION_LIST /end CHARACTERISTIC
/begin CHARACTERISTIC mDLPRHTID "At the time of the heat resisting idle purge, the amount of a change in a target purge rate" VALUE 0x00008468 REC_UBYTE_C 0 COMP_0394_S 0 2.55 /begin FUNCTION_LIST KF7-371.1E[15] /end FUNCTION_LIST /end CHARACTERISTIC
/begin CHARACTERISTIC mDLTALPDY "A purge cut switchover delay for the purge-type judgement" VALUE 0x00008469 REC_UBYTE_C 0 COMP_0049 0 255 /begin FUNCTION_LIST KF7-371.1E[15] /end FUNCTION_LIST /end CHARACTERISTIC
/begin CHARACTERISTIC mDLTALPHT "At the time of the heat resisting judgement purge cut, ALPHA deviation threshold" VALUE 0x0000846A REC_UBYTE_C 0 COMP_0101_S 0 51 /begin FUNCTION_LIST KF7-371.1E[15] /end FUNCTION_LIST /end CHARACTERISTIC
/begin CHARACTERISTIC mDLTFMNS "Addition drive power subtraction value (lamp treatment)" VALUE 0x00009114 REC_UWORD_C 0 COMP_0218_S 0 65535 /begin FUNCTION_LIST KF7-340.15[3] /end FUNCTION_LIST /end CHARACTERISTIC
/begin CHARACTERISTIC mDLTFPLS "Addition drive power addition value (lamp treatment)" VALUE 0x00009116 REC_UWORD_C 0 COMP_0218_S 0 65535 /begin FUNCTION_LIST KF7-340.15[3] /end FUNCTION_LIST /end CHARACTERISTIC
/begin CHARACTERISTIC mDLTFZMNS "Addition drive power subtraction value (lamp treatment)" VALUE 0x00009118 REC_UWORD_C 0 COMP_0219_S 0 65535 /begin FUNCTION_LIST KF7-340.16[4] /end FUNCTION_LIST /end CHARACTERISTIC
/begin CHARACTERISTIC mDLTFZPLS "Addition drive power addition value (lamp treatment)" VALUE 0x0000911A REC_UWORD_C 0 COMP_0219_S 0 65535 /begin FUNCTION_LIST KF7-340.16[4] /end FUNCTION_LIST /end CHARACTERISTIC
/begin CHARACTERISTIC mDLTMPR "At the time of the additional charge un-judgement, the amount of a change in an idle purge rate" VALUE 0x0000846D REC_UBYTE_C 0 COMP_0395_S 0 25.5 /begin FUNCTION_LIST KF7-371.1E[15] /end FUNCTION_LIST /end CHARACTERISTIC
/begin CHARACTERISTIC mDLVSP2 "A/C SW At the time of on, L/U prohibition vehicle speed" VALUE 0x00008478 REC_UBYTE_C 0 COMP_0007 0 510 /begin FUNCTION_LIST KF7-376.2[21] KF7-385.1[32] /end FUNCTION_LIST /end CHARACTERISTIC
/begin CHARACTERISTIC mDLVSPB "At the time of brake SW on, L/U prohibition vehicle speed" VALUE 0x00008479 REC_UBYTE_C 0 COMP_0007 0 510 /begin FUNCTION_LIST KF7-376.2[21] KF7-385.1[32] /end FUNCTION_LIST /end CHARACTERISTIC
/begin CHARACTERISTIC mDMPRGMX "Requirement purge treatment quantity maximum value" VALUE 0x00009128 REC_UWORD_C 0 COMP_0156 0 65535 /begin FUNCTION_LIST KF7-371.1E[15] /end FUNCTION_LIST /end CHARACTERISTIC
/begin CHARACTERISTIC mDQLEN "A high-speed air learning condition formation delay" VALUE 0x000084B1 REC_UBYTE_C 0 COMP_0008 0 25500 /begin FUNCTION_LIST KF7-351.3[11] /end FUNCTION_LIST /end CHARACTERISTIC
/begin CHARACTERISTIC mDRNCTDLY "Canister drain-cut switchover delay" VALUE 0x000084B6 REC_UBYTE_C 0 COMP_0049 0 255 /begin FUNCTION_LIST KF7-371.1E[15] /end FUNCTION_LIST /end CHARACTERISTIC
/begin CHARACTERISTIC mDRNCTDY2 "After the drain-cut OK judgement, drain-cut switchover delay" VALUE 0x000084B7 REC_UBYTE_C 0 COMP_0267_S 0 25.5 /begin FUNCTION_LIST KF7-371.1E[15] /end FUNCTION_LIST /end CHARACTERISTIC
/begin CHARACTERISTIC mDRNCTPAF "Pressure-type judgement permission purge A/F" VALUE 0x000084B8 REC_UBYTE_C 0 COMP_0015 0 31.875 /begin FUNCTION_LIST KF7-371.1E[15] /end FUNCTION_LIST /end CHARACTERISTIC
/begin CHARACTERISTIC mDRNJGTM "Canister drain-cut time" VALUE 0x000084B9 REC_UBYTE_C 0 COMP_0049 0 255 /begin FUNCTION_LIST KF7-371.1E[15] /end FUNCTION_LIST /end CHARACTERISTIC
/begin CHARACTERISTIC mDSISREV "A canister model desorption index number for the calibration" VALUE 0x000084C5 REC_UBYTE_C 0 COMP_0373 0 2.55 /begin FUNCTION_LIST KF7-371.1E[15] /end FUNCTION_LIST /end CHARACTERISTIC
/begin CHARACTERISTIC mDSISUUK "Canister model reference desorption index number" VALUE 0x0000913E REC_UWORD_C 0 COMP_0399_S 0 6553.5 /begin FUNCTION_LIST KF7-371.1E[15] /end FUNCTION_LIST /end CHARACTERISTIC
/begin CHARACTERISTIC mDTPQLR "A high-speed air learning dead-zone" VALUE 0x000084E5 REC_UBYTE_C 0 COMP_0125 0 0.99609375 /begin FUNCTION_LIST KF7-351.3[11] /end FUNCTION_LIST /end CHARACTERISTIC
/begin CHARACTERISTIC mDTRHEAT "Desorption heat" VALUE 0x000084E8 REC_UBYTE_C 0 COMP_0402_S 0 10200 /begin FUNCTION_LIST KF7-371.1E[15] /end FUNCTION_LIST /end CHARACTERISTIC
/begin CHARACTERISTIC mDTVQLS "The amount of low speed air learning (usually, mode) step" VALUE 0x000084FA REC_UBYTE_C 0 COMP_0131 0 4.98046875 /begin FUNCTION_LIST KF7-351.3[11] /end FUNCTION_LIST /end CHARACTERISTIC
/begin CHARACTERISTIC mDTYTOPQ "duty flow-quantity conversion coefficient" VALUE 0x000084FF REC_UBYTE_C 0 COMP_0403_S 0 0.79815 /begin FUNCTION_LIST KF7-371.1E[15] /end FUNCTION_LIST /end CHARACTERISTIC
/begin CHARACTERISTIC mDYCKLU "L/U judgement delay" VALUE 0x00008522 REC_UBYTE_C 0 COMP_0014 0 2550 /begin FUNCTION_LIST KF7-360.8M[4] R301.8.Inverse_filter_1_1_3 /end FUNCTION_LIST /end CHARACTERISTIC
/begin CHARACTERISTIC mFBDLY "At the time of the idle, air-fuel ratio feedback time" VALUE 0x000085D7 REC_UBYTE_C 0 COMP_0136 0 5.1 /begin FUNCTION_LIST KF7-371.1E[15] /end FUNCTION_LIST /end CHARACTERISTIC
/begin CHARACTERISTIC mFCTTMLM "Calibration fuel cut condition continuation time" VALUE 0x000085F3 REC_UBYTE_C 0 COMP_0267_S 0 25.5 /begin FUNCTION_LIST KF7-371.1E[15] /end FUNCTION_LIST /end CHARACTERISTIC
/begin CHARACTERISTIC mFHOSCON "At the time of learning, FHOS value fixed magnification" VALUE 0x00008602 REC_UBYTE_C 0 COMP_0341 0 0.99705 /begin FUNCTION_LIST KF7-371.1E[15] /end FUNCTION_LIST /end CHARACTERISTIC
/begin CHARACTERISTIC mFPCUT "A hand-operated purge cut flag" VALUE 0x00008617 REC_UBYTE_C 0 COMP_0068 0 255 /begin FUNCTION_LIST KF7-371.1E[15] /end FUNCTION_LIST /end CHARACTERISTIC
/begin CHARACTERISTIC mGD1_H "Compensation vessel H/G filter constant 4 (HI gain)" VALUE 0x000091D0 REC_UWORD_C 0 COMP_0068 0 65535 /begin FUNCTION_LIST KF7-360.1[12] /end FUNCTION_LIST /end CHARACTERISTIC
/begin CHARACTERISTIC mGD1_L "Compensation vessel H/G filter constant 4 (LO gain)" VALUE 0x000091D2 REC_UWORD_C 0 COMP_0068 0 65535 /begin FUNCTION_LIST KF7-360.1[12] /end FUNCTION_LIST /end CHARACTERISTIC
/begin CHARACTERISTIC mGDELAY "The acceleration filter the first delay coefficient" VALUE 0x000091D4 REC_UWORD_C 0 COMP_0410 0 99.9985458 /begin FUNCTION_LIST KF7-340.15[3] /end FUNCTION_LIST /end CHARACTERISTIC
/begin CHARACTERISTIC mGN0_H "Compensation vessel H/G filter constant 3 (HI gain)" VALUE 0x000091E4 REC_UWORD_C 0 COMP_0068 0 65535 /begin FUNCTION_LIST KF7-360.1[12] /end FUNCTION_LIST /end CHARACTERISTIC
/begin CHARACTERISTIC mGN0_L "Compensation vessel H/G filter constant 3 (LO gain)" VALUE 0x000091E6 REC_UWORD_C 0 COMP_0068 0 65535 /begin FUNCTION_LIST KF7-360.1[12] /end FUNCTION_LIST /end CHARACTERISTIC
/begin CHARACTERISTIC mGN1_H "Compensation vessel H/G filter constant 2 (HI gain)" VALUE 0x000091E8 REC_UWORD_C 0 COMP_0068 0 65535 /begin FUNCTION_LIST KF7-360.1[12] /end FUNCTION_LIST /end CHARACTERISTIC
/begin CHARACTERISTIC mGN1_L "Compensation vessel H/G filter constant 2 (LO gain)" VALUE 0x000091EA REC_UWORD_C 0 COMP_0068 0 65535 /begin FUNCTION_LIST KF7-360.1[12] /end FUNCTION_LIST /end CHARACTERISTIC
/begin CHARACTERISTIC mGN2_H "Compensation vessel H/G filter constant 1 (HI gain)" VALUE 0x000091EC REC_UWORD_C 0 COMP_0068 0 65535 /begin FUNCTION_LIST KF7-360.1[12] /end FUNCTION_LIST /end CHARACTERISTIC
/begin CHARACTERISTIC mGN2_L "Compensation vessel H/G filter constant 1 (LO gain)" VALUE 0x000091EE REC_UWORD_C 0 COMP_0068 0 65535 /begin FUNCTION_LIST KF7-360.1[12] /end FUNCTION_LIST /end CHARACTERISTIC
/begin CHARACTERISTIC mGTVQLH "A high-speed air learning F/B gain (High)" VALUE 0x0000867F REC_UBYTE_C 0 COMP_0414_S 0 2.490234375 /begin FUNCTION_LIST KF7-351.3[11] /end FUNCTION_LIST /end CHARACTERISTIC
/begin CHARACTERISTIC mGTVQLL "A high-speed air learning F/B gain (Low)" VALUE 0x00008680 REC_UBYTE_C 0 COMP_0414_S 0 2.490234375 /begin FUNCTION_LIST KF7-351.3[11] /end FUNCTION_LIST /end CHARACTERISTIC
/begin CHARACTERISTIC mGTVQLSR "Low speed air learning (rapid mode) gain" VALUE 0x00008681 REC_UBYTE_C 0 COMP_0063 0 0.99609375 /begin FUNCTION_LIST KF7-351.3[11] /end FUNCTION_LIST /end CHARACTERISTIC
/begin CHARACTERISTIC mHD1_H "Compensation vessel H filter constant 3 (HI gain)" VALUE 0x0000920E REC_UWORD_C 0 COMP_0068 0 65535 /begin FUNCTION_LIST KF7-360.1[12] /end FUNCTION_LIST /end CHARACTERISTIC
/begin CHARACTERISTIC mHD1_L "Compensation vessel H filter constant 3 (LO gain)" VALUE 0x00009210 REC_UWORD_C 0 COMP_0068 0 65535 /begin FUNCTION_LIST KF7-360.1[12] /end FUNCTION_LIST /end CHARACTERISTIC
/begin CHARACTERISTIC mHN0_H "Compensation vessel H filter constant 2 (HI gain)" VALUE 0x0000922E REC_UWORD_C 0 COMP_0068 0 65535 /begin FUNCTION_LIST KF7-360.1[12] /end FUNCTION_LIST /end CHARACTERISTIC
/begin CHARACTERISTIC mHN0_L "Compensation vessel H filter constant 2 (LO gain)" VALUE 0x00009230 REC_UWORD_C 0 COMP_0068 0 65535 /begin FUNCTION_LIST KF7-360.1[12] /end FUNCTION_LIST /end CHARACTERISTIC
/begin CHARACTERISTIC mHN1_H "Compensation vessel H filter constant 1 (HI gain)" VALUE 0x00009232 REC_UWORD_C 0 COMP_0068 0 65535 /begin FUNCTION_LIST KF7-360.1[12] /end FUNCTION_LIST /end CHARACTERISTIC
/begin CHARACTERISTIC mHN1_L "Compensation vessel H filter constant 1 (LO gain)" VALUE 0x00009234 REC_UWORD_C 0 COMP_0068 0 65535 /begin FUNCTION_LIST KF7-360.1[12] /end FUNCTION_LIST /end CHARACTERISTIC
/begin CHARACTERISTIC mHNTN "Hunting judgement number of times" VALUE 0x00008698 REC_UBYTE_C 0 COMP_0016 0 255 /begin FUNCTION_LIST KF7-376.2[21] /end FUNCTION_LIST /end CHARACTERISTIC
/begin CHARACTERISTIC mHOTIDLMX "Heat resisting idle purge maximum purge rate" VALUE 0x000086A1 REC_UBYTE_C 0 COMP_0419 0 25.5 /begin FUNCTION_LIST KF7-371.1E[15] /end FUNCTION_LIST /end CHARACTERISTIC
/begin CHARACTERISTIC mHTPRDLY "Heat resisting off idle purge rate rise delay" VALUE 0x000086A4 REC_UBYTE_C 0 COMP_0394_S 0 2.55 /begin FUNCTION_LIST KF7-371.1E[15] /end FUNCTION_LIST /end CHARACTERISTIC
/begin CHARACTERISTIC mIDLEMXPR "Idle maximum purge rate" VALUE 0x000086ED REC_UBYTE_C 0 COMP_0419 0 25.5 /begin FUNCTION_LIST KF7-371.1E[15] /end FUNCTION_LIST /end CHARACTERISTIC
/begin CHARACTERISTIC mIDLEREF "A vEVOUTT operation coefficient for the idle" VALUE 0x000086EE REC_UBYTE_C 0 COMP_0068 0 255 /begin FUNCTION_LIST KF7-371.1E[15] /end FUNCTION_LIST /end CHARACTERISTIC
/begin CHARACTERISTIC mIDLFBHS "At the time of the heat resisting idle purge, target ALPHA deviation hysteresis" VALUE 0x000086EF REC_UBYTE_C 0 COMP_0419 0 25.5 /begin FUNCTION_LIST KF7-371.1E[15] /end FUNCTION_LIST /end CHARACTERISTIC
/begin CHARACTERISTIC mIDLFHLM "Slowdown, idle purge fuel assignment rate limitation value" VALUE 0x000086F0 REC_UBYTE_C 0 COMP_0419 0 25.5 /begin FUNCTION_LIST KF7-371.1E[15] /end FUNCTION_LIST /end CHARACTERISTIC
/begin CHARACTERISTIC mIDLJGDLY "Idle purge start delay" VALUE 0x000086F1 REC_UBYTE_C 0 COMP_0049 0 255 /begin FUNCTION_LIST KF7-371.1E[15] /end FUNCTION_LIST /end CHARACTERISTIC
/begin CHARACTERISTIC mIDLOKPAF "Slowdown, idle purge permission purge A/F" VALUE 0x000086F5 REC_UBYTE_C 0 COMP_0464 0 31.875 /begin FUNCTION_LIST KF7-371.1E[15] /end FUNCTION_LIST /end CHARACTERISTIC
/begin CHARACTERISTIC mILIMIT "An electric current limiter for the inside model" VALUE 0x00009758 REC_ULONG_C 0 COMP_0233_S 0 32767.9805308001 /begin FUNCTION_LIST KF7-360.1[12] KF7-505.32[6] /end FUNCTION_LIST /end CHARACTERISTIC
/begin CHARACTERISTIC mINVGPH "Control permission upper limit gear position" VALUE 0x0000873F REC_UBYTE_C 0 COMP_0068 0 255 /begin FUNCTION_LIST KF7-360.8M[4] R301.8.Inverse_filter_1_1_3 /end FUNCTION_LIST /end CHARACTERISTIC
/begin CHARACTERISTIC mINVGPL "Control permission lower limit gear position" VALUE 0x00008740 REC_UBYTE_C 0 COMP_0068 0 255 /begin FUNCTION_LIST KF7-360.8M[4] R301.8.Inverse_filter_1_1_3 /end FUNCTION_LIST /end CHARACTERISTIC
/begin CHARACTERISTIC mINVGR1 "A gear ratio lattice point for parameter switching" VALUE 0x000092F0 REC_UWORD_C 0 COMP_0063 0 255.99609375 /begin FUNCTION_LIST KF7-360.8M[4] R301.8.Inverse_filter_1_1_3 /end FUNCTION_LIST /end CHARACTERISTIC
/begin CHARACTERISTIC mINVGR2 "A gear ratio lattice point for parameter switching" VALUE 0x000092F2 REC_UWORD_C 0 COMP_0063 0 255.99609375 /begin FUNCTION_LIST KF7-360.8M[4] R301.8.Inverse_filter_1_1_3 /end FUNCTION_LIST /end CHARACTERISTIC
/begin CHARACTERISTIC mINVGR3 "A gear ratio lattice point for parameter switching" VALUE 0x000092F4 REC_UWORD_C 0 COMP_0063 0 255.99609375 /begin FUNCTION_LIST KF7-360.8M[4] R301.8.Inverse_filter_1_1_3 /end FUNCTION_LIST /end CHARACTERISTIC
/begin CHARACTERISTIC mINVGR4 "A gear ratio lattice point for parameter switching" VALUE 0x000092F6 REC_UWORD_C 0 COMP_0063 0 255.99609375 /begin FUNCTION_LIST KF7-360.8M[4] R301.8.Inverse_filter_1_1_3 /end FUNCTION_LIST /end CHARACTERISTIC
/begin CHARACTERISTIC mINVGR5 "A gear ratio lattice point for parameter switching" VALUE 0x000092F8 REC_UWORD_C 0 COMP_0063 0 255.99609375 /begin FUNCTION_LIST KF7-360.8M[4] R301.8.Inverse_filter_1_1_3 /end FUNCTION_LIST /end CHARACTERISTIC
/begin CHARACTERISTIC mINVGR6 "A gear ratio lattice point for parameter switching" VALUE 0x000092FA REC_UWORD_C 0 COMP_0063 0 255.99609375 /begin FUNCTION_LIST KF7-360.8M[4] R301.8.Inverse_filter_1_1_3 /end FUNCTION_LIST /end CHARACTERISTIC
/begin CHARACTERISTIC mINVGR7 "A gear ratio lattice point for parameter switching" VALUE 0x000092FC REC_UWORD_C 0 COMP_0063 0 255.99609375 /begin FUNCTION_LIST KF7-360.8M[4] R301.8.Inverse_filter_1_1_3 /end FUNCTION_LIST /end CHARACTERISTIC
/begin CHARACTERISTIC mINVGR8 "A gear ratio lattice point for parameter switching" VALUE 0x000092FE REC_UWORD_C 0 COMP_0063 0 255.99609375 /begin FUNCTION_LIST KF7-360.8M[4] R301.8.Inverse_filter_1_1_3 /end FUNCTION_LIST /end CHARACTERISTIC
/begin CHARACTERISTIC mINVGRH "- control effect-less switching gear ratio condition upper limit" VALUE 0x00009300 REC_UWORD_C 0 COMP_0063 0 255.99609375 /begin FUNCTION_LIST KF7-360.8M[4] R301.8.Inverse_filter_1_1_3 /end FUNCTION_LIST /end CHARACTERISTIC
/begin CHARACTERISTIC mINVGRL "- control effect-less switching gear ratio condition lower limit" VALUE 0x00009302 REC_UWORD_C 0 COMP_0063 0 255.99609375 /begin FUNCTION_LIST KF7-360.8M[4] R301.8.Inverse_filter_1_1_3 /end FUNCTION_LIST /end CHARACTERISTIC
/begin CHARACTERISTIC mINVRPM1 "Engine speed limitation condition 1" VALUE 0x00008741 REC_UBYTE_C 0 COMP_0020 0 12750 /begin FUNCTION_LIST KF7-360.8M[4] R301.8.Inverse_filter_1_1_3 /end FUNCTION_LIST /end CHARACTERISTIC
/begin CHARACTERISTIC mINVRPM2 "Engine speed limitation condition 2" VALUE 0x00008742 REC_UBYTE_C 0 COMP_0020 0 12750 /begin FUNCTION_LIST KF7-360.8M[4] R301.8.Inverse_filter_1_1_3 /end FUNCTION_LIST /end CHARACTERISTIC
/begin CHARACTERISTIC mINVVSP "- control effect-less switching vehicle speed condition" VALUE 0x00008743 REC_UBYTE_C 0 COMP_0007 0 510 /begin FUNCTION_LIST KF7-360.8M[4] R301.8.Inverse_filter_1_1_3 /end FUNCTION_LIST /end CHARACTERISTIC
/begin CHARACTERISTIC mISCLRD "Learning operation start delay" VALUE 0x00008757 REC_UBYTE_C 0 COMP_0008 0 25500 /begin FUNCTION_LIST KF7-351.1[16] KF7-351.2[17] /end FUNCTION_LIST /end CHARACTERISTIC
/begin CHARACTERISTIC mISLRDD "Subtraction side learning start delay" VALUE 0x0000876C REC_UBYTE_C 0 COMP_0013 0 255 /begin FUNCTION_LIST KF7-351.2[17] /end FUNCTION_LIST /end CHARACTERISTIC
/begin CHARACTERISTIC mIVGROF "Gear ratio offset value" VALUE 0x00008F14 REC_SWORD_C 0 COMP_0203 -128 127.99609375 /begin FUNCTION_LIST KF7-360.8M[4] R301.8.Inverse_filter_1_1_3 /end FUNCTION_LIST /end CHARACTERISTIC
/begin CHARACTERISTIC mJGVSPHYS "Switchover compensation permission vehicle speed hysteresis" VALUE 0x00009312 REC_UWORD_C 0 COMP_0436 0 6553.5 /begin FUNCTION_LIST KF7-340.15[3] /end FUNCTION_LIST /end CHARACTERISTIC
/begin CHARACTERISTIC mJGVSPON "Switchover compensation permission vehicle speed" VALUE 0x00009314 REC_UWORD_C 0 COMP_0436 0 6553.5 /begin FUNCTION_LIST KF7-340.15[3] /end FUNCTION_LIST /end CHARACTERISTIC
/begin CHARACTERISTIC mKDECRS1 "Addition drive power subtraction value" VALUE 0x00009326 REC_UWORD_C 0 COMP_0218_S 0 65535 /begin FUNCTION_LIST KF7-340.15[3] /end FUNCTION_LIST /end CHARACTERISTIC
/begin CHARACTERISTIC mKDELAY "The running resistance torque increase width filter the first delay coefficient" VALUE 0x00009328 REC_UWORD_C 0 COMP_0410 0 99.9985458 /begin FUNCTION_LIST KF7-340.15[3] /end FUNCTION_LIST /end CHARACTERISTIC
/begin CHARACTERISTIC mKEVREF "vEVOUTT operation coefficient" VALUE 0x00008799 REC_UBYTE_C 0 COMP_0004 0 255 /begin FUNCTION_LIST KF7-371.1E[15] /end FUNCTION_LIST /end CHARACTERISTIC
/begin CHARACTERISTIC mKG2FD "Acceleration resistance conversion coefficient" VALUE 0x0000932A REC_UWORD_C 0 COMP_0238_S 0 65535 /begin FUNCTION_LIST KF7-340.15[3] /end FUNCTION_LIST /end CHARACTERISTIC
/begin CHARACTERISTIC mKREDUCT "Delay compensation A/F change decrease rate" VALUE 0x000087DE REC_UBYTE_C 0 COMP_0432_S 0 0.99603 /begin FUNCTION_LIST KF7-371.1E[15] /end FUNCTION_LIST /end CHARACTERISTIC
/begin CHARACTERISTIC mKTVOFAD "mVdeg conversion coefficient" VALUE 0x0000934A REC_UWORD_C 0 COMP_0223 0 6.5535 /begin FUNCTION_LIST KF7-351.3[11] /end FUNCTION_LIST /end CHARACTERISTIC
/begin CHARACTERISTIC mKVSPMNS "When control is turned off, the amount of a change in compensation coefficient" VALUE 0x00009354 REC_UWORD_C 0 COMP_0410 0 99.9985458 /begin FUNCTION_LIST KF7-340.15[3] /end FUNCTION_LIST /end CHARACTERISTIC
/begin CHARACTERISTIC mKVSPMNS1 "When control is turned off, compensation coefficient change quantity (at the time of idle SW on)" VALUE 0x00009356 REC_UWORD_C 0 COMP_0146 0 99.998480265 /begin FUNCTION_LIST KF7-340.15[3] /end FUNCTION_LIST /end CHARACTERISTIC
/begin CHARACTERISTIC mKVSPPLS "When control is turned on, the amount of a change in compensation coefficient" VALUE 0x00009358 REC_UWORD_C 0 COMP_0410 0 99.9985458 /begin FUNCTION_LIST KF7-340.15[3] /end FUNCTION_LIST /end CHARACTERISTIC
/begin CHARACTERISTIC mLARNPRG "At the time of air-fuel ratio learning, purge rate" VALUE 0x000087F5 REC_UBYTE_C 0 COMP_0133_S 0 9.9609375 /begin FUNCTION_LIST KF7-371.1E[15] /end FUNCTION_LIST /end CHARACTERISTIC
/begin CHARACTERISTIC mLCSTVB "Learning operation start battery voltage" VALUE 0x000087FC REC_UBYTE_C 0 COMP_0033 0 20400 /begin FUNCTION_LIST KF7-351.1[16] KF7-351.2[17] /end FUNCTION_LIST /end CHARACTERISTIC
/begin CHARACTERISTIC mLENDLY "Lean operation permission delay" VALUE 0x0000880D REC_UBYTE_C 0 COMP_0234 0 2550 /begin FUNCTION_LIST KF7-351.3[11] /end FUNCTION_LIST /end CHARACTERISTIC
/begin CHARACTERISTIC mLMISCL "QFBI limiter (addition side)" VALUE 0x0000881D REC_UBYTE_C 0 COMP_0051 0 255 /begin FUNCTION_LIST KF7-351.2[17] /end FUNCTION_LIST /end CHARACTERISTIC
/begin CHARACTERISTIC mLMISLD "Learning value maximum change width" VALUE 0x0000881E REC_UBYTE_C 0 COMP_0051 0 255 /begin FUNCTION_LIST KF7-351.2[17] /end FUNCTION_LIST /end CHARACTERISTIC
/begin CHARACTERISTIC mLMISLG "Subtraction side learning value maximum change width" VALUE 0x0000881F REC_UBYTE_C 0 COMP_0051 0 255 /begin FUNCTION_LIST KF7-351.2[17] /end FUNCTION_LIST /end CHARACTERISTIC
/begin CHARACTERISTIC mLN0 "Compensation vessel L filter constant 2" VALUE 0x0000937E REC_UWORD_C 0 COMP_0068 0 65535 /begin FUNCTION_LIST KF7-360.1[12] /end FUNCTION_LIST /end CHARACTERISTIC
/begin CHARACTERISTIC mLN1 "Compensation vessel L filter constant 1" VALUE 0x00009380 REC_UWORD_C 0 COMP_0068 0 65535 /begin FUNCTION_LIST KF7-360.1[12] /end FUNCTION_LIST /end CHARACTERISTIC
/begin CHARACTERISTIC mMABF "A change in a target A/F" VALUE 0x00008836 REC_UBYTE_C 0 COMP_0373 0 2.55 /begin FUNCTION_LIST KF7-371.1E[15] /end FUNCTION_LIST /end CHARACTERISTIC
/begin CHARACTERISTIC mMISFTMLM "Calibration misfire condition continuation time" VALUE 0x00008856 REC_UBYTE_C 0 COMP_0267_S 0 25.5 /begin FUNCTION_LIST KF7-371.1E[15] /end FUNCTION_LIST /end CHARACTERISTIC
/begin CHARACTERISTIC mMOTRES "Motor resistance value" VALUE 0x000093B0 REC_UWORD_C 0 COMP_0245_S 0 655.35 /begin FUNCTION_LIST KF7-360.1[12] /end FUNCTION_LIST /end CHARACTERISTIC
/begin CHARACTERISTIC mMPROKTM "Purge-type OK judgement purge rate continuation time" VALUE 0x00008866 REC_UBYTE_C 0 COMP_0267_S 0 25.5 /begin FUNCTION_LIST KF7-371.1E[15] /end FUNCTION_LIST /end CHARACTERISTIC
/begin CHARACTERISTIC mMPRUP "At the time of the ALPHA limiter MPR limitation, purge rate UP interval" VALUE 0x00008867 REC_UBYTE_C 0 COMP_0267_S 0 25.5 /begin FUNCTION_LIST KF7-371.1E[15] /end FUNCTION_LIST /end CHARACTERISTIC
/begin CHARACTERISTIC mMPRUPVOL "At the time of the ALPHA limiter MPR limitation, purge UP rate" VALUE 0x00008868 REC_UBYTE_C 0 COMP_0419 0 25.5 /begin FUNCTION_LIST KF7-371.1E[15] /end FUNCTION_LIST /end CHARACTERISTIC
/begin CHARACTERISTIC mMPRZRT "Purge cut time for the calibration" VALUE 0x00008869 REC_UBYTE_C 0 COMP_0267_S 0 25.5 /begin FUNCTION_LIST KF7-371.1E[15] /end FUNCTION_LIST /end CHARACTERISTIC
/begin CHARACTERISTIC mMXDLALP2 "The second learning requirement maximum air-fuel ratio change target value" VALUE 0x00008876 REC_UBYTE_C 0 COMP_0419 0 25.5 /begin FUNCTION_LIST KF7-371.1E[15] /end FUNCTION_LIST /end CHARACTERISTIC
/begin CHARACTERISTIC mMXDLTALP "Maximum air-fuel ratio change target value" VALUE 0x00008877 REC_UBYTE_C 0 COMP_0419 0 25.5 /begin FUNCTION_LIST KF7-371.1E[15] /end FUNCTION_LIST /end CHARACTERISTIC
/begin CHARACTERISTIC mMXMPR "Target purge rate maximum value" VALUE 0x00008878 REC_UBYTE_C 0 COMP_0027 0 255 /begin FUNCTION_LIST KF7-371.1E[15] /end FUNCTION_LIST /end CHARACTERISTIC
/begin CHARACTERISTIC mNACC "Air-conditioning cut speed" VALUE 0x0000887A REC_UBYTE_C 0 COMP_0020 0 12750 /begin FUNCTION_LIST KF7-376.2[21] /end FUNCTION_LIST /end CHARACTERISTIC
/begin CHARACTERISTIC mNACCUT "Air-conditioning cut speed" VALUE 0x0000887B REC_UBYTE_C 0 COMP_0020 0 12750 /begin FUNCTION_LIST KF7-376.1[6] /end FUNCTION_LIST /end CHARACTERISTIC
/begin CHARACTERISTIC mNACREC "Recover speed" VALUE 0x0000887C REC_UBYTE_C 0 COMP_0020 0 12750 /begin FUNCTION_LIST KF7-376.1[6] /end FUNCTION_LIST /end CHARACTERISTIC
/begin CHARACTERISTIC mNACRECI "Recover speed (idle)" VALUE 0x0000887D REC_UBYTE_C 0 COMP_0020 0 12750 /begin FUNCTION_LIST KF7-376.1[6] /end FUNCTION_LIST /end CHARACTERISTIC
/begin CHARACTERISTIC mNEACH "Engine rotation upper limit value" VALUE 0x00008899 REC_UBYTE_C 0 COMP_0020 0 12750 /begin FUNCTION_LIST KF7-376.1[6] /end FUNCTION_LIST /end CHARACTERISTIC
/begin CHARACTERISTIC mNEACL "Engine rotation lower limit value" VALUE 0x0000889A REC_UBYTE_C 0 COMP_0020 0 12750 /begin FUNCTION_LIST KF7-376.2[21] /end FUNCTION_LIST /end CHARACTERISTIC
/begin CHARACTERISTIC mNEACM "Engine rotation middle value" VALUE 0x0000889B REC_UBYTE_C 0 COMP_0020 0 12750 /begin FUNCTION_LIST KF7-376.1[6] /end FUNCTION_LIST /end CHARACTERISTIC
/begin CHARACTERISTIC mNEARL "Engine rotation recover lower limit value" VALUE 0x0000889D REC_UBYTE_C 0 COMP_0020 0 12750 /begin FUNCTION_LIST KF7-376.2[21] /end FUNCTION_LIST /end CHARACTERISTIC
/begin CHARACTERISTIC mNILRH "É¢N upper limit value (learning condition)" VALUE 0x000088B8 REC_UBYTE_C 0 COMP_0006 0 3187.5 /begin FUNCTION_LIST KF7-351.1[16] KF7-351.2[17] /end FUNCTION_LIST /end CHARACTERISTIC
/begin CHARACTERISTIC mNILRL "É¢N lower limit value (learning condition)" VALUE 0x000088B9 REC_UBYTE_C 0 COMP_0006 0 3187.5 /begin FUNCTION_LIST KF7-351.1[16] KF7-351.2[17] /end FUNCTION_LIST /end CHARACTERISTIC
/begin CHARACTERISTIC mNSISCI1 "F/B I integral number of times" VALUE 0x000088F4 REC_UBYTE_C 0 COMP_0004 0 255 /begin FUNCTION_LIST KF7-351.1[16] /end FUNCTION_LIST /end CHARACTERISTIC
/begin CHARACTERISTIC mNSISCI2 "F/B I integral number of times" VALUE 0x000088F5 REC_UBYTE_C 0 COMP_0004 0 255 /begin FUNCTION_LIST KF7-351.2[17] /end FUNCTION_LIST /end CHARACTERISTIC
/begin CHARACTERISTIC mNTVQL "The high-speed air learning convergent judgement number of times" VALUE 0x000093DE REC_UWORD_C 0 COMP_0068 0 65535 /begin FUNCTION_LIST KF7-351.3[11] /end FUNCTION_LIST /end CHARACTERISTIC
/begin CHARACTERISTIC mNTVQLS "Low speed air learning (usually, mode) convergent judgement number of times" VALUE 0x00008901 REC_UBYTE_C 0 COMP_0068 0 255 /begin FUNCTION_LIST KF7-351.3[11] /end FUNCTION_LIST /end CHARACTERISTIC
/begin CHARACTERISTIC mNTVQLSR "Low speed air learning (rapid mode) convergent judgement number of times" VALUE 0x000093E0 REC_UWORD_C 0 COMP_0068 0 65535 /begin FUNCTION_LIST KF7-351.3[11] /end FUNCTION_LIST /end CHARACTERISTIC
/begin CHARACTERISTIC mN_BMF "Model matching constant" VALUE 0x00008196 REC_SBYTE_C 0 COMP_0263 -128 127 /begin FUNCTION_LIST KF7-360.1[12] /end FUNCTION_LIST /end CHARACTERISTIC
/begin CHARACTERISTIC mN_GD1_H "Compensation vessel H/G constant 4 (HI gain)" VALUE 0x00008197 REC_SBYTE_C 0 COMP_0263 -128 127 /begin FUNCTION_LIST KF7-360.1[12] /end FUNCTION_LIST /end CHARACTERISTIC
/begin CHARACTERISTIC mN_GD1_L "Compensation vessel H/G constant 4 (LO gain)" VALUE 0x00008198 REC_SBYTE_C 0 COMP_0263 -128 127 /begin FUNCTION_LIST KF7-360.1[12] /end FUNCTION_LIST /end CHARACTERISTIC
/begin CHARACTERISTIC mN_GN0_H "Compensation vessel H/G constant 3 (HI gain)" VALUE 0x00008199 REC_SBYTE_C 0 COMP_0263 -128 127 /begin FUNCTION_LIST KF7-360.1[12] /end FUNCTION_LIST /end CHARACTERISTIC
/begin CHARACTERISTIC mN_GN0_L "Compensation vessel H/G constant 3 (LO gain)" VALUE 0x0000819A REC_SBYTE_C 0 COMP_0263 -128 127 /begin FUNCTION_LIST KF7-360.1[12] /end FUNCTION_LIST /end CHARACTERISTIC
/begin CHARACTERISTIC mN_GN1_H "Compensation vessel H/G constant 2 (HI gain)" VALUE 0x0000819B REC_SBYTE_C 0 COMP_0263 -128 127 /begin FUNCTION_LIST KF7-360.1[12] /end FUNCTION_LIST /end CHARACTERISTIC
/begin CHARACTERISTIC mN_GN1_L "Compensation vessel H/G constant 2 (LO gain)" VALUE 0x0000819C REC_SBYTE_C 0 COMP_0263 -128 127 /begin FUNCTION_LIST KF7-360.1[12] /end FUNCTION_LIST /end CHARACTERISTIC
/begin CHARACTERISTIC mN_GN2_H "Compensation vessel H/G constant 1 (HI gain)" VALUE 0x0000819D REC_SBYTE_C 0 COMP_0263 -128 127 /begin FUNCTION_LIST KF7-360.1[12] /end FUNCTION_LIST /end CHARACTERISTIC
/begin CHARACTERISTIC mN_GN2_L "Compensation vessel H/G constant 1 (LO gain)" VALUE 0x0000819E REC_SBYTE_C 0 COMP_0263 -128 127 /begin FUNCTION_LIST KF7-360.1[12] /end FUNCTION_LIST /end CHARACTERISTIC
/begin CHARACTERISTIC mN_HD1_H "Compensation vessel H constant 3 (HI gain)" VALUE 0x0000819F REC_SBYTE_C 0 COMP_0263 -128 127 /begin FUNCTION_LIST KF7-360.1[12] /end FUNCTION_LIST /end CHARACTERISTIC
/begin CHARACTERISTIC mN_HD1_L "Compensation vessel H constant 3 (LO gain)" VALUE 0x000081A0 REC_SBYTE_C 0 COMP_0263 -128 127 /begin FUNCTION_LIST KF7-360.1[12] /end FUNCTION_LIST /end CHARACTERISTIC
/begin CHARACTERISTIC mN_HN0_H "Compensation vessel H constant 2 (HI gain)" VALUE 0x000081A1 REC_SBYTE_C 0 COMP_0263 -128 127 /begin FUNCTION_LIST KF7-360.1[12] /end FUNCTION_LIST /end CHARACTERISTIC
/begin CHARACTERISTIC mN_HN0_L "Compensation vessel H constant 2 (LO gain)" VALUE 0x000081A2 REC_SBYTE_C 0 COMP_0263 -128 127 /begin FUNCTION_LIST KF7-360.1[12] /end FUNCTION_LIST /end CHARACTERISTIC
/begin CHARACTERISTIC mN_HN1_H "Compensation vessel H constant 1 (HI gain)" VALUE 0x000081A3 REC_SBYTE_C 0 COMP_0263 -128 127 /begin FUNCTION_LIST KF7-360.1[12] /end FUNCTION_LIST /end CHARACTERISTIC
/begin CHARACTERISTIC mN_HN1_L "Compensation vessel H constant 1 (LO gain)" VALUE 0x000081A4 REC_SBYTE_C 0 COMP_0263 -128 127 /begin FUNCTION_LIST KF7-360.1[12] /end FUNCTION_LIST /end CHARACTERISTIC
/begin CHARACTERISTIC mN_LN0 "Compensation vessel L constant 2" VALUE 0x000081A5 REC_SBYTE_C 0 COMP_0263 -128 127 /begin FUNCTION_LIST KF7-360.1[12] /end FUNCTION_LIST /end CHARACTERISTIC
/begin CHARACTERISTIC mN_LN1 "Compensation vessel L constant 1" VALUE 0x000081A6 REC_SBYTE_C 0 COMP_0263 -128 127 /begin FUNCTION_LIST KF7-360.1[12] /end FUNCTION_LIST /end CHARACTERISTIC
/begin CHARACTERISTIC mN_RD0 "Compensation vessel 1/R constant 1" VALUE 0x000081A7 REC_SBYTE_C 0 COMP_0263 -128 127 /begin FUNCTION_LIST KF7-360.1[12] /end FUNCTION_LIST /end CHARACTERISTIC
/begin CHARACTERISTIC mOVADCGAF "An extreme heat resisting switchover A/F deviation" VALUE 0x00008965 REC_UBYTE_C 0 COMP_0343_S 0 5.1 /begin FUNCTION_LIST KF7-371.1E[15] /end FUNCTION_LIST /end CHARACTERISTIC
/begin CHARACTERISTIC mOVCFABFT "An extreme heat resisting switchover delay by the A/F condition" VALUE 0x00008966 REC_UBYTE_C 0 COMP_0267_S 0 25.5 /begin FUNCTION_LIST KF7-371.1E[15] /end FUNCTION_LIST /end CHARACTERISTIC
/begin CHARACTERISTIC mOVCGALPT "ALPHA It sticks, an extreme heat resisting switchover delay by the condition" VALUE 0x00008967 REC_UBYTE_C 0 COMP_0267_S 0 25.5 /begin FUNCTION_LIST KF7-371.1E[15] /end FUNCTION_LIST /end CHARACTERISTIC
/begin CHARACTERISTIC mOVCGPMPR "At the time of the extreme heat resisting, partial target purge rate" VALUE 0x00008968 REC_UBYTE_C 0 COMP_0163 0 15.9375 /begin FUNCTION_LIST KF7-371.1E[15] /end FUNCTION_LIST /end CHARACTERISTIC
/begin CHARACTERISTIC mPABFDLY "A delay for the purge requirement treatment quantity judgement" VALUE 0x00009404 REC_UWORD_C 0 COMP_0267_S 0 6553.5 /begin FUNCTION_LIST KF7-371.1E[15] /end FUNCTION_LIST /end CHARACTERISTIC
/begin CHARACTERISTIC mPDACH "Pd pressure upper limit value" VALUE 0x0000898A REC_UBYTE_C 0 COMP_0011 0 5.1 /begin FUNCTION_LIST KF7-376.1[6] /end FUNCTION_LIST /end CHARACTERISTIC
/begin CHARACTERISTIC mPDACM "Pd pressure middle value" VALUE 0x0000898B REC_UBYTE_C 0 COMP_0011 0 5.1 /begin FUNCTION_LIST KF7-376.1[6] /end FUNCTION_LIST /end CHARACTERISTIC
/begin CHARACTERISTIC mPDEGAIN "PDE computed gain" VALUE 0x0000898C REC_UBYTE_C 0 COMP_0436_S 0 2.55 /begin FUNCTION_LIST KF7-371.1E[15] /end FUNCTION_LIST /end CHARACTERISTIC
/begin CHARACTERISTIC mPDEOFSET "PDE computed offset" VALUE 0x0000898D REC_UBYTE_C 0 COMP_0419 0 25.5 /begin FUNCTION_LIST KF7-371.1E[15] /end FUNCTION_LIST /end CHARACTERISTIC
/begin CHARACTERISTIC mPDOKTIM "A/C load stable distinction time" VALUE 0x00008997 REC_UBYTE_C 0 COMP_0008 0 25500 /begin FUNCTION_LIST KF7-351.2[17] /end FUNCTION_LIST /end CHARACTERISTIC
/begin CHARACTERISTIC mPGUPSTAF "At the time of the heat resisting idle purge, purge rate up stop A/F deviation" VALUE 0x000089A8 REC_UBYTE_C 0 COMP_0343_S 0 5.1 /begin FUNCTION_LIST KF7-371.1E[15] /end FUNCTION_LIST /end CHARACTERISTIC
/begin CHARACTERISTIC mPSSTDY "Power steering OFFON rest delay" VALUE 0x000089DC REC_UBYTE_C 0 COMP_0008 0 25500 /begin FUNCTION_LIST KF7-376.2[21] /end FUNCTION_LIST /end CHARACTERISTIC
/begin CHARACTERISTIC mQGLPM2 "Mass airflow meter output physics value conversion coefficient" VALUE 0x0000945E REC_UWORD_C 0 COMP_0446_S 0 65.535 /begin FUNCTION_LIST KF7-371.1E[15] /end FUNCTION_LIST /end CHARACTERISTIC
/begin CHARACTERISTIC mQH0TMLM "Calibration QH0 condition continuation time" VALUE 0x00008A04 REC_UBYTE_C 0 COMP_0267_S 0 25.5 /begin FUNCTION_LIST KF7-371.1E[15] /end FUNCTION_LIST /end CHARACTERISTIC
/begin CHARACTERISTIC mQH0TWDT "Delta-QH0 measuring interval" VALUE 0x00008A05 REC_UBYTE_C 0 COMP_0202 0 2550 /begin FUNCTION_LIST KF7-371.1E[15] /end FUNCTION_LIST /end CHARACTERISTIC
/begin CHARACTERISTIC mQLDNE "High-speed air learning permission NE change width" VALUE 0x00008A0D REC_UBYTE_C 0 COMP_0065 0 796.875 /begin FUNCTION_LIST KF7-351.3[11] /end FUNCTION_LIST /end CHARACTERISTIC
/begin CHARACTERISTIC mQLDTP "High-speed air learning permission TP change width" VALUE 0x00009464 REC_UWORD_C 0 COMP_0052 0 31.99956087 /begin FUNCTION_LIST KF7-351.3[11] /end FUNCTION_LIST /end CHARACTERISTIC
/begin CHARACTERISTIC mQLDTV "High-speed air learning permission TPS1 change width" VALUE 0x00008A10 REC_UBYTE_C 0 COMP_0023 0 1275 /begin FUNCTION_LIST KF7-351.3[11] /end FUNCTION_LIST /end CHARACTERISTIC
/begin CHARACTERISTIC mQLIMN1 "At the time of off-line idle learning, QFBI lower limit" VALUE 0x00008F3A REC_SWORD_C 0 COMP_0278 -65536 65534 /begin FUNCTION_LIST KF7-351.1[16] /end FUNCTION_LIST /end CHARACTERISTIC
/begin CHARACTERISTIC mQLIMX1 "At the time of off-line idle learning, QFBI upper limit" VALUE 0x00008F3C REC_SWORD_C 0 COMP_0278 -65536 65534 /begin FUNCTION_LIST KF7-351.1[16] /end FUNCTION_LIST /end CHARACTERISTIC
/begin CHARACTERISTIC mQLOFEN "Low speed air learning (usually, mode) dead-zone" VALUE 0x00009466 REC_UWORD_C 0 COMP_0131 0 1279.98046875 /begin FUNCTION_LIST KF7-351.3[11] /end FUNCTION_LIST /end CHARACTERISTIC
/begin CHARACTERISTIC mQLQMAX "A high-speed air learning permission air quantity upper limit" VALUE 0x00008A13 REC_UBYTE_C 0 COMP_0276 0 1020 /begin FUNCTION_LIST KF7-351.3[11] /end FUNCTION_LIST /end CHARACTERISTIC
/begin CHARACTERISTIC mQTASMN1 "QTASEEP1 lower limit value" VALUE 0x00008F40 REC_SWORD_C 0 COMP_0277 -32768 32767 /begin FUNCTION_LIST KF7-351.1[16] /end FUNCTION_LIST /end CHARACTERISTIC
/begin CHARACTERISTIC mQTASMX1 "QTASEEP1 upper limit value" VALUE 0x00008F42 REC_SWORD_C 0 COMP_0277 -32768 32767 /begin FUNCTION_LIST KF7-351.1[16] /end FUNCTION_LIST /end CHARACTERISTIC
/begin CHARACTERISTIC mRATIO1ST "Gear ratio for 1st judgement" VALUE 0x00009482 REC_UWORD_C 0 COMP_0450 0 63.999056205 /begin FUNCTION_LIST KF7-360.9M[43] /end FUNCTION_LIST /end CHARACTERISTIC
/begin CHARACTERISTIC mRCDALLM2 "A change in the second learning requirement purge rate limitation release air-fuel ratio" VALUE 0x00008A2A REC_UBYTE_C 0 COMP_0419 0 25.5 /begin FUNCTION_LIST KF7-371.1E[15] /end FUNCTION_LIST /end CHARACTERISTIC
/begin CHARACTERISTIC mRCDLALLM "A change in a purge rate limitation release air-fuel ratio" VALUE 0x00008A2B REC_UBYTE_C 0 COMP_0419 0 25.5 /begin FUNCTION_LIST KF7-371.1E[15] /end FUNCTION_LIST /end CHARACTERISTIC
/begin CHARACTERISTIC mRCLDLY "At the time of the ALP limiter purge limitation, re-calibration requirement delay" VALUE 0x00008A2C REC_UBYTE_C 0 COMP_0267_S 0 25.5 /begin FUNCTION_LIST KF7-371.1E[15] /end FUNCTION_LIST /end CHARACTERISTIC
/begin CHARACTERISTIC mRD0 "Compensation vessel 1/R filter constant 1" VALUE 0x0000948C REC_UWORD_C 0 COMP_0068 0 65535 /begin FUNCTION_LIST KF7-360.1[12] /end FUNCTION_LIST /end CHARACTERISTIC
/begin CHARACTERISTIC mRLDTGAIN "Target speed setup D gain" VALUE 0x000094B6 REC_UWORD_C 0 COMP_0450 0 63.999056205 /begin FUNCTION_LIST KF7-360.12[6] /end FUNCTION_LIST /end CHARACTERISTIC
/begin CHARACTERISTIC mRLHTW "A high coolant temperature judgement coolant temperature" VALUE 0x00008AA2 REC_UBYTE_C 0 COMP_0035 -50 205 /begin FUNCTION_LIST KF7-360.12[6] /end FUNCTION_LIST /end CHARACTERISTIC
/begin CHARACTERISTIC mRLHTWHYS "A high coolant temperature judgement coolant temperature hysteresis" VALUE 0x00008AA3 REC_UBYTE_C 0 COMP_0003 0 255 /begin FUNCTION_LIST KF7-360.12[6] /end FUNCTION_LIST /end CHARACTERISTIC
/begin CHARACTERISTIC mRLIGAIN "Speed limiter I-gain gain" VALUE 0x000094BA REC_UWORD_C 0 COMP_0452_S 0 65.535 /begin FUNCTION_LIST KF7-360.12[6] /end FUNCTION_LIST /end CHARACTERISTIC
/begin CHARACTERISTIC mRLIGAIN0 "Speed limiter I-gain initial gain" VALUE 0x000094BC REC_UWORD_C 0 COMP_0452_S 0 65.535 /begin FUNCTION_LIST KF7-360.12[6] /end FUNCTION_LIST /end CHARACTERISTIC
/begin CHARACTERISTIC mRLIGDLY "I-gain initial gain time" VALUE 0x00008AA4 REC_UBYTE_C 0 COMP_0014 0 2550 /begin FUNCTION_LIST KF7-360.12[6] /end FUNCTION_LIST /end CHARACTERISTIC
/begin CHARACTERISTIC mRLPGAIN "Speed limiter P-gain gain" VALUE 0x000094BE REC_UWORD_C 0 COMP_0453_S 0 65.535 /begin FUNCTION_LIST KF7-360.12[6] /end FUNCTION_LIST /end CHARACTERISTIC
/begin CHARACTERISTIC mRLRPM "Limit speed" VALUE 0x000094C0 REC_UWORD_C 0 COMP_0454_S 0 51199.21875 /begin FUNCTION_LIST KF7-360.12[6] /end FUNCTION_LIST /end CHARACTERISTIC
/begin CHARACTERISTIC mRLRPMDCL "At the time of the high coolant temperature, limit speed decrease rate" VALUE 0x000094C2 REC_UWORD_C 0 COMP_0455_S 0 51199.21875 /begin FUNCTION_LIST KF7-360.12[6] /end FUNCTION_LIST /end CHARACTERISTIC
/begin CHARACTERISTIC mRLRPMHTW "At the time of the high coolant temperature, limit speed" VALUE 0x000094C6 REC_UWORD_C 0 COMP_0454_S 0 51199.21875 /begin FUNCTION_LIST KF7-360.12[6] /end FUNCTION_LIST /end CHARACTERISTIC
/begin CHARACTERISTIC mRLRPMICL "At the time of the high coolant temperature, the limit speed rate of increase" VALUE 0x000094C8 REC_UWORD_C 0 COMP_0455_S 0 51199.21875 /begin FUNCTION_LIST KF7-360.12[6] /end FUNCTION_LIST /end CHARACTERISTIC
/begin CHARACTERISTIC mRLTEREC1 "TTERLUPS The rate of increase 1" VALUE 0x000094CC REC_UWORD_C 0 COMP_0193 0 6553.5 /begin FUNCTION_LIST KF7-360.12[6] /end FUNCTION_LIST /end CHARACTERISTIC
/begin CHARACTERISTIC mRLTEREC2 "TTERLUPS The rate of increase 2" VALUE 0x000094CE REC_UWORD_C 0 COMP_0193 0 6553.5 /begin FUNCTION_LIST KF7-360.12[6] /end FUNCTION_LIST /end CHARACTERISTIC
/begin CHARACTERISTIC mRLVAPO "In the limiter, VAPO for the up-shift" VALUE 0x000094D0 REC_UWORD_C 0 COMP_0005 0 7208.85 /begin FUNCTION_LIST KF7-360.12[6] /end FUNCTION_LIST /end CHARACTERISTIC
/begin CHARACTERISTIC mSADFD "The amount of alley drive power compensation" VALUE 0x00008F4A REC_SWORD_C 0 COMP_0030_S -32768 32767 /begin FUNCTION_LIST KF7-340.16[4] /end FUNCTION_LIST /end CHARACTERISTIC
/begin CHARACTERISTIC mSAFARA "Activated charcoal surface area" VALUE 0x00008AE4 REC_UBYTE_C 0 COMP_0462_S 0 0.255 /begin FUNCTION_LIST KF7-371.1E[15] /end FUNCTION_LIST /end CHARACTERISTIC
/begin CHARACTERISTIC mSLIGAIN "Vehicle speed limiter I-gain gain" VALUE 0x00009504 REC_UWORD_C 0 COMP_0257_S 0 65535 /begin FUNCTION_LIST KF7-360.11[1] /end FUNCTION_LIST /end CHARACTERISTIC
/begin CHARACTERISTIC mSLPGAIN "Vehicle speed limiter P-gain gain" VALUE 0x0000950C REC_UWORD_C 0 COMP_0258_S 0 65535 /begin FUNCTION_LIST KF7-360.11[1] /end FUNCTION_LIST /end CHARACTERISTIC
/begin CHARACTERISTIC mSLTTE0 "A basic limiter torque (for the limiter vehicle speed R/L)" VALUE 0x00009514 REC_UWORD_C 0 COMP_0176_S 0 655.35 /begin FUNCTION_LIST KF7-360.11[1] /end FUNCTION_LIST /end CHARACTERISTIC
/begin CHARACTERISTIC mSLVSP "Limiter vehicle speed" VALUE 0x00009516 REC_UWORD_C 0 COMP_0436 0 6553.5 /begin FUNCTION_LIST KF7-360.11[1] /end FUNCTION_LIST /end CHARACTERISTIC
/begin CHARACTERISTIC mSLVSP2 "Limiter vehicle speed 2 (vehicle speed decline judgement value)" VALUE 0x00009518 REC_UWORD_C 0 COMP_0436 0 6553.5 /begin FUNCTION_LIST KF7-360.11[1] /end FUNCTION_LIST /end CHARACTERISTIC
/begin CHARACTERISTIC mSPFCHEAT "Activated charcoal specific heat" VALUE 0x00008B21 REC_UBYTE_C 0 COMP_0466_S 0 7.65 /begin FUNCTION_LIST KF7-371.1E[15] /end FUNCTION_LIST /end CHARACTERISTIC
/begin CHARACTERISTIC mSTTMOK "At the time of the extreme low temperature, engine initial judgement time" VALUE 0x00008B49 REC_UBYTE_C 0 COMP_0014 0 2550 /begin FUNCTION_LIST KF7-360.9M[43] /end FUNCTION_LIST /end CHARACTERISTIC
/begin CHARACTERISTIC mTAFSSW "After starter SW_ off, delay" VALUE 0x00009570 REC_UWORD_C 0 COMP_0008 0 6553500 /begin FUNCTION_LIST KF7-351.1[16] KF7-351.2[17] /end FUNCTION_LIST /end CHARACTERISTIC
/begin CHARACTERISTIC mTANGL "Intake air temperature sensor diagnosis NG judgement intake air temperature" VALUE 0x00008B75 REC_UBYTE_C 0 COMP_0035 -50 205 /begin FUNCTION_LIST KF7-360.9M[43] KF7-500.2A[29] KF7-500.44[3] /end FUNCTION_LIST /end CHARACTERISTIC
/begin CHARACTERISTIC mTAPIG "Pre-ignition avoidance control lower limit intake air temperature" VALUE 0x00008B83 REC_UBYTE_C 0 COMP_0035 -50 205 /begin FUNCTION_LIST KF7-360.9M[43] /end FUNCTION_LIST /end CHARACTERISTIC
/begin CHARACTERISTIC mTASLRD2 "Learning operation start delay 2" VALUE 0x00008B87 REC_UBYTE_C 0 COMP_0008 0 25500 /begin FUNCTION_LIST KF7-351.2[17] /end FUNCTION_LIST /end CHARACTERISTIC
/begin CHARACTERISTIC mTASOF2 "Offset value for rapid TAS highlands" VALUE 0x00008B88 REC_UBYTE_C 0 COMP_0051 0 255 /begin FUNCTION_LIST KF7-351.1[16] /end FUNCTION_LIST /end CHARACTERISTIC
/begin CHARACTERISTIC mTBNLMT "Control completion judgement turbine speed" VALUE 0x00009574 REC_UWORD_C 0 COMP_0443 0 65535 /begin FUNCTION_LIST KF7-360.9M[43] /end FUNCTION_LIST /end CHARACTERISTIC
/begin CHARACTERISTIC mTDRQARI2 "The whole area torque going down control switching flag" VALUE 0x00008BA2 REC_UBYTE_C 0 COMP_0068 0 255 /begin FUNCTION_LIST KF7-360.9M[43] /end FUNCTION_LIST /end CHARACTERISTIC
/begin CHARACTERISTIC mTGTMLM "Calibration target A/F condition continuation time" VALUE 0x00008BD9 REC_UBYTE_C 0 COMP_0267_S 0 25.5 /begin FUNCTION_LIST KF7-371.1E[15] /end FUNCTION_LIST /end CHARACTERISTIC
/begin CHARACTERISTIC mTIDPRFB "Idle purge rate feedback target ALPHA" VALUE 0x00008BED REC_UBYTE_C 0 COMP_0047 0 127.5 /begin FUNCTION_LIST KF7-371.1E[15] /end FUNCTION_LIST /end CHARACTERISTIC
/begin CHARACTERISTIC mTMACC "Air-conditioning cut delay" VALUE 0x00008C09 REC_UBYTE_C 0 COMP_0049 0 255 /begin FUNCTION_LIST KF7-376.2[21] /end FUNCTION_LIST /end CHARACTERISTIC
/begin CHARACTERISTIC mTMACLT "TVO air-conditioning cut time" VALUE 0x00008C0A REC_UBYTE_C 0 COMP_0013 0 255 /begin FUNCTION_LIST KF7-376.2[21] R301.6.IscAirflow_1_4_5 /end FUNCTION_LIST /end CHARACTERISTIC
/begin CHARACTERISTIC mTMACON "A/C relay on time" VALUE 0x00008C0B REC_UBYTE_C 0 COMP_0014 0 2550 /begin FUNCTION_LIST KF7-376.1[6] /end FUNCTION_LIST /end CHARACTERISTIC
/begin CHARACTERISTIC mTMACST "At the time of the start, air-conditioning cut delay time" VALUE 0x00008C0C REC_UBYTE_C 0 COMP_0008 0 25500 /begin FUNCTION_LIST KF7-376.2[21] /end FUNCTION_LIST /end CHARACTERISTIC
/begin CHARACTERISTIC mTMHNT "Hunting judgement time" VALUE 0x00008C54 REC_UBYTE_C 0 COMP_0008 0 25500 /begin FUNCTION_LIST KF7-376.2[21] /end FUNCTION_LIST /end CHARACTERISTIC
/begin CHARACTERISTIC mTMRND "At the time of the ND select, a timer for the accelerator judgement" VALUE 0x00008C7B REC_UBYTE_C 0 COMP_0014 0 2550 /begin FUNCTION_LIST KF7-360.9M[43] /end FUNCTION_LIST /end CHARACTERISTIC
/begin CHARACTERISTIC mTMRNR "At the time of the NR select, a timer for the accelerator judgement" VALUE 0x00008C80 REC_UBYTE_C 0 COMP_0014 0 2550 /begin FUNCTION_LIST KF7-360.9M[43] /end FUNCTION_LIST /end CHARACTERISTIC
/begin CHARACTERISTIC mTOWCUTH "Air-conditioning cut coolant temperature" VALUE 0x00008CC1 REC_UBYTE_C 0 COMP_0035 -50 205 /begin FUNCTION_LIST KF7-376.2[21] /end FUNCTION_LIST /end CHARACTERISTIC
/begin CHARACTERISTIC mTOWCUTL "Recover coolant temperature" VALUE 0x00008CC2 REC_UBYTE_C 0 COMP_0035 -50 205 /begin FUNCTION_LIST KF7-376.2[21] /end FUNCTION_LIST /end CHARACTERISTIC
/begin CHARACTERISTIC mTPACC "Air-conditioning cut TP" VALUE 0x000095E2 REC_UWORD_C 0 COMP_0144 0 31.999495335 /begin FUNCTION_LIST KF7-376.2[21] /end FUNCTION_LIST /end CHARACTERISTIC
/begin CHARACTERISTIC mTQTMLMT "At the time of the torque control fail, torque" VALUE 0x00008F58 REC_SWORD_C 0 COMP_0228 -3276.8 3276.7 /begin FUNCTION_LIST KF7-360.9M[43] /end FUNCTION_LIST /end CHARACTERISTIC
/begin CHARACTERISTIC mTQTMREC "T/M requirement steady state torque control recover speed" VALUE 0x0000961C REC_UWORD_C 0 COMP_0213_S 0 6553.5 /begin FUNCTION_LIST KF7-360.9M[43] /end FUNCTION_LIST /end CHARACTERISTIC
/begin CHARACTERISTIC mTRQ4LMT "Electric 4WD drive protection engine torque lower limit limiter" VALUE 0x00008F5A REC_SWORD_C 0 COMP_0228 -3276.8 3276.7 /begin FUNCTION_LIST KF7-360.9M[43] KF7-410.21[3] /end FUNCTION_LIST /end CHARACTERISTIC
/begin CHARACTERISTIC mTRQ4REC "Electric 4WD drive protection recover speed" VALUE 0x00009622 REC_UWORD_C 0 COMP_0213_S 0 6553.5 /begin FUNCTION_LIST KF7-360.9M[43] KF7-410.21[3] /end FUNCTION_LIST /end CHARACTERISTIC
/begin CHARACTERISTIC mTRQ4RECF "At the time of the electric 4WD drive protection fail, recover speed" VALUE 0x00009624 REC_UWORD_C 0 COMP_0213_S 0 6553.5 /begin FUNCTION_LIST KF7-360.9M[43] KF7-410.21[3] /end FUNCTION_LIST /end CHARACTERISTIC
/begin CHARACTERISTIC mTRQLT1 "Upper limit limit torque" VALUE 0x00008F5E REC_SWORD_C 0 COMP_0228 -3276.8 3276.7 /begin FUNCTION_LIST KF7-360.9M[43] /end FUNCTION_LIST /end CHARACTERISTIC
/begin CHARACTERISTIC mTRQLT2 "Upper limit limit torque" VALUE 0x00008F60 REC_SWORD_C 0 COMP_0228 -3276.8 3276.7 /begin FUNCTION_LIST KF7-360.9M[43] /end FUNCTION_LIST /end CHARACTERISTIC
/begin CHARACTERISTIC mTRQLT2AT "At the time of 2nd stall, an upper limit limit torque (AT allowable input torque) for the torque going down control" VALUE 0x00008F62 REC_SWORD_C 0 COMP_0228 -3276.8 3276.7 /begin FUNCTION_LIST KF7-360.9M[43] /end FUNCTION_LIST /end CHARACTERISTIC
/begin CHARACTERISTIC mTRQLT3 "Upper limit limit torque" VALUE 0x00008F64 REC_SWORD_C 0 COMP_0228 -3276.8 3276.7 /begin FUNCTION_LIST KF7-360.9M[43] /end FUNCTION_LIST /end CHARACTERISTIC
/begin CHARACTERISTIC mTRQLT3AT "At the time of 1st stall, an upper limit limit torque (AT allowable input torque) for the torque going down control" VALUE 0x00008F66 REC_SWORD_C 0 COMP_0228 -3276.8 3276.7 /begin FUNCTION_LIST KF7-360.9M[43] /end FUNCTION_LIST /end CHARACTERISTIC
/begin CHARACTERISTIC mTRQLT4 "Upper limit limit torque" VALUE 0x00008F68 REC_SWORD_C 0 COMP_0228 -3276.8 3276.7 /begin FUNCTION_LIST KF7-360.9M[43] /end FUNCTION_LIST /end CHARACTERISTIC
/begin CHARACTERISTIC mTRQLT4AT "At the time of the reverse stall, an upper limit limit torque (AT allowable input torque) for the torque going down control" VALUE 0x00008F6A REC_SWORD_C 0 COMP_0228 -3276.8 3276.7 /begin FUNCTION_LIST KF7-360.9M[43] /end FUNCTION_LIST /end CHARACTERISTIC
/begin CHARACTERISTIC mTRQLTA "Upper limit limit torque" VALUE 0x00008F6C REC_SWORD_C 0 COMP_0228 -3276.8 3276.7 /begin FUNCTION_LIST KF7-360.9M[43] /end FUNCTION_LIST /end CHARACTERISTIC
/begin CHARACTERISTIC mTRQLTND "Upper limit limit torque" VALUE 0x00008F6E REC_SWORD_C 0 COMP_0228 -3276.8 3276.7 /begin FUNCTION_LIST KF7-360.9M[43] /end FUNCTION_LIST /end CHARACTERISTIC
/begin CHARACTERISTIC mTRREC1 "Recover speed" VALUE 0x00009626 REC_UWORD_C 0 COMP_0213_S 0 6553.5 /begin FUNCTION_LIST KF7-360.9M[43] /end FUNCTION_LIST /end CHARACTERISTIC
/begin CHARACTERISTIC mTRREC2 "Recover speed" VALUE 0x00009628 REC_UWORD_C 0 COMP_0213_S 0 6553.5 /begin FUNCTION_LIST KF7-360.9M[43] /end FUNCTION_LIST /end CHARACTERISTIC
/begin CHARACTERISTIC mTRRECND "Recover speed" VALUE 0x00009630 REC_UWORD_C 0 COMP_0193 0 6553.5 /begin FUNCTION_LIST KF7-360.9M[43] /end FUNCTION_LIST /end CHARACTERISTIC
/begin CHARACTERISTIC mTTERL0L "TTERL0 decline judgement value" VALUE 0x00008F70 REC_SWORD_C 0 COMP_0228 -3276.8 3276.7 /begin FUNCTION_LIST KF7-360.12[6] /end FUNCTION_LIST /end CHARACTERISTIC
/begin CHARACTERISTIC mTVFQMX "A high low speed Q learning addition value upper limit limiter" VALUE 0x00008F72 REC_SWORD_C 0 COMP_0500 -901.12 901.0925 /begin FUNCTION_LIST KF7-351.3[11] /end FUNCTION_LIST /end CHARACTERISTIC
/begin CHARACTERISTIC mTVFQMX_S "Height, low speed Q learning addition value upper limit limiter (vice-operation part)" VALUE 0x0000F6C4 REC_SWORD_C 0 COMP_0500 -901.12 901.0925 /begin FUNCTION_LIST KF7-350.4P[13] /end FUNCTION_LIST /end CHARACTERISTIC
/begin CHARACTERISTIC mTVODEFO "Default open-degree equivalent value" VALUE 0x00008D06 REC_UBYTE_C 0 COMP_0005 0 28.05
 /begin FUNCTION_LIST KF7-350.4M[14] KF7-350.4P[13] KF7-360.1[12] KF7-450.50[10] KF7-505.15[4] KF7-505.32[6] KF7-505.33[8] R000.1.RS_Integ_1_10_2 /end FUNCTION_LIST
/end CHARACTERISTIC
/begin CHARACTERISTIC mTVQLMN "A high-speed air learning lower limit limiter" VALUE 0x000081B7 REC_SBYTE_C 0 COMP_0353 -640 635 /begin FUNCTION_LIST KF7-351.3[11] /end FUNCTION_LIST /end CHARACTERISTIC
/begin CHARACTERISTIC mTVQLMX "A high-speed air learning upper limit limiter" VALUE 0x000081B8 REC_SBYTE_C 0 COMP_0353 -640 635 /begin FUNCTION_LIST KF7-351.3[11] /end FUNCTION_LIST /end CHARACTERISTIC
/begin CHARACTERISTIC mTVQLSMN "Low speed air learning lower limit limiter" VALUE 0x000081B9 REC_SBYTE_C 0 COMP_0353 -640 635 /begin FUNCTION_LIST KF7-351.3[11] /end FUNCTION_LIST /end CHARACTERISTIC
/begin CHARACTERISTIC mTVQLSMX "Low speed air learning upper limit limiter" VALUE 0x000081BA REC_SBYTE_C 0 COMP_0353 -640 635 /begin FUNCTION_LIST KF7-351.3[11] /end FUNCTION_LIST /end CHARACTERISTIC
/begin CHARACTERISTIC mTWACH "A/C relay on coolant temperature condition upper limit" VALUE 0x00008D0F REC_UBYTE_C 0 COMP_0035 -50 205 /begin FUNCTION_LIST KF7-376.1[6] /end FUNCTION_LIST /end CHARACTERISTIC
/begin CHARACTERISTIC mTWACL "A/C relay on coolant temperature condition lower limit" VALUE 0x00008D10 REC_UBYTE_C 0 COMP_0035 -50 205 /begin FUNCTION_LIST KF7-376.1[6] /end FUNCTION_LIST /end CHARACTERISTIC
/begin CHARACTERISTIC mTWACPS "At the time of power steering on, AC cut judgement coolant temperature" VALUE 0x00008D11 REC_UBYTE_C 0 COMP_0035 -50 205 /begin FUNCTION_LIST KF7-376.2[21] /end FUNCTION_LIST /end CHARACTERISTIC
/begin CHARACTERISTIC mTWACRH "Air-conditioning cut coolant temperature" VALUE 0x00008D12 REC_UBYTE_C 0 COMP_0035 -50 205 /begin FUNCTION_LIST KF7-376.2[21] /end FUNCTION_LIST /end CHARACTERISTIC
/begin CHARACTERISTIC mTWACRL "Air-conditioning cut release coolant temperature" VALUE 0x00008D13 REC_UBYTE_C 0 COMP_0035 -50 205 /begin FUNCTION_LIST KF7-376.2[21] /end FUNCTION_LIST /end CHARACTERISTIC
/begin CHARACTERISTIC mTWISLH "Learning operation start coolant temperature upper limit" VALUE 0x00008D3C REC_UBYTE_C 0 COMP_0035 -50 205 /begin FUNCTION_LIST KF7-351.1[16] KF7-351.2[17] KF7-377.1A[19] /end FUNCTION_LIST /end CHARACTERISTIC
/begin CHARACTERISTIC mTWISLL "Learning operation start coolant temperature lower limit" VALUE 0x00008D3D REC_UBYTE_C 0 COMP_0035 -50 205 /begin FUNCTION_LIST KF7-351.1[16] KF7-351.2[17] /end FUNCTION_LIST /end CHARACTERISTIC
/begin CHARACTERISTIC mTWQLH "A high-speed air learning permission coolant temperature upper limit" VALUE 0x00008D60 REC_UBYTE_C 0 COMP_0035 -50 205 /begin FUNCTION_LIST KF7-351.3[11] /end FUNCTION_LIST /end CHARACTERISTIC
/begin CHARACTERISTIC mTWQLL "A high-speed air learning permission coolant temperature lower limit" VALUE 0x00008D61 REC_UBYTE_C 0 COMP_0035 -50 205 /begin FUNCTION_LIST KF7-351.3[11] /end FUNCTION_LIST /end CHARACTERISTIC
/begin CHARACTERISTIC mVDELAY "The vehicle speed filter the first delay coefficient" VALUE 0x00009652 REC_UWORD_C 0 COMP_0410 0 99.9985458 /begin FUNCTION_LIST KF7-340.15[3] /end FUNCTION_LIST /end CHARACTERISTIC
/begin CHARACTERISTIC mVMAX1 "Control control MAX vehicle speed (low)" VALUE 0x00008DD5 REC_UBYTE_C 0 COMP_0007 0 510 /begin FUNCTION_LIST KF7-360.7M[9] /end FUNCTION_LIST /end CHARACTERISTIC
/begin CHARACTERISTIC mVMAX2 "Control control MAX vehicle speed (height)" VALUE 0x00008DD8 REC_UBYTE_C 0 COMP_0007 0 510 /begin FUNCTION_LIST KF7-360.7M[9] /end FUNCTION_LIST /end CHARACTERISTIC
/begin CHARACTERISTIC mVPDACH1 "High pressure cut pressure" VALUE 0x00008DE6 REC_UBYTE_C 0 COMP_0011 0 5.1 /begin FUNCTION_LIST KF7-376.1[6] KF7-376.4[4] /end FUNCTION_LIST /end CHARACTERISTIC
/begin CHARACTERISTIC mVPDACL "Low pressure cut pressure" VALUE 0x00008DE7 REC_UBYTE_C 0 COMP_0011 0 5.1 /begin FUNCTION_LIST KF7-376.1[6] KF7-376.4[4] /end FUNCTION_LIST /end CHARACTERISTIC
/begin CHARACTERISTIC mVPDARH "High pressure reversion pressure" VALUE 0x00008DE8 REC_UBYTE_C 0 COMP_0011 0 5.1 /begin FUNCTION_LIST KF7-376.1[6] /end FUNCTION_LIST /end CHARACTERISTIC
/begin CHARACTERISTIC mVPDARHI "High pressure reversion pressure (idle)" VALUE 0x00008DE9 REC_UBYTE_C 0 COMP_0011 0 5.1 /begin FUNCTION_LIST KF7-376.1[6] /end FUNCTION_LIST /end CHARACTERISTIC
/begin CHARACTERISTIC mVPDARL "Low pressure reversion pressure" VALUE 0x00008DEA REC_UBYTE_C 0 COMP_0011 0 5.1 /begin FUNCTION_LIST KF7-376.1[6] /end FUNCTION_LIST /end CHARACTERISTIC
/begin CHARACTERISTIC mVSP1SD "At the time of 1st stall, torque going down control vehicle speed condition" VALUE 0x00008E05 REC_UBYTE_C 0 COMP_0360 0 510 /begin FUNCTION_LIST KF7-360.9M[43] /end FUNCTION_LIST /end CHARACTERISTIC
/begin CHARACTERISTIC mVSP2SD "At the time of 2nd stall, torque going down control vehicle speed condition" VALUE 0x00008E06 REC_UBYTE_C 0 COMP_0360 0 510 /begin FUNCTION_LIST KF7-360.9M[43] /end FUNCTION_LIST /end CHARACTERISTIC
/begin CHARACTERISTIC mVSPRSD "At the time of the reverse stall, torque going down control vehicle speed condition" VALUE 0x00008E19 REC_UBYTE_C 0 COMP_0360 0 510 /begin FUNCTION_LIST KF7-360.9M[43] /end FUNCTION_LIST /end CHARACTERISTIC
/begin CHARACTERISTIC mWISCLD "Subtraction side learning weighted average value" VALUE 0x00008E96 REC_UBYTE_C 0 COMP_0032 0 0.99609375 /begin FUNCTION_LIST KF7-351.2[17] /end FUNCTION_LIST /end CHARACTERISTIC
/begin CHARACTERISTIC mWISCLR "Learning weighted average value" VALUE 0x00008E97 REC_UBYTE_C 0 COMP_0032 0 0.99609375 /begin FUNCTION_LIST KF7-351.2[17] /end FUNCTION_LIST /end CHARACTERISTIC
/begin CHARACTERISTIC mZHADAPLM "High speed APS limiter slope" VALUE 0x00009672 REC_UWORD_C 0 COMP_0480_S 0 2327.237174205 /begin FUNCTION_LIST KF7-340.16[4] /end FUNCTION_LIST /end CHARACTERISTIC
/begin CHARACTERISTIC mZKFLTIM "NAVI- Communication fail judgement time" VALUE 0x00008E9F REC_UBYTE_C 0 COMP_0267_S 0 25.5 /begin FUNCTION_LIST KF7-340.16[4] /end FUNCTION_LIST /end CHARACTERISTIC
/begin CHARACTERISTIC mZLADAPLM "Alley APS limiter slope" VALUE 0x00009676 REC_UWORD_C 0 COMP_0480_S 0 2327.237174205 /begin FUNCTION_LIST KF7-340.16[4] /end FUNCTION_LIST /end CHARACTERISTIC
/begin CHARACTERISTIC mZLADVSLM "Alley VSP slope" VALUE 0x0000967A REC_UWORD_C 0 COMP_0481_S 0 2559.9609375 /begin FUNCTION_LIST KF7-340.16[4] /end FUNCTION_LIST /end CHARACTERISTIC
/begin CHARACTERISTIC mMWTOY "A map for the calibration" MAP 0x0000C3F2 REC_UWORD_C 0 COMP_0487_S 0 0.99993303
 /begin AXIS_DESCR COM_AXIS NO_INPUT_QUANTITY COMP_0487_S 8 0 0.99993303 AXIS_PTS_REF mJKW /end AXIS_DESCR
 /begin AXIS_DESCR COM_AXIS NO_INPUT_QUANTITY COMP_0373 8 0 655.35 AXIS_PTS_REF mJKNI16 /end AXIS_DESCR
 /begin FUNCTION_LIST KF7-371.1E[15] /end FUNCTION_LIST
/end CHARACTERISTIC
/begin CHARACTERISTIC mMYTOW "Desorption quantity equivalent quantity map" MAP 0x0000C472 REC_UWORD_C 0 COMP_0488_S 0 0.499966515
 /begin AXIS_DESCR COM_AXIS NO_INPUT_QUANTITY COMP_0487_S 8 0 0.99993303 AXIS_PTS_REF mJKYPA /end AXIS_DESCR
 /begin AXIS_DESCR COM_AXIS NO_INPUT_QUANTITY COMP_0489_S 8 0 15.9997149 AXIS_PTS_REF mJKN /end AXIS_DESCR
 /begin FUNCTION_LIST KF7-371.1E[15] /end FUNCTION_LIST
/end CHARACTERISTIC
/begin CHARACTERISTIC mTBASTFS "Base throttle open-degree table (APOFS shaft conversion)" CURVE 0x0000E6BA REC_UWORD_C 0 COMP_0005 0 7208.85
 /begin AXIS_DESCR FIX_AXIS NO_INPUT_QUANTITY COMP_0272_S 16 0 84 FIX_AXIS_PAR_DIST 0 1 16 /end AXIS_DESCR
 /begin FUNCTION_LIST KF7-360.7M[9] /end FUNCTION_LIST
/end CHARACTERISTIC
/begin CHARACTERISTIC mTKPB "The difference pressure compensation coefficient table" CURVE 0x0000D442 REC_UBYTE_C 0 COMP_0246 0 1593.75
 /begin AXIS_DESCR FIX_AXIS NO_INPUT_QUANTITY COMP_0246 16 0 93.75 FIX_AXIS_PAR_DIST 0 1 16 /end AXIS_DESCR
 /begin FUNCTION_LIST KF7-371.1E[15] /end FUNCTION_LIST
/end CHARACTERISTIC
/begin CHARACTERISTIC mTSTSTFS "Control control throttle open-degree table (APOFS shaft conversion)" CURVE 0x0000F1AE REC_UWORD_C 0 COMP_0005 0 7208.85
 /begin AXIS_DESCR FIX_AXIS NO_INPUT_QUANTITY COMP_0272_S 16 0 84 FIX_AXIS_PAR_DIST 0 1 16 /end AXIS_DESCR
 /begin FUNCTION_LIST KF7-360.7M[9] /end FUNCTION_LIST
/end CHARACTERISTIC
/begin CHARACTERISTIC mRLTENG2 "In the limiter, TENG2 for the up-shift" CURVE 0x0000E40C REC_UWORD_C 0 COMP_0226 -3276.8 3276.7
 /begin AXIS_DESCR FIX_AXIS NO_INPUT_QUANTITY COMP_0068 5 0 4 FIX_AXIS_PAR_DIST 0 1 5 /end AXIS_DESCR
 /begin FUNCTION_LIST KF7-360.12[6] /end FUNCTION_LIST
/end CHARACTERISTIC
/begin CHARACTERISTIC mDMDPRG "Requirement purge treatment quantity table" CURVE 0x0000DFF0 REC_UWORD_C 0 COMP_0156 0 65535
 /begin AXIS_DESCR COM_AXIS NO_INPUT_QUANTITY COMP_0509_S 8 0 127.79325 AXIS_PTS_REF mJKPABF /end AXIS_DESCR
 /begin FUNCTION_LIST KF7-371.1E[15] /end FUNCTION_LIST
/end CHARACTERISTIC
/begin CHARACTERISTIC mHADFD "A high-speed drive power compensation quantity table" CURVE 0x0000E070 REC_UWORD_C 0 COMP_0123_S -32768 32767
 /begin AXIS_DESCR COM_AXIS NO_INPUT_QUANTITY COMP_0436 8 0 6553.5 AXIS_PTS_REF mHADDVSP /end AXIS_DESCR
 /begin FUNCTION_LIST KF7-340.16[4] /end FUNCTION_LIST
/end CHARACTERISTIC
/begin CHARACTERISTIC mTAPOAC "At the time of the acceleration, A/C cut judgement VAPO table" CURVE 0x0000E58A REC_UWORD_C 0 COMP_0005 0 7208.85
 /begin AXIS_DESCR FIX_AXIS NO_INPUT_QUANTITY COMP_0268_S 8 0 56 FIX_AXIS_PAR_DIST 0 1 8 /end AXIS_DESCR
 /begin FUNCTION_LIST KF7-376.2[21] R301.6.IscAirflow_1_4_5 /end FUNCTION_LIST
/end CHARACTERISTIC
/begin CHARACTERISTIC mTBLTSPH "ÉgÉãÉNÉXÉeÉA/power hop upper limit table" CURVE 0x0000E76A REC_UWORD_C 0 COMP_0226 -3276.8 3276.7
 /begin AXIS_DESCR FIX_AXIS NO_INPUT_QUANTITY COMP_0273_S 8 400 3200 FIX_AXIS_PAR_DIST 0 1 8 /end AXIS_DESCR
 /begin FUNCTION_LIST KF7-360.9M[43] /end FUNCTION_LIST
/end CHARACTERISTIC
/begin CHARACTERISTIC mTBTUPMPR "Boot rise purge rate addition quantity computed table" CURVE 0x0000CE8A REC_UBYTE_C 0 COMP_0513_S -6.4 6.35
 /begin AXIS_DESCR COM_AXIS NO_INPUT_QUANTITY COMP_0027 8 0 255 AXIS_PTS_REF mJKDALP /end AXIS_DESCR
 /begin FUNCTION_LIST KF7-371.1E[15] /end FUNCTION_LIST
/end CHARACTERISTIC
/begin CHARACTERISTIC mTEVOPB "A basic purge invalid pulse width table" CURVE 0x0000D06E REC_UBYTE_C 0 COMP_0311 0 16320
 /begin AXIS_DESCR FIX_AXIS NO_INPUT_QUANTITY COMP_0122_S 8 0 14 FIX_AXIS_PAR_DIST 0 1 8 /end AXIS_DESCR
 /begin FUNCTION_LIST KF7-371.1E[15] /end FUNCTION_LIST
/end CHARACTERISTIC
/begin CHARACTERISTIC mTPDNSLIM "A maximum purge rate purge concentration limitation table" CURVE 0x0000D728 REC_UBYTE_C 0 COMP_0034 0 63.75
 /begin AXIS_DESCR COM_AXIS NO_INPUT_QUANTITY COMP_0281_S 8 0 63.75 AXIS_PTS_REF mJKPDNSLM /end AXIS_DESCR
 /begin FUNCTION_LIST KF7-371.1E[15] /end FUNCTION_LIST
/end CHARACTERISTIC
/begin CHARACTERISTIC mTRLDFD "Flat road running resistance table" CURVE 0x0000F006 REC_UWORD_C 0 COMP_0123_S -32768 32767
 /begin AXIS_DESCR COM_AXIS NO_INPUT_QUANTITY COMP_0436 8 0 6553.5 AXIS_PTS_REF mTRLVSP /end AXIS_DESCR
 /begin FUNCTION_LIST KF7-340.15[3] /end FUNCTION_LIST
/end CHARACTERISTIC
/begin CHARACTERISTIC mTTALPHA "Compensation rate TALPHA table" CURVE 0x0000F1CE REC_UWORD_C 0 COMP_0410 0 99.9985458
 /begin AXIS_DESCR COM_AXIS NO_INPUT_QUANTITY COMP_0014_S 8 0 65535 AXIS_PTS_REF mTRESFDFL /end AXIS_DESCR
 /begin FUNCTION_LIST KF7-340.15[3] /end FUNCTION_LIST
/end CHARACTERISTIC
/begin CHARACTERISTIC mTTRQPIG "TRQPIG reference table" CURVE 0x0000F44E REC_UWORD_C 0 COMP_0196 0 6553.5
 /begin AXIS_DESCR FIX_AXIS NO_INPUT_QUANTITY COMP_0283_S 8 0 1400 FIX_AXIS_PAR_DIST 0 1 8 /end AXIS_DESCR
 /begin FUNCTION_LIST KF7-360.9M[43] /end FUNCTION_LIST
/end CHARACTERISTIC
/begin CHARACTERISTIC mTTVOULM "A throttle open-degree upper limit speed table (a main operation part) for the intake pulsation countermeasure" CURVE 0x0000DC4A REC_UBYTE_C 0 COMP_0529_S 0 91.1625
 /begin AXIS_DESCR COM_AXIS NO_INPUT_QUANTITY COMP_0000 8 0 6375 AXIS_PTS_REF mTTVONBP /end AXIS_DESCR
 /begin FUNCTION_LIST KF7-350.4M[14] /end FUNCTION_LIST
/end CHARACTERISTIC
/begin CHARACTERISTIC mTTVOULMS "A throttle open-degree upper limit speed table (vice-operation part) for the intake pulsation countermeasure" CURVE 0x0000DC52 REC_UBYTE_C 0 COMP_0529_S 0 91.1625
 /begin AXIS_DESCR COM_AXIS NO_INPUT_QUANTITY COMP_0000 8 0 6375 AXIS_PTS_REF mTTVONBPS /end AXIS_DESCR
 /begin FUNCTION_LIST KF7-350.4P[13] /end FUNCTION_LIST
/end CHARACTERISTIC
/begin CHARACTERISTIC mVPOVLMZ "Engine-brake compensation target acceleration table" CURVE 0x0000DDFE REC_UBYTE_C 0 COMP_0331_S -0.5 0.49609375
 /begin AXIS_DESCR FIX_AXIS NO_INPUT_QUANTITY COMP_0332_S 8 0 179.2 FIX_AXIS_PAR_DIST 0 1 8 /end AXIS_DESCR
 /begin FUNCTION_LIST KF7-340.16[4] /end FUNCTION_LIST
/end CHARACTERISTIC
/begin CHARACTERISTIC mINV_N_D "Inverse filter constant" MAP 0x0000B0BE REC_UWORD_C 0 COMP_0068 0 65535
 /begin AXIS_DESCR FIX_AXIS NO_INPUT_QUANTITY COMP_0205_S 5 0 4 FIX_AXIS_PAR_DIST 0 1 5 /end AXIS_DESCR
 /begin AXIS_DESCR FIX_AXIS NO_INPUT_QUANTITY COMP_0276_S 9 1 9 FIX_AXIS_PAR_DIST 0 1 9 /end AXIS_DESCR
 /begin FUNCTION_LIST KF7-360.8M[4] R301.8.Inverse_filter_1_1_3 /end FUNCTION_LIST
/end CHARACTERISTIC
/begin CHARACTERISTIC mNINV_N_D "The number of inverse filter constant shifts" MAP 0x00009780 REC_SBYTE_C 0 COMP_0263 -128 127
 /begin AXIS_DESCR FIX_AXIS NO_INPUT_QUANTITY COMP_0205_S 5 0 4 FIX_AXIS_PAR_DIST 0 1 5 /end AXIS_DESCR
 /begin AXIS_DESCR FIX_AXIS NO_INPUT_QUANTITY COMP_0276_S 9 1 9 FIX_AXIS_PAR_DIST 0 1 9 /end AXIS_DESCR
 /begin FUNCTION_LIST KF7-360.8M[4] R301.8.Inverse_filter_1_1_3 /end FUNCTION_LIST
/end CHARACTERISTIC
/begin CHARACTERISTIC mDGNVSPNG "ROM Const mDGNVSPNG" VALUE 0x00010B04 REC_UWORD_C 0 COMP_0091 0 65535 /begin FUNCTION_LIST KF7-376.2[21] /end FUNCTION_LIST /end CHARACTERISTIC
/begin CHARACTERISTIC mfVSPNG "0:Not DGN  1:DGN" VALUE 0x0001020C REC_UBYTE_C 0 COMP_0283 0 1 BIT_MASK 0x0010
 /begin FUNCTION_LIST KF7-376.2[21] KF7-450.14[2] KF7-450.19[4] KF7-500.2A[29] KF7-500.16[4] KF7-525.2[6] /end FUNCTION_LIST
/end CHARACTERISTIC
/begin CHARACTERISTIC mfTPS4NG "0:Not DGN  1:DGN" VALUE 0x0001022B REC_UBYTE_C 0 COMP_0283 0 1 BIT_MASK 0x0010
 /begin FUNCTION_LIST KF7-360.1[12] KF7-500.2A[29] KF7-505.28[1] KF7-525.2[6] KF7-525.2S[10] /end FUNCTION_LIST
/end CHARACTERISTIC
/begin CHARACTERISTIC mfRTSPNG "0:Not DGN  1:DGN" VALUE 0x00010230 REC_UBYTE_C 0 COMP_0283 0 1 BIT_MASK 0x0080
 /begin FUNCTION_LIST KF7-350.4M[14] KF7-350.4P[13] KF7-410.16M[1] KF7-450.22[1] KF7-500.2A[29] KF7-505.33[8] KF7-525.2[6] KF7-525.2S[10] /end FUNCTION_LIST
/end CHARACTERISTIC
/begin CHARACTERISTIC mfDFLTNG "0:Not DGN  1:DGN" VALUE 0x00010230 REC_UBYTE_C 0 COMP_0283 0 1 BIT_MASK 0x0040
 /begin FUNCTION_LIST KF7-350.4M[14] KF7-350.4P[13] KF7-410.16M[1] KF7-450.22[1] KF7-500.2A[29] KF7-505.33[8] KF7-525.2[6] KF7-525.2S[10] /end FUNCTION_LIST
/end CHARACTERISTIC
/begin CHARACTERISTIC mfTANGL "0:Not DGN  1:DGN" VALUE 0x00010241 REC_UBYTE_C 0 COMP_0283 0 1 BIT_MASK 0x0008 /begin FUNCTION_LIST KF7-360.9M[43] KF7-500.2A[29] KF7-500.44[3] /end FUNCTION_LIST /end CHARACTERISTIC
/begin CHARACTERISTIC mfTANGH "0:Not DGN  1:DGN" VALUE 0x00010241 REC_UBYTE_C 0 COMP_0283 0 1 BIT_MASK 0x0004 /begin FUNCTION_LIST KF7-360.9M[43] KF7-500.2A[29] KF7-500.44[3] /end FUNCTION_LIST /end CHARACTERISTIC
/begin CHARACTERISTIC mfTANGR "0:Not DGN  1:DGN" VALUE 0x00010241 REC_UBYTE_C 0 COMP_0283 0 1 BIT_MASK 0x0002 /begin FUNCTION_LIST KF7-360.9M[43] KF7-500.2A[29] KF7-500.44[3] /end FUNCTION_LIST /end CHARACTERISTIC
/begin CHARACTERISTIC mfTP1NGH "0:Not DGN  1:DGN" VALUE 0x00010247 REC_UBYTE_C 0 COMP_0283 0 1 BIT_MASK 0x0080
 /begin FUNCTION_LIST KF7-360.4[14] KF7-450.50[10] KF7-500.2A[29] KF7-505.2[9] KF7-505.33[8] /end FUNCTION_LIST
/end CHARACTERISTIC
/begin CHARACTERISTIC mfTP1NGL "0:Not DGN  1:DGN" VALUE 0x00010247 REC_UBYTE_C 0 COMP_0283 0 1 BIT_MASK 0x0040
 /begin FUNCTION_LIST KF7-360.4[14] KF7-450.50[10] KF7-500.2A[29] KF7-505.2[9] KF7-505.33[8] /end FUNCTION_LIST
/end CHARACTERISTIC
/begin CHARACTERISTIC mfTP2NGH "0:Not DGN  1:DGN" VALUE 0x00010247 REC_UBYTE_C 0 COMP_0283 0 1 BIT_MASK 0x0020 /begin FUNCTION_LIST KF7-360.4[14] KF7-450.50[10] KF7-500.2A[29] KF7-505.2[9] /end FUNCTION_LIST /end CHARACTERISTIC
/begin CHARACTERISTIC mfTP2NGL "0:Not DGN  1:DGN" VALUE 0x00010247 REC_UBYTE_C 0 COMP_0283 0 1 BIT_MASK 0x0010 /begin FUNCTION_LIST KF7-360.4[14] KF7-450.50[10] KF7-500.2A[29] KF7-505.2[9] /end FUNCTION_LIST /end CHARACTERISTIC
/begin CHARACTERISTIC mfTP12NG "0:Not DGN  1:DGN" VALUE 0x00010247 REC_UBYTE_C 0 COMP_0283 0 1 BIT_MASK 0x0008
 /begin FUNCTION_LIST KF7-360.4[14] KF7-450.50[10] KF7-500.2A[29] KF7-505.2[9] KF7-505.33[8] /end FUNCTION_LIST
/end CHARACTERISTIC
/begin AXIS_PTS mJKW "1/65536-" 0x0000E0B0 NO_INPUT_QUANTITY REC_AXIS_UWORD 0 COMP_0487_S 8 0 0.99993303 /end AXIS_PTS
/begin AXIS_PTS mJKNI16 "0.01-" 0x0000E090 NO_INPUT_QUANTITY REC_AXIS_UWORD 0 COMP_0373 8 0 655.35 /end AXIS_PTS
/begin AXIS_PTS mJKYPA "1/65536-" 0x0000E0C0 NO_INPUT_QUANTITY REC_AXIS_UWORD 0 COMP_0487_S 8 0 0.99993303 /end AXIS_PTS
/begin AXIS_PTS mJKN "1/4096-" 0x0000E080 NO_INPUT_QUANTITY REC_AXIS_UWORD 0 COMP_0489_S 8 0 15.9997149 /end AXIS_PTS
/begin AXIS_PTS mJKPABF "0.5/256-" 0x0000E0A0 NO_INPUT_QUANTITY REC_AXIS_UWORD 0 COMP_0509_S 8 0 127.79325 /end AXIS_PTS
/begin AXIS_PTS mHADDVSP "0.1km/h" 0x0000E060 NO_INPUT_QUANTITY REC_AXIS_UWORD 0 COMP_0436 8 0 6553.5 /end AXIS_PTS
/begin AXIS_PTS mJKDALP "1%" 0x0000CA6B NO_INPUT_QUANTITY REC_AXIS_UBYTE 0 COMP_0027 8 0 255 /end AXIS_PTS
/begin AXIS_PTS mJKPDNSLM "0.25-" 0x0000CA7B NO_INPUT_QUANTITY REC_AXIS_UBYTE 0 COMP_0281_S 8 0 63.75 /end AXIS_PTS
/begin AXIS_PTS mTRLVSP "0.1km/h" 0x0000F016 NO_INPUT_QUANTITY REC_AXIS_UWORD 0 COMP_0436 8 0 6553.5 /end AXIS_PTS
/begin AXIS_PTS mTRESFDFL "1N" 0x0000EF96 NO_INPUT_QUANTITY REC_AXIS_UWORD 0 COMP_0014_S 8 0 65535 /end AXIS_PTS
/begin AXIS_PTS mTTVONBP "25rpm" 0x0000DC3A NO_INPUT_QUANTITY REC_AXIS_UBYTE 0 COMP_0000 8 0 6375 /end AXIS_PTS
/begin AXIS_PTS mTTVONBPS "25rpm" 0x0000DC42 NO_INPUT_QUANTITY REC_AXIS_UBYTE 0 COMP_0000 8 0 6375 /end AXIS_PTS
/begin MEASUREMENT wfENGSTP "Engine stall judgement flag" UBYTE COMP_0283 1 100 0 1 BIT_MASK 0x0020 ECU_ADDRESS 0xFFFF49C2 /begin FUNCTION_LIST KF7-350.4M[14] KF7-350.4P[13] /end FUNCTION_LIST /end MEASUREMENT
/begin MEASUREMENT fENGSTP "Engine stall judgement flag" UBYTE COMP_0283 1 100 0 1 BIT_MASK 0x0020 ECU_ADDRESS 0xFFFF49C3 /begin FUNCTION_LIST KF7-350.4M[14] KF7-350.4P[13] R301.3.FanAftPwl_1_0_4 /end FUNCTION_LIST /end MEASUREMENT
/begin MEASUREMENT wfASCDCSW "ASCD cruise SW signal" UBYTE COMP_0283 1 100 0 1 BIT_MASK 0x0002 ECU_ADDRESS 0xFFFF49C7 /begin FUNCTION_LIST KF7-340.15[3] KF7-340.16[4] /end FUNCTION_LIST /end MEASUREMENT
/begin MEASUREMENT wfETCENA "ETC permission signal" UBYTE COMP_0283 1 100 0 1 BIT_MASK 0x0080 ECU_ADDRESS 0xFFFF49CE
 /begin FUNCTION_LIST KF7-360.4[14] KF7-505.31[5] KF7-505.40[1] KF7-505.41[2] KF7-505.42[2] KF7-505.43[3] /end FUNCTION_LIST
/end MEASUREMENT
/begin MEASUREMENT wfETQDNETS "Electric 4WD drive protection engine torque decrease requirement flag" UBYTE COMP_0283 1 100 0 1 BIT_MASK 0x0040 ECU_ADDRESS 0xFFFF49CE /begin FUNCTION_LIST KF7-360.9M[43] /end FUNCTION_LIST /end MEASUREMENT
/begin MEASUREMENT wfSNOWSW "SNOW SW" UBYTE COMP_0283 1 100 0 1 BIT_MASK 0x0040 ECU_ADDRESS 0xFFFF49D4 /begin FUNCTION_LIST KF7-360.7M[9] KF7-580.1[8] /end FUNCTION_LIST /end MEASUREMENT
/begin MEASUREMENT fASCDCSW "ASCD cruise SW signal" UBYTE COMP_0283 1 100 0 1 BIT_MASK 0x0002 ECU_ADDRESS 0xFFFF49D7 /begin FUNCTION_LIST KF7-340.15[3] KF7-340.16[4] /end FUNCTION_LIST /end MEASUREMENT
/begin MEASUREMENT fETCENA "ETC permission signal" UBYTE COMP_0283 1 100 0 1 BIT_MASK 0x0080 ECU_ADDRESS 0xFFFF49DE
 /begin FUNCTION_LIST KF7-360.4[14] KF7-505.31[5] KF7-505.40[1] KF7-505.41[2] KF7-505.42[2] KF7-505.43[3] /end FUNCTION_LIST
/end MEASUREMENT
/begin MEASUREMENT fETQDNETS "Electric 4WD drive protection engine torque decrease requirement flag" UBYTE COMP_0283 1 100 0 1 BIT_MASK 0x0040 ECU_ADDRESS 0xFFFF49DE /begin FUNCTION_LIST KF7-360.9M[43] KF7-410.21[3] /end FUNCTION_LIST /end MEASUREMENT
/begin MEASUREMENT fSNOWSW "SNOW SW" UBYTE COMP_0283 1 100 0 1 BIT_MASK 0x0040 ECU_ADDRESS 0xFFFF49E4 /begin FUNCTION_LIST KF7-360.7M[9] KF7-580.1[8] /end FUNCTION_LIST /end MEASUREMENT
/begin MEASUREMENT fADALPNG "At the time of the purge ceremony additional charge judgement, purge cut flag" UBYTE COMP_0283 1 100 0 1 BIT_MASK 0x0020 ECU_ADDRESS 0xFFFF427C /begin FUNCTION_LIST KF7-371.1E[15] /end FUNCTION_LIST /end MEASUREMENT
/begin MEASUREMENT fADCGA "Pressure ceremony notOK judgement flag" UBYTE COMP_0283 1 100 0 1 BIT_MASK 0x0010 ECU_ADDRESS 0xFFFF427C /begin FUNCTION_LIST KF7-371.1E[15] /end FUNCTION_LIST /end MEASUREMENT
/begin MEASUREMENT fADCGBNG "Purge ceremony NG judgement flag" UBYTE COMP_0283 1 100 0 1 BIT_MASK 0x0008 ECU_ADDRESS 0xFFFF427C /begin FUNCTION_LIST KF7-371.1E[15] /end FUNCTION_LIST /end MEASUREMENT
/begin MEASUREMENT fADCGBOK "Purge-type OK judgement flag" UBYTE COMP_0283 1 100 0 1 BIT_MASK 0x0004 ECU_ADDRESS 0xFFFF427C /begin FUNCTION_LIST KF7-371.1E[15] /end FUNCTION_LIST /end MEASUREMENT
/begin MEASUREMENT fADCGC "An extreme heat resisting judgement flag" UBYTE COMP_0283 1 100 0 1 BIT_MASK 0x0002 ECU_ADDRESS 0xFFFF427C /begin FUNCTION_LIST KF7-371.1E[15] /end FUNCTION_LIST /end MEASUREMENT
/begin MEASUREMENT fADCGD "Heat resisting OK judgement cancellation judgement flag" UBYTE COMP_0283 1 100 0 1 BIT_MASK 0x0001 ECU_ADDRESS 0xFFFF427C /begin FUNCTION_LIST KF7-371.1E[15] /end FUNCTION_LIST /end MEASUREMENT
/begin MEASUREMENT fALPINIT "ALPHA initialization flag" UBYTE COMP_0283 1 100 0 1 BIT_MASK 0x0010 ECU_ADDRESS 0xFFFF4281 /begin FUNCTION_LIST KF7-371.1E[15] /end FUNCTION_LIST /end MEASUREMENT
/begin MEASUREMENT fALPLMMON "During the purge rate limitation by the air-fuel ratio error, flag" UBYTE COMP_0283 1 100 0 1 BIT_MASK 0x0008 ECU_ADDRESS 0xFFFF4281 /begin FUNCTION_LIST KF7-371.1E[15] /end FUNCTION_LIST /end MEASUREMENT
/begin MEASUREMENT fBRKSWCA3 "Brake SWCA3 flag" UBYTE COMP_0283 1 100 0 1 BIT_MASK 0x0004 ECU_ADDRESS 0xFFFF4285 /begin FUNCTION_LIST KF7-360.4[14] KF7-450.50[10] R000.1.RS_Integ_1_10_2 /end FUNCTION_LIST /end MEASUREMENT
/begin MEASUREMENT fCARIBARI "Calibration executive one's personal history flag" UBYTE COMP_0283 1 100 0 1 BIT_MASK 0x0010 ECU_ADDRESS 0xFFFF4286 /begin FUNCTION_LIST KF7-371.1E[15] /end FUNCTION_LIST /end MEASUREMENT
/begin MEASUREMENT fCARIBGO "Calibration permission flag" UBYTE COMP_0283 1 100 0 1 BIT_MASK 0x0008 ECU_ADDRESS 0xFFFF4286 /begin FUNCTION_LIST KF7-371.1E[15] /end FUNCTION_LIST /end MEASUREMENT
/begin MEASUREMENT fCRBBBGOK "Calibration blow-by condition" UBYTE COMP_0283 1 100 0 1 BIT_MASK 0x0020 ECU_ADDRESS 0xFFFF428D /begin FUNCTION_LIST KF7-371.1E[15] /end FUNCTION_LIST /end MEASUREMENT
/begin MEASUREMENT fCRBDNSOK "Calibration purge concentration condition" UBYTE COMP_0283 1 100 0 1 BIT_MASK 0x0010 ECU_ADDRESS 0xFFFF428D /begin FUNCTION_LIST KF7-371.1E[15] /end FUNCTION_LIST /end MEASUREMENT
/begin MEASUREMENT fCRBFCTOK "Calibration fuel cut condition" UBYTE COMP_0283 1 100 0 1 BIT_MASK 0x0008 ECU_ADDRESS 0xFFFF428D /begin FUNCTION_LIST KF7-371.1E[15] /end FUNCTION_LIST /end MEASUREMENT
/begin MEASUREMENT fCRBGSOK "Calibration steady state slowdown condition" UBYTE COMP_0283 1 100 0 1 BIT_MASK 0x0004 ECU_ADDRESS 0xFFFF428D /begin FUNCTION_LIST KF7-371.1E[15] /end FUNCTION_LIST /end MEASUREMENT
/begin MEASUREMENT fCRBMFOK "Calibration misfire condition" UBYTE COMP_0283 1 100 0 1 BIT_MASK 0x0002 ECU_ADDRESS 0xFFFF428D /begin FUNCTION_LIST KF7-371.1E[15] /end FUNCTION_LIST /end MEASUREMENT
/begin MEASUREMENT fCRBPQOK "Calibration purge flow-quantity condition" UBYTE COMP_0283 1 100 0 1 BIT_MASK 0x0001 ECU_ADDRESS 0xFFFF428D /begin FUNCTION_LIST KF7-371.1E[15] /end FUNCTION_LIST /end MEASUREMENT
/begin MEASUREMENT fCRBPROK "Calibration purge rate condition" UBYTE COMP_0283 1 100 0 1 BIT_MASK 0x0080 ECU_ADDRESS 0xFFFF428E /begin FUNCTION_LIST KF7-371.1E[15] /end FUNCTION_LIST /end MEASUREMENT
/begin MEASUREMENT fCRBQH0OK "Calibration steady state QH0 condition" UBYTE COMP_0283 1 100 0 1 BIT_MASK 0x0040 ECU_ADDRESS 0xFFFF428E /begin FUNCTION_LIST KF7-371.1E[15] /end FUNCTION_LIST /end MEASUREMENT
/begin MEASUREMENT fCRBSTCOK "Calibration basic condition" UBYTE COMP_0283 1 100 0 1 BIT_MASK 0x0020 ECU_ADDRESS 0xFFFF428E /begin FUNCTION_LIST KF7-371.1E[15] /end FUNCTION_LIST /end MEASUREMENT
/begin MEASUREMENT fCRBTGABF "Calibration target A/F condition" UBYTE COMP_0283 1 100 0 1 BIT_MASK 0x0010 ECU_ADDRESS 0xFFFF428E /begin FUNCTION_LIST KF7-371.1E[15] /end FUNCTION_LIST /end MEASUREMENT
/begin MEASUREMENT fDECELGO "Slowdown purge permission flag" UBYTE COMP_0283 1 100 0 1 BIT_MASK 0x0080 ECU_ADDRESS 0xFFFF4293 /begin FUNCTION_LIST KF7-371.1E[15] /end FUNCTION_LIST /end MEASUREMENT
/begin MEASUREMENT fDLTAFSOK "A/F enactment condition formation flag" UBYTE COMP_0283 1 100 0 1 BIT_MASK 0x0004 ECU_ADDRESS 0xFFFF4294 /begin FUNCTION_LIST KF7-371.1E[15] /end FUNCTION_LIST /end MEASUREMENT
/begin MEASUREMENT fDRNCT "Canister drain valve cut flag" UBYTE COMP_0283 1 100 0 1 BIT_MASK 0x0002 ECU_ADDRESS 0xFFFF4294 /begin FUNCTION_LIST KF7-371.1E[15] /end FUNCTION_LIST /end MEASUREMENT
/begin MEASUREMENT fDRNCTEND "Pressure-type judgement completion flag (at the time of the limitation number of times execution)" UBYTE COMP_0283 1 100 0 1 BIT_MASK 0x0001 ECU_ADDRESS 0xFFFF4294 /begin FUNCTION_LIST KF7-371.1E[15] /end FUNCTION_LIST /end MEASUREMENT
/begin MEASUREMENT fDRNCTON "Pressure-type judgement permission condition formation flag" UBYTE COMP_0283 1 100 0 1 BIT_MASK 0x0080 ECU_ADDRESS 0xFFFF4295 /begin FUNCTION_LIST KF7-371.1E[15] /end FUNCTION_LIST /end MEASUREMENT
/begin MEASUREMENT fEEPQEND "TAS learning value EEPROM writing treatment complete flag" UBYTE COMP_0283 1 100 0 1 BIT_MASK 0x0002 ECU_ADDRESS 0xFFFF4297 /begin FUNCTION_LIST KF7-351.1[16] /end FUNCTION_LIST /end MEASUREMENT
/begin MEASUREMENT fETCOFF "ETC failsafe" UBYTE COMP_0283 1 100 0 1 BIT_MASK 0x0010 ECU_ADDRESS 0xFFFF42A1
 /begin FUNCTION_LIST KF7-360.4[14] KF7-393.1C[8] KF7-450.50[10] KF7-500.1[54] R000.1.RS_Integ_1_10_2 /end FUNCTION_LIST
/end MEASUREMENT
/begin MEASUREMENT fETCON2 "An ETC control permission flag for the TPS un-adjustment diagnosis" UBYTE COMP_0283 1 100 0 1 BIT_MASK 0x0008 ECU_ADDRESS 0xFFFF42A1 /begin FUNCTION_LIST KF7-360.4[14] KF7-505.2[9] /end FUNCTION_LIST /end MEASUREMENT
/begin MEASUREMENT fETSFAIL "Fail treatment condition judgement flag" UBYTE COMP_0283 1 100 0 1 BIT_MASK 0x0002 ECU_ADDRESS 0xFFFF42A2 /begin FUNCTION_LIST KF7-360.9M[43] /end FUNCTION_LIST /end MEASUREMENT
/begin MEASUREMENT fETSOK "Electric 4WD drive protection control judgement flag" UBYTE COMP_0283 1 100 0 1 BIT_MASK 0x0020 ECU_ADDRESS 0xFFFF42A3 /begin FUNCTION_LIST KF7-360.9M[43] /end FUNCTION_LIST /end MEASUREMENT
/begin MEASUREMENT fFEDTAS1 "Low speed air quantity learning rapid mode completion flag" UBYTE COMP_0283 1 100 0 1 BIT_MASK 0x0004 ECU_ADDRESS 0xFFFF42AF /begin FUNCTION_LIST KF7-351.1[16] KF7-351.3[11] /end FUNCTION_LIST /end MEASUREMENT
/begin MEASUREMENT fFEDTAS3 "At the time of the off idle, TAS learning completion flag" UBYTE COMP_0283 1 100 0 1 BIT_MASK 0x0002 ECU_ADDRESS 0xFFFF42AF /begin FUNCTION_LIST KF7-351.1[16] /end FUNCTION_LIST /end MEASUREMENT
/begin MEASUREMENT fFNDSHK "At the time of the ND select shock, torque going down control condition formation flag" UBYTE COMP_0283 1 100 0 1 BIT_MASK 0x0004 ECU_ADDRESS 0xFFFF42BB /begin FUNCTION_LIST KF7-360.9M[43] /end FUNCTION_LIST /end MEASUREMENT
/begin MEASUREMENT fFPTTFS "At the time of the fail, gear shift limitation requirement flag" UBYTE COMP_0283 1 100 0 1 BIT_MASK 0x0020 ECU_ADDRESS 0xFFFF42BD /begin FUNCTION_LIST KF7-360.9M[43] /end FUNCTION_LIST /end MEASUREMENT
/begin MEASUREMENT fFQCDLY "TAS learning operation start judgement flag" UBYTE COMP_0283 1 100 0 1 BIT_MASK 0x0008 ECU_ADDRESS 0xFFFF42BD /begin FUNCTION_LIST KF7-351.1[16] /end FUNCTION_LIST /end MEASUREMENT
/begin MEASUREMENT fFQLSRTD "Air quantity learning (low speed rapid mode) convergent judgement flag" UBYTE COMP_0283 1 100 0 1 BIT_MASK 0x0080 ECU_ADDRESS 0xFFFF42BE /begin FUNCTION_LIST KF7-351.3[11] /end FUNCTION_LIST /end MEASUREMENT
/begin MEASUREMENT fFQLSTD "Air quantity learning (low speed, usually, mode) convergent judgement flag" UBYTE COMP_0283 1 100 0 1 BIT_MASK 0x0040 ECU_ADDRESS 0xFFFF42BE /begin FUNCTION_LIST KF7-351.3[11] /end FUNCTION_LIST /end MEASUREMENT
/begin MEASUREMENT fFQLTD "Air quantity learning (high speed) convergent judgement flag" UBYTE COMP_0283 1 100 0 1 BIT_MASK 0x0020 ECU_ADDRESS 0xFFFF42BE /begin FUNCTION_LIST KF7-351.2[17] KF7-351.3[11] /end FUNCTION_LIST /end MEASUREMENT
/begin MEASUREMENT fFQLTD2 "A high-speed air quantity learning cancellation flag" UBYTE COMP_0283 1 100 0 1 BIT_MASK 0x0010 ECU_ADDRESS 0xFFFF42BE /begin FUNCTION_LIST KF7-351.2[17] KF7-351.3[11] /end FUNCTION_LIST /end MEASUREMENT
/begin MEASUREMENT fFTQTMSTA "T/M requirement steady state torque control condition judgement flag" UBYTE COMP_0283 1 100 0 1 BIT_MASK 0x0008 ECU_ADDRESS 0xFFFF42C2 /begin FUNCTION_LIST KF7-360.9M[43] /end FUNCTION_LIST /end MEASUREMENT
/begin MEASUREMENT fFTVQLSR "Low speed learning (rapid mode) renewal trigger condition" UBYTE COMP_0283 1 100 0 1 BIT_MASK 0x0040 ECU_ADDRESS 0xFFFF42C4 /begin FUNCTION_LIST KF7-351.1[16] KF7-351.3[11] KF7-580.1[8] /end FUNCTION_LIST /end MEASUREMENT
/begin MEASUREMENT fIDLEJGOK "Idle purge start delay condition formation flag" UBYTE COMP_0283 1 100 0 1 BIT_MASK 0x0010 ECU_ADDRESS 0xFFFF42C8 /begin FUNCTION_LIST KF7-371.1E[15] /end FUNCTION_LIST /end MEASUREMENT
/begin MEASUREMENT fIDLJGOKB "Purge-type judgement permission condition formation flag" UBYTE COMP_0283 1 100 0 1 BIT_MASK 0x0008 ECU_ADDRESS 0xFFFF42C8 /begin FUNCTION_LIST KF7-371.1E[15] /end FUNCTION_LIST /end MEASUREMENT
/begin MEASUREMENT fPKDGNDMD "Prohibition of a purge by the diagnosis NG" UBYTE COMP_0283 1 100 0 1 BIT_MASK 0x0040 ECU_ADDRESS 0xFFFF42E0 /begin FUNCTION_LIST KF7-371.1E[15] /end FUNCTION_LIST /end MEASUREMENT
/begin MEASUREMENT fPKDGNNG "Idle purge permission flag" UBYTE COMP_0283 1 100 0 1 BIT_MASK 0x0020 ECU_ADDRESS 0xFFFF42E0 /begin FUNCTION_LIST KF7-371.1E[15] /end FUNCTION_LIST /end MEASUREMENT
/begin MEASUREMENT fPKLMDCLS "Purge prohibition lambda control condition" UBYTE COMP_0283 1 100 0 1 BIT_MASK 0x0010 ECU_ADDRESS 0xFFFF42E0 /begin FUNCTION_LIST KF7-371.1E[15] /end FUNCTION_LIST /end MEASUREMENT
/begin MEASUREMENT fPKTWN "Purge prohibition coolant temperature condition" UBYTE COMP_0283 1 100 0 1 BIT_MASK 0x0008 ECU_ADDRESS 0xFFFF42E0 /begin FUNCTION_LIST KF7-371.1E[15] /end FUNCTION_LIST /end MEASUREMENT
/begin MEASUREMENT fPUPAFNG "Purge rate up stop flag" UBYTE COMP_0283 1 100 0 1 BIT_MASK 0x0080 ECU_ADDRESS 0xFFFF42E6 /begin FUNCTION_LIST KF7-371.1E[15] /end FUNCTION_LIST /end MEASUREMENT
/begin MEASUREMENT fTASHAC "Rapid TAS learning flag for the factory" UBYTE COMP_0283 1 100 0 1 BIT_MASK 0x0020 ECU_ADDRESS 0xFFFF42F2 /begin FUNCTION_LIST KF7-351.1[16] KF7-580.1[8] /end FUNCTION_LIST /end MEASUREMENT
/begin MEASUREMENT fTVOFQLJG "A high-speed learning value renewal condition" UBYTE COMP_0283 1 100 0 1 BIT_MASK 0x0020 ECU_ADDRESS 0xFFFF42F6 /begin FUNCTION_LIST KF7-351.3[11] /end FUNCTION_LIST /end MEASUREMENT
/begin MEASUREMENT fTWQLH "Hysteresis flag" UBYTE COMP_0283 1 100 0 1 BIT_MASK 0x0001 ECU_ADDRESS 0xFFFF42F6 /begin FUNCTION_LIST KF7-351.3[11] /end FUNCTION_LIST /end MEASUREMENT
/begin MEASUREMENT fTWQLL "Hysteresis flag" UBYTE COMP_0283 1 100 0 1 BIT_MASK 0x0080 ECU_ADDRESS 0xFFFF42F7 /begin FUNCTION_LIST KF7-351.3[11] /end FUNCTION_LIST /end MEASUREMENT
/begin MEASUREMENT fVSPKT "Vehicle speed experience flag" UBYTE COMP_0283 1 100 0 1 BIT_MASK 0x0020 ECU_ADDRESS 0xFFFF42FA /begin FUNCTION_LIST KF7-360.9M[43] /end FUNCTION_LIST /end MEASUREMENT
/begin MEASUREMENT fZKADFON "Drive power compensation ON/ off flag" UBYTE COMP_0283 1 100 0 1 BIT_MASK 0x0020 ECU_ADDRESS 0xFFFF42FF /begin FUNCTION_LIST KF7-340.16[4] /end FUNCTION_LIST /end MEASUREMENT
/begin MEASUREMENT fETCOFF_S "ETC failsafe" UBYTE COMP_0283 1 100 0 1 BIT_MASK 0x0002 ECU_ADDRESS 0xFFFF42FF /begin FUNCTION_LIST KF7-360.4[14] KF7-500.1[54] /end FUNCTION_LIST /end MEASUREMENT
/begin MEASUREMENT fCCW "Motor rotation direction (proper ì]) flag" UBYTE COMP_0283 1 100 0 1 BIT_MASK 0x0010 ECU_ADDRESS 0xFFFF4304 /begin FUNCTION_LIST KF7-360.1[12] KF7-505.31[5] KF7-525.2[6] /end FUNCTION_LIST /end MEASUREMENT
/begin MEASUREMENT fRCW "Motor rotation direction (reverse) flag" UBYTE COMP_0283 1 100 0 1 BIT_MASK 0x0080 ECU_ADDRESS 0xFFFF4306 /begin FUNCTION_LIST KF7-360.1[12] KF7-505.31[5] /end FUNCTION_LIST /end MEASUREMENT
/begin MEASUREMENT fNAVING "NAVI fail flag" UBYTE COMP_0283 1 100 0 1 BIT_MASK 0x0008 ECU_ADDRESS 0xFFFF430A /begin FUNCTION_LIST KF7-340.16[4] /end FUNCTION_LIST /end MEASUREMENT
/begin MEASUREMENT fINDDRNG "D range choice flag" UBYTE COMP_0283 1 100 0 1 BIT_MASK 0x0080 ECU_ADDRESS 0xFFFF432E /begin FUNCTION_LIST KF7-360.9M[43] /end FUNCTION_LIST /end MEASUREMENT
/begin MEASUREMENT fMECHADGN "A mechanical trouble is being diagnosed at the time of key off, flag" UBYTE COMP_0283 1 100 0 1 BIT_MASK 0x0020 ECU_ADDRESS 0xFFFF4331 /begin FUNCTION_LIST KF7-360.4[14] KF7-505.33[8] /end FUNCTION_LIST /end MEASUREMENT
/begin MEASUREMENT fMECHAEND "At the time of key off, input trouble diagnosis completion flag" UBYTE COMP_0283 1 100 0 1 BIT_MASK 0x0001 ECU_ADDRESS 0xFFFF4331 /begin FUNCTION_LIST KF7-360.4[14] KF7-505.33[8] KF7-505.39[2] /end FUNCTION_LIST /end MEASUREMENT
/begin MEASUREMENT fRLYCKEND "Relay diagnosis completion flag" UBYTE COMP_0283 1 100 0 1 BIT_MASK 0x0020 ECU_ADDRESS 0xFFFF4336 /begin FUNCTION_LIST KF7-360.4[14] KF7-505.31[5] /end FUNCTION_LIST /end MEASUREMENT
/begin MEASUREMENT fRLYOFFRQ "Relay diagnosis-main CPU relay on requirement flag" UBYTE COMP_0283 1 100 0 1 BIT_MASK 0x0010 ECU_ADDRESS 0xFFFF4336 /begin FUNCTION_LIST KF7-360.2[N] KF7-505.31[5] /end FUNCTION_LIST /end MEASUREMENT
/begin MEASUREMENT fTPSXCA "TPSX system precaution flag" UBYTE COMP_0283 1 100 0 1 BIT_MASK 0x0020 ECU_ADDRESS 0xFFFF433E
 /begin FUNCTION_LIST KF7-360.1[12] KF7-360.4[14] KF7-450.50[10] KF7-505.2[9] KF7-505.15[4] KF7-505.34[3] R000.1.RS_Integ_1_10_2 /end FUNCTION_LIST
/end MEASUREMENT
/begin MEASUREMENT fZKOFF "Compensation prohibition flag" UBYTE COMP_0283 1 100 0 1 BIT_MASK 0x0020 ECU_ADDRESS 0xFFFF4342 /begin FUNCTION_LIST KF7-340.16[4] /end FUNCTION_LIST /end MEASUREMENT
/begin MEASUREMENT fZKON2 "ECM recognition control ON/ off flag" UBYTE COMP_0283 1 100 0 1 BIT_MASK 0x0008 ECU_ADDRESS 0xFFFF4342 /begin FUNCTION_LIST KF7-340.16[4] /end FUNCTION_LIST /end MEASUREMENT
/begin MEASUREMENT fRLYON_S "Motor relay control flag" UBYTE COMP_0283 1 100 0 1 BIT_MASK 0x0040 ECU_ADDRESS 0xFFFF4343 /begin FUNCTION_LIST KF7-360.2[N] KF7-505.31[5] KF7-505.34[3] KF7-525.2S[10] /end FUNCTION_LIST /end MEASUREMENT
/begin MEASUREMENT fRLYON_SQ "Relay on requirement flag" UBYTE COMP_0283 1 100 0 1 BIT_MASK 0x0020 ECU_ADDRESS 0xFFFF4343 /begin FUNCTION_LIST KF7-360.2[N] KF7-505.31[5] /end FUNCTION_LIST /end MEASUREMENT
/begin MEASUREMENT afDAPSNG "Accelerator sensor trouble judgement flag" UBYTE COMP_0283 1 100 0 1 BIT_MASK 0x0020 ECU_ADDRESS 0xFFFF4351 /begin FUNCTION_LIST KF7-376.2[21] KF7-385.1[32] KF7-450.50[10] KF7-505.91[2] /end FUNCTION_LIST /end MEASUREMENT
/begin MEASUREMENT afPKINSHI "A purge cut requirement by the diagnosis" UBYTE COMP_0283 1 100 0 1 BIT_MASK 0x0020 ECU_ADDRESS 0xFFFF4357 /begin FUNCTION_LIST KF7-371.1E[15] /end FUNCTION_LIST /end MEASUREMENT
/begin MEASUREMENT fBCDCV "CDCV output" UBYTE COMP_0283 1 100 0 1 BIT_MASK 0x0020 ECU_ADDRESS 0xFFFF435C /begin FUNCTION_LIST KF7-371.1E[15] /end FUNCTION_LIST /end MEASUREMENT
/begin MEASUREMENT fDAPSNG "Accelerator sensor trouble judgement flag" UBYTE COMP_0283 1 100 0 1 BIT_MASK 0x0020 ECU_ADDRESS 0xFFFF4362
 /begin FUNCTION_LIST KF7-376.2[21] KF7-385.1[32] KF7-410.10[6] KF7-450.50[10] KF7-505.91[2] R000.1.RS_Integ_1_10_2 R301.6.IscAirflow_1_4_5 /end FUNCTION_LIST
/end MEASUREMENT
/begin MEASUREMENT fPKINSHI "A purge cut requirement by the diagnosis" UBYTE COMP_0283 1 100 0 1 BIT_MASK 0x0020 ECU_ADDRESS 0xFFFF4368 /begin FUNCTION_LIST KF7-371.1E[15] /end FUNCTION_LIST /end MEASUREMENT
/begin MEASUREMENT wfSHAPSW "A sharp mode signal" UBYTE COMP_0283 1 100 0 1 BIT_MASK 0x0001 ECU_ADDRESS 0xFFFF8A90 /begin FUNCTION_LIST KF7-360.7M[9] /end FUNCTION_LIST /end MEASUREMENT
/begin MEASUREMENT fSHAPSW "A sharp mode signal" UBYTE COMP_0283 1 100 0 1 BIT_MASK 0x0001 ECU_ADDRESS 0xFFFF8A93 /begin FUNCTION_LIST KF7-360.7M[9] /end FUNCTION_LIST /end MEASUREMENT
/begin MEASUREMENT bfISCFF "Ignition timing F/F judgement flag" UBYTE COMP_0283 1 100 0 1 BIT_MASK 0x0080 ECU_ADDRESS 0xFFFF2457 /begin FUNCTION_LIST KF7-376.3[2] KF7-377.1A[19] KF7-390.3A[15] /end FUNCTION_LIST /end MEASUREMENT
/begin MEASUREMENT fACCTVO "For the air-conditioning cut control operation" UBYTE COMP_0283 1 100 0 1 BIT_MASK 0x0080 ECU_ADDRESS 0xFFFF2458 /begin FUNCTION_LIST KF7-376.2[21] /end FUNCTION_LIST /end MEASUREMENT
/begin MEASUREMENT fACCUT2 "Air-conditioning cut high rotation tense executive flag" UBYTE COMP_0283 1 100 0 1 BIT_MASK 0x0040 ECU_ADDRESS 0xFFFF2458 /begin FUNCTION_LIST KF7-376.1[6] KF7-376.2[21] KF7-376.4[4] /end FUNCTION_LIST /end MEASUREMENT
/begin MEASUREMENT fACDMD "Air-conditioning relay requirement" UBYTE COMP_0283 1 100 0 1 BIT_MASK 0x0020 ECU_ADDRESS 0xFFFF2458 /begin FUNCTION_LIST KF7-376.3[2] /end FUNCTION_LIST /end MEASUREMENT
/begin MEASUREMENT fACOUT0 "A flag for the AC relay timing adjustment" UBYTE COMP_0283 1 100 0 1 BIT_MASK 0x0010 ECU_ADDRESS 0xFFFF2458 /begin FUNCTION_LIST KF7-376.1[6] /end FUNCTION_LIST /end MEASUREMENT
/begin MEASUREMENT fACRLY "A flag for AC relay & ignition F/F sympathizing" UBYTE COMP_0283 1 100 0 1 BIT_MASK 0x0008 ECU_ADDRESS 0xFFFF2458 /begin FUNCTION_LIST KF7-376.1[6] KF7-376.3[2] KF7-390.3A[15] /end FUNCTION_LIST /end MEASUREMENT
/begin MEASUREMENT fFCKBL0 "(CK) Control executive condition for the belt slide" UBYTE COMP_0283 1 100 0 1 BIT_MASK 0x0002 ECU_ADDRESS 0xFFFF2458 /begin FUNCTION_LIST KF7-360.9M[43] /end FUNCTION_LIST /end MEASUREMENT
/begin MEASUREMENT fFCKBLT "(CK) Control practice for the belt slide" UBYTE COMP_0283 1 100 0 1 BIT_MASK 0x0001 ECU_ADDRESS 0xFFFF2458 /begin FUNCTION_LIST KF7-360.9M[43] /end FUNCTION_LIST /end MEASUREMENT
/begin MEASUREMENT fHTWLMT "vHTWLMT computed condition formation flag" UBYTE COMP_0283 1 100 0 1 BIT_MASK 0x0002 ECU_ADDRESS 0xFFFF2459 /begin FUNCTION_LIST KF7-360.9M[43] KF7-360.9P[22] /end FUNCTION_LIST /end MEASUREMENT
/begin MEASUREMENT fACCUT1 "Air-conditioning cut acceleration tense executive flag" UBYTE COMP_0283 1 100 0 1 BIT_MASK 0x0004 ECU_ADDRESS 0xFFFF2460 /begin FUNCTION_LIST KF7-376.2[21] KF7-376.3[2] R301.6.IscAirflow_1_4_5 /end FUNCTION_LIST /end MEASUREMENT
/begin MEASUREMENT fACCUT11 "At the time of the towing, air-conditioning cut control executive flag" UBYTE COMP_0283 1 100 0 1 BIT_MASK 0x0002 ECU_ADDRESS 0xFFFF2460 /begin FUNCTION_LIST KF7-376.2[21] /end FUNCTION_LIST /end MEASUREMENT
/begin MEASUREMENT fACCUT3 "Air-conditioning cut initial tense executive flag" UBYTE COMP_0283 1 100 0 1 BIT_MASK 0x0001 ECU_ADDRESS 0xFFFF2460 /begin FUNCTION_LIST KF7-376.2[21] /end FUNCTION_LIST /end MEASUREMENT
/begin MEASUREMENT fACCUT4 "Air-conditioning cut high coolant temperature tense executive flag" UBYTE COMP_0283 1 100 0 1 BIT_MASK 0x0020 ECU_ADDRESS 0xFFFF2461 /begin FUNCTION_LIST KF7-376.2[21] /end FUNCTION_LIST /end MEASUREMENT
/begin MEASUREMENT fACCUT5 "Air-conditioning cut control executive flag" UBYTE COMP_0283 1 100 0 1 BIT_MASK 0x0010 ECU_ADDRESS 0xFFFF2461 /begin FUNCTION_LIST KF7-376.2[21] /end FUNCTION_LIST /end MEASUREMENT
/begin MEASUREMENT fACCUT6 "Air-conditioning cut control executive flag" UBYTE COMP_0283 1 100 0 1 BIT_MASK 0x0008 ECU_ADDRESS 0xFFFF2461 /begin FUNCTION_LIST KF7-376.2[21] /end FUNCTION_LIST /end MEASUREMENT
/begin MEASUREMENT fACCUT8 "Air-conditioning cut control executive flag" UBYTE COMP_0283 1 100 0 1 BIT_MASK 0x0004 ECU_ADDRESS 0xFFFF2461 /begin FUNCTION_LIST KF7-376.2[21] /end FUNCTION_LIST /end MEASUREMENT
/begin MEASUREMENT fACCUT9 "At the time of the reverse, air-conditioning cut control executive flag" UBYTE COMP_0283 1 100 0 1 BIT_MASK 0x0002 ECU_ADDRESS 0xFFFF2461 /begin FUNCTION_LIST KF7-376.2[21] /end FUNCTION_LIST /end MEASUREMENT
/begin MEASUREMENT fACSTDY "A/C Off    on rest delay flag" UBYTE COMP_0283 1 100 0 1 BIT_MASK 0x0010 ECU_ADDRESS 0xFFFF2463 /begin FUNCTION_LIST KF7-376.2[21] /end FUNCTION_LIST /end MEASUREMENT
/begin MEASUREMENT fACTCRIB "An active calibration requirement" UBYTE COMP_0283 1 100 0 1 BIT_MASK 0x0004 ECU_ADDRESS 0xFFFF2463 /begin FUNCTION_LIST KF7-371.1E[15] /end FUNCTION_LIST /end MEASUREMENT
/begin MEASUREMENT fALINHTJG "At the time of the purge ceremony heat resisting judgement, ALPHA initialization condition formation flag" UBYTE COMP_0283 1 100 0 1 BIT_MASK 0x0002 ECU_ADDRESS 0xFFFF2464 /begin FUNCTION_LIST KF7-371.1E[15] /end FUNCTION_LIST /end MEASUREMENT
/begin MEASUREMENT fALPRECRI "At the time of the ALP limiter purge limitation, re-calibration requirement" UBYTE COMP_0283 1 100 0 1 BIT_MASK 0x0001 ECU_ADDRESS 0xFFFF2464 /begin FUNCTION_LIST KF7-371.1E[15] /end FUNCTION_LIST /end MEASUREMENT
/begin MEASUREMENT fBANKAD "ADALP operation reference bank" UBYTE COMP_0283 1 100 0 1 BIT_MASK 0x0008 ECU_ADDRESS 0xFFFF2466 /begin FUNCTION_LIST KF7-371.1E[15] /end FUNCTION_LIST /end MEASUREMENT
/begin MEASUREMENT fBSERCND "Base air-fuel ratio error judgement condition" UBYTE COMP_0283 1 100 0 1 BIT_MASK 0x0002 ECU_ADDRESS 0xFFFF2467 /begin FUNCTION_LIST KF7-371.1E[15] /end FUNCTION_LIST /end MEASUREMENT
/begin MEASUREMENT fCARIBGO2 "An active calibration timing" UBYTE COMP_0283 1 100 0 1 BIT_MASK 0x0001 ECU_ADDRESS 0xFFFF2467 /begin FUNCTION_LIST KF7-371.1E[15] /end FUNCTION_LIST /end MEASUREMENT
/begin MEASUREMENT fCARIBGOB "During the purge cut, calibration condition" UBYTE COMP_0283 1 100 0 1 BIT_MASK 0x0080 ECU_ADDRESS 0xFFFF2468 /begin FUNCTION_LIST KF7-371.1E[15] /end FUNCTION_LIST /end MEASUREMENT
/begin MEASUREMENT fCARIBGOK "Model reflection calibration timing" UBYTE COMP_0283 1 100 0 1 BIT_MASK 0x0040 ECU_ADDRESS 0xFFFF2468 /begin FUNCTION_LIST KF7-371.1E[15] /end FUNCTION_LIST /end MEASUREMENT
/begin MEASUREMENT fCKLU "L/U judgement" UBYTE COMP_0283 1 100 0 1 BIT_MASK 0x0080 ECU_ADDRESS 0xFFFF246A /begin FUNCTION_LIST KF7-360.8M[4] R301.8.Inverse_filter_1_1_3 /end FUNCTION_LIST /end MEASUREMENT
/begin MEASUREMENT fCONND "D range conclusion complete judgement flag" UBYTE COMP_0283 1 100 0 1 BIT_MASK 0x0010 ECU_ADDRESS 0xFFFF246A /begin FUNCTION_LIST KF7-360.9M[43] /end FUNCTION_LIST /end MEASUREMENT
/begin MEASUREMENT fCRIKIN1 "Calibration prohibition 1" UBYTE COMP_0283 1 100 0 1 BIT_MASK 0x0040 ECU_ADDRESS 0xFFFF246B /begin FUNCTION_LIST KF7-371.1E[15] /end FUNCTION_LIST /end MEASUREMENT
/begin MEASUREMENT fCRIPCT "A purge cut for the calibration" UBYTE COMP_0283 1 100 0 1 BIT_MASK 0x0020 ECU_ADDRESS 0xFFFF246B /begin FUNCTION_LIST KF7-371.1E[15] /end FUNCTION_LIST /end MEASUREMENT
/begin MEASUREMENT fDLVSP2 "Hysteresis flag" UBYTE COMP_0283 1 100 0 1 BIT_MASK 0x0040 ECU_ADDRESS 0xFFFF246E /begin FUNCTION_LIST KF7-376.2[21] KF7-385.1[32] /end FUNCTION_LIST /end MEASUREMENT
/begin MEASUREMENT fDLVSPB "Hysteresis flag" UBYTE COMP_0283 1 100 0 1 BIT_MASK 0x0020 ECU_ADDRESS 0xFFFF246E /begin FUNCTION_LIST KF7-376.2[21] KF7-385.1[32] /end FUNCTION_LIST /end MEASUREMENT
/begin MEASUREMENT fDSTLCUT "D range stall fuel cut condition" UBYTE COMP_0283 1 100 0 1 BIT_MASK 0x0004 ECU_ADDRESS 0xFFFF246E /begin FUNCTION_LIST KF7-360.9M[43] /end FUNCTION_LIST /end MEASUREMENT
/begin MEASUREMENT fFAPLT1 "At the time of 1st steady state, torque going down control condition formation flag" UBYTE COMP_0283 1 100 0 1 BIT_MASK 0x0010 ECU_ADDRESS 0xFFFF2476 /begin FUNCTION_LIST KF7-360.9M[43] /end FUNCTION_LIST /end MEASUREMENT
/begin MEASUREMENT fFAPLT2 "At the time of 2nd stall, torque going down control condition formation flag" UBYTE COMP_0283 1 100 0 1 BIT_MASK 0x0008 ECU_ADDRESS 0xFFFF2476 /begin FUNCTION_LIST KF7-360.9M[43] /end FUNCTION_LIST /end MEASUREMENT
/begin MEASUREMENT fFAPLT3 "At the time of 1st stall, torque going down control condition formation flag" UBYTE COMP_0283 1 100 0 1 BIT_MASK 0x0004 ECU_ADDRESS 0xFFFF2476 /begin FUNCTION_LIST KF7-360.9M[43] /end FUNCTION_LIST /end MEASUREMENT
/begin MEASUREMENT fFAPLT4 "At the time of the reverse stall, torque going down control condition formation flag" UBYTE COMP_0283 1 100 0 1 BIT_MASK 0x0002 ECU_ADDRESS 0xFFFF2476 /begin FUNCTION_LIST KF7-360.9M[43] /end FUNCTION_LIST /end MEASUREMENT
/begin MEASUREMENT fFAPLTA "The whole area torque going down control condition formation flag" UBYTE COMP_0283 1 100 0 1 BIT_MASK 0x0001 ECU_ADDRESS 0xFFFF2476 /begin FUNCTION_LIST KF7-360.9M[43] /end FUNCTION_LIST /end MEASUREMENT
/begin MEASUREMENT fFCKHOGO "Control executive flag" UBYTE COMP_0283 1 100 0 1 BIT_MASK 0x0080 ECU_ADDRESS 0xFFFF2478 /begin FUNCTION_LIST KF7-360.9M[43] /end FUNCTION_LIST /end MEASUREMENT
/begin MEASUREMENT fFLGRFC "Control ON/ off judgement flag" UBYTE COMP_0283 1 100 0 1 BIT_MASK 0x0020 ECU_ADDRESS 0xFFFF247E /begin FUNCTION_LIST KF7-340.15[3] /end FUNCTION_LIST /end MEASUREMENT
/begin MEASUREMENT fFLUON "Lockup judgement (for the DUETTE control)" UBYTE COMP_0283 1 100 0 1 BIT_MASK 0x0001 ECU_ADDRESS 0xFFFF247E
 /begin FUNCTION_LIST KF7-360.8M[4] KF7-376.2[21] KF7-385.1[32] R301.8.Inverse_filter_1_1_3 /end FUNCTION_LIST
/end MEASUREMENT
/begin MEASUREMENT fFQBLRN "The former condition formation which learns an off-line idle" UBYTE COMP_0283 1 100 0 1 BIT_MASK 0x0002 ECU_ADDRESS 0xFFFF2480 /begin FUNCTION_LIST KF7-351.1[16] /end FUNCTION_LIST /end MEASUREMENT
/begin MEASUREMENT fFQCAL "An off-line idle learning permission condition" UBYTE COMP_0283 1 100 0 1 BIT_MASK 0x0001 ECU_ADDRESS 0xFFFF2480 /begin FUNCTION_LIST KF7-351.1[16] KF7-580.1[8] /end FUNCTION_LIST /end MEASUREMENT
/begin MEASUREMENT fFQTASRF "During off-line idle air quantity learning, oil pressure radiator fan, at least, speed fixed requirement flag" UBYTE COMP_0283 1 100 0 1 BIT_MASK 0x0040 ECU_ADDRESS 0xFFFF2481 /begin FUNCTION_LIST KF7-351.1[16] /end FUNCTION_LIST /end MEASUREMENT
/begin MEASUREMENT fFTSPH "ÉgÉãÉNÉXÉeÉA/power hop control condition formation flag" UBYTE COMP_0283 1 100 0 1 BIT_MASK 0x0008 ECU_ADDRESS 0xFFFF2484 /begin FUNCTION_LIST KF7-360.9M[43] /end FUNCTION_LIST /end MEASUREMENT
/begin MEASUREMENT fGO2EXPC "fCRIBGO2 experience" UBYTE COMP_0283 1 100 0 1 BIT_MASK 0x0020 ECU_ADDRESS 0xFFFF2486 /begin FUNCTION_LIST KF7-371.1E[15] /end FUNCTION_LIST /end MEASUREMENT
/begin MEASUREMENT fLCSTVB "A hysteresis flag for the ISCLRC operation" UBYTE COMP_0283 1 100 0 1 BIT_MASK 0x0004 ECU_ADDRESS 0xFFFF248C /begin FUNCTION_LIST KF7-351.1[16] KF7-351.2[17] /end FUNCTION_LIST /end MEASUREMENT
/begin MEASUREMENT fLMDCLSAD "LMDCLS for the ADALP operation" UBYTE COMP_0283 1 100 0 1 BIT_MASK 0x0002 ECU_ADDRESS 0xFFFF248C /begin FUNCTION_LIST KF7-371.1E[15] /end FUNCTION_LIST /end MEASUREMENT
/begin MEASUREMENT fLMDCLSPK "Purge stop ÉGÉAÉÄÉRÉì condition" UBYTE COMP_0283 1 100 0 1 BIT_MASK 0x0001 ECU_ADDRESS 0xFFFF248C /begin FUNCTION_LIST KF7-371.1E[15] /end FUNCTION_LIST /end MEASUREMENT
/begin MEASUREMENT fLUCKBL "(CK) After the dealing with the belt slide is controlled, for the accelerator open-degree operation" UBYTE COMP_0283 1 100 0 1 BIT_MASK 0x0040 ECU_ADDRESS 0xFFFF248E /begin FUNCTION_LIST KF7-360.9M[43] /end FUNCTION_LIST /end MEASUREMENT
/begin MEASUREMENT fPIGTH "Pre-ignition avoidance control condition flag" UBYTE COMP_0283 1 100 0 1 BIT_MASK 0x0001 ECU_ADDRESS 0xFFFF2495 /begin FUNCTION_LIST KF7-360.9M[43] /end FUNCTION_LIST /end MEASUREMENT
/begin MEASUREMENT fPKDCL "At the time of the slowdown, purge cut condition formation flag" UBYTE COMP_0283 1 100 0 1 BIT_MASK 0x0040 ECU_ADDRESS 0xFFFF2496 /begin FUNCTION_LIST KF7-371.1E[15] /end FUNCTION_LIST /end MEASUREMENT
/begin MEASUREMENT fPKHTOFID "Heat resisting purge off idle rush purge cut condition formation flag" UBYTE COMP_0283 1 100 0 1 BIT_MASK 0x0020 ECU_ADDRESS 0xFFFF2496 /begin FUNCTION_LIST KF7-371.1E[15] /end FUNCTION_LIST /end MEASUREMENT
/begin MEASUREMENT fPSSTDY "P/S Off    on rest delay flag" UBYTE COMP_0283 1 100 0 1 BIT_MASK 0x0001 ECU_ADDRESS 0xFFFF2496 /begin FUNCTION_LIST KF7-376.2[21] /end FUNCTION_LIST /end MEASUREMENT
/begin MEASUREMENT fRLHTW "A high coolant temperature judgement coolant temperature hysteresis flag" UBYTE COMP_0283 1 100 0 1 BIT_MASK 0x0010 ECU_ADDRESS 0xFFFF249A /begin FUNCTION_LIST KF7-360.12[6] /end FUNCTION_LIST /end MEASUREMENT
/begin MEASUREMENT fRQ_ENBR "Engine-brake compensation requirement signal" UBYTE COMP_0283 1 100 0 1 BIT_MASK 0x0080 ECU_ADDRESS 0xFFFF249B /begin FUNCTION_LIST KF7-340.16[4] /end FUNCTION_LIST /end MEASUREMENT
/begin MEASUREMENT fSNOWMODE "SNOW MODE   Control condition judgement flag" UBYTE COMP_0283 1 100 0 1 BIT_MASK 0x0008 ECU_ADDRESS 0xFFFF249B /begin FUNCTION_LIST KF7-360.7M[9] KF7-360.7P[8] /end FUNCTION_LIST /end MEASUREMENT
/begin MEASUREMENT fSTCTRL "At the time of starting, control performance improvement control start flag" UBYTE COMP_0283 1 100 0 1 BIT_MASK 0x0040 ECU_ADDRESS 0xFFFF249C /begin FUNCTION_LIST KF7-360.7M[9] KF7-360.7P[8] /end FUNCTION_LIST /end MEASUREMENT
/begin MEASUREMENT fTAPIG "Pre-ignition avoidance control lower limit intake air temperature" UBYTE COMP_0283 1 100 0 1 BIT_MASK 0x0004 ECU_ADDRESS 0xFFFF249D /begin FUNCTION_LIST KF7-360.9M[43] /end FUNCTION_LIST /end MEASUREMENT
/begin MEASUREMENT fTMKT1 "TMKTAP setup judgement" UBYTE COMP_0283 1 100 0 1 BIT_MASK 0x0040 ECU_ADDRESS 0xFFFF249F /begin FUNCTION_LIST KF7-360.9M[43] /end FUNCTION_LIST /end MEASUREMENT
/begin MEASUREMENT fTMKT2 "TMKTLT setup judgement" UBYTE COMP_0283 1 100 0 1 BIT_MASK 0x0020 ECU_ADDRESS 0xFFFF249F /begin FUNCTION_LIST KF7-360.9M[43] /end FUNCTION_LIST /end MEASUREMENT
/begin MEASUREMENT fTTERL0L "TTERL0<=TTERL0L# Åy TTERL0 Åz experience flag" UBYTE COMP_0283 1 100 0 1 BIT_MASK 0x0080 ECU_ADDRESS 0xFFFF24A1 /begin FUNCTION_LIST KF7-360.12[6] /end FUNCTION_LIST /end MEASUREMENT
/begin MEASUREMENT fTWISLH "A hysteresis for the ISCLRC operation" UBYTE COMP_0283 1 100 0 1 BIT_MASK 0x0004 ECU_ADDRESS 0xFFFF24A1 /begin FUNCTION_LIST KF7-351.1[16] KF7-351.2[17] KF7-377.1A[19] /end FUNCTION_LIST /end MEASUREMENT
/begin MEASUREMENT fTWISLL "A hysteresis for the ISCLRC operation" UBYTE COMP_0283 1 100 0 1 BIT_MASK 0x0002 ECU_ADDRESS 0xFFFF24A1 /begin FUNCTION_LIST KF7-351.1[16] KF7-351.2[17] /end FUNCTION_LIST /end MEASUREMENT
/begin MEASUREMENT fIPDDI1 "MOTOR-DI1" UBYTE COMP_0283 1 100 0 1 BIT_MASK 0x0010 ECU_ADDRESS 0xFFFF24AF /begin FUNCTION_LIST KF7-360.1[12] /end FUNCTION_LIST /end MEASUREMENT
/begin MEASUREMENT fIPDSF "MOTOR- SF" UBYTE COMP_0283 1 100 0 1 BIT_MASK 0x0008 ECU_ADDRESS 0xFFFF24AF /begin FUNCTION_LIST KF7-360.1[12] KF7-505.32[6] /end FUNCTION_LIST /end MEASUREMENT
/begin MEASUREMENT fACCAPO "Air-conditioning cut acceleration tense VAPO flag" UBYTE COMP_0283 1 100 0 1 BIT_MASK 0x0020 ECU_ADDRESS 0xFFFF24B5 /begin FUNCTION_LIST KF7-376.2[21] R301.6.IscAirflow_1_4_5 /end FUNCTION_LIST /end MEASUREMENT
/begin MEASUREMENT fACSW0 "Air-conditioning SW (MDI)" UBYTE COMP_0283 1 100 0 1 BIT_MASK 0x0010 ECU_ADDRESS 0xFFFF24B5 /begin FUNCTION_LIST KF7-376.3[2] /end FUNCTION_LIST /end MEASUREMENT
/begin MEASUREMENT fFLOESTJ "At the time of the extreme low temperature, engine initial judgement signal flag" UBYTE COMP_0283 1 100 0 1 BIT_MASK 0x0080 ECU_ADDRESS 0xFFFF24B8 /begin FUNCTION_LIST KF7-360.9M[43] /end FUNCTION_LIST /end MEASUREMENT
/begin MEASUREMENT fSHAPMODE "A sharp mode control condition judgement flag" UBYTE COMP_0283 1 100 0 1 BIT_MASK 0x0040 ECU_ADDRESS 0xFFFF24BD /begin FUNCTION_LIST KF7-360.7M[9] KF7-360.7P[8] /end FUNCTION_LIST /end MEASUREMENT
/begin MEASUREMENT afACOUT "Air-conditioning relay control output flag" UBYTE COMP_0283 1 100 0 1 BIT_MASK 0x0040 ECU_ADDRESS 0xFFFF24C6 /begin FUNCTION_LIST KF7-376.1[6] KF7-386.3[8] /end FUNCTION_LIST /end MEASUREMENT
/begin MEASUREMENT fACOUT "Air-conditioning relay control output flag" UBYTE COMP_0283 1 100 0 1 BIT_MASK 0x0040 ECU_ADDRESS 0xFFFF24C7 /begin FUNCTION_LIST KF7-376.1[6] KF7-386.3[8] R301.6.IscAirflow_1_4_5 /end FUNCTION_LIST /end MEASUREMENT
/begin MEASUREMENT afRLYON "Motor relay control flag" UBYTE COMP_0283 1 100 0 1 BIT_MASK 0x0004 ECU_ADDRESS 0xFFFF24D1 /begin FUNCTION_LIST KF7-360.2[N] KF7-505.31[5] KF7-505.34[3] KF7-525.2[6] /end FUNCTION_LIST /end MEASUREMENT
/begin MEASUREMENT fRLYON "Motor relay control flag" UBYTE COMP_0283 1 100 0 1 BIT_MASK 0x0004 ECU_ADDRESS 0xFFFF24D8 /begin FUNCTION_LIST KF7-360.2[N] KF7-505.31[5] KF7-505.34[3] KF7-525.2[6] /end FUNCTION_LIST /end MEASUREMENT
/begin MEASUREMENT tTMACC "Air-conditioning cut delay timer" UBYTE COMP_0201_S 1 100 0 255 ECU_ADDRESS 0xFFFF440E /begin FUNCTION_LIST KF7-376.2[21] /end FUNCTION_LIST /end MEASUREMENT
/begin MEASUREMENT tCHECKTM "Self-diagnosis indication mode switching operation timer" UBYTE COMP_0202_S 1 100 0 255 ECU_ADDRESS 0xFFFF445B /begin FUNCTION_LIST KF7-351.1[16] KF7-351.3[11] KF7-500.1[54] /end FUNCTION_LIST /end MEASUREMENT
/begin MEASUREMENT tDQLEN "A high-speed air learning condition formation delay timer" UBYTE COMP_0202_S 1 100 0 255 ECU_ADDRESS 0xFFFF4464 /begin FUNCTION_LIST KF7-351.3[11] /end FUNCTION_LIST /end MEASUREMENT
/begin MEASUREMENT tTMACON "At the time of the start, A/C on time" UBYTE COMP_0203_S 1 100 0 255 ECU_ADDRESS 0xFFFF4630 /begin FUNCTION_LIST KF7-376.1[6] /end FUNCTION_LIST /end MEASUREMENT
/begin MEASUREMENT tTMRND "At the time of the ND select, a timer for the accelerator judgement" UBYTE COMP_0203_S 1 100 0 255 ECU_ADDRESS 0xFFFF465D /begin FUNCTION_LIST KF7-360.9M[43] /end FUNCTION_LIST /end MEASUREMENT
/begin MEASUREMENT tTPSFSDL2 "TPS At the time of the single trouble, failsafe delay (for the TTAAPO operation)" UWORD COMP_0203_S 1 100 0 65535 ECU_ADDRESS 0xFFFF4726 /begin FUNCTION_LIST KF7-350.1M[5] /end FUNCTION_LIST /end MEASUREMENT
/begin MEASUREMENT tTPSFSDL3 "TPS/APS At the time of the single trouble, condition failure delay timer" UWORD COMP_0203_S 1 100 0 65535 ECU_ADDRESS 0xFFFF472A /begin FUNCTION_LIST KF7-350.4M[14] /end FUNCTION_LIST /end MEASUREMENT
/begin MEASUREMENT tCKSTTM "After the start, a timer for the time judgement" UBYTE COMP_0201_S 1 100 0 255 ECU_ADDRESS 0xFFFF24DE /begin FUNCTION_LIST KF7-360.9M[43] /end FUNCTION_LIST /end MEASUREMENT
/begin MEASUREMENT tCUTMSK "At the time of the re-acceleration, a timer for the A/C cut prohibition time judgement" UBYTE COMP_0201_S 1 100 0 255 ECU_ADDRESS 0xFFFF24E1 /begin FUNCTION_LIST KF7-376.2[21] /end FUNCTION_LIST /end MEASUREMENT
/begin MEASUREMENT tTMACLT "TVO air-conditioning cut timer" UBYTE COMP_0201_S 1 100 0 255 ECU_ADDRESS 0xFFFF2508 /begin FUNCTION_LIST KF7-376.2[21] /end FUNCTION_LIST /end MEASUREMENT
/begin MEASUREMENT tACOFDY "At the time of air-conditioning off, delay timer" UBYTE COMP_0202_S 1 100 0 255 ECU_ADDRESS 0xFFFF251E /begin FUNCTION_LIST KF7-376.3[2] /end FUNCTION_LIST /end MEASUREMENT
/begin MEASUREMENT tACREDY "Air-conditioning recover delay timer" UBYTE COMP_0202_S 1 100 0 255 ECU_ADDRESS 0xFFFF2520 /begin FUNCTION_LIST KF7-376.2[21] /end FUNCTION_LIST /end MEASUREMENT
/begin MEASUREMENT tACSTDY "AC After OFFON, delay timer" UBYTE COMP_0202_S 1 100 0 255 ECU_ADDRESS 0xFFFF2521 /begin FUNCTION_LIST KF7-376.2[21] /end FUNCTION_LIST /end MEASUREMENT
/begin MEASUREMENT tACUTLUTM "Air-conditioning relay off timer" UBYTE COMP_0202_S 1 100 0 255 ECU_ADDRESS 0xFFFF2523 /begin FUNCTION_LIST KF7-376.2[21] /end FUNCTION_LIST /end MEASUREMENT
/begin MEASUREMENT tBRK2TM "At the time of the cold slowdown, A/C cut timer" UBYTE COMP_0202_S 1 100 0 255 ECU_ADDRESS 0xFFFF252B /begin FUNCTION_LIST KF7-376.2[21] /end FUNCTION_LIST /end MEASUREMENT
/begin MEASUREMENT tBRKTM "At the time of the cold slowdown, A/C cut ISCFB timer" UBYTE COMP_0202_S 1 100 0 255 ECU_ADDRESS 0xFFFF252C /begin FUNCTION_LIST KF7-376.2[21] /end FUNCTION_LIST /end MEASUREMENT
/begin MEASUREMENT tCKTDTM "A timer for the torque limiter completion time judgement" UBYTE COMP_0202_S 1 100 0 255 ECU_ADDRESS 0xFFFF252E /begin FUNCTION_LIST KF7-360.9M[43] /end FUNCTION_LIST /end MEASUREMENT
/begin MEASUREMENT tISCLRD "ISC learning operation start judgement timer" UBYTE COMP_0202_S 1 100 0 255 ECU_ADDRESS 0xFFFF255C /begin FUNCTION_LIST KF7-351.1[16] KF7-351.2[17] /end FUNCTION_LIST /end MEASUREMENT
/begin MEASUREMENT tISCLRDQ "Learning operation start delay timer" UBYTE COMP_0202_S 1 100 0 255 ECU_ADDRESS 0xFFFF255D /begin FUNCTION_LIST KF7-351.1[16] /end FUNCTION_LIST /end MEASUREMENT
/begin MEASUREMENT tPDOKTIM "A/C load stable distinction time" UBYTE COMP_0202_S 1 100 0 255 ECU_ADDRESS 0xFFFF257A /begin FUNCTION_LIST KF7-351.2[17] /end FUNCTION_LIST /end MEASUREMENT
/begin MEASUREMENT tPSSTDY "Power steering OFFON rest delay timer" UBYTE COMP_0202_S 1 100 0 255 ECU_ADDRESS 0xFFFF2580 /begin FUNCTION_LIST KF7-376.2[21] /end FUNCTION_LIST /end MEASUREMENT
/begin MEASUREMENT tTAFSSW "STSW ONOFF Rear time timer" UBYTE COMP_0202_S 1 100 0 255 ECU_ADDRESS 0xFFFF258B /begin FUNCTION_LIST KF7-351.1[16] KF7-351.2[17] /end FUNCTION_LIST /end MEASUREMENT
/begin MEASUREMENT tTMACST "At the time of the start, ÉGÉAÉRÉìÉJÉbÉhÉBÉåÉCÉ^ÉCÉ}" UBYTE COMP_0202_S 1 100 0 255 ECU_ADDRESS 0xFFFF25A3 /begin FUNCTION_LIST KF7-376.2[21] /end FUNCTION_LIST /end MEASUREMENT
/begin MEASUREMENT tTMHNT "Air-conditioning CUT hunting judgement time timer" UBYTE COMP_0202_S 1 100 0 255 ECU_ADDRESS 0xFFFF25AC /begin FUNCTION_LIST KF7-376.2[21] /end FUNCTION_LIST /end MEASUREMENT
/begin MEASUREMENT tACUTLUDY "L/U release delay" UBYTE COMP_0203_S 1 100 0 255 ECU_ADDRESS 0xFFFF25C8 /begin FUNCTION_LIST KF7-376.2[21] /end FUNCTION_LIST /end MEASUREMENT
/begin MEASUREMENT tCONNDTM "A delay timer for the ND conclusion judgement" UBYTE COMP_0203_S 1 100 0 255 ECU_ADDRESS 0xFFFF25DC /begin FUNCTION_LIST KF7-360.9M[43] /end FUNCTION_LIST /end MEASUREMENT
/begin MEASUREMENT tDYCKLU "A timer for the L/U judgement delay" UBYTE COMP_0203_S 1 100 0 255 ECU_ADDRESS 0xFFFF25FD /begin FUNCTION_LIST KF7-360.8M[4] R301.8.Inverse_filter_1_1_3 /end FUNCTION_LIST /end MEASUREMENT
/begin MEASUREMENT tRLIGDLY "I-gain initial gain time" UBYTE COMP_0203_S 1 100 0 255 ECU_ADDRESS 0xFFFF2631 /begin FUNCTION_LIST KF7-360.12[6] /end FUNCTION_LIST /end MEASUREMENT
/begin MEASUREMENT tSTTMOK "At the time of the extreme low temperature, a timer for the engine initial judgement" UBYTE COMP_0203_S 1 100 0 255 ECU_ADDRESS 0xFFFF2642 /begin FUNCTION_LIST KF7-360.9M[43] /end FUNCTION_LIST /end MEASUREMENT
/begin MEASUREMENT tTCKBLT "Accelerator open-degree limiter continuation time" UBYTE COMP_0203_S 1 100 0 255 ECU_ADDRESS 0xFFFF2648 /begin FUNCTION_LIST KF7-360.9M[43] /end FUNCTION_LIST /end MEASUREMENT
/begin MEASUREMENT tTPSXCA "-" UBYTE COMP_0203_S 1 100 0 255 ECU_ADDRESS 0xFFFF2675
 /begin FUNCTION_LIST KF7-360.1[12] KF7-360.4[14] KF7-450.50[10] KF7-505.2[9] KF7-505.15[4] KF7-505.26[2] KF7-505.34[3] /end FUNCTION_LIST
/end MEASUREMENT
/begin MEASUREMENT avATAPOST "APOST for the ATCU transmission" UBYTE COMP_0378 1 100 0 100.000000065 ECU_ADDRESS 0xFFFF2300 /begin FUNCTION_LIST KF7-360.7M[9] /end FUNCTION_LIST /end MEASUREMENT
/begin MEASUREMENT avDUMADDFD "The target addition drive power (dummy)" UWORD COMP_0014_S 1 100 0 65535 ECU_ADDRESS 0xFFFF2322 /begin FUNCTION_LIST KF7-340.15[3] /end FUNCTION_LIST /end MEASUREMENT
/begin MEASUREMENT avEVPS "Basis DUTY value" UBYTE COMP_0047 1 100 0 127.5 ECU_ADDRESS 0xFFFF2324
 /begin FUNCTION_LIST KF7-371.1E[15] KF7-500.1[54] KF7-500.7[12] KF7-500.30[8] KF7-580.1[8] /end FUNCTION_LIST
/end MEASUREMENT
/begin MEASUREMENT avEVPSM "A purge DUTY for the model standard" UWORD COMP_0534_S 1 100 0 1638.375 ECU_ADDRESS 0xFFFF2326 /begin FUNCTION_LIST KF7-371.1E[15] /end FUNCTION_LIST /end MEASUREMENT
/begin MEASUREMENT avMFDTY "Radiator fan drive Duty order value" UBYTE COMP_0027 1 100 0 255 ECU_ADDRESS 0xFFFF233A /begin FUNCTION_LIST KF7-351.1[16] KF7-351.2[17] KF7-377.1A[19] KF7-580.1[8] /end FUNCTION_LIST /end MEASUREMENT
/begin MEASUREMENT avRLTENG2 "In the limiter, TENG2 for the up-shift" SWORD COMP_0228 1 100 -3276.8 3276.7 ECU_ADDRESS 0xFFFF2350 /begin FUNCTION_LIST KF7-360.12[6] /end FUNCTION_LIST /end MEASUREMENT
/begin MEASUREMENT avRLVAPO "In the limiter, VAPO for the up-shift" UWORD COMP_0005 1 100 0 7208.85 ECU_ADDRESS 0xFFFF4158 /begin FUNCTION_LIST KF7-360.12[6] /end FUNCTION_LIST /end MEASUREMENT
/begin MEASUREMENT avTENG2 "Engine torque basic value without DUETTE compensation" SWORD COMP_0228 1 100 -3276.8 3276.7 ECU_ADDRESS 0xFFFF2360 /begin FUNCTION_LIST KF7-360.12[6] KF7-385.2[18] KF7-386.2[4] KF7-410.10[6] /end FUNCTION_LIST /end MEASUREMENT
/begin MEASUREMENT avTTEPDIF "Inverse filter input PTD torque" SWORD COMP_0228 1 100 -3276.8 3276.7 ECU_ADDRESS 0xFFFF2398 /begin FUNCTION_LIST KF7-360.8M[4] KF7-360.9M[43] /end FUNCTION_LIST /end MEASUREMENT
/begin MEASUREMENT avTTETD "After the drive protection control, target torque" SWORD COMP_0228 1 100 -3276.8 3276.7 ECU_ADDRESS 0xFFFF239C /begin FUNCTION_LIST KF7-360.9M[43] /end FUNCTION_LIST /end MEASUREMENT
/begin MEASUREMENT bvFHOSB "Purge fuel compensation coefficient" UWORD COMP_0031 1 100 0 255.99609375 ECU_ADDRESS 0xFFFF40CE /begin FUNCTION_LIST KF7-371.1E[15] /end FUNCTION_LIST /end MEASUREMENT
/begin MEASUREMENT bvFHOSB_R#1 "Purge fuel compensation coefficient" UWORD COMP_0031 1 100 0 255.99609375 ECU_ADDRESS 0xFFFF40CE /begin FUNCTION_LIST KF7-371.1E[15] /end FUNCTION_LIST /end MEASUREMENT
/begin MEASUREMENT bvFHOSB_R#2 "Purge fuel compensation coefficient" UWORD COMP_0031 1 100 0 255.99609375 ECU_ADDRESS 0xFFFF40D0 /begin FUNCTION_LIST KF7-371.1E[15] /end FUNCTION_LIST /end MEASUREMENT
/begin MEASUREMENT bvFHOSBI "The former purge fuel compensation coefficient which compensates delay" UWORD COMP_0031 1 100 0 255.99609375 ECU_ADDRESS 0xFFFF40D2 /begin FUNCTION_LIST KF7-371.1E[15] /end FUNCTION_LIST /end MEASUREMENT
/begin MEASUREMENT bvFHOSBI_R#1 "The former purge fuel compensation coefficient which compensates delay" UWORD COMP_0031 1 100 0 255.99609375 ECU_ADDRESS 0xFFFF40D2 /begin FUNCTION_LIST KF7-371.1E[15] /end FUNCTION_LIST /end MEASUREMENT
/begin MEASUREMENT bvFHOSBI_R#2 "The former purge fuel compensation coefficient which compensates delay" UWORD COMP_0031 1 100 0 255.99609375 ECU_ADDRESS 0xFFFF40D4 /begin FUNCTION_LIST KF7-371.1E[15] /end FUNCTION_LIST /end MEASUREMENT
/begin MEASUREMENT bvFHOSI "The former purge fuel compensation coefficient which compensates delay" UWORD COMP_0031 1 100 0 255.99609375 ECU_ADDRESS 0xFFFF40D6 /begin FUNCTION_LIST KF7-371.1E[15] /end FUNCTION_LIST /end MEASUREMENT
/begin MEASUREMENT vAACTVO_S "ISC, very, throttle open-degree" UWORD COMP_0005 1 100 0 7208.85 ECU_ADDRESS 0xFFFF34E2 /begin FUNCTION_LIST KF7-350.4P[13] /end FUNCTION_LIST /end MEASUREMENT
/begin MEASUREMENT vACRECN "A/C At the time of on, recover speed" UBYTE COMP_0000 1 100 0 6375 ECU_ADDRESS 0xFFFF10ED /begin FUNCTION_LIST KF7-376.2[21] KF7-385.1[32] /end FUNCTION_LIST /end MEASUREMENT
/begin MEASUREMENT vADALP "ALPHA for the additional charge judgement" UWORD COMP_0242 1 100 0 256.24185 ECU_ADDRESS 0xFFFF10F0 /begin FUNCTION_LIST KF7-371.1E[15] /end FUNCTION_LIST /end MEASUREMENT
/begin MEASUREMENT vADDFDBF "Low vehicle speed j éû addition drive power limiter value" UWORD COMP_0014_S 1 100 0 65535 ECU_ADDRESS 0xFFFF10F6 /begin FUNCTION_LIST KF7-340.15[3] /end FUNCTION_LIST /end MEASUREMENT
/begin MEASUREMENT vADDQFBI "QFBI integration value" SLONG COMP_0277 1 100 -2147483648 2147483647 ECU_ADDRESS 0xFFFF10F8 /begin FUNCTION_LIST KF7-351.1[16] /end FUNCTION_LIST /end MEASUREMENT
/begin MEASUREMENT vAFSAFDT "The target A/F deviation big side AFSAF" UBYTE COMP_0092_S 1 100 0 5.1 ECU_ADDRESS 0xFFFF27C8 /begin FUNCTION_LIST KF7-371.1E[15] /end FUNCTION_LIST /end MEASUREMENT
/begin MEASUREMENT vAFSAFJG "AFSAF for the A/F stillness fixed judgement" UWORD COMP_0453 1 100 0 131.07 ECU_ADDRESS 0xFFFF27CA /begin FUNCTION_LIST KF7-371.1E[15] /end FUNCTION_LIST /end MEASUREMENT
/begin MEASUREMENT vAISCTTC "ISC opening area (for the TTC operation)" UWORD COMP_0042 1 100 0 52.428 ECU_ADDRESS 0xFFFF2804 /begin FUNCTION_LIST KF7-350.1M[5] /end FUNCTION_LIST /end MEASUREMENT
/begin MEASUREMENT vALPHAAD "ALPHA for the ADALP operation" UWORD COMP_0031 1 100 0 255.99609375 ECU_ADDRESS 0xFFFF1140 /begin FUNCTION_LIST KF7-371.1E[15] /end FUNCTION_LIST /end MEASUREMENT
/begin MEASUREMENT vALPHAAV "ALPHA bank mean" UWORD COMP_0031 1 100 0 255.99609375 ECU_ADDRESS 0xFFFF1142 /begin FUNCTION_LIST KF7-371.1E[15] /end FUNCTION_LIST /end MEASUREMENT
/begin MEASUREMENT vALPHADT "100% deviation big sides ALPHA" UBYTE COMP_0419 1 100 0 25.5 ECU_ADDRESS 0xFFFF1144 /begin FUNCTION_LIST KF7-371.1E[15] /end FUNCTION_LIST /end MEASUREMENT
/begin MEASUREMENT vALPHAMN "The small side ALPHA" UWORD COMP_0031 1 100 0 255.99609375 ECU_ADDRESS 0xFFFF1146 /begin FUNCTION_LIST KF7-371.1E[15] /end FUNCTION_LIST /end MEASUREMENT
/begin MEASUREMENT vAPOST0 "The former open-degree which compensates a POWER mode" UWORD COMP_0005 1 100 0 7208.85 ECU_ADDRESS 0xFFFF1178 /begin FUNCTION_LIST KF7-360.7M[9] /end FUNCTION_LIST /end MEASUREMENT
/begin MEASUREMENT vAPOST0_S "The former open-degree which compensates a POWER mode" UWORD COMP_0005 1 100 0 7208.85 ECU_ADDRESS 0xFFFF1C38 /begin FUNCTION_LIST KF7-360.7P[8] /end FUNCTION_LIST /end MEASUREMENT
/begin MEASUREMENT vAPOSTFS "After it deals with APOFS shaft conversion, accelerator open-degree" UWORD COMP_0005 1 100 0 7208.85 ECU_ADDRESS 0xFFFF117A /begin FUNCTION_LIST KF7-360.7M[9] /end FUNCTION_LIST /end MEASUREMENT
/begin MEASUREMENT vATAPOST "APOST for the ATCU transmission" UBYTE COMP_0378 1 100 0 100.000000065 ECU_ADDRESS 0xFFFF23AE /begin FUNCTION_LIST KF7-360.7M[9] /end FUNCTION_LIST /end MEASUREMENT
/begin MEASUREMENT vBASEALP "Former ADALP that a purge is cut" UWORD COMP_0556_S 1 100 0 5119.921875 ECU_ADDRESS 0xFFFF11A4 /begin FUNCTION_LIST KF7-371.1E[15] /end FUNCTION_LIST /end MEASUREMENT
/begin MEASUREMENT vBASEPRS "In front of the drain-cut, line pressure" UWORD COMP_0557_S 1 100 0 5119.921875 ECU_ADDRESS 0xFFFF11A6 /begin FUNCTION_LIST KF7-371.1E[15] /end FUNCTION_LIST /end MEASUREMENT
/begin MEASUREMENT vBASETVO "Base throttle open-degree" UWORD COMP_0005 1 100 0 7208.85 ECU_ADDRESS 0xFFFF11A8 /begin FUNCTION_LIST KF7-360.7M[9] /end FUNCTION_LIST /end MEASUREMENT
/begin MEASUREMENT vBASTFS "Base throttle open-degree (APOFS shaft conversion)" UWORD COMP_0005 1 100 0 7208.85 ECU_ADDRESS 0xFFFF11B8 /begin FUNCTION_LIST KF7-360.7M[9] /end FUNCTION_LIST /end MEASUREMENT
/begin MEASUREMENT vBASTVN "Base throttle open-degree (non-SHAP)" UWORD COMP_0039 1 100 0 7208.85 ECU_ADDRESS 0xFFFF1E5E /begin FUNCTION_LIST KF7-360.7M[9] /end FUNCTION_LIST /end MEASUREMENT
/begin MEASUREMENT vBASTVN_S "Base throttle open-degree (non-SHAP)" UWORD COMP_0005 1 100 0 7208.85 ECU_ADDRESS 0xFFFF1C3C /begin FUNCTION_LIST KF7-360.7P[8] /end FUNCTION_LIST /end MEASUREMENT
/begin MEASUREMENT vBASTVS "Base throttle open-degree (SHAP)" UWORD COMP_0039 1 100 0 7208.85 ECU_ADDRESS 0xFFFF1E60 /begin FUNCTION_LIST KF7-360.7M[9] /end FUNCTION_LIST /end MEASUREMENT
/begin MEASUREMENT vBASTVS_S "Base throttle open-degree (SHAP)" UWORD COMP_0005 1 100 0 7208.85 ECU_ADDRESS 0xFFFF1C3E /begin FUNCTION_LIST KF7-360.7P[8] /end FUNCTION_LIST /end MEASUREMENT
/begin MEASUREMENT vBATVO_S "Base throttle open-degree" UWORD COMP_0005 1 100 0 7208.85 ECU_ADDRESS 0xFFFF1C40 /begin FUNCTION_LIST KF7-360.7P[8] /end FUNCTION_LIST /end MEASUREMENT
/begin MEASUREMENT vBPS8M "At the time of the active diagnosis, EVPS" UBYTE COMP_0047 1 100 0 127.5 ECU_ADDRESS 0xFFFF11C7 /begin FUNCTION_LIST KF7-371.1E[15] /end FUNCTION_LIST /end MEASUREMENT
/begin MEASUREMENT vCANITMP "Canister average temperature" UWORD COMP_0559_S 1 100 0 65535 ECU_ADDRESS 0xFFFF2946 /begin FUNCTION_LIST KF7-371.1E[15] /end FUNCTION_LIST /end MEASUREMENT
/begin MEASUREMENT vCAW "The amount of desorption quantity equivalent for the canister model calibration" UBYTE COMP_0560_S 1 100 0 0.06222 ECU_ADDRESS 0xFFFF2957 /begin FUNCTION_LIST KF7-371.1E[15] /end FUNCTION_LIST /end MEASUREMENT
/begin MEASUREMENT vCRICUT "Active calibration purge cut limitation value" UWORD COMP_0566_S 1 100 0 63.999056205 ECU_ADDRESS 0xFFFF1204 /begin FUNCTION_LIST KF7-371.1E[15] /end FUNCTION_LIST /end MEASUREMENT
/begin MEASUREMENT vCTVQL "A high-speed air learning counter" UWORD COMP_0004 1 100 0 65535 ECU_ADDRESS 0xFFFF29E0 /begin FUNCTION_LIST KF7-351.3[11] /end FUNCTION_LIST /end MEASUREMENT
/begin MEASUREMENT vCTVQLS "Low speed air learning (usually, mode) counter" UBYTE COMP_0004 1 100 0 255 ECU_ADDRESS 0xFFFF29E2 /begin FUNCTION_LIST KF7-351.3[11] /end FUNCTION_LIST /end MEASUREMENT
/begin MEASUREMENT vCTVQLSR "Low speed air learning (rapid mode) counter" UWORD COMP_0004 1 100 0 65535 ECU_ADDRESS 0xFFFF29E4 /begin FUNCTION_LIST KF7-351.3[11] /end FUNCTION_LIST /end MEASUREMENT
/begin MEASUREMENT vCVTRNG "Range signal" UBYTE COMP_0068 1 100 0 255 ECU_ADDRESS 0xFFFF491A /begin FUNCTION_LIST KF7-360.9M[43] /end FUNCTION_LIST /end MEASUREMENT
/begin MEASUREMENT vDALPLIM "Maximum purge rate air-fuel ratio error limitation value" UWORD COMP_0568_S 1 100 0 64.001481 ECU_ADDRESS 0xFFFF2A12 /begin FUNCTION_LIST KF7-371.1E[15] /end FUNCTION_LIST /end MEASUREMENT
/begin MEASUREMENT vDEMDFLW "The amount of requirement purge treatment" UWORD COMP_0156 1 100 0 65535 ECU_ADDRESS 0xFFFF1260 /begin FUNCTION_LIST KF7-371.1E[15] /end FUNCTION_LIST /end MEASUREMENT
/begin MEASUREMENT vDHCGPS "Canister desorption speed" UBYTE COMP_0571_S 1 100 0 0.99603 ECU_ADDRESS 0xFFFF2A44 /begin FUNCTION_LIST KF7-371.1E[15] /end FUNCTION_LIST /end MEASUREMENT
/begin MEASUREMENT vDRIVETD "A torque going down signal for the drive protection" UBYTE COMP_0068 1 100 0 255 ECU_ADDRESS 0xFFFF1E7C /begin FUNCTION_LIST KF7-360.9M[43] /end FUNCTION_LIST /end MEASUREMENT
/begin MEASUREMENT vDTE1_2 "A convergent judgement deviation" UWORD COMP_0402 1 100 0 0.999998565 ECU_ADDRESS 0xFFFF129C /begin FUNCTION_LIST KF7-360.8M[4] R301.8.Inverse_filter_1_1_3 /end FUNCTION_LIST /end MEASUREMENT
/begin MEASUREMENT vDTEALP "At the time of the air-fuel ratio deviation calibration, reflection value" UWORD COMP_0028 1 100 0 2.5599609375 ECU_ADDRESS 0xFFFF129E /begin FUNCTION_LIST KF7-371.1E[15] /end FUNCTION_LIST /end MEASUREMENT
/begin MEASUREMENT vDUMADDFD "The target addition drive power (dummy)" UWORD COMP_0014_S 1 100 0 65535 ECU_ADDRESS 0xFFFF23D0 /begin FUNCTION_LIST KF7-340.15[3] /end FUNCTION_LIST /end MEASUREMENT
/begin MEASUREMENT vDUMZADFD "The target addition drive power (dummy)" SWORD COMP_0030_S 1 100 -32768 32767 ECU_ADDRESS 0xFFFF3C14 /begin FUNCTION_LIST KF7-340.16[4] /end FUNCTION_LIST /end MEASUREMENT
/begin MEASUREMENT vENGFD "The engine occurrence drive power" SWORD COMP_0030_S 1 100 -32768 32767 ECU_ADDRESS 0xFFFF12D4 /begin FUNCTION_LIST KF7-340.15[3] /end FUNCTION_LIST /end MEASUREMENT
/begin MEASUREMENT vETQETS "Electric 4WD drive protection target engine torque (CAN)" UBYTE COMP_0518 1 100 0 510 ECU_ADDRESS 0xFFFF4932 /begin FUNCTION_LIST KF7-360.9M[43] /end FUNCTION_LIST /end MEASUREMENT
/begin MEASUREMENT vETQETSC "Electric 4WD drive protection target engine torque" SWORD COMP_0228 1 100 -3276.8 3276.7 ECU_ADDRESS 0xFFFF4934 /begin FUNCTION_LIST KF7-360.9M[43] KF7-410.21[3] /end FUNCTION_LIST /end MEASUREMENT
/begin MEASUREMENT vETSMSG2T "ETSMSG2T reception interval counter" UBYTE COMP_0014 1 100 0 2550 ECU_ADDRESS 0xFFFF4938 /begin FUNCTION_LIST KF7-360.9M[43] /end FUNCTION_LIST /end MEASUREMENT
/begin MEASUREMENT vEVCNTIN "When a requirement is calculated, the amount of accumulation purge" UWORD COMP_0156 1 100 0 65535 ECU_ADDRESS 0xFFFF133C /begin FUNCTION_LIST KF7-371.1E[15] /end FUNCTION_LIST /end MEASUREMENT
/begin MEASUREMENT vEVOFST "Purge valve invalid pulse width" SWORD COMP_0416 1 100 -262144 262136 ECU_ADDRESS 0xFFFF1FC4 /begin FUNCTION_LIST KF7-371.1E[15] /end FUNCTION_LIST /end MEASUREMENT
/begin MEASUREMENT vEVPCNT "The amount of accumulation purge" ULONG COMP_0160 1 100 0 131072.093921892 ECU_ADDRESS 0xFFFFA3A0 /begin FUNCTION_LIST KF7-371.1E[15] KF7-580.1[8] /end FUNCTION_LIST /end MEASUREMENT
/begin MEASUREMENT vEVPS "Basis DUTY value" UBYTE COMP_0047 1 100 0 127.5 ECU_ADDRESS 0xFFFF23D2
 /begin FUNCTION_LIST KF7-371.1E[15] KF7-500.1[54] KF7-500.7[12] KF7-500.30[8] KF7-580.1[8] R901.1.Diag_on_can_app_1_6_2 /end FUNCTION_LIST
/end MEASUREMENT
/begin MEASUREMENT vEVPSM "A purge DUTY for the model standard" UWORD COMP_0534_S 1 100 0 1638.375 ECU_ADDRESS 0xFFFF23D4 /begin FUNCTION_LIST KF7-371.1E[15] /end FUNCTION_LIST /end MEASUREMENT
/begin MEASUREMENT vEVPSMAX "vEVPS upper limit value" UBYTE COMP_0047 1 100 0 127.5 ECU_ADDRESS 0xFFFF8A3A /begin FUNCTION_LIST KF7-371.1E[15] /end FUNCTION_LIST /end MEASUREMENT
/begin MEASUREMENT vFACTVDGN "An active diagnosis requirement" UBYTE COMP_0068 1 100 0 255 ECU_ADDRESS 0xFFFF1358 /begin FUNCTION_LIST KF7-371.1E[15] /end FUNCTION_LIST /end MEASUREMENT
/begin MEASUREMENT vFDGNNG "Diagnosis NG condition variable" UBYTE COMP_0068 1 100 0 255 ECU_ADDRESS 0xFFFF1371 /begin FUNCTION_LIST KF7-371.1E[15] R301.14.CanisterPurge_1_0_3 /end FUNCTION_LIST /end MEASUREMENT
/begin MEASUREMENT vFHOSBAD "FHOSB for the ADALP operation" UWORD COMP_0031 1 100 0 255.99609375 ECU_ADDRESS 0xFFFF2D66 /begin FUNCTION_LIST KF7-371.1E[15] /end FUNCTION_LIST /end MEASUREMENT
/begin MEASUREMENT vFHOSBIKA "FHOSIK model origin value" UWORD COMP_0031 1 100 0 255.99609375 ECU_ADDRESS 0xFFFF137E /begin FUNCTION_LIST KF7-371.1E[15] /end FUNCTION_LIST /end MEASUREMENT
/begin MEASUREMENT vFHOSBIKA_R#1 "FHOSIK model origin value" UWORD COMP_0031 1 100 0 255.99609375 ECU_ADDRESS 0xFFFF137E /begin FUNCTION_LIST KF7-371.1E[15] /end FUNCTION_LIST /end MEASUREMENT
/begin MEASUREMENT vFHOSBIKA_R#2 "FHOSIK model origin value" UWORD COMP_0031 1 100 0 255.99609375 ECU_ADDRESS 0xFFFF1380 /begin FUNCTION_LIST KF7-371.1E[15] /end FUNCTION_LIST /end MEASUREMENT
/begin MEASUREMENT vFHOSBIKC "FHOSIK fixed value" UWORD COMP_0031 1 100 0 255.99609375 ECU_ADDRESS 0xFFFF1382 /begin FUNCTION_LIST KF7-371.1E[15] /end FUNCTION_LIST /end MEASUREMENT
/begin MEASUREMENT vFHOSBIKC_R#1 "FHOSIK fixed value" UWORD COMP_0031 1 100 0 255.99609375 ECU_ADDRESS 0xFFFF1382 /begin FUNCTION_LIST KF7-371.1E[15] /end FUNCTION_LIST /end MEASUREMENT
/begin MEASUREMENT vFHOSBIKC_R#2 "FHOSIK fixed value" UWORD COMP_0031 1 100 0 255.99609375 ECU_ADDRESS 0xFFFF1384 /begin FUNCTION_LIST KF7-371.1E[15] /end FUNCTION_LIST /end MEASUREMENT
/begin MEASUREMENT vFHOSIKA "FHOSIK model origin value" UWORD COMP_0242 1 100 0 256.24185 ECU_ADDRESS 0xFFFF1386 /begin FUNCTION_LIST KF7-371.1E[15] /end FUNCTION_LIST /end MEASUREMENT
/begin MEASUREMENT vFHOSIKC "FHOSIK fixed value" UWORD COMP_0242 1 100 0 256.24185 ECU_ADDRESS 0xFFFF1388 /begin FUNCTION_LIST KF7-371.1E[15] /end FUNCTION_LIST /end MEASUREMENT
/begin MEASUREMENT vG "At the time of the idle, the amount of relative value requirement retard control" SBYTE COMP_0018 1 100 -128 127 ECU_ADDRESS 0xFFFF1FD4
 /begin FUNCTION_LIST KF7-340.15[3] KF7-340.16[4] KF7-360.1[12] KF7-386.2[4] KF7-390.1A[3] KF7-393.1C[8] KF7-500.1[54] KF7-500.21[19] KF7-500.26[17] KF7-500.38A[4] /end FUNCTION_LIST
/end MEASUREMENT
/begin MEASUREMENT vGACC1 "Acceleration G (before the filter)" UWORD COMP_0079_S 1 100 -32.768 32.767 ECU_ADDRESS 0xFFFF13B6 /begin FUNCTION_LIST KF7-340.15[3] /end FUNCTION_LIST /end MEASUREMENT
/begin MEASUREMENT vGACC2 "Acceleration G (after the filter)" SWORD COMP_0080_S 1 100 -32.768 32.767 ECU_ADDRESS 0xFFFF13B8 /begin FUNCTION_LIST KF7-340.15[3] /end FUNCTION_LIST /end MEASUREMENT
/begin MEASUREMENT vGACCFL "After the filter, acceleration G" ULONG COMP_0596_S 1 100 -32.7680234881024 32.7680234728436 ECU_ADDRESS 0xFFFF13BC /begin FUNCTION_LIST KF7-340.15[3] /end FUNCTION_LIST /end MEASUREMENT
/begin MEASUREMENT vGD1 "Compensation vessel H/G filter 4" UWORD COMP_0004 1 100 0 65535 ECU_ADDRESS 0xFFFF3636 /begin FUNCTION_LIST KF7-360.1[12] /end FUNCTION_LIST /end MEASUREMENT
/begin MEASUREMENT vGFD "Acceleration resistance" SWORD COMP_0030_S 1 100 -32768 32767 ECU_ADDRESS 0xFFFF13C6 /begin FUNCTION_LIST KF7-340.15[3] /end FUNCTION_LIST /end MEASUREMENT
/begin MEASUREMENT vGKPRG "Purge rate limitation value for learning" UWORD COMP_0566_S 1 100 0 63.999056205 ECU_ADDRESS 0xFFFF13CC /begin FUNCTION_LIST KF7-371.1E[15] /end FUNCTION_LIST /end MEASUREMENT
/begin MEASUREMENT vGN0 "Compensation vessel H/G filter 3" UWORD COMP_0004 1 100 0 65535 ECU_ADDRESS 0xFFFF3638 /begin FUNCTION_LIST KF7-360.1[12] /end FUNCTION_LIST /end MEASUREMENT
/begin MEASUREMENT vGN1 "Compensation vessel H/G filter 2" UWORD COMP_0004 1 100 0 65535 ECU_ADDRESS 0xFFFF363A /begin FUNCTION_LIST KF7-360.1[12] /end FUNCTION_LIST /end MEASUREMENT
/begin MEASUREMENT vGN2 "Compensation vessel H/G filter 1" UWORD COMP_0004 1 100 0 65535 ECU_ADDRESS 0xFFFF363C /begin FUNCTION_LIST KF7-360.1[12] /end FUNCTION_LIST /end MEASUREMENT
/begin MEASUREMENT vHD1 "Compensation vessel H filter 3" UWORD COMP_0004 1 100 0 65535 ECU_ADDRESS 0xFFFF3644 /begin FUNCTION_LIST KF7-360.1[12] /end FUNCTION_LIST /end MEASUREMENT
/begin MEASUREMENT vHN0 "Compensation vessel H filter 2" UWORD COMP_0004 1 100 0 65535 ECU_ADDRESS 0xFFFF3646 /begin FUNCTION_LIST KF7-360.1[12] /end FUNCTION_LIST /end MEASUREMENT
/begin MEASUREMENT vHN1 "Compensation vessel H filter 1" UWORD COMP_0004 1 100 0 65535 ECU_ADDRESS 0xFFFF3648 /begin FUNCTION_LIST KF7-360.1[12] /end FUNCTION_LIST /end MEASUREMENT
/begin MEASUREMENT vHNTCNT "Hunting number of times" UBYTE COMP_0030 1 100 0 255 ECU_ADDRESS 0xFFFF1407 /begin FUNCTION_LIST KF7-376.2[21] /end FUNCTION_LIST /end MEASUREMENT
/begin MEASUREMENT vHRVSPFL "After the filter, a high precision vehicle speed" ULONG COMP_0599_S 1 100 0 6553.6046960946 ECU_ADDRESS 0xFFFF140C /begin FUNCTION_LIST KF7-340.15[3] /end FUNCTION_LIST /end MEASUREMENT
/begin MEASUREMENT vHTWLMT "A high coolant temperature limiter torque" SWORD COMP_0228 1 100 -3276.8 3276.7 ECU_ADDRESS 0xFFFF1414 /begin FUNCTION_LIST KF7-360.9M[43] KF7-360.9P[22] /end FUNCTION_LIST /end MEASUREMENT
/begin MEASUREMENT vICOM1 "The absolute value of the model matching compensation vessel 1/R output" ULONG COMP_0178_S 1 100 0 16385.300230425 ECU_ADDRESS 0xFFFF35D8 /begin FUNCTION_LIST KF7-360.1[12] /end FUNCTION_LIST /end MEASUREMENT
/begin MEASUREMENT vICOM1S "The sign of ICOM1" UBYTE COMP_0068 1 100 0 255 ECU_ADDRESS 0xFFFF35DC /begin FUNCTION_LIST KF7-360.1[12] /end FUNCTION_LIST /end MEASUREMENT
/begin MEASUREMENT vICOM2 "The absolute value of the electric current order value (after the limiter)" ULONG COMP_0600_S 1 100 0 32766.305493555 ECU_ADDRESS 0xFFFF474C /begin FUNCTION_LIST KF7-360.1[12] KF7-505.32[6] KF7-505.33[8] /end FUNCTION_LIST /end MEASUREMENT
/begin MEASUREMENT vICOM2S "The sign of ICOM2" UBYTE COMP_0068 1 100 0 255 ECU_ADDRESS 0xFFFF35DD /begin FUNCTION_LIST KF7-360.1[12] /end FUNCTION_LIST /end MEASUREMENT
/begin MEASUREMENT vID0 "Inverse filter constant 2" UWORD COMP_0004 1 100 0 65535 ECU_ADDRESS 0xFFFF1436 /begin FUNCTION_LIST KF7-360.8M[4] R301.8.Inverse_filter_1_1_3 /end FUNCTION_LIST /end MEASUREMENT
/begin MEASUREMENT vID1 "Inverse filter constant 1" UWORD COMP_0004 1 100 0 65535 ECU_ADDRESS 0xFFFF1438 /begin FUNCTION_LIST KF7-360.8M[4] R301.8.Inverse_filter_1_1_3 /end FUNCTION_LIST /end MEASUREMENT
/begin MEASUREMENT vIDLELIM "Maximum purge rate idle limitation value" UWORD COMP_0269 1 100 0 127.998046875 ECU_ADDRESS 0xFFFF2E48 /begin FUNCTION_LIST KF7-371.1E[15] /end FUNCTION_LIST /end MEASUREMENT
/begin MEASUREMENT vIDUTY "Motor drive DUTY ratio" UWORD COMP_0101_S 1 100 0 13107 ECU_ADDRESS 0xFFFF3674 /begin FUNCTION_LIST KF7-360.1[12] R901.1.Diag_on_can_app_1_6_2 /end FUNCTION_LIST /end MEASUREMENT
/begin MEASUREMENT vIFBK "The absolute value of robust compensator H/G output" ULONG COMP_0488_S 1 100 0 32766.305493555 ECU_ADDRESS 0xFFFF35E0 /begin FUNCTION_LIST KF7-360.1[12] /end FUNCTION_LIST /end MEASUREMENT
/begin MEASUREMENT vIFBKS "The sign of IFBK" UBYTE COMP_0068 1 100 0 255 ECU_ADDRESS 0xFFFF35E4 /begin FUNCTION_LIST KF7-360.1[12] /end FUNCTION_LIST /end MEASUREMENT
/begin MEASUREMENT vIMAX "Maximum electric current value" UWORD COMP_0104_S 1 100 0 31.999495335 ECU_ADDRESS 0xFFFF3696 /begin FUNCTION_LIST KF7-360.1[12] /end FUNCTION_LIST /end MEASUREMENT
/begin MEASUREMENT vIN0 "Inverse filter constant 5" UWORD COMP_0004 1 100 0 65535 ECU_ADDRESS 0xFFFF145E /begin FUNCTION_LIST KF7-360.8M[4] R301.8.Inverse_filter_1_1_3 /end FUNCTION_LIST /end MEASUREMENT
/begin MEASUREMENT vIN1 "Inverse filter constant 4" UWORD COMP_0004 1 100 0 65535 ECU_ADDRESS 0xFFFF1460 /begin FUNCTION_LIST KF7-360.8M[4] R301.8.Inverse_filter_1_1_3 /end FUNCTION_LIST /end MEASUREMENT
/begin MEASUREMENT vIN2 "Inverse filter constant 3" UWORD COMP_0004 1 100 0 65535 ECU_ADDRESS 0xFFFF1462 /begin FUNCTION_LIST KF7-360.8M[4] R301.8.Inverse_filter_1_1_3 /end FUNCTION_LIST /end MEASUREMENT
/begin MEASUREMENT vIREF "The absolute value of robust compensator Hi output" ULONG COMP_0177_S 1 100 0 16385.300230425 ECU_ADDRESS 0xFFFF35E8 /begin FUNCTION_LIST KF7-360.1[12] /end FUNCTION_LIST /end MEASUREMENT
/begin MEASUREMENT vIREFS "The sign of IREF" UBYTE COMP_0068 1 100 0 255 ECU_ADDRESS 0xFFFF35EC /begin FUNCTION_LIST KF7-360.1[12] /end FUNCTION_LIST /end MEASUREMENT
/begin MEASUREMENT vISCLRC01 "Idle speed learning operation value" SLONG COMP_0602_S 1 100 -32768.0234881024 32768.0234728436 ECU_ADDRESS 0xFFFFA4B0 /begin FUNCTION_LIST KF7-351.1[16] KF7-351.2[17] R901.1.Diag_on_can_app_1_6_2 /end FUNCTION_LIST /end MEASUREMENT
/begin MEASUREMENT vISCLRC11 "Idle speed learning value" SWORD COMP_0277 1 100 -32768 32767 ECU_ADDRESS 0xFFFF1484 /begin FUNCTION_LIST KF7-351.2[17] /end FUNCTION_LIST /end MEASUREMENT
/begin MEASUREMENT vISCLRCZ0 "Idle speed learning previous value" SWORD COMP_0277 1 100 -32768 32767 ECU_ADDRESS 0xFFFF1488 /begin FUNCTION_LIST KF7-351.1[16] /end FUNCTION_LIST /end MEASUREMENT
/begin MEASUREMENT vISCLRCZ01 "Idle speed learning previous value" SLONG COMP_0106_S 1 100 -8388608 8388607.99609375 ECU_ADDRESS 0xFFFF148C /begin FUNCTION_LIST KF7-351.1[16] /end FUNCTION_LIST /end MEASUREMENT
/begin MEASUREMENT vITAFS "Combustion efficiency compensation rate (1)" UBYTE COMP_0009 1 100 0 199.21875 ECU_ADDRESS 0xFFFF2E66 /begin FUNCTION_LIST KF7-350.4M[14] KF7-350.4P[13] /end FUNCTION_LIST /end MEASUREMENT
/begin MEASUREMENT vITAFS_S "Combustion efficiency compensation rate (1)" UBYTE COMP_0009 1 100 0 199.21875 ECU_ADDRESS 0xFFFF34F4 /begin FUNCTION_LIST KF7-350.4P[13] /end FUNCTION_LIST /end MEASUREMENT
/begin MEASUREMENT vKITAEGR "EGR At the time of ON/ off, combustion efficiency compensation value" UBYTE COMP_0009 1 100 0 199.21875 ECU_ADDRESS 0xFFFF14D3 /begin FUNCTION_LIST KF7-350.4M[14] /end FUNCTION_LIST /end MEASUREMENT
/begin MEASUREMENT vKITAEGR_S "EGR At the time of ON/ off, combustion efficiency compensation value" UBYTE COMP_0009 1 100 0 199.21875 ECU_ADDRESS 0xFFFF1C44 /begin FUNCTION_LIST KF7-350.4P[13] /end FUNCTION_LIST /end MEASUREMENT
/begin MEASUREMENT vK_ENBR "Engine-brake compensation" UBYTE COMP_0121_S 1 100 0 0.99609375 ECU_ADDRESS 0xFFFF14B9 /begin FUNCTION_LIST KF7-340.16[4] /end FUNCTION_LIST /end MEASUREMENT
/begin MEASUREMENT vMALPHADT "100% deviation big sides MALPHA" UWORD COMP_0031 1 100 0 255.99609375 ECU_ADDRESS 0xFFFF155A /begin FUNCTION_LIST KF7-371.1E[15] /end FUNCTION_LIST /end MEASUREMENT
/begin MEASUREMENT vMDL "The amount of a change in a target purge rate maximum" UWORD COMP_0606_S 1 100 0 64.001481 ECU_ADDRESS 0xFFFF2F7A /begin FUNCTION_LIST KF7-371.1E[15] /end FUNCTION_LIST /end MEASUREMENT
/begin MEASUREMENT vMFDTY "Radiator fan drive Duty order value" UBYTE COMP_0027 1 100 0 255 ECU_ADDRESS 0xFFFF23E8 /begin FUNCTION_LIST KF7-351.1[16] KF7-351.2[17] KF7-377.1A[19] KF7-580.1[8] /end FUNCTION_LIST /end MEASUREMENT
/begin MEASUREMENT vMONGR "A gear ratio position for the monitor" UBYTE COMP_0068 1 100 0 255 ECU_ADDRESS 0xFFFF15A9 /begin FUNCTION_LIST KF7-360.8M[4] R301.8.Inverse_filter_1_1_3 /end FUNCTION_LIST /end MEASUREMENT
/begin MEASUREMENT vMPRC "At the time of the heat resisting purge condition, target purge rate" UWORD COMP_0566_S 1 100 0 63.999056205 ECU_ADDRESS 0xFFFF15AE /begin FUNCTION_LIST KF7-371.1E[15] /end FUNCTION_LIST /end MEASUREMENT
/begin MEASUREMENT vMPRK "TEMIN Former compensated target purge rate" UWORD COMP_0568_S 1 100 0 64.001481 ECU_ADDRESS 0xFFFF2FE8 /begin FUNCTION_LIST KF7-371.1E[15] /end FUNCTION_LIST /end MEASUREMENT
/begin MEASUREMENT vMPRKR "The former target purge rate that a purge cut reflects" UWORD COMP_0568_S 1 100 0 64.001481 ECU_ADDRESS 0xFFFF2FEA /begin FUNCTION_LIST KF7-371.1E[15] /end FUNCTION_LIST /end MEASUREMENT
/begin MEASUREMENT vMXPR "A maximum purge rate" UWORD COMP_0568_S 1 100 0 64.001481 ECU_ADDRESS 0xFFFF2FFC /begin FUNCTION_LIST KF7-371.1E[15] /end FUNCTION_LIST /end MEASUREMENT
/begin MEASUREMENT vNADDQFBI "QFBI integration number of times" UWORD COMP_0030 1 100 0 65535 ECU_ADDRESS 0xFFFF15C6 /begin FUNCTION_LIST KF7-351.1[16] /end FUNCTION_LIST /end MEASUREMENT
/begin MEASUREMENT vNEKTMIN "D range, at least, engine speed" UWORD COMP_0065 1 100 0 204796.875 ECU_ADDRESS 0xFFFF15D0 /begin FUNCTION_LIST KF7-360.9M[43] /end FUNCTION_LIST /end MEASUREMENT
/begin MEASUREMENT vNEKTND "At the time of the ND select, engine speed" UWORD COMP_0065 1 100 0 204796.875 ECU_ADDRESS 0xFFFF15D2 /begin FUNCTION_LIST KF7-360.9M[43] /end FUNCTION_LIST /end MEASUREMENT
/begin MEASUREMENT vN_GD1 "Compensation vessel H/G constant 4" SBYTE COMP_0263 1 100 -128 127 ECU_ADDRESS 0xFFFF3719 /begin FUNCTION_LIST KF7-360.1[12] /end FUNCTION_LIST /end MEASUREMENT
/begin MEASUREMENT vN_GN0 "Compensation vessel H/G constant 3" SBYTE COMP_0263 1 100 -128 127 ECU_ADDRESS 0xFFFF371A /begin FUNCTION_LIST KF7-360.1[12] /end FUNCTION_LIST /end MEASUREMENT
/begin MEASUREMENT vN_GN1 "Compensation vessel H/G constant 2" SBYTE COMP_0263 1 100 -128 127 ECU_ADDRESS 0xFFFF371B /begin FUNCTION_LIST KF7-360.1[12] /end FUNCTION_LIST /end MEASUREMENT
/begin MEASUREMENT vN_GN2 "Compensation vessel H/G constant 1" SBYTE COMP_0263 1 100 -128 127 ECU_ADDRESS 0xFFFF371C /begin FUNCTION_LIST KF7-360.1[12] /end FUNCTION_LIST /end MEASUREMENT
/begin MEASUREMENT vN_HD1 "Compensation vessel H constant 3" SBYTE COMP_0263 1 100 -128 127 ECU_ADDRESS 0xFFFF371D /begin FUNCTION_LIST KF7-360.1[12] /end FUNCTION_LIST /end MEASUREMENT
/begin MEASUREMENT vN_HN0 "Compensation vessel H constant 2" SBYTE COMP_0263 1 100 -128 127 ECU_ADDRESS 0xFFFF371E /begin FUNCTION_LIST KF7-360.1[12] /end FUNCTION_LIST /end MEASUREMENT
/begin MEASUREMENT vN_HN1 "Compensation vessel H constant 1" SBYTE COMP_0263 1 100 -128 127 ECU_ADDRESS 0xFFFF371F /begin FUNCTION_LIST KF7-360.1[12] /end FUNCTION_LIST /end MEASUREMENT
/begin MEASUREMENT vN_ID0 "The number of ID0 shifts" SBYTE COMP_0264 1 100 -128 127 ECU_ADDRESS 0xFFFF15BE /begin FUNCTION_LIST KF7-360.8M[4] R301.8.Inverse_filter_1_1_3 /end FUNCTION_LIST /end MEASUREMENT
/begin MEASUREMENT vN_ID1 "The number of ID1 shifts" SBYTE COMP_0264 1 100 -128 127 ECU_ADDRESS 0xFFFF15BF /begin FUNCTION_LIST KF7-360.8M[4] R301.8.Inverse_filter_1_1_3 /end FUNCTION_LIST /end MEASUREMENT
/begin MEASUREMENT vN_IN0 "The number of IN0 shifts" SBYTE COMP_0264 1 100 -128 127 ECU_ADDRESS 0xFFFF15C0 /begin FUNCTION_LIST KF7-360.8M[4] R301.8.Inverse_filter_1_1_3 /end FUNCTION_LIST /end MEASUREMENT
/begin MEASUREMENT vN_IN1 "The number of IN1 shifts" SBYTE COMP_0264 1 100 -128 127 ECU_ADDRESS 0xFFFF15C1 /begin FUNCTION_LIST KF7-360.8M[4] R301.8.Inverse_filter_1_1_3 /end FUNCTION_LIST /end MEASUREMENT
/begin MEASUREMENT vN_IN2 "The number of IN2 shifts" SBYTE COMP_0264 1 100 -128 127 ECU_ADDRESS 0xFFFF15C2 /begin FUNCTION_LIST KF7-360.8M[4] R301.8.Inverse_filter_1_1_3 /end FUNCTION_LIST /end MEASUREMENT
/begin MEASUREMENT vPABF "Estimated purge A/F" UWORD COMP_0612_S 1 100 0 127.989855 ECU_ADDRESS 0xFFFF3064 /begin FUNCTION_LIST KF7-371.1E[15] /end FUNCTION_LIST /end MEASUREMENT
/begin MEASUREMENT vPABFERR "After error compensation, canister model computed purge A/F" UWORD COMP_0613_S 1 100 0 127.998046875 ECU_ADDRESS 0xFFFF3066 /begin FUNCTION_LIST KF7-371.1E[15] /end FUNCTION_LIST /end MEASUREMENT
/begin MEASUREMENT vPDE "Estimated purge A/F error" UBYTE COMP_0027 1 100 0 255 ECU_ADDRESS 0xFFFF3075 /begin FUNCTION_LIST KF7-371.1E[15] /end FUNCTION_LIST /end MEASUREMENT
/begin MEASUREMENT vPDNSLIM "Maximum purge rate purge concentration limitation value" UWORD COMP_0568_S 1 100 0 64.001481 ECU_ADDRESS 0xFFFF3078 /begin FUNCTION_LIST KF7-371.1E[15] /end FUNCTION_LIST /end MEASUREMENT
/begin MEASUREMENT vPMDAPLMT "POWER mode upper limit limiter" UWORD COMP_0005 1 100 0 7208.85 ECU_ADDRESS 0xFFFF1690 /begin FUNCTION_LIST KF7-360.7M[9] KF7-360.7P[8] /end FUNCTION_LIST /end MEASUREMENT
/begin MEASUREMENT vPMDGAIN "POWER mode control gain" UBYTE COMP_0045 1 100 0 1.9921875 ECU_ADDRESS 0xFFFF3094 /begin FUNCTION_LIST KF7-360.7M[9] KF7-360.7P[8] /end FUNCTION_LIST /end MEASUREMENT
/begin MEASUREMENT vPVSLIM "Maximum purge rate purge valve limitation value" UWORD COMP_0568_S 1 100 0 64.001481 ECU_ADDRESS 0xFFFF30BA /begin FUNCTION_LIST KF7-371.1E[15] /end FUNCTION_LIST /end MEASUREMENT
/begin MEASUREMENT vQFBIAVE "QFBI mean" SLONG COMP_0277 1 100 -2147483648 2147483647 ECU_ADDRESS 0xFFFF16D0 /begin FUNCTION_LIST KF7-351.2[17] /end FUNCTION_LIST /end MEASUREMENT
/begin MEASUREMENT vQFBIBAK "F/B I-gain air flow-quantity" SWORD COMP_0277 1 100 -32768 32767 ECU_ADDRESS 0xFFFF16D4 /begin FUNCTION_LIST KF7-351.1[16] /end FUNCTION_LIST /end MEASUREMENT
/begin MEASUREMENT vRESFD "Running resistance increase width" UWORD COMP_0014_S 1 100 0 65535 ECU_ADDRESS 0xFFFF1732 /begin FUNCTION_LIST KF7-340.15[3] /end FUNCTION_LIST /end MEASUREMENT
/begin MEASUREMENT vRESFD0 "Running resistance increase width basic value" UWORD COMP_0123_S 1 100 -32768 32767 ECU_ADDRESS 0xFFFF1734 /begin FUNCTION_LIST KF7-340.15[3] /end FUNCTION_LIST /end MEASUREMENT
/begin MEASUREMENT vRESHUFL "ON/ off switchover compensation coefficient" UWORD COMP_0146 1 100 0 99.998480265 ECU_ADDRESS 0xFFFF1736 /begin FUNCTION_LIST KF7-340.15[3] /end FUNCTION_LIST /end MEASUREMENT
/begin MEASUREMENT vRFNRLY "RFN Variable for relay & ignition F/F sympathizing" UBYTE COMP_0004 1 100 0 255 ECU_ADDRESS 0xFFFF1034
 /begin FUNCTION_LIST KF7-351.1[16] KF7-351.2[17] KF7-377.1A[19] KF7-390.3A[15] R000.1.RS_Integ_1_10_2 /end FUNCTION_LIST
/end MEASUREMENT
/begin MEASUREMENT vRLDFD "Flat road running resistance torque" SWORD COMP_0030_S 1 100 -32768 32767 ECU_ADDRESS 0xFFFF174C /begin FUNCTION_LIST KF7-340.15[3] /end FUNCTION_LIST /end MEASUREMENT
/begin MEASUREMENT vRLFLTNE "After filter treatment is added, engine speed" UWORD COMP_0454_S 1 100 0 51199.21875 ECU_ADDRESS 0xFFFF174E /begin FUNCTION_LIST KF7-360.12[6] /end FUNCTION_LIST /end MEASUREMENT
/begin MEASUREMENT vRLRPM "Limit speed" UWORD COMP_0454_S 1 100 0 51199.21875 ECU_ADDRESS 0xFFFF1750 /begin FUNCTION_LIST KF7-360.12[6] /end FUNCTION_LIST /end MEASUREMENT
/begin MEASUREMENT vRLTENG2 "In the limiter, TENG2 for the up-shift" SWORD COMP_0228 1 100 -3276.8 3276.7 ECU_ADDRESS 0xFFFF23FE /begin FUNCTION_LIST KF7-360.12[6] KF7-410.10[6] /end FUNCTION_LIST /end MEASUREMENT
/begin MEASUREMENT vRLTGTRPM "High rotation limiter target speed" UWORD COMP_0454_S 1 100 0 51199.21875 ECU_ADDRESS 0xFFFF1752 /begin FUNCTION_LIST KF7-360.12[6] /end FUNCTION_LIST /end MEASUREMENT
/begin MEASUREMENT vRLVAPO "In the limiter, VAPO for the up-shift" UWORD COMP_0005 1 100 0 7208.85 ECU_ADDRESS 0xFFFF4218 /begin FUNCTION_LIST KF7-360.12[6] /end FUNCTION_LIST /end MEASUREMENT
/begin MEASUREMENT vSTSTFS "Control control throttle open-degree (APOFS shaft conversion)" UWORD COMP_0005 1 100 0 7208.85 ECU_ADDRESS 0xFFFF17C6 /begin FUNCTION_LIST KF7-360.7M[9] /end FUNCTION_LIST /end MEASUREMENT
/begin MEASUREMENT vTADDFD0 "Target addition drive power basic value" UWORD COMP_0014_S 1 100 0 65535 ECU_ADDRESS 0xFFFF17E6 /begin FUNCTION_LIST KF7-340.15[3] /end FUNCTION_LIST /end MEASUREMENT
/begin MEASUREMENT vTADDFD00 "After the limiter, target addition drive power basic value" UWORD COMP_0014_S 1 100 0 65535 ECU_ADDRESS 0xFFFF17E8 /begin FUNCTION_LIST KF7-340.15[3] /end FUNCTION_LIST /end MEASUREMENT
/begin MEASUREMENT vTADDFD1 "The first target addition drive power" UWORD COMP_0014_S 1 100 0 65535 ECU_ADDRESS 0xFFFF17EA /begin FUNCTION_LIST KF7-340.15[3] /end FUNCTION_LIST /end MEASUREMENT
/begin MEASUREMENT vTADDFD2 "The second target addition drive power" UWORD COMP_0014_S 1 100 0 65535 ECU_ADDRESS 0xFFFF17EC /begin FUNCTION_LIST KF7-340.15[3] /end FUNCTION_LIST /end MEASUREMENT
/begin MEASUREMENT vTALPHA "Compensation rate" UWORD COMP_0146 1 100 0 99.998480265 ECU_ADDRESS 0xFFFF1800 /begin FUNCTION_LIST KF7-340.15[3] /end FUNCTION_LIST /end MEASUREMENT
/begin MEASUREMENT vTCKBL "(CK) Control upper limit torque for the belt slide" SWORD COMP_0228 1 100 -3276.8 3276.7 ECU_ADDRESS 0xFFFF1816 /begin FUNCTION_LIST KF7-360.9M[43] KF7-360.9P[22] /end FUNCTION_LIST /end MEASUREMENT
/begin MEASUREMENT vTCKBL0 "An initial torque" SWORD COMP_0228 1 100 -3276.8 3276.7 ECU_ADDRESS 0xFFFF1818 /begin FUNCTION_LIST KF7-360.9M[43] /end FUNCTION_LIST /end MEASUREMENT
/begin MEASUREMENT vTCKBLC "CK, at least, a requirement limit torque for line pressure MIN-ization" SWORD COMP_0228 1 100 -3276.8 3276.7 ECU_ADDRESS 0xFFFF181A /begin FUNCTION_LIST KF7-360.9M[43] /end FUNCTION_LIST /end MEASUREMENT
/begin MEASUREMENT vTCKBLCC "CK, at least, a requirement limit torque (CAN receiving data) for line pressure MIN-ization" UBYTE COMP_0349 1 100 0 408 ECU_ADDRESS 0xFFFF89C8 /begin FUNCTION_LIST KF7-360.9M[43] /end FUNCTION_LIST /end MEASUREMENT
/begin MEASUREMENT vTCKBLCL "CK, at least, a lower limit limit torque for line pressure MIN-ization" SWORD COMP_0228 1 100 -3276.8 3276.7 ECU_ADDRESS 0xFFFF181C /begin FUNCTION_LIST KF7-360.9M[43] /end FUNCTION_LIST /end MEASUREMENT
/begin MEASUREMENT vTCKBLCLM "CK, at least, a final limit torque for line pressure MIN-ization" SWORD COMP_0228 1 100 -3276.8 3276.7 ECU_ADDRESS 0xFFFF181E /begin FUNCTION_LIST KF7-360.9M[43] KF7-360.9P[22] /end FUNCTION_LIST /end MEASUREMENT
/begin MEASUREMENT vTCKLM "Upper limit limit table reference value" SWORD COMP_0228 1 100 -3276.8 3276.7 ECU_ADDRESS 0xFFFF1820 /begin FUNCTION_LIST KF7-360.9M[43] KF7-360.9P[22] /end FUNCTION_LIST /end MEASUREMENT
/begin MEASUREMENT vTCKTD "At the time of the extreme low temperature, after the (CK) protection limiter, torque" SWORD COMP_0228 1 100 -3276.8 3276.7 ECU_ADDRESS 0xFFFF1822 /begin FUNCTION_LIST KF7-360.9M[43] /end FUNCTION_LIST /end MEASUREMENT
/begin MEASUREMENT vTDTVO "Target throttle open-degree" UWORD COMP_0130 1 100 0 1802.2125 ECU_ADDRESS 0xFFFF32DA /begin FUNCTION_LIST KF7-350.4M[14] R000.1.RS_Integ_1_10_2 /end FUNCTION_LIST /end MEASUREMENT
/begin MEASUREMENT vTDTVO_S "Target throttle open-degree" UWORD COMP_0130 1 100 0 1802.2125 ECU_ADDRESS 0xFFFF1C66 /begin FUNCTION_LIST KF7-350.4P[13] /end FUNCTION_LIST /end MEASUREMENT
/begin MEASUREMENT vTE1INV "Inverse filter input torque" ULONG COMP_0630_S 1 100 0 512.007346204245 ECU_ADDRESS 0xFFFF1848 /begin FUNCTION_LIST KF7-360.8M[4] R301.8.Inverse_filter_1_1_3 /end FUNCTION_LIST /end MEASUREMENT
/begin MEASUREMENT vTE1INVS "The sign of TE1INV" UBYTE COMP_0004 1 100 0 255 ECU_ADDRESS 0xFFFF184C /begin FUNCTION_LIST KF7-360.8M[4] R301.8.Inverse_filter_1_1_3 /end FUNCTION_LIST /end MEASUREMENT
/begin MEASUREMENT vTE2INV "Inverse filter output torque" ULONG COMP_0630_S 1 100 0 512.007346204245 ECU_ADDRESS 0xFFFF185C /begin FUNCTION_LIST KF7-360.8M[4] R301.8.Inverse_filter_1_1_3 /end FUNCTION_LIST /end MEASUREMENT
/begin MEASUREMENT vTE2INVS "The sign of TE2INV" UBYTE COMP_0004 1 100 0 255 ECU_ADDRESS 0xFFFF1880 /begin FUNCTION_LIST KF7-360.8M[4] R301.8.Inverse_filter_1_1_3 /end FUNCTION_LIST /end MEASUREMENT
/begin MEASUREMENT vTEMINLIM "FHOS lower limit value by TEMIN" UWORD COMP_0631_S 1 100 0 255.97971 ECU_ADDRESS 0xFFFF32E2 /begin FUNCTION_LIST KF7-371.1E[15] /end FUNCTION_LIST /end MEASUREMENT
/begin MEASUREMENT vTENG14 "Engine torque (After delay is compensated.)" SWORD COMP_0228 1 100 -3276.8 3276.7 ECU_ADDRESS 0xFFFF18A0 /begin FUNCTION_LIST KF7-340.15[3] KF7-386.1[4] /end FUNCTION_LIST /end MEASUREMENT
/begin MEASUREMENT vTENG2 "Engine torque basic value without DUETTE compensation" SWORD COMP_0228 1 100 -3276.8 3276.7 ECU_ADDRESS 0xFFFF240E
 /begin FUNCTION_LIST KF7-360.12[6] KF7-385.2[18] KF7-386.2[4] KF7-410.10[6] R301.1.Torque_realization_1_0_3 /end FUNCTION_LIST
/end MEASUREMENT
/begin MEASUREMENT vTGABF "Target air-fuel ratio" UWORD COMP_0453 1 100 0 131.07 ECU_ADDRESS 0xFFFF191A /begin FUNCTION_LIST KF7-371.1E[15] /end FUNCTION_LIST /end MEASUREMENT
/begin MEASUREMENT vTGABFEJG "TGABFE for the A/F stillness fixed judgement" UWORD COMP_0453 1 100 0 131.07 ECU_ADDRESS 0xFFFF32F6 /begin FUNCTION_LIST KF7-371.1E[15] /end FUNCTION_LIST /end MEASUREMENT
/begin MEASUREMENT vTGABFEMX "The big side TGABF" UWORD COMP_0453 1 100 0 131.07 ECU_ADDRESS 0xFFFF32F8 /begin FUNCTION_LIST KF7-371.1E[15] /end FUNCTION_LIST /end MEASUREMENT
/begin MEASUREMENT vTGTVG1 "A TP->QH0 gain for offset learning" UBYTE COMP_0315 1 100 0 24.90075 ECU_ADDRESS 0xFFFF330A /begin FUNCTION_LIST KF7-351.3[11] /end FUNCTION_LIST /end MEASUREMENT
/begin MEASUREMENT vTGTVO_S "(SubCPU) After the diagnosis, target throttle open-degree (after the limit)" UWORD COMP_0130 1 100 0 1802.2125 ECU_ADDRESS 0xFFFF4034
 /begin FUNCTION_LIST KF7-350.1P[4] KF7-350.4P[13] KF7-505.16[1] KF7-525.2S[10] R000.1.RS_Integ_1_10_2 R301.21.SafetyLevel2_1_0_2 /end FUNCTION_LIST
/end MEASUREMENT
/begin MEASUREMENT vTLAMBDA_S "The rate that fresh air is excessive" UWORD COMP_0217 1 100 0 3.999941832 ECU_ADDRESS 0xFFFF3522 /begin FUNCTION_LIST KF7-350.4P[13] /end FUNCTION_LIST /end MEASUREMENT
/begin MEASUREMENT vTMKT1 "A timer for the TRQKT1 torque going down control" UBYTE COMP_0008 1 100 0 25500 ECU_ADDRESS 0xFFFF1953 /begin FUNCTION_LIST KF7-360.9M[43] /end FUNCTION_LIST /end MEASUREMENT
/begin MEASUREMENT vTMKT2 "A timer for the TRQKT2 torque going down control" UWORD COMP_0008 1 100 0 6553500 ECU_ADDRESS 0xFFFF1954 /begin FUNCTION_LIST KF7-360.9M[43] /end FUNCTION_LIST /end MEASUREMENT
/begin MEASUREMENT vTMKTAP "MPFCKT map reference value" UBYTE COMP_0008 1 100 0 25500 ECU_ADDRESS 0xFFFF1956 /begin FUNCTION_LIST KF7-360.9M[43] /end FUNCTION_LIST /end MEASUREMENT
/begin MEASUREMENT vTMKTLT "MPAPKT map reference value" UWORD COMP_0008 1 100 0 6553500 ECU_ADDRESS 0xFFFF1958 /begin FUNCTION_LIST KF7-360.9M[43] /end FUNCTION_LIST /end MEASUREMENT
/begin MEASUREMENT vTMSPTRN "Sharp Corp. ON/ off switchover rate" UWORD COMP_0290 1 100 0 0.999985458 ECU_ADDRESS 0xFFFF1F24 /begin FUNCTION_LIST KF7-360.7M[9] KF7-360.7P[8] /end FUNCTION_LIST /end MEASUREMENT
/begin MEASUREMENT vTPOLH "After the linear-interpolation, throttle open-degree" UWORD COMP_0164_S 1 100 -14.08205 98.55623125 ECU_ADDRESS 0xFFFF374C /begin FUNCTION_LIST KF7-360.1[12] /end FUNCTION_LIST /end MEASUREMENT
/begin MEASUREMENT vTPOSELHI "Select HI rest throttle open-degree" UWORD COMP_0164_S 1 100 -14.08205 98.55623125 ECU_ADDRESS 0xFFFF374E /begin FUNCTION_LIST KF7-360.1[12] /end FUNCTION_LIST /end MEASUREMENT
/begin MEASUREMENT vTPQLR "Air quantity basic value" UWORD COMP_0144 1 100 0 31.999495335 ECU_ADDRESS 0xFFFF338A /begin FUNCTION_LIST KF7-351.3[11] /end FUNCTION_LIST /end MEASUREMENT
/begin MEASUREMENT vTQLIMSLW "Engine requirement upper limit SLOW torque" SWORD COMP_0228 1 100 -3276.8 3276.7 ECU_ADDRESS 0xFFFF33B8 /begin FUNCTION_LIST KF7-360.9M[43] /end FUNCTION_LIST /end MEASUREMENT
/begin MEASUREMENT vTQTMDYNC "T/M requirement transient state torque (CAN receiving value)" UBYTE COMP_0021_S 1 100 -100 410 ECU_ADDRESS 0xFFFF4990 /begin FUNCTION_LIST KF7-360.9M[43] KF7-385.2[18] /end FUNCTION_LIST /end MEASUREMENT
/begin MEASUREMENT vTQTMSTA "T/M requirement steady state torque" SWORD COMP_0228 1 100 -3276.8 3276.7 ECU_ADDRESS 0xFFFF33BA /begin FUNCTION_LIST KF7-360.9M[43] KF7-360.9P[22] /end FUNCTION_LIST /end MEASUREMENT
/begin MEASUREMENT vTQTMSTAC "T/M requirement steady state torque (CAN receiving value)" UBYTE COMP_0021_S 1 100 -100 410 ECU_ADDRESS 0xFFFF4788 /begin FUNCTION_LIST KF7-360.9M[43] KF7-360.9P[22] /end FUNCTION_LIST /end MEASUREMENT
/begin MEASUREMENT vTQTMSTAR "T/M requirement steady state torque (CAN receiving value)" UBYTE COMP_0021_S 1 100 -100 410 ECU_ADDRESS 0xFFFF4991 /begin FUNCTION_LIST KF7-360.9M[43] /end FUNCTION_LIST /end MEASUREMENT
/begin MEASUREMENT vTRQ1SD "At the time of 1st stall, torque going down control torque" SWORD COMP_0228 1 100 -3276.8 3276.7 ECU_ADDRESS 0xFFFF33C8 /begin FUNCTION_LIST KF7-360.9M[43] KF7-360.9P[22] /end FUNCTION_LIST /end MEASUREMENT
/begin MEASUREMENT vTRQ1TD "At the time of 1st steady state, torque going down control torque" SWORD COMP_0228 1 100 -3276.8 3276.7 ECU_ADDRESS 0xFFFF33CA /begin FUNCTION_LIST KF7-360.9M[43] KF7-360.9P[22] /end FUNCTION_LIST /end MEASUREMENT
/begin MEASUREMENT vTRQ2SD "At the time of 2nd stall, torque going down control torque" SWORD COMP_0228 1 100 -3276.8 3276.7 ECU_ADDRESS 0xFFFF33CC /begin FUNCTION_LIST KF7-360.9M[43] KF7-360.9P[22] /end FUNCTION_LIST /end MEASUREMENT
/begin MEASUREMENT vTRQ4WD "Electric 4WD drive protection torque" SWORD COMP_0228 1 100 -3276.8 3276.7 ECU_ADDRESS 0xFFFF33CE /begin FUNCTION_LIST KF7-360.9M[43] KF7-360.9P[22] KF7-410.21[3] /end FUNCTION_LIST /end MEASUREMENT
/begin MEASUREMENT vTRQ4WD0 "Electric 4WD drive protection torque basic value" SWORD COMP_0228 1 100 -3276.8 3276.7 ECU_ADDRESS 0xFFFF33D0 /begin FUNCTION_LIST KF7-360.9M[43] KF7-410.21[3] /end FUNCTION_LIST /end MEASUREMENT
/begin MEASUREMENT vTRQATD "The whole area torque going down control torque" SWORD COMP_0228 1 100 -3276.8 3276.7 ECU_ADDRESS 0xFFFF33D6 /begin FUNCTION_LIST KF7-360.9M[43] KF7-360.9P[22] /end FUNCTION_LIST /end MEASUREMENT
/begin MEASUREMENT vTRQKT0 "At the time of KT low oil temperature, drive protection control torque" SWORD COMP_0228 1 100 -3276.8 3276.7 ECU_ADDRESS 0xFFFF33D8 /begin FUNCTION_LIST KF7-360.9M[43] /end FUNCTION_LIST /end MEASUREMENT
/begin MEASUREMENT vTRQKT2 "At the time of KT low oil temperature, drive protection control torque" SWORD COMP_0228 1 100 -3276.8 3276.7 ECU_ADDRESS 0xFFFF33DC /begin FUNCTION_LIST KF7-360.9M[43] /end FUNCTION_LIST /end MEASUREMENT
/begin MEASUREMENT vTRQKTD "After it deals with drive protection control at the time of the final KT low oil temperature, torque" SWORD COMP_0228 1 100 -3276.8 3276.7 ECU_ADDRESS 0xFFFF33DE /begin FUNCTION_LIST KF7-360.9M[43] KF7-360.9P[22] /end FUNCTION_LIST /end MEASUREMENT
/begin MEASUREMENT vTRQLSD "LC/B At the time of the conclusion, stall torque going down control torque" SWORD COMP_0228 1 100 -3276.8 3276.7 ECU_ADDRESS 0xFFFF33E0 /begin FUNCTION_LIST KF7-360.9M[43] KF7-360.9P[22] /end FUNCTION_LIST /end MEASUREMENT
/begin MEASUREMENT vTRQMDLT "Rotation synchronous control limit target torque" SWORD COMP_0228 1 100 -3276.8 3276.7 ECU_ADDRESS 0xFFFF33E2 /begin FUNCTION_LIST KF7-360.9M[43] KF7-360.9P[22] /end FUNCTION_LIST /end MEASUREMENT
/begin MEASUREMENT vTRQND "At the time of the ND select shock, torque going down control torque" SWORD COMP_0228 1 100 -3276.8 3276.7 ECU_ADDRESS 0xFFFF33E6 /begin FUNCTION_LIST KF7-360.9M[43] KF7-360.9P[22] /end FUNCTION_LIST /end MEASUREMENT
/begin MEASUREMENT vTRQPIG "Pre-ignition avoidance control torque" SWORD COMP_0228 1 100 -3276.8 3276.7 ECU_ADDRESS 0xFFFF33EE /begin FUNCTION_LIST KF7-360.9M[43] KF7-360.9P[22] /end FUNCTION_LIST /end MEASUREMENT
/begin MEASUREMENT vTRQRSD "At the time of the reverse stall, torque going down control torque" SWORD COMP_0228 1 100 -3276.8 3276.7 ECU_ADDRESS 0xFFFF33F2 /begin FUNCTION_LIST KF7-360.9M[43] KF7-360.9P[22] /end FUNCTION_LIST /end MEASUREMENT
/begin MEASUREMENT vTTAAPO_S "Opening area (accelerator +ISC)" UWORD COMP_0042 1 100 0 52.428 ECU_ADDRESS 0xFFFF1C94 /begin FUNCTION_LIST KF7-350.1P[4] KF7-350.4P[13] R000.1.RS_Integ_1_10_2 /end FUNCTION_LIST /end MEASUREMENT
/begin MEASUREMENT vTTCAAPO "A total basic opening area (for the TTC operation)" UWORD COMP_0042 1 100 0 52.428 ECU_ADDRESS 0xFFFF19DA /begin FUNCTION_LIST KF7-350.1M[5] R000.1.RS_Integ_1_10_2 /end FUNCTION_LIST /end MEASUREMENT
/begin MEASUREMENT vTTEIF0 "A former inverse filter output torque to control" SWORD COMP_0228 1 100 -3276.8 3276.7 ECU_ADDRESS 0xFFFF19E4 /begin FUNCTION_LIST KF7-360.8M[4] KF7-360.8P[3] R301.8.Inverse_filter_1_1_3 /end FUNCTION_LIST /end MEASUREMENT
/begin MEASUREMENT vTTEIFD "Inverse filter output torque FAST" SWORD COMP_0228 1 100 -3276.8 3276.7 ECU_ADDRESS 0xFFFF19E6
 /begin FUNCTION_LIST KF7-360.8M[4] R000.1.RS_Integ_1_10_2 R301.8.Inverse_filter_1_1_3 /end FUNCTION_LIST
/end MEASUREMENT
/begin MEASUREMENT vTTEIF_S "Inverse filter output torque" SWORD COMP_0228 1 100 -3276.8 3276.7 ECU_ADDRESS 0xFFFF1C98 /begin FUNCTION_LIST KF7-360.8P[3] KF7-360.9P[22] R000.1.RS_Integ_1_10_2 /end FUNCTION_LIST /end MEASUREMENT
/begin MEASUREMENT vTTEMAX "MTTE maximum torque" UWORD COMP_0196 1 100 0 6553.5 ECU_ADDRESS 0xFFFF19E8 /begin FUNCTION_LIST KF7-360.8M[4] R301.8.Inverse_filter_1_1_3 /end FUNCTION_LIST /end MEASUREMENT
/begin MEASUREMENT vTTEPDIF "Inverse filter input PTD torque" SWORD COMP_0228 1 100 -3276.8 3276.7 ECU_ADDRESS 0xFFFF2446
 /begin FUNCTION_LIST KF7-360.8M[4] KF7-360.9M[43] R000.1.RS_Integ_1_10_2 R301.8.Inverse_filter_1_1_3 /end FUNCTION_LIST
/end MEASUREMENT
/begin MEASUREMENT vTTEPDI_S "Inverse filter input PTD torque" SWORD COMP_0228 1 100 -3276.8 3276.7 ECU_ADDRESS 0xFFFF1C9E /begin FUNCTION_LIST KF7-360.8P[3] KF7-360.9P[22] R000.1.RS_Integ_1_10_2 /end FUNCTION_LIST /end MEASUREMENT
/begin MEASUREMENT vTTERL "A high rotation limiter torque" SWORD COMP_0228 1 100 -3276.8 3276.7 ECU_ADDRESS 0xFFFF19FE /begin FUNCTION_LIST KF7-360.9M[43] KF7-360.9P[22] KF7-360.12[6] /end FUNCTION_LIST /end MEASUREMENT
/begin MEASUREMENT vTTERL0 "A high rotation limiter basic torque (R/L + I-gain)" SWORD COMP_0228 1 100 -3276.8 3276.7 ECU_ADDRESS 0xFFFF1A00 /begin FUNCTION_LIST KF7-360.12[6] /end FUNCTION_LIST /end MEASUREMENT
/begin MEASUREMENT vTTERLUPS "At the time of the up-shift, a high rotation limiter torque" SWORD COMP_0228 1 100 -3276.8 3276.7 ECU_ADDRESS 0xFFFF1A02 /begin FUNCTION_LIST KF7-360.12[6] /end FUNCTION_LIST /end MEASUREMENT
/begin MEASUREMENT vTTESL "A high vehicle speed limiter torque" SWORD COMP_0228 1 100 -3276.8 3276.7 ECU_ADDRESS 0xFFFF1A04 /begin FUNCTION_LIST KF7-360.9M[43] KF7-360.9P[22] KF7-360.11[1] /end FUNCTION_LIST /end MEASUREMENT
/begin MEASUREMENT vTTESL0 "A basic limiter torque (R/L + I-gain)" UWORD COMP_0176_S 1 100 0 655.35 ECU_ADDRESS 0xFFFF1A06 /begin FUNCTION_LIST KF7-360.11[1] /end FUNCTION_LIST /end MEASUREMENT
/begin MEASUREMENT vTTETD "After the drive protection control, target torque" SWORD COMP_0228 1 100 -3276.8 3276.7 ECU_ADDRESS 0xFFFF244A /begin FUNCTION_LIST KF7-360.9M[43] /end FUNCTION_LIST /end MEASUREMENT
/begin MEASUREMENT vTTETD_S "After drive protection is controlled, torque (vice-operation part)" SWORD COMP_0228 1 100 -3276.8 3276.7 ECU_ADDRESS 0xFFFF1CA4 /begin FUNCTION_LIST KF7-360.9P[22] /end FUNCTION_LIST /end MEASUREMENT
/begin MEASUREMENT vTTP "The amount of target cylinder intake" UWORD COMP_0052 1 100 0 31.99956087 ECU_ADDRESS 0xFFFF340E /begin FUNCTION_LIST KF7-350.4M[14] KF7-450.50[10] /end FUNCTION_LIST /end MEASUREMENT
/begin MEASUREMENT vTTPST_S "The amount of target basic intake" UWORD COMP_0144 1 100 0 31.999495335 ECU_ADDRESS 0xFFFF3538 /begin FUNCTION_LIST KF7-350.4P[13] /end FUNCTION_LIST /end MEASUREMENT
/begin MEASUREMENT vTTP_S "The amount of target fresh air" UWORD COMP_0144 1 100 0 31.999495335 ECU_ADDRESS 0xFFFF1CA6 /begin FUNCTION_LIST KF7-350.4P[13] /end FUNCTION_LIST /end MEASUREMENT
/begin MEASUREMENT vTVFQAD_S "Height, low speed Q learning addition value (vice-operation part)" SWORD COMP_0500 1 100 -901.12 901.0925 ECU_ADDRESS 0xFFFFB528 /begin FUNCTION_LIST KF7-350.4P[13] /end FUNCTION_LIST /end MEASUREMENT
/begin MEASUREMENT vTVOCMP "The absolute value of the model matching compensation vessel output" ULONG COMP_0177_S 1 100 0 16385.300230425 ECU_ADDRESS 0xFFFF3790 /begin FUNCTION_LIST KF7-360.1[12] /end FUNCTION_LIST /end MEASUREMENT
/begin MEASUREMENT vTVOCMPS "The sign of TVOCMP" UBYTE COMP_0068 1 100 0 255 ECU_ADDRESS 0xFFFF3798 /begin FUNCTION_LIST KF7-360.1[12] /end FUNCTION_LIST /end MEASUREMENT
/begin MEASUREMENT vTVOCOM1 "Throttle open-degree order value" UWORD COMP_0168_S 1 100 0 112.63828125 ECU_ADDRESS 0xFFFF379E /begin FUNCTION_LIST KF7-360.1[12] /end FUNCTION_LIST /end MEASUREMENT
/begin MEASUREMENT vTVOCOM1S "The sign of TVOCOM1" UBYTE COMP_0068 1 100 0 255 ECU_ADDRESS 0xFFFF37A0 /begin FUNCTION_LIST KF7-360.1[12] /end FUNCTION_LIST /end MEASUREMENT
/begin MEASUREMENT vTVOCOMR "Throttle open-degree order value for the digital filter" ULONG COMP_0179_S 1 100 0 4097.39879943 ECU_ADDRESS 0xFFFF37A4 /begin FUNCTION_LIST KF7-360.1[12] /end FUNCTION_LIST /end MEASUREMENT
/begin MEASUREMENT vTVOCOMRS "The sign of TVOCOMR" UBYTE COMP_0068 1 100 0 255 ECU_ADDRESS 0xFFFF37A8 /begin FUNCTION_LIST KF7-360.1[12] /end FUNCTION_LIST /end MEASUREMENT
/begin MEASUREMENT vTVOFBK "The absolute value of the model matching compensation vessel L output" ULONG COMP_0177_S 1 100 0 16385.300230425 ECU_ADDRESS 0xFFFF37AC /begin FUNCTION_LIST KF7-360.1[12] /end FUNCTION_LIST /end MEASUREMENT
/begin MEASUREMENT vTVOFBKS "The sign of TVOFBK" UBYTE COMP_0068 1 100 0 255 ECU_ADDRESS 0xFFFF37B8 /begin FUNCTION_LIST KF7-360.1[12] /end FUNCTION_LIST /end MEASUREMENT
/begin MEASUREMENT vTVOFQAD "High low speed Q learning addition value" SWORD COMP_0500 1 100 -901.12 901.0925 ECU_ADDRESS 0xFFFFB2B6 /begin FUNCTION_LIST KF7-350.4M[14] KF7-351.3[11] R000.1.RS_Integ_1_10_2 /end FUNCTION_LIST /end MEASUREMENT
/begin MEASUREMENT vTVOFQAD1 "Height, low speed Q learning addition value" SWORD COMP_0500 1 100 -901.12 901.0925 ECU_ADDRESS 0xFFFF1A3C /begin FUNCTION_LIST KF7-350.4P[13] KF7-351.3[11] /end FUNCTION_LIST /end MEASUREMENT
/begin MEASUREMENT vTVOLPF "Throttle open-degree for the digital filter" ULONG COMP_0179_S 1 100 0 4097.39879943 ECU_ADDRESS 0xFFFF35F0 /begin FUNCTION_LIST KF7-360.1[12] /end FUNCTION_LIST /end MEASUREMENT
/begin MEASUREMENT vTVOLPFS "The sign of TVOLPF" UBYTE COMP_0068 1 100 0 255 ECU_ADDRESS 0xFFFF35F4 /begin FUNCTION_LIST KF7-360.1[12] /end FUNCTION_LIST /end MEASUREMENT
/begin MEASUREMENT vTVOST "Control control throttle open-degree" UWORD COMP_0005 1 100 0 7208.85 ECU_ADDRESS 0xFFFF1A3E /begin FUNCTION_LIST KF7-360.7M[9] /end FUNCTION_LIST /end MEASUREMENT
/begin MEASUREMENT vTVOSTN "Control control throttle open-degree (non-SHAP)" UWORD COMP_0039 1 100 0 7208.85 ECU_ADDRESS 0xFFFF1F4A /begin FUNCTION_LIST KF7-360.7M[9] /end FUNCTION_LIST /end MEASUREMENT
/begin MEASUREMENT vTVOSTN_S "Control control throttle open-degree (non-SHAP)" UWORD COMP_0005 1 100 0 7208.85 ECU_ADDRESS 0xFFFF1CAA /begin FUNCTION_LIST KF7-360.7P[8] /end FUNCTION_LIST /end MEASUREMENT
/begin MEASUREMENT vTVOSTS "Control control throttle open-degree (SHAP)" UWORD COMP_0039 1 100 0 7208.85 ECU_ADDRESS 0xFFFF1F4C /begin FUNCTION_LIST KF7-360.7M[9] /end FUNCTION_LIST /end MEASUREMENT
/begin MEASUREMENT vTVOSTS_S "Control control throttle open-degree (SHAP)" UWORD COMP_0005 1 100 0 7208.85 ECU_ADDRESS 0xFFFF1CAC /begin FUNCTION_LIST KF7-360.7P[8] /end FUNCTION_LIST /end MEASUREMENT
/begin MEASUREMENT vTVOST_S "Control control throttle open-degree" UWORD COMP_0005 1 100 0 7208.85 ECU_ADDRESS 0xFFFF1CA8 /begin FUNCTION_LIST KF7-360.7P[8] /end FUNCTION_LIST /end MEASUREMENT
/begin MEASUREMENT vTVOUPLM "TGTVO Open-degree upper limit value (TGTVO open upper limit)" UWORD COMP_0130 1 100 0 1802.2125 ECU_ADDRESS 0xFFFF3420 /begin FUNCTION_LIST KF7-350.4M[14] /end FUNCTION_LIST /end MEASUREMENT
/begin MEASUREMENT vTVOUPLMS "TGTVO open-degree upper limit value (vice-operation part)" UWORD COMP_0130 1 100 0 1802.2125 ECU_ADDRESS 0xFFFF3422 /begin FUNCTION_LIST KF7-350.4P[13] /end FUNCTION_LIST /end MEASUREMENT
/begin MEASUREMENT vTZADFD "The amount of target drive power compensation" SWORD COMP_0030_S 1 100 -32768 32767 ECU_ADDRESS 0xFFFF343E /begin FUNCTION_LIST KF7-340.16[4] /end FUNCTION_LIST /end MEASUREMENT
/begin MEASUREMENT vVAPOAC "Air-conditioning cut VAPO" UWORD COMP_0005 1 100 0 7208.85 ECU_ADDRESS 0xFFFF1A64 /begin FUNCTION_LIST KF7-376.2[21] R301.6.IscAirflow_1_4_5 /end FUNCTION_LIST /end MEASUREMENT
/begin MEASUREMENT vVGEAR "A gear ratio for the parameter switching operation" UWORD COMP_0063 1 100 0 255.99609375 ECU_ADDRESS 0xFFFF1A88 /begin FUNCTION_LIST KF7-360.8M[4] R301.8.Inverse_filter_1_1_3 /end FUNCTION_LIST /end MEASUREMENT
/begin MEASUREMENT vZOKU2 "ECM recognition attribute parameter" UBYTE COMP_0068 1 100 0 255 ECU_ADDRESS 0xFFFF4021 /begin FUNCTION_LIST KF7-340.16[4] /end FUNCTION_LIST /end MEASUREMENT
/begin MEASUREMENT wvCVTRNG "Range signal" UBYTE COMP_0068 1 100 0 255 ECU_ADDRESS 0xFFFF4818 /begin FUNCTION_LIST KF7-360.9M[43] /end FUNCTION_LIST /end MEASUREMENT
/begin MEASUREMENT wvETQETS "Electric 4WD drive protection target engine torque (CAN)" UBYTE COMP_0518 1 100 0 510 ECU_ADDRESS 0xFFFF4830 /begin FUNCTION_LIST KF7-360.9M[43] /end FUNCTION_LIST /end MEASUREMENT
/begin MEASUREMENT wvETQETSC "Electric 4WD drive protection target engine torque" SWORD COMP_0228 1 100 -3276.8 3276.7 ECU_ADDRESS 0xFFFF4832 /begin FUNCTION_LIST KF7-360.9M[43] /end FUNCTION_LIST /end MEASUREMENT
/begin MEASUREMENT wvETSMSG2T "ETSMSG2 reception interval counter" UBYTE COMP_0014 1 100 0 2550 ECU_ADDRESS 0xFFFF4836 /begin FUNCTION_LIST KF7-360.9M[43] /end FUNCTION_LIST /end MEASUREMENT
/begin MEASUREMENT wvEVPSMAX "vEVPS upper limit value" UBYTE COMP_0047 1 100 0 127.5 ECU_ADDRESS 0xFFFF8A02 /begin FUNCTION_LIST KF7-371.1E[15] /end FUNCTION_LIST /end MEASUREMENT
/begin MEASUREMENT wvICOM2 "The absolute value of the electric current order value (after the limiter)" ULONG COMP_0600_S 1 100 0 32766.305493555 ECU_ADDRESS 0xFFFF4748 /begin FUNCTION_LIST KF7-360.1[12] KF7-505.32[6] KF7-505.33[8] /end FUNCTION_LIST /end MEASUREMENT
/begin MEASUREMENT wvTCKBLCC "CK, at least, a requirement limit torque (CAN communication) for line pressure MIN-ization" UBYTE COMP_0349 1 100 0 408 ECU_ADDRESS 0xFFFF893C /begin FUNCTION_LIST KF7-360.9M[43] /end FUNCTION_LIST /end MEASUREMENT
/begin MEASUREMENT wvTQTMDYNC "T/M requirement transient state torque (CAN receiving value)" UBYTE COMP_0021_S 1 100 -100 410 ECU_ADDRESS 0xFFFF488E /begin FUNCTION_LIST KF7-360.9M[43] KF7-385.2[18] /end FUNCTION_LIST /end MEASUREMENT
/begin MEASUREMENT wvTQTMSTAC "T/M requirement steady state torque (CAN receiving value)" UBYTE COMP_0021_S 1 100 -100 410 ECU_ADDRESS 0xFFFF477C /begin FUNCTION_LIST KF7-360.9M[43] KF7-360.9P[22] /end FUNCTION_LIST /end MEASUREMENT
/begin MEASUREMENT wvTQTMSTAR "T/M requirement steady state torque (CAN receiving value)" UBYTE COMP_0021_S 1 100 -100 410 ECU_ADDRESS 0xFFFF488F /begin FUNCTION_LIST KF7-360.9M[43] /end FUNCTION_LIST /end MEASUREMENT
/begin MEASUREMENT VSPNG "RAM value VSPNG" UBYTE COMP_0068 1 100 0 255 ECU_ADDRESS 0xFFFF9C6C
 /begin FUNCTION_LIST KF7-376.2[21] KF7-450.14[2] KF7-450.19[4] KF7-500.2A[29] KF7-500.16[4] KF7-525.2[6] /end FUNCTION_LIST
/end MEASUREMENT
/begin MEASUREMENT TPS4NG "RAM value TPS4NG" UBYTE COMP_0068 1 100 0 255 ECU_ADDRESS 0xFFFF9CD2
 /begin FUNCTION_LIST KF7-360.1[12] KF7-500.2A[29] KF7-505.28[1] KF7-525.2[6] KF7-525.2S[10] R000.3.RS_SelfDiagflags_1_1_2 /end FUNCTION_LIST
/end MEASUREMENT
/begin MEASUREMENT RTSPNG "RAM value RTSPNG" UBYTE COMP_0068 1 100 0 255 ECU_ADDRESS 0xFFFF9D02
 /begin FUNCTION_LIST KF7-350.4M[14] KF7-350.4P[13] KF7-410.16M[1] KF7-450.22[1] KF7-500.2A[29] KF7-505.33[8] KF7-525.2[6] KF7-525.2S[10] /end FUNCTION_LIST
/end MEASUREMENT
/begin MEASUREMENT DFLTNG "RAM value DFLTNG" UBYTE COMP_0068 1 100 0 255 ECU_ADDRESS 0xFFFF9D05
 /begin FUNCTION_LIST KF7-350.4M[14] KF7-350.4P[13] KF7-410.16M[1] KF7-450.22[1] KF7-500.2A[29] KF7-505.33[8] KF7-525.2[6] KF7-525.2S[10] /end FUNCTION_LIST
/end MEASUREMENT
/begin MEASUREMENT TANGL "RAM value TANGL" UBYTE COMP_0068 1 100 0 255 ECU_ADDRESS 0xFFFF9D98 /begin FUNCTION_LIST KF7-360.9M[43] KF7-500.2A[29] KF7-500.44[3] /end FUNCTION_LIST /end MEASUREMENT
/begin MEASUREMENT TANGH "RAM value TANGH" UBYTE COMP_0068 1 100 0 255 ECU_ADDRESS 0xFFFF9D9B /begin FUNCTION_LIST KF7-360.9M[43] KF7-500.2A[29] KF7-500.44[3] /end FUNCTION_LIST /end MEASUREMENT
/begin MEASUREMENT TANGR "RAM value TANGR" UBYTE COMP_0068 1 100 0 255 ECU_ADDRESS 0xFFFF9D9E /begin FUNCTION_LIST KF7-360.9M[43] KF7-500.2A[29] KF7-500.44[3] /end FUNCTION_LIST /end MEASUREMENT
/begin MEASUREMENT TP1NGH "RAM value TP1NGH" UBYTE COMP_0068 1 100 0 255 ECU_ADDRESS 0xFFFF9DC5
 /begin FUNCTION_LIST KF7-360.4[14] KF7-450.50[10] KF7-500.2A[29] KF7-505.2[9] KF7-505.33[8] R000.1.RS_Integ_1_10_2 /end FUNCTION_LIST
/end MEASUREMENT
/begin MEASUREMENT TP1NGL "RAM value TP1NGL" UBYTE COMP_0068 1 100 0 255 ECU_ADDRESS 0xFFFF9DC8
 /begin FUNCTION_LIST KF7-360.4[14] KF7-450.50[10] KF7-500.2A[29] KF7-505.2[9] KF7-505.33[8] R000.1.RS_Integ_1_10_2 /end FUNCTION_LIST
/end MEASUREMENT
/begin MEASUREMENT TP2NGH "RAM value TP2NGH" UBYTE COMP_0068 1 100 0 255 ECU_ADDRESS 0xFFFF9DCB
 /begin FUNCTION_LIST KF7-360.4[14] KF7-450.50[10] KF7-500.2A[29] KF7-505.2[9] R000.1.RS_Integ_1_10_2 /end FUNCTION_LIST
/end MEASUREMENT
/begin MEASUREMENT TP2NGL "RAM value TP2NGL" UBYTE COMP_0068 1 100 0 255 ECU_ADDRESS 0xFFFF9DCE
 /begin FUNCTION_LIST KF7-360.4[14] KF7-450.50[10] KF7-500.2A[29] KF7-505.2[9] R000.1.RS_Integ_1_10_2 /end FUNCTION_LIST
/end MEASUREMENT
/begin MEASUREMENT TP12NG "RAM value TP12NG" UBYTE COMP_0068 1 100 0 255 ECU_ADDRESS 0xFFFF9DD1
 /begin FUNCTION_LIST KF7-360.4[14] KF7-450.50[10] KF7-500.2A[29] KF7-505.2[9] KF7-505.33[8] R000.1.RS_Integ_1_10_2 /end FUNCTION_LIST
/end MEASUREMENT
/begin MEASUREMENT vDFLTNG "RAM value vDFLTNG" UWORD COMP_0068 1 100 0 65535 ECU_ADDRESS 0xFFFF9D06
 /begin FUNCTION_LIST KF7-350.4M[14] KF7-350.4P[13] KF7-410.16M[1] KF7-450.22[1] KF7-500.2A[29] KF7-505.33[8] KF7-525.2[6] KF7-525.2S[10] /end FUNCTION_LIST
/end MEASUREMENT
/begin MEASUREMENT vTANGH "RAM value vTANGH" UWORD COMP_0068 1 100 0 65535 ECU_ADDRESS 0xFFFF9D9C /begin FUNCTION_LIST KF7-360.9M[43] KF7-500.2A[29] KF7-500.44[3] /end FUNCTION_LIST /end MEASUREMENT
/begin MEASUREMENT vTP1NGH "RAM value vTP1NGH" UWORD COMP_0068 1 100 0 65535 ECU_ADDRESS 0xFFFF9DC6
 /begin FUNCTION_LIST KF7-360.4[14] KF7-450.50[10] KF7-500.2A[29] KF7-505.2[9] KF7-505.33[8] /end FUNCTION_LIST
/end MEASUREMENT
/begin MEASUREMENT vTP2NGH "RAM value vTP2NGH" UWORD COMP_0068 1 100 0 65535 ECU_ADDRESS 0xFFFF9DCC /begin FUNCTION_LIST KF7-360.4[14] KF7-450.50[10] KF7-500.2A[29] KF7-505.2[9] /end FUNCTION_LIST /end MEASUREMENT
/begin MEASUREMENT vTP12NG "RAM value vTP12NG" UWORD COMP_0068 1 100 0 65535 ECU_ADDRESS 0xFFFF9DD2
 /begin FUNCTION_LIST KF7-360.4[14] KF7-450.50[10] KF7-500.2A[29] KF7-505.2[9] KF7-505.33[8] /end FUNCTION_LIST
/end MEASUREMENT
/begin COMPU_METHOD COMP_0205_S "fixed axis Long" RAT_FUNC "%8.2" "Long" COEFFS 0 1 0 0 0 1 /end COMPU_METHOD
/begin COMPU_METHOD COMP_0290 "1/65536-" RAT_FUNC "%8.6" "-" COEFFS 0 1 0 0 0 0.0000152588 /end COMPU_METHOD
/begin COMPU_METHOD COMP_0068 "1-" RAT_FUNC "%8.2" "-" COEFFS 0 1 0 0 0 1 /end COMPU_METHOD
/begin COMPU_METHOD COMP_0004 "1Å|" RAT_FUNC "%8.2" "Å|" COEFFS 0 1 0 0 0 1 /end COMPU_METHOD
/begin COMPU_METHOD COMP_0023 "5mV" RAT_FUNC "%8.2" "mV" COEFFS 0 1 0 0 0 5 /end COMPU_METHOD
/begin COMPU_METHOD COMP_0045 "1/128-" RAT_FUNC "%8.4" "-" COEFFS 0 1 0 0 0 0.0078125 /end COMPU_METHOD
/begin COMPU_METHOD COMP_0020 "50rpm" RAT_FUNC "%8.2" "rpm" COEFFS 0 1 0 0 0 50 /end COMPU_METHOD
/begin COMPU_METHOD COMP_0003 "1Åé" RAT_FUNC "%8.2" "Åé" COEFFS 0 1 0 0 0 1 /end COMPU_METHOD
/begin COMPU_METHOD COMP_0453 "0.002-" RAT_FUNC "%8.4" "-" COEFFS 0 1 0 0 0 0.002 /end COMPU_METHOD
/begin COMPU_METHOD COMP_0014 "10ms" RAT_FUNC "%8.2" "ms" COEFFS 0 1 0 0 0 10 /end COMPU_METHOD
/begin COMPU_METHOD COMP_0006 "12.5rpm" RAT_FUNC "%8.2" "rpm" COEFFS 0 1 0 0 0 12.5 /end COMPU_METHOD
/begin COMPU_METHOD COMP_0008 "100ms" RAT_FUNC "%8.2" "ms" COEFFS 0 1 0 0 0 100 /end COMPU_METHOD
/begin COMPU_METHOD COMP_0196 "0.1Nm" RAT_FUNC "%8.2" "Nm" COEFFS 0 1 0 0 0 0.1 /end COMPU_METHOD
/begin COMPU_METHOD COMP_0009 "100/128%" RAT_FUNC "%8.2" "%" COEFFS 0 1 0 0 0 0.78125 /end COMPU_METHOD
/begin COMPU_METHOD COMP_0010 "0.003MPa" RAT_FUNC "%8.4" "MPa" COEFFS 0 1 0 0 0 0.003 /end COMPU_METHOD
/begin COMPU_METHOD COMP_0013 "1s" RAT_FUNC "%8.2" "s" COEFFS 0 1 0 0 0 1 /end COMPU_METHOD
/begin COMPU_METHOD COMP_0000 "25rpm" RAT_FUNC "%8.2" "rpm" COEFFS 0 1 0 0 0 25 /end COMPU_METHOD
/begin COMPU_METHOD COMP_0047 "0.5%" RAT_FUNC "%8.2" "%" COEFFS 0 1 0 0 0 0.5 /end COMPU_METHOD
/begin COMPU_METHOD COMP_0163 "1/16%" RAT_FUNC "%8.3" "%" COEFFS 0 1 0 0 0 0.0625 /end COMPU_METHOD
/begin COMPU_METHOD COMP_0339_S "2sec" RAT_FUNC "%8.2" "sec" COEFFS 0 1 0 0 0 2 /end COMPU_METHOD
/begin COMPU_METHOD COMP_0486 "20/256mv" RAT_FUNC "%8.3" "mv" COEFFS 0 1 0 0 0 0.078125 /end COMPU_METHOD
/begin COMPU_METHOD COMP_0014_S "NN" RAT_FUNC "%8.2" "N" COEFFS 0 1 0 0 0 1 /end COMPU_METHOD
/begin COMPU_METHOD COMP_0436 "0.1km/h" RAT_FUNC "%8.2" "km/h" COEFFS 0 1 0 0 0 0.1 /end COMPU_METHOD
/begin COMPU_METHOD COMP_0353 "5mV" RAT_FUNC "%8.2" "mV" COEFFS 0 1 0 0 0 5 /end COMPU_METHOD
/begin COMPU_METHOD COMP_0018 "1deg" RAT_FUNC "%8.2" "deg" COEFFS 0 1 0 0 0 1 /end COMPU_METHOD
/begin COMPU_METHOD COMP_0007 "2km/h" RAT_FUNC "%8.2" "km/h" COEFFS 0 1 0 0 0 2 /end COMPU_METHOD
/begin COMPU_METHOD COMP_0217 "1/16384-" RAT_FUNC "%8.6" "-" COEFFS 0 1 0 0 0 0.0000610352 /end COMPU_METHOD
/begin COMPU_METHOD COMP_0033 "80mV" RAT_FUNC "%8.2" "mV" COEFFS 0 1 0 0 0 80 /end COMPU_METHOD
/begin COMPU_METHOD COMP_0027 "1%" RAT_FUNC "%8.2" "%" COEFFS 0 1 0 0 0 1 /end COMPU_METHOD
/begin COMPU_METHOD COMP_0267_S "0.1sec" RAT_FUNC "%8.2" "sec" COEFFS 0 1 0 0 0 0.1 /end COMPU_METHOD
/begin COMPU_METHOD COMP_0165_S "secsec" RAT_FUNC "%8.3" "sec" COEFFS 0 1 0 0 0 0.01 /end COMPU_METHOD
/begin COMPU_METHOD COMP_0049 "1sec" RAT_FUNC "%8.2" "sec" COEFFS 0 1 0 0 0 1 /end COMPU_METHOD
/begin COMPU_METHOD COMP_0032 "1/256Å|" RAT_FUNC "%8.4" "Å|" COEFFS 0 1 0 0 0 0.00390625 /end COMPU_METHOD
/begin COMPU_METHOD COMP_0063 "1/256-" RAT_FUNC "%8.4" "-" COEFFS 0 1 0 0 0 0.00390625 /end COMPU_METHOD
/begin COMPU_METHOD COMP_0130 "0.0275deg" RAT_FUNC "%8.3" "deg" COEFFS 0 1 0 0 0 0.0275 /end COMPU_METHOD
/begin COMPU_METHOD COMP_0015 "0.125Å|" RAT_FUNC "%8.2" "Å|" COEFFS 0 1 0 0 0 0.125 /end COMPU_METHOD
/begin COMPU_METHOD COMP_0030 "1âÒ" RAT_FUNC "%8.2" "âÒ" COEFFS 0 1 0 0 0 1 /end COMPU_METHOD
/begin COMPU_METHOD COMP_0343_S "0.02Å|" RAT_FUNC "%8.3" "Å|" COEFFS 0 1 0 0 0 0.02 /end COMPU_METHOD
/begin COMPU_METHOD COMP_0443 "1rpm" RAT_FUNC "%8.2" "rpm" COEFFS 0 1 0 0 0 1 /end COMPU_METHOD
/begin COMPU_METHOD COMP_0349_S "4g" RAT_FUNC "%8.2" "g" COEFFS 0 1 0 0 0 4 /end COMPU_METHOD
/begin COMPU_METHOD COMP_0031 "1/256%" RAT_FUNC "%8.4" "%" COEFFS 0 1 0 0 0 0.00390625 /end COMPU_METHOD
/begin COMPU_METHOD COMP_0005 "0.11deg" RAT_FUNC "%8.2" "deg" COEFFS 0 1 0 0 0 0.11 /end COMPU_METHOD
/begin COMPU_METHOD COMP_0016 "1count" RAT_FUNC "%8.2" "count" COEFFS 0 1 0 0 0 1 /end COMPU_METHOD
/begin COMPU_METHOD COMP_0372_S "0.05%" RAT_FUNC "%8.3" "%" COEFFS 0 1 0 0 0 0.05 /end COMPU_METHOD
/begin COMPU_METHOD COMP_0419 "0.1%" RAT_FUNC "%8.2" "%" COEFFS 0 1 0 0 0 0.1 /end COMPU_METHOD
/begin COMPU_METHOD COMP_0373 "1/100-" RAT_FUNC "%8.3" "-" COEFFS 0 1 0 0 0 0.01 /end COMPU_METHOD
/begin COMPU_METHOD COMP_0035 "X-50Åé" RAT_FUNC "%8.2" "Åé" COEFFS 0 1 50 0 0 1 /end COMPU_METHOD
/begin COMPU_METHOD COMP_0228 "0.1Nm" RAT_FUNC "%8.2" "Nm" COEFFS 0 1 0 0 0 0.1 /end COMPU_METHOD
/begin COMPU_METHOD COMP_0038 "0.11deg/10ms" RAT_FUNC "%8.2" "deg/10ms" COEFFS 0 1 0 0 0 0.11 /end COMPU_METHOD
/begin COMPU_METHOD COMP_0390_S "0.1j/mmks" RAT_FUNC "%8.2" "j/mmks" COEFFS 0 1 0 0 0 0.1 /end COMPU_METHOD
/begin COMPU_METHOD COMP_0051 "1L/min" RAT_FUNC "%8.2" "L/min" COEFFS 0 1 0 0 0 1 /end COMPU_METHOD
/begin COMPU_METHOD COMP_0091_S "--" RAT_FUNC "%8.3" "-" COEFFS 0 1 0 0 0 0.05 /end COMPU_METHOD
/begin COMPU_METHOD COMP_0394_S "0.01%/sec" RAT_FUNC "%8.3" "%/sec" COEFFS 0 1 0 0 0 0.01 /end COMPU_METHOD
/begin COMPU_METHOD COMP_0101_S "%%" RAT_FUNC "%8.2" "%" COEFFS 0 1 0 0 0 0.2 /end COMPU_METHOD
/begin COMPU_METHOD COMP_0410 "100/256/256%" RAT_FUNC "%8.4" "%" COEFFS 0 1 0 0 0 0.00152588 /end COMPU_METHOD
/begin COMPU_METHOD COMP_0218_S "1N/100ms" RAT_FUNC "%8.2" "N/100ms" COEFFS 0 1 0 0 0 1 /end COMPU_METHOD
/begin COMPU_METHOD COMP_0219_S "1N/10ms" RAT_FUNC "%8.2" "N/10ms" COEFFS 0 1 0 0 0 1 /end COMPU_METHOD
/begin COMPU_METHOD COMP_0395_S "0.1%/sec" RAT_FUNC "%8.2" "%/sec" COEFFS 0 1 0 0 0 0.1 /end COMPU_METHOD
/begin COMPU_METHOD COMP_0156 "1L" RAT_FUNC "%8.2" "L" COEFFS 0 1 0 0 0 1 /end COMPU_METHOD
/begin COMPU_METHOD COMP_0399_S "0.11/k" RAT_FUNC "%8.2" "1/k" COEFFS 0 1 0 0 0 0.1 /end COMPU_METHOD
/begin COMPU_METHOD COMP_0125 "1/256ms" RAT_FUNC "%8.4" "ms" COEFFS 0 1 0 0 0 0.00390625 /end COMPU_METHOD
/begin COMPU_METHOD COMP_0402_S "40j/mole" RAT_FUNC "%8.2" "j/mole" COEFFS 0 1 0 0 0 40 /end COMPU_METHOD
/begin COMPU_METHOD COMP_0131 "5/256mV" RAT_FUNC "%8.3" "mV" COEFFS 0 1 0 0 0 0.01953125 /end COMPU_METHOD
/begin COMPU_METHOD COMP_0403_S "0.8/256Å|" RAT_FUNC "%8.4" "Å|" COEFFS 0 1 0 0 0 0.00313 /end COMPU_METHOD
/begin COMPU_METHOD COMP_0136 "0.02sec" RAT_FUNC "%8.3" "sec" COEFFS 0 1 0 0 0 0.02 /end COMPU_METHOD
/begin COMPU_METHOD COMP_0277 "1L/min" RAT_FUNC "%8.2" "L/min" COEFFS 0 1 0 0 0 1 /end COMPU_METHOD
/begin COMPU_METHOD COMP_0450 "1/1024-" RAT_FUNC "%8.5" "-" COEFFS 0 1 0 0 0 0.000976563 /end COMPU_METHOD
/begin COMPU_METHOD COMP_0341 "1/256-" RAT_FUNC "%8.4" "-" COEFFS 0 1 0 0 0 0.00391 /end COMPU_METHOD
/begin COMPU_METHOD COMP_0414_S "5/512mV/ms" RAT_FUNC "%8.4" "mV/ms" COEFFS 0 1 0 0 0 0.009765625 /end COMPU_METHOD
/begin COMPU_METHOD COMP_0213_S "0.1Nm/100ms" RAT_FUNC "%8.2" "Nm/100ms" COEFFS 0 1 0 0 0 0.1 /end COMPU_METHOD
/begin COMPU_METHOD COMP_0464 "1/8-" RAT_FUNC "%8.2" "-" COEFFS 0 1 0 0 0 0.125 /end COMPU_METHOD
/begin COMPU_METHOD COMP_0233_S "2^-17A" RAT_FUNC "%8.6" "A" COEFFS 0 1 0 0 0 0.00000762939 /end COMPU_METHOD
/begin COMPU_METHOD COMP_0203 "1/256-" RAT_FUNC "%8.4" "-" COEFFS 0 1 0 0 0 0.00390625 /end COMPU_METHOD
/begin COMPU_METHOD COMP_0238_S "1N/G" RAT_FUNC "%8.2" "N/G" COEFFS 0 1 0 0 0 1 /end COMPU_METHOD
/begin COMPU_METHOD COMP_0432_S "1/256-" RAT_FUNC "%8.4" "-" COEFFS 0 1 0 0 0 0.003906 /end COMPU_METHOD
/begin COMPU_METHOD COMP_0223 "0.0001deg/mV" RAT_FUNC "%8.5" "deg/mV" COEFFS 0 1 0 0 0 0.0001 /end COMPU_METHOD
/begin COMPU_METHOD COMP_0146 "100/256/256%" RAT_FUNC "%8.4" "%" COEFFS 0 1 0 0 0 0.001525879 /end COMPU_METHOD
/begin COMPU_METHOD COMP_0133_S "%%" RAT_FUNC "%8.3" "%" COEFFS 0 1 0 0 0 0.0390625 /end COMPU_METHOD
/begin COMPU_METHOD COMP_0234 "10sec" RAT_FUNC "%8.2" "sec" COEFFS 0 1 0 0 0 10 /end COMPU_METHOD
/begin COMPU_METHOD COMP_0245_S "0.01µ∞—" RAT_FUNC "%8.3" "µ∞—" COEFFS 0 1 0 0 0 0.01 /end COMPU_METHOD
/begin COMPU_METHOD COMP_0202 "10msec" RAT_FUNC "%8.2" "msec" COEFFS 0 1 0 0 0 10 /end COMPU_METHOD
/begin COMPU_METHOD COMP_0263 "1-" RAT_FUNC "%8.2" "-" COEFFS 0 1 0 0 0 1 /end COMPU_METHOD
/begin COMPU_METHOD COMP_0011 "0.02MPa" RAT_FUNC "%8.3" "MPa" COEFFS 0 1 0 0 0 0.02 /end COMPU_METHOD
/begin COMPU_METHOD COMP_0436_S "0.01%" RAT_FUNC "%8.3" "%" COEFFS 0 1 0 0 0 0.01 /end COMPU_METHOD
/begin COMPU_METHOD COMP_0446_S "0.001l/min" RAT_FUNC "%8.4" "l/min" COEFFS 0 1 0 0 0 0.001 /end COMPU_METHOD
/begin COMPU_METHOD COMP_0065 "3.125rpm" RAT_FUNC "%8.2" "rpm" COEFFS 0 1 0 0 0 3.125 /end COMPU_METHOD
/begin COMPU_METHOD COMP_0052 "1/2048ms" RAT_FUNC "%8.5" "ms" COEFFS 0 1 0 0 0 0.000488282 /end COMPU_METHOD
/begin COMPU_METHOD COMP_0276 "4L/min" RAT_FUNC "%8.2" "L/min" COEFFS 0 1 0 0 0 4 /end COMPU_METHOD
/begin COMPU_METHOD COMP_0278 "2L/min" RAT_FUNC "%8.2" "L/min" COEFFS 0 1 0 0 0 2 /end COMPU_METHOD
/begin COMPU_METHOD COMP_0452_S "0.001Nm/rpm/1" RAT_FUNC "%8.4" "Nm/rpm/1" COEFFS 0 1 0 0 0 0.001 /end COMPU_METHOD
/begin COMPU_METHOD COMP_0453_S "0.001Nm/rpm" RAT_FUNC "%8.4" "Nm/rpm" COEFFS 0 1 0 0 0 0.001 /end COMPU_METHOD
/begin COMPU_METHOD COMP_0454_S "0.78125rpm" RAT_FUNC "%8.2" "rpm" COEFFS 0 1 0 0 0 0.78125 /end COMPU_METHOD
/begin COMPU_METHOD COMP_0455_S "0.78125rpm/100m" RAT_FUNC "%8.2" "rpm/100m" COEFFS 0 1 0 0 0 0.78125 /end COMPU_METHOD
/begin COMPU_METHOD COMP_0193 "0.1Nm/10ms" RAT_FUNC "%8.2" "Nm/10ms" COEFFS 0 1 0 0 0 0.1 /end COMPU_METHOD
/begin COMPU_METHOD COMP_0030_S "NN" RAT_FUNC "%8.2" "N" COEFFS 0 1 0 0 0 1 /end COMPU_METHOD
/begin COMPU_METHOD COMP_0462_S "0.001m^2" RAT_FUNC "%8.4" "m^2" COEFFS 0 1 0 0 0 0.001 /end COMPU_METHOD
/begin COMPU_METHOD COMP_0257_S "1Nm/km_h/" RAT_FUNC "%8.2" "Nm/km_h/" COEFFS 0 1 0 0 0 1 /end COMPU_METHOD
/begin COMPU_METHOD COMP_0258_S "1Nm/km_h" RAT_FUNC "%8.2" "Nm/km_h" COEFFS 0 1 0 0 0 1 /end COMPU_METHOD
/begin COMPU_METHOD COMP_0176_S "NmNm" RAT_FUNC "%8.3" "Nm" COEFFS 0 1 0 0 0 0.01 /end COMPU_METHOD
/begin COMPU_METHOD COMP_0466_S "0.03kmole/j" RAT_FUNC "%8.3" "kmole/j" COEFFS 0 1 0 0 0 0.03 /end COMPU_METHOD
/begin COMPU_METHOD COMP_0315 "0.09765%/ms" RAT_FUNC "%8.3" "%/ms" COEFFS 0 1 0 0 0 0.09765 /end COMPU_METHOD
/begin COMPU_METHOD COMP_0144 "1/2048ms" RAT_FUNC "%8.5" "ms" COEFFS 0 1 0 0 0 0.000488281 /end COMPU_METHOD
/begin COMPU_METHOD COMP_0500 "0.0275deg" RAT_FUNC "%8.3" "deg" COEFFS 0 1 0 0 0 0.0275 /end COMPU_METHOD
/begin COMPU_METHOD COMP_0360 "2Km/h" RAT_FUNC "%8.2" "Km/h" COEFFS 0 1 0 0 0 2 /end COMPU_METHOD
/begin COMPU_METHOD COMP_0480_S "1/0.11/256N/deg" RAT_FUNC "%8.3" "N/deg" COEFFS 0 1 0 0 0 0.035511363 /end COMPU_METHOD
/begin COMPU_METHOD COMP_0481_S "1/0.1/256N/km_h" RAT_FUNC "%8.3" "N/km_h" COEFFS 0 1 0 0 0 0.0390625 /end COMPU_METHOD
/begin COMPU_METHOD COMP_0123_S "NN" RAT_FUNC "%8.2" "N" COEFFS 0 1 32768 0 0 1 /end COMPU_METHOD
/begin COMPU_METHOD COMP_0226 "0.1Nm" RAT_FUNC "%8.2" "Nm" COEFFS 0 1 3276.8 0 0 0.1 /end COMPU_METHOD
/begin COMPU_METHOD COMP_0273_S "fixed axis rpm" RAT_FUNC "%8.2" "rpm" COEFFS 0 1 -400 0 0 400 /end COMPU_METHOD
/begin COMPU_METHOD COMP_0276_S "fixed axis -" RAT_FUNC "%8.2" "-" COEFFS 0 1 -1 0 0 1 /end COMPU_METHOD
/begin COMPU_METHOD COMP_0487_S "1/65536-" RAT_FUNC "%8.6" "-" COEFFS 0 1 0 0 0 0.000015258 /end COMPU_METHOD
/begin COMPU_METHOD COMP_0488_S "1/131072-" RAT_FUNC "%8.6" "-" COEFFS 0 1 0 0 0 0.000007629 /end COMPU_METHOD
/begin COMPU_METHOD COMP_0489_S "1/4096-" RAT_FUNC "%8.5" "-" COEFFS 0 1 0 0 0 0.00024414 /end COMPU_METHOD
/begin COMPU_METHOD COMP_0042 "0.0008cm**2" RAT_FUNC "%8.5" "cm**2" COEFFS 0 1 0 0 0 0.0008 /end COMPU_METHOD
/begin COMPU_METHOD COMP_0272_S "fixed axis deg" RAT_FUNC "%8.2" "deg" COEFFS 0 1 0 0 0 5.6 /end COMPU_METHOD
/begin COMPU_METHOD COMP_0268_S "fixed axis km/h" RAT_FUNC "%8.2" "km/h" COEFFS 0 1 0 0 0 8 /end COMPU_METHOD
/begin COMPU_METHOD COMP_0283_S "fixed axis rpm" RAT_FUNC "%8.2" "rpm" COEFFS 0 1 0 0 0 200 /end COMPU_METHOD
/begin COMPU_METHOD COMP_0246 "100/16%" RAT_FUNC "%8.2" "%" COEFFS 0 1 0 0 0 6.25 /end COMPU_METHOD
/begin COMPU_METHOD COMP_0509_S "0.5/256-" RAT_FUNC "%8.4" "-" COEFFS 0 1 0 0 0 0.00195 /end COMPU_METHOD
/begin COMPU_METHOD COMP_0122_S "msms" RAT_FUNC "%8.2" "ms" COEFFS 0 1 0 0 0 2 /end COMPU_METHOD
/begin COMPU_METHOD COMP_0513_S "0.05%/sec" RAT_FUNC "%8.3" "%/sec" COEFFS 0 1 6.4 0 0 0.05 /end COMPU_METHOD
/begin COMPU_METHOD COMP_0311 "64us" RAT_FUNC "%8.2" "us" COEFFS 0 1 0 0 0 64 /end COMPU_METHOD
/begin COMPU_METHOD COMP_0092_S "--" RAT_FUNC "%8.3" "-" COEFFS 0 1 0 0 0 0.02 /end COMPU_METHOD
/begin COMPU_METHOD COMP_0034 "64/256%" RAT_FUNC "%8.2" "%" COEFFS 0 1 0 0 0 0.25 /end COMPU_METHOD
/begin COMPU_METHOD COMP_0281_S "fixed axis -" RAT_FUNC "%8.2" "-" COEFFS 0 1 0 0 0 0.25 /end COMPU_METHOD
/begin COMPU_METHOD COMP_0529_S "0.3575deg" RAT_FUNC "%8.2" "deg" COEFFS 0 1 0 0 0 0.3575 /end COMPU_METHOD
/begin COMPU_METHOD COMP_0331_S "1/256G" RAT_FUNC "%8.4" "G" COEFFS 0 1 0.5 0 0 0.00390625 /end COMPU_METHOD
/begin COMPU_METHOD COMP_0332_S "fixed axis Km/h" RAT_FUNC "%8.2" "Km/h" COEFFS 0 1 0 0 0 25.6 /end COMPU_METHOD
/begin COMPU_METHOD COMP_0283 "1flag" RAT_FUNC "%8.2" "flag" COEFFS 0 1 0 0 0 1 /end COMPU_METHOD
/begin COMPU_METHOD COMP_0091 "Ã◊∏ﬁÃ◊∏ﬁ" RAT_FUNC "%8.2" "Ã◊∏ﬁ" COEFFS 0 1 0 0 0 1 /end COMPU_METHOD
/begin COMPU_METHOD COMP_0201_S "1s1s" RAT_FUNC "%8.2" "1s" COEFFS 0 1 0 0 0 1 /end COMPU_METHOD
/begin COMPU_METHOD COMP_0202_S "100ms100ms" RAT_FUNC "%8.2" "100ms" COEFFS 0 1 0 0 0 1 /end COMPU_METHOD
/begin COMPU_METHOD COMP_0203_S "10ms10ms" RAT_FUNC "%8.2" "10ms" COEFFS 0 1 0 0 0 1 /end COMPU_METHOD
/begin COMPU_METHOD COMP_0378 "100/255%" RAT_FUNC "%8.2" "%" COEFFS 0 1 0 0 0 0.392156863 /end COMPU_METHOD
/begin COMPU_METHOD COMP_0534_S "%%" RAT_FUNC "%8.3" "%" COEFFS 0 1 0 0 0 0.025 /end COMPU_METHOD
/begin COMPU_METHOD COMP_0242 "1/256%" RAT_FUNC "%8.4" "%" COEFFS 0 1 0 0 0 0.00391 /end COMPU_METHOD
/begin COMPU_METHOD COMP_0264 "1Å|" RAT_FUNC "%8.2" "Å|" COEFFS 0 1 0 0 0 1 /end COMPU_METHOD
/begin COMPU_METHOD COMP_0269 "0.5/256%" RAT_FUNC "%8.4" "%" COEFFS 0 1 0 0 0 0.001953125 /end COMPU_METHOD
/begin COMPU_METHOD COMP_0021_S "NmNm" RAT_FUNC "%8.2" "Nm" COEFFS 0 1 100 0 0 2 /end COMPU_METHOD
/begin COMPU_METHOD COMP_0556_S "%%" RAT_FUNC "%8.3" "%" COEFFS 0 1 0 0 0 0.078125 /end COMPU_METHOD
/begin COMPU_METHOD COMP_0557_S "ÇçÇñÇçÇñ" RAT_FUNC "%8.3" "ÇçÇñ" COEFFS 0 1 0 0 0 0.078125 /end COMPU_METHOD
/begin COMPU_METHOD COMP_0039 "--" RAT_FUNC "%8.2" "-" COEFFS 0 1 0 0 0 0.11 /end COMPU_METHOD
/begin COMPU_METHOD COMP_0559_S "kk" RAT_FUNC "%8.2" "k" COEFFS 0 1 0 0 0 1 /end COMPU_METHOD
/begin COMPU_METHOD COMP_0560_S "--" RAT_FUNC "%8.5" "-" COEFFS 0 1 0 0 0 0.000244 /end COMPU_METHOD
/begin COMPU_METHOD COMP_0566_S "%%" RAT_FUNC "%8.5" "%" COEFFS 0 1 0 0 0 0.000976563 /end COMPU_METHOD
/begin COMPU_METHOD COMP_0568_S "%%" RAT_FUNC "%8.5" "%" COEFFS 0 1 0 0 0 0.0009766 /end COMPU_METHOD
/begin COMPU_METHOD COMP_0571_S "g/secg/sec" RAT_FUNC "%8.4" "g/sec" COEFFS 0 1 0 0 0 0.003906 /end COMPU_METHOD
/begin COMPU_METHOD COMP_0402 "1/65535-" RAT_FUNC "%8.6" "-" COEFFS 0 1 0 0 0 0.000015259 /end COMPU_METHOD
/begin COMPU_METHOD COMP_0028 "1/(100*256)-" RAT_FUNC "%8.6" "-" COEFFS 0 1 0 0 0 0.0000390625 /end COMPU_METHOD
/begin COMPU_METHOD COMP_0518 "2Nm" RAT_FUNC "%8.2" "Nm" COEFFS 0 1 0 0 0 2 /end COMPU_METHOD
/begin COMPU_METHOD COMP_0416 "8us" RAT_FUNC "%8.2" "us" COEFFS 0 1 0 0 0 8 /end COMPU_METHOD
/begin COMPU_METHOD COMP_0160 "2/65536L" RAT_FUNC "%8.6" "L" COEFFS 0 1 0 0 0 0.0000305176 /end COMPU_METHOD
/begin COMPU_METHOD COMP_0079_S "GG" RAT_FUNC "%8.4" "G" COEFFS 0 1 32.768 0 0 0.001 /end COMPU_METHOD
/begin COMPU_METHOD COMP_0080_S "GG" RAT_FUNC "%8.4" "G" COEFFS 0 1 0 0 0 0.001 /end COMPU_METHOD
/begin COMPU_METHOD COMP_0596_S "GG" RAT_FUNC "%8.6" "G" COEFFS 0 1 32.7680234881024 0 0 0.0000000152588 /end COMPU_METHOD
/begin COMPU_METHOD COMP_0599_S "km/hkm/h" RAT_FUNC "%8.6" "km/h" COEFFS 0 1 0 0 0 0.00000152588 /end COMPU_METHOD
/begin COMPU_METHOD COMP_0178_S "Å|Å|" RAT_FUNC "%8.6" "Å|" COEFFS 0 1 0 0 0 0.000003815 /end COMPU_METHOD
/begin COMPU_METHOD COMP_0600_S "AA" RAT_FUNC "%8.6" "A" COEFFS 0 1 0 0 0 0.000007629 /end COMPU_METHOD
/begin COMPU_METHOD COMP_0104_S "AA" RAT_FUNC "%8.5" "A" COEFFS 0 1 0 0 0 0.000488281 /end COMPU_METHOD
/begin COMPU_METHOD COMP_0177_S "--" RAT_FUNC "%8.6" "-" COEFFS 0 1 0 0 0 0.000003815 /end COMPU_METHOD
/begin COMPU_METHOD COMP_0106_S "L/minL/min" RAT_FUNC "%8.4" "L/min" COEFFS 0 1 0 0 0 0.00390625 /end COMPU_METHOD
/begin COMPU_METHOD COMP_0602_S "L/minL/min" RAT_FUNC "%8.6" "L/min" COEFFS 0 1 0 0 0 0.0000152588 /end COMPU_METHOD
/begin COMPU_METHOD COMP_0121_S "GG" RAT_FUNC "%8.4" "G" COEFFS 0 1 0 0 0 0.00390625 /end COMPU_METHOD
/begin COMPU_METHOD COMP_0606_S "%/100ms%/100ms" RAT_FUNC "%8.5" "%/100ms" COEFFS 0 1 0 0 0 0.0009766 /end COMPU_METHOD
/begin COMPU_METHOD COMP_0612_S "--" RAT_FUNC "%8.4" "-" COEFFS 0 1 0 0 0 0.001953 /end COMPU_METHOD
/begin COMPU_METHOD COMP_0613_S "--" RAT_FUNC "%8.4" "-" COEFFS 0 1 0 0 0 0.001953125 /end COMPU_METHOD
/begin COMPU_METHOD COMP_0349 "1.6Nm" RAT_FUNC "%8.2" "Nm" COEFFS 0 1 0 0 0 1.6 /end COMPU_METHOD
/begin COMPU_METHOD COMP_0630_S "Å|Å|" RAT_FUNC "%8.6" "Å|" COEFFS 0 1 0 0 0 0.000000119211 /end COMPU_METHOD
/begin COMPU_METHOD COMP_0631_S "%%" RAT_FUNC "%8.4" "%" COEFFS 0 1 0 0 0 0.003906 /end COMPU_METHOD
/begin COMPU_METHOD COMP_0164_S "degdeg" RAT_FUNC "%8.4" "deg" COEFFS 0 1 14.08205 0 0 0.00171875 /end COMPU_METHOD
/begin COMPU_METHOD COMP_0168_S "degdeg" RAT_FUNC "%8.4" "deg" COEFFS 0 1 0 0 0 0.00171875 /end COMPU_METHOD
/begin COMPU_METHOD COMP_0179_S "degdeg" RAT_FUNC "%8.6" "deg" COEFFS 0 1 0 0 0 0.000000954 /end COMPU_METHOD
/* RECORD_LAYOUT ------------------------------------------------------ */
/begin RECORD_LAYOUT REC_UBYTE_C FNC_VALUES 1 UBYTE COLUMN_DIR DIRECT /end RECORD_LAYOUT
/begin RECORD_LAYOUT REC_UWORD_C FNC_VALUES 1 UWORD COLUMN_DIR DIRECT /end RECORD_LAYOUT
/begin RECORD_LAYOUT REC_SWORD_C FNC_VALUES 1 SWORD COLUMN_DIR DIRECT /end RECORD_LAYOUT
/begin RECORD_LAYOUT REC_SBYTE_C FNC_VALUES 1 SBYTE COLUMN_DIR DIRECT /end RECORD_LAYOUT
/begin RECORD_LAYOUT REC_ULONG_C FNC_VALUES 1 ULONG COLUMN_DIR DIRECT /end RECORD_LAYOUT
/begin RECORD_LAYOUT REC_AXIS_UBYTE AXIS_PTS_X 1 UBYTE INDEX_INCR DIRECT /end RECORD_LAYOUT
/begin RECORD_LAYOUT REC_AXIS_UWORD AXIS_PTS_X 1 UWORD INDEX_INCR DIRECT /end RECORD_LAYOUT
/end MODULE
/end PROJECT
