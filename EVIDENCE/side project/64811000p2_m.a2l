ASAP2_VERSION 1 3_BETA
/begin PROJECT TK_X91_EUR_VC ""
/begin HEADER "" /* key HEADER ++ "comment" Ç… Par.scomment */ PROJECT_NO TK_X91_EUR_VC /* key PROJECT_NO ++ project number Ç… car_eng_desti_lot */ VERSION "7V4YHZEB2" /* key VERSION ++ version number Ç… mProgver */ /end HEADER
/begin MODULE DIM ""
/begin MOD_COMMON "" DEPOSIT ABSOLUTE BYTE_ORDER MSB_FIRST /* ﬁ≤ƒµ∞¿ﬁ∞Ç™ÿÃﬂ⁄∞ΩÇ≥ÇÍÇÈ */ /end MOD_COMMON
/begin FUNCTION KF7-376.4[4] "Output control for air conditioner cut signals" /end FUNCTION
/begin FUNCTION KF7-377.1A[19] "Control of electric radiator fan" /end FUNCTION
/begin FUNCTION KF7-378.2B[6] "Control of rear O2 sensor heater (duty type)" /end FUNCTION
/begin FUNCTION KF7-378.3B[5] "Control of front UEGO sensor heater (internal resistance F/B type)" /end FUNCTION
/begin FUNCTION KF7-379.1[9] "Knock detection" /end FUNCTION
/begin FUNCTION KF7-379.2[1] "Judgment of knock control area" /end FUNCTION
/begin FUNCTION KF7-379.3[3] "High-octane gasoline/regular gasoline judgment" /end FUNCTION
/begin FUNCTION KF7-379.4[1] "Knock control learning value" /end FUNCTION
/begin FUNCTION KF7-379.5[3] "Judgment value of knock control" /end FUNCTION
/begin FUNCTION KF7-379.6[N] "Knock control parameter monitor" /end FUNCTION
/begin FUNCTION KF7-381.9[2] "Prohibition of self-diagnosis during TCS/VDC operation" /end FUNCTION
/begin FUNCTION KF7-385.1[32] "Common control of DUETTE control" /end FUNCTION
/begin FUNCTION KF7-385.2[18] "DUETTE control for normal AT" /end FUNCTION
/begin FUNCTION KF7-385.3[4] "DUETTE control for CVT" /end FUNCTION
/begin FUNCTION KF7-386.1[4] "Engine torque value estimation calculation " /end FUNCTION
/begin FUNCTION KF7-386.2[4] "Engine torque estimation calculation (Equivalent to no DUETTE torque down correction)" /end FUNCTION
/begin FUNCTION KF7-386.3[8] "Auxiliary equipment load torque calculation " /end FUNCTION
/begin FUNCTION KF7-390.1A[3] "Composition of requirements on torque correction (ignition: for MPI)" /end FUNCTION
/begin FUNCTION KF7-390.2[N] "Composition of requirements on torque correction (fuel)" /end FUNCTION
/begin FUNCTION KF7-390.3A[15] "Calculation of torque correction volume(for MPI)" /end FUNCTION
/begin FUNCTION KF7-393.1C[8] "C-VTC control (hall IC crank angle sensor (for C-VTC))" /end FUNCTION
/begin FUNCTION KF7-395.1[4] "Variable intake value control" /end FUNCTION
/begin FUNCTION KF7-400.1[1] "Control designated for VCC non-adjustment" /end FUNCTION
/begin FUNCTION KF7-400.2[N] "Initialization process for control designated for VCC non-adjustment " /end FUNCTION
/begin FUNCTION KF7-400.3[N] "KVCC checking " /end FUNCTION
/begin FUNCTION KF7-400.5[3] "A/D conversion value correction calculation 2" /end FUNCTION
/begin FUNCTION KF7-410.3[N] "Driving style analysis" /end FUNCTION
/begin FUNCTION KF7-410.10[6] "CAN Interpretation " /end FUNCTION
/begin FUNCTION KF7-410.11M[4] "MIN/MAX Available Torque Calculation" /end FUNCTION
/begin FUNCTION KF7-410.11P[4] "MIN/MAX Available Torque Calculation (sub)" /end FUNCTION
/begin FUNCTION KF7-410.12[2] "FAST torque injection cut off" /end FUNCTION
/begin FUNCTION KF7-410.16M[1] "Limphome Powertrain Setpoint" /end FUNCTION
/begin FUNCTION KF7-410.17M[5] "PTD ETD Interface ( D2 Block )" /end FUNCTION
/begin FUNCTION KF7-410.17P[1] "PTD ETD Interface ( D2 Block ) (sub)" /end FUNCTION
/begin FUNCTION KF7-410.19[2] "Conversion of Target Driving Force for AT CVT Communication" /end FUNCTION
/begin FUNCTION KF7-410.20[N] "Open degree indication for AT on ASCD activation" /end FUNCTION
/begin FUNCTION KF7-410.21[3] "Dependability of ETS / ENG Exchange" /end FUNCTION
/begin FUNCTION KF7-450.1[N] "Control when fuel system integration is failed" /end FUNCTION
/begin FUNCTION KF7-450.2[1] "Control when duel system integration is failed " /end FUNCTION
/begin FUNCTION KF7-450.3[1] "Control when air system integration is failed " /end FUNCTION
/begin FUNCTION KF7-450.4[1] "Control when ignition system integration is failed " /end FUNCTION
/begin FUNCTION KF7-450.5[1] "Control when air flow meter is failed " /end FUNCTION
/begin FUNCTION KF7-450.7[2] "Control when throttle sensor is failed" /end FUNCTION
/begin FUNCTION KF7-450.8[2] "Control when coolant temperature sensor is failed " /end FUNCTION
/begin FUNCTION KF7-450.9A[5] "Control when crank angle sensor is failed (hall crank angle sensor)" /end FUNCTION
/begin FUNCTION KF7-450.14[2] "Control when vehicle speed sensor is failed " /end FUNCTION
/begin FUNCTION KF7-450.19[4] "Break switch fail safe" /end FUNCTION
/begin FUNCTION KF7-450.20[2] "Control when knock sensor is failed " /end FUNCTION
/begin FUNCTION KF7-450.22[1] "Fail safe for AT communication line designated for CAN" /end FUNCTION
/begin CHARACTERISTIC mMKLMRTH "KLMRT map high-octane" MAP 0x0000CB9F REC_UBYTE_C 0 COMP_0017 0 255
 /begin AXIS_DESCR FIX_AXIS NO_INPUT_QUANTITY COMP_0205_S 3 0 2 FIX_AXIS_PAR_DIST 0 1 3 /end AXIS_DESCR
 /begin AXIS_DESCR FIX_AXIS NO_INPUT_QUANTITY COMP_0205_S 3 0 2 FIX_AXIS_PAR_DIST 0 1 3 /end AXIS_DESCR
 /begin FUNCTION_LIST KF7-379.5[3] /end FUNCTION_LIST
/end CHARACTERISTIC
/begin CHARACTERISTIC mMKLMRTR "KLMRT map regular" MAP 0x0000CBA8 REC_UBYTE_C 0 COMP_0017 0 255
 /begin AXIS_DESCR FIX_AXIS NO_INPUT_QUANTITY COMP_0205_S 3 0 2 FIX_AXIS_PAR_DIST 0 1 3 /end AXIS_DESCR
 /begin AXIS_DESCR FIX_AXIS NO_INPUT_QUANTITY COMP_0205_S 3 0 2 FIX_AXIS_PAR_DIST 0 1 3 /end AXIS_DESCR
 /begin FUNCTION_LIST KF7-379.5[3] /end FUNCTION_LIST
/end CHARACTERISTIC
/begin CHARACTERISTIC mRPACLVH "A vehicle speed upper limit for the urgent pushing judgement" CURVE 0x0000CCA8 REC_UBYTE_C 0 COMP_0429 0 255
 /begin AXIS_DESCR FIX_AXIS NO_INPUT_QUANTITY COMP_0205_S 5 0 4 FIX_AXIS_PAR_DIST 0 1 5 /end AXIS_DESCR
 /begin FUNCTION_LIST KF7-385.1[32] /end FUNCTION_LIST
/end CHARACTERISTIC
/begin CHARACTERISTIC mRPACLVHM "A vehicle speed upper limit (for the M mode) for the urgent pushing judgement" CURVE 0x0000CCAD REC_UBYTE_C 0 COMP_0429 0 255
 /begin AXIS_DESCR FIX_AXIS NO_INPUT_QUANTITY COMP_0205_S 5 0 4 FIX_AXIS_PAR_DIST 0 1 5 /end AXIS_DESCR
 /begin FUNCTION_LIST KF7-385.1[32] /end FUNCTION_LIST
/end CHARACTERISTIC
/begin CHARACTERISTIC mRPACLVL "A vehicle speed lower limit for the urgent pushing judgement" CURVE 0x0000CCB2 REC_UBYTE_C 0 COMP_0429 0 255
 /begin AXIS_DESCR FIX_AXIS NO_INPUT_QUANTITY COMP_0205_S 5 0 4 FIX_AXIS_PAR_DIST 0 1 5 /end AXIS_DESCR
 /begin FUNCTION_LIST KF7-385.1[32] /end FUNCTION_LIST
/end CHARACTERISTIC
/begin CHARACTERISTIC mRPACLVLM "A vehicle speed lower limit (for the M mode) for the urgent pushing judgement" CURVE 0x0000CCB7 REC_UBYTE_C 0 COMP_0429 0 255
 /begin AXIS_DESCR FIX_AXIS NO_INPUT_QUANTITY COMP_0205_S 5 0 4 FIX_AXIS_PAR_DIST 0 1 5 /end AXIS_DESCR
 /begin FUNCTION_LIST KF7-385.1[32] /end FUNCTION_LIST
/end CHARACTERISTIC
/begin CHARACTERISTIC mAFBTP "AFM backup TP" CURVE 0x000097EA REC_UBYTE_C 0 COMP_0001 0 31.875
 /begin AXIS_DESCR FIX_AXIS NO_INPUT_QUANTITY COMP_0205_S 12 0 11 FIX_AXIS_PAR_DIST 0 1 12 /end AXIS_DESCR
 /begin FUNCTION_LIST KF7-450.5[1] /end FUNCTION_LIST
/end CHARACTERISTIC
/begin CHARACTERISTIC mACADLY "A delay for the A/C compensation timing adjustment" VALUE 0x000081C0 REC_UBYTE_C 0 COMP_0004 0 255 /begin FUNCTION_LIST KF7-390.3A[15] /end FUNCTION_LIST /end CHARACTERISTIC
/begin CHARACTERISTIC mADDBTIM "Dizzer addition start delay" VALUE 0x000081F0 REC_UBYTE_C 0 COMP_0014 0 2550 /begin FUNCTION_LIST KF7-393.1C[8] /end FUNCTION_LIST /end CHARACTERISTIC
/begin CHARACTERISTIC mADLOCK "Urgent slowdown torque compensation setup value" VALUE 0x000081F3 REC_UBYTE_C 0 COMP_0009 0 199.21875 /begin FUNCTION_LIST KF7-385.1[32] /end FUNCTION_LIST /end CHARACTERISTIC
/begin CHARACTERISTIC mADVDLY "BETAA, BETAB computed delay" VALUE 0x000081F6 REC_UBYTE_C 0 COMP_0008 0 25500 /begin FUNCTION_LIST KF7-379.4[1] /end FUNCTION_LIST /end CHARACTERISTIC
/begin CHARACTERISTIC mADVFAL "At the time of the knock sensor trouble, BETA" VALUE 0x00008187 REC_SBYTE_C 0 COMP_0018 -128 127 /begin FUNCTION_LIST KF7-379.5[3] KF7-450.20[2] /end FUNCTION_LIST /end CHARACTERISTIC
/begin CHARACTERISTIC mADVN1 "KLMRT rotation lattice Low" VALUE 0x000081FC REC_UBYTE_C 0 COMP_0020 0 12750 /begin FUNCTION_LIST KF7-379.5[3] /end FUNCTION_LIST /end CHARACTERISTIC
/begin CHARACTERISTIC mADVN2 "KLMRT rotation lattice High" VALUE 0x000081FD REC_UBYTE_C 0 COMP_0020 0 12750 /begin FUNCTION_LIST KF7-379.5[3] /end FUNCTION_LIST /end CHARACTERISTIC
/begin CHARACTERISTIC mADVNEH "ADV F/B Start bias speed (upper limit value)" VALUE 0x000081FE REC_UBYTE_C 0 COMP_0006 0 3187.5 /begin FUNCTION_LIST KF7-390.3A[15] /end FUNCTION_LIST /end CHARACTERISTIC
/begin CHARACTERISTIC mADVNEL "ADV F/B Start bias speed" VALUE 0x000081FF REC_UBYTE_C 0 COMP_0006 0 3187.5 /begin FUNCTION_LIST KF7-390.3A[15] /end FUNCTION_LIST /end CHARACTERISTIC
/begin CHARACTERISTIC mADVSTDLY "ADV F/B Start delay (After it starts.)" VALUE 0x00008200 REC_UBYTE_C 0 COMP_0008 0 25500 /begin FUNCTION_LIST KF7-390.3A[15] /end FUNCTION_LIST /end CHARACTERISTIC
/begin CHARACTERISTIC mADVTP1 "KLMRT basic pulse width lattice Low" VALUE 0x00008201 REC_UBYTE_C 0 COMP_0001 0 31.875 /begin FUNCTION_LIST KF7-379.5[3] /end FUNCTION_LIST /end CHARACTERISTIC
/begin CHARACTERISTIC mADVTP2 "KLMRT basic pulse width lattice High" VALUE 0x00008202 REC_UBYTE_C 0 COMP_0001 0 31.875 /begin FUNCTION_LIST KF7-379.5[3] /end FUNCTION_LIST /end CHARACTERISTIC
/begin CHARACTERISTIC mADVWA "A BETAA weight coefficient for BETAC" VALUE 0x00008205 REC_UBYTE_C 0 COMP_0021 0 99.609375 /begin FUNCTION_LIST KF7-379.4[1] /end FUNCTION_LIST /end CHARACTERISTIC
/begin CHARACTERISTIC mADVWB "A BETAB weight coefficient for BETAC" VALUE 0x00008206 REC_UBYTE_C 0 COMP_0021 0 99.609375 /begin FUNCTION_LIST KF7-379.4[1] /end FUNCTION_LIST /end CHARACTERISTIC
/begin CHARACTERISTIC mAFHCTDD "A/F sensor heater control permission judgement delay 1" VALUE 0x00008217 REC_UBYTE_C 0 COMP_0013 0 255 /begin FUNCTION_LIST KF7-378.3B[5] R301.18.VB_short_Protection_1_0_2 /end FUNCTION_LIST /end CHARACTERISTIC
/begin CHARACTERISTIC mAPOTIM "IDLE After SW turns it off, continuous progress time" VALUE 0x0000827F REC_UBYTE_C 0 COMP_0014 0 2550 /begin FUNCTION_LIST KF7-385.1[32] /end FUNCTION_LIST /end CHARACTERISTIC
/begin CHARACTERISTIC mAPOTIMM "IDLE After SW turns it off, continuous progress time (for the M mode)" VALUE 0x00008280 REC_UBYTE_C 0 COMP_0014 0 2550 /begin FUNCTION_LIST KF7-385.1[32] /end FUNCTION_LIST /end CHARACTERISTIC
/begin CHARACTERISTIC mATMODNE "Fuel cut prohibition region speed" VALUE 0x00008292 REC_UBYTE_C 0 COMP_0000 0 6375 /begin FUNCTION_LIST KF7-385.2[18] R301.1.Torque_realization_1_0_3 /end FUNCTION_LIST /end CHARACTERISTIC
/begin CHARACTERISTIC mATMODVAP "Fuel cut prohibition region limit" VALUE 0x00009086 REC_UWORD_C 0 COMP_0005 0 7208.85 /begin FUNCTION_LIST KF7-385.2[18] R301.1.Torque_realization_1_0_3 /end FUNCTION_LIST /end CHARACTERISTIC
/begin CHARACTERISTIC mBASANG "VTC maximum-retard degree reference angle" VALUE 0x000082A5 REC_UBYTE_C 0 COMP_0048 0 127.5 /begin FUNCTION_LIST KF7-393.1C[8] KF7-500.6D[9] KF7-500.47B[15] /end FUNCTION_LIST /end CHARACTERISTIC
/begin CHARACTERISTIC mBASANGL "VTC reference angle (the left bank)" VALUE 0x000082AA REC_UBYTE_C 0 COMP_0048 0 127.5 /begin FUNCTION_LIST KF7-393.1C[8] KF7-500.6D[9] KF7-500.47B[15] /end FUNCTION_LIST /end CHARACTERISTIC
/begin CHARACTERISTIC mBRKFLSL "APS open-degree threshold" VALUE 0x0000908E REC_UWORD_C 0 COMP_0005 0 7208.85 /begin FUNCTION_LIST KF7-450.19[4] /end FUNCTION_LIST /end CHARACTERISTIC
/begin CHARACTERISTIC mBRKFSVSP "Failsafe operation vehicle speed" VALUE 0x000082C9 REC_UBYTE_C 0 COMP_0007 0 510 /begin FUNCTION_LIST KF7-450.19[4] /end FUNCTION_LIST /end CHARACTERISTIC
/begin CHARACTERISTIC mCHNMODE1 "Heater control mode 1 switchover judgement time" VALUE 0x00008317 REC_UBYTE_C 0 COMP_0013 0 255 /begin FUNCTION_LIST KF7-378.3B[5] /end FUNCTION_LIST /end CHARACTERISTIC
/begin CHARACTERISTIC mCSBDLY "POS backup control start delay" VALUE 0x0000836F REC_UBYTE_C 0 COMP_0008 0 25500 /begin FUNCTION_LIST KF7-450.9A[5] /end FUNCTION_LIST /end CHARACTERISTIC
/begin CHARACTERISTIC mCSOFS "REF position compensation value" VALUE 0x00008384 REC_UBYTE_C 0 COMP_0017 0 255 /begin FUNCTION_LIST KF7-450.9A[5] /end FUNCTION_LIST /end CHARACTERISTIC
/begin CHARACTERISTIC mCTRQQ "Air torque response model coefficient" VALUE 0x0000838E REC_UBYTE_C 0 COMP_0032 0 0.99609375 /begin FUNCTION_LIST KF7-390.3A[15] /end FUNCTION_LIST /end CHARACTERISTIC
/begin CHARACTERISTIC mCVTTDUS "CVT torque going down rate decrease rate" VALUE 0x000090DA REC_UWORD_C 0 COMP_0383_S 0 0.999985458 /begin FUNCTION_LIST KF7-385.2[18] /end FUNCTION_LIST /end CHARACTERISTIC
/begin CHARACTERISTIC mCVTTLMT "At the time of CVT gear shift, upper limit torque" VALUE 0x00008EEE REC_SWORD_C 0 COMP_0228 -3276.8 3276.7 /begin FUNCTION_LIST KF7-385.2[18] /end FUNCTION_LIST /end CHARACTERISTIC
/begin CHARACTERISTIC mCYLCLNE "Cylinder distinction clear permission rotation condition lower limit" VALUE 0x000083A5 REC_UBYTE_C 0 COMP_0006 0 3187.5 /begin FUNCTION_LIST KF7-450.9A[5] /end FUNCTION_LIST /end CHARACTERISTIC
/begin CHARACTERISTIC mCYLCLTM "Cylinder distinction clear permission time" VALUE 0x000083A6 REC_UBYTE_C 0 COMP_0008 0 25500 /begin FUNCTION_LIST KF7-450.9A[5] /end FUNCTION_LIST /end CHARACTERISTIC
/begin CHARACTERISTIC mDADV "The amount of knock advance" VALUE 0x00008EFA REC_SWORD_C 0 COMP_0078 -128 127.99609375 /begin FUNCTION_LIST KF7-379.5[3] /end FUNCTION_LIST /end CHARACTERISTIC
/begin CHARACTERISTIC mDBETA "BETA maximum change width" VALUE 0x000090E6 REC_UWORD_C 0 COMP_0081 0 255.99609375 /begin FUNCTION_LIST KF7-379.5[3] /end FUNCTION_LIST /end CHARACTERISTIC
/begin CHARACTERISTIC mDDGNTC "Self-diagnosis reopening delay" VALUE 0x000083E8 REC_UBYTE_C 0 COMP_0014 0 2550 /begin FUNCTION_LIST KF7-381.9[2] KF7-410.12[2] /end FUNCTION_LIST /end CHARACTERISTIC
/begin CHARACTERISTIC mDINPNE1 "Slowdown occasion threshold 1" VALUE 0x00008434 REC_UBYTE_C 0 COMP_0392_S 0 255 /begin FUNCTION_LIST KF7-385.1[32] /end FUNCTION_LIST /end CHARACTERISTIC
/begin CHARACTERISTIC mDLUN "L/U prohibition engine speed (at the time of A/C off)" VALUE 0x00008473 REC_UBYTE_C 0 COMP_0000 0 6375 /begin FUNCTION_LIST KF7-385.1[32] /end FUNCTION_LIST /end CHARACTERISTIC
/begin CHARACTERISTIC mDLUN1 "At the time of the slowdown, L/U prohibition engine speed (at the time of A/C off) 1" VALUE 0x00008474 REC_UBYTE_C 0 COMP_0000 0 6375 /begin FUNCTION_LIST KF7-385.1[32] /end FUNCTION_LIST /end CHARACTERISTIC
/begin CHARACTERISTIC mDLVSP1 "A/C SW At the time of off, L/U prohibition vehicle speed" VALUE 0x00008477 REC_UBYTE_C 0 COMP_0007 0 510 /begin FUNCTION_LIST KF7-385.1[32] /end FUNCTION_LIST /end CHARACTERISTIC
/begin CHARACTERISTIC mDLYLON "Lockup continuation time for the lean judgement" VALUE 0x00008481 REC_UBYTE_C 0 COMP_0008 0 25500 /begin FUNCTION_LIST KF7-385.1[32] /end FUNCTION_LIST /end CHARACTERISTIC
/begin CHARACTERISTIC mDMFMANU "At the time of D.S.A. off, manual value" VALUE 0x00008486 REC_UBYTE_C 0 COMP_0425 0 99.99999981 /begin FUNCTION_LIST KF7-410.3[N] /end FUNCTION_LIST /end CHARACTERISTIC
/begin CHARACTERISTIC mDNLUIN "L/U prohibition engine speed" VALUE 0x00008491 REC_UBYTE_C 0 COMP_0000 0 6375 /begin FUNCTION_LIST KF7-385.1[32] /end FUNCTION_LIST /end CHARACTERISTIC
/begin CHARACTERISTIC mDQAACV "AACV response speed" VALUE 0x000084A9 REC_UBYTE_C 0 COMP_0051 0 255 /begin FUNCTION_LIST KF7-390.3A[15] /end FUNCTION_LIST /end CHARACTERISTIC
/begin CHARACTERISTIC mDRET "The amount of knock retard" VALUE 0x00008EFE REC_SWORD_C 0 COMP_0078 -128 127.99609375 /begin FUNCTION_LIST KF7-379.5[3] /end FUNCTION_LIST /end CHARACTERISTIC
/begin CHARACTERISTIC mDSACTAPH "Normalized pedal pushing speed operation pedal condition upper limit" VALUE 0x00009138 REC_UWORD_C 0 COMP_0362_S 0 8191.875 /begin FUNCTION_LIST KF7-410.3[N] /end FUNCTION_LIST /end CHARACTERISTIC
/begin CHARACTERISTIC mDSACTAPL "Normalized pedal pushing speed operation pedal condition lower limit" VALUE 0x0000913A REC_UWORD_C 0 COMP_0362_S 0 8191.875 /begin FUNCTION_LIST KF7-410.3[N] /end FUNCTION_LIST /end CHARACTERISTIC
/begin CHARACTERISTIC mDSACTVSL "Normalized pedal pushing speed operation vehicle speed condition lower limit" VALUE 0x0000913C REC_UWORD_C 0 COMP_0436 0 6553.5 /begin FUNCTION_LIST KF7-410.3[N] /end FUNCTION_LIST /end CHARACTERISTIC
/begin CHARACTERISTIC mDSMAXPWR "At the time of the pedal extreme pushing, the power" VALUE 0x00009140 REC_UWORD_C 0 COMP_0400_S 0 4095937.5 /begin FUNCTION_LIST KF7-410.3[N] /end FUNCTION_LIST /end CHARACTERISTIC
/begin CHARACTERISTIC mDSPWRAPL "Normalized pedal pushing quantity operation vehicle speed condition lower limit" VALUE 0x00009144 REC_UWORD_C 0 COMP_0362_S 0 8191.875 /begin FUNCTION_LIST KF7-410.3[N] /end FUNCTION_LIST /end CHARACTERISTIC
/begin CHARACTERISTIC mDSPWRVSL "Normalized pedal pushing quantity operation pedal condition lower limit" VALUE 0x00009146 REC_UWORD_C 0 COMP_0436 0 6553.5 /begin FUNCTION_LIST KF7-410.3[N] /end FUNCTION_LIST /end CHARACTERISTIC
/begin CHARACTERISTIC mDTDTMR "Torque compensation quantity increase switchover delay" VALUE 0x000084D6 REC_UBYTE_C 0 COMP_0014 0 2550 /begin FUNCTION_LIST KF7-385.2[18] /end FUNCTION_LIST /end CHARACTERISTIC
/begin CHARACTERISTIC mDTDTMRU "Torque compensation quantity increase switchover delay (for the up-shift)" VALUE 0x000084D7 REC_UBYTE_C 0 COMP_0014 0 2550 /begin FUNCTION_LIST KF7-385.2[18] /end FUNCTION_LIST /end CHARACTERISTIC
/begin CHARACTERISTIC mDTFCAP "Torque going down control prohibition accelerator open-degree" VALUE 0x0000914A REC_UWORD_C 0 COMP_0005 0 7208.85 /begin FUNCTION_LIST KF7-385.1[32] KF7-385.2[18] /end FUNCTION_LIST /end CHARACTERISTIC
/begin CHARACTERISTIC mDTFCN "Torque going down control prohibition rotation" VALUE 0x000084DC REC_UBYTE_C 0 COMP_0020 0 12750 /begin FUNCTION_LIST KF7-385.1[32] KF7-385.2[18] /end FUNCTION_LIST /end CHARACTERISTIC
/begin CHARACTERISTIC mDTLVSP "During lockup, control start judgement vehicle speed" VALUE 0x000084E1 REC_UBYTE_C 0 COMP_0007 0 510 /begin FUNCTION_LIST KF7-385.1[32] /end FUNCTION_LIST /end CHARACTERISTIC
/begin CHARACTERISTIC mDTQD "Retard quantity decrease rate" VALUE 0x0000914C REC_UWORD_C 0 COMP_0083 0 255.99609375 /begin FUNCTION_LIST KF7-385.2[18] KF7-385.3[4] /end FUNCTION_LIST /end CHARACTERISTIC
/begin CHARACTERISTIC mDTWLUI "L/U prohibition coolant temperature" VALUE 0x000084FD REC_UBYTE_C 0 COMP_0035 -50 205 /begin FUNCTION_LIST KF7-385.1[32] /end FUNCTION_LIST /end CHARACTERISTIC
/begin CHARACTERISTIC mDTWLUI2 "Heater performance requirement L/U prohibition coolant temperature" VALUE 0x000084FE REC_UBYTE_C 0 COMP_0035 -50 205 /begin FUNCTION_LIST KF7-385.1[32] /end FUNCTION_LIST /end CHARACTERISTIC
/begin CHARACTERISTIC mENSTDLYT "Engine operating time delay" VALUE 0x00008546 REC_UBYTE_C 0 COMP_0008 0 25500 /begin FUNCTION_LIST KF7-378.3B[5] /end FUNCTION_LIST /end CHARACTERISTIC
/begin CHARACTERISTIC mERRLIM "The amount of dizzer addition upper limit deviation" VALUE 0x00008552 REC_UBYTE_C 0 COMP_0048 0 127.5 /begin FUNCTION_LIST KF7-393.1C[8] /end FUNCTION_LIST /end CHARACTERISTIC
/begin CHARACTERISTIC mFCADV1 "At the time of the fuel cut, retard value" VALUE 0x000085DE REC_UBYTE_C 0 COMP_0017 0 255 /begin FUNCTION_LIST KF7-390.3A[15] R301.5.FuelCut_1_2_2 /end FUNCTION_LIST /end CHARACTERISTIC
/begin CHARACTERISTIC mFCPRDT "Time for the pre-retard start time judgement" VALUE 0x000085E7 REC_UBYTE_C 0 COMP_0014 0 2550 /begin FUNCTION_LIST KF7-390.3A[15] R301.5.FuelCut_1_2_2 /end FUNCTION_LIST /end CHARACTERISTIC
/begin CHARACTERISTIC mFSTVO "At the time of the throttle sensor trouble, TVO" VALUE 0x00008646 REC_UBYTE_C 0 COMP_0002 0 89.25 /begin FUNCTION_LIST KF7-450.7[2] /end FUNCTION_LIST /end CHARACTERISTIC
/begin CHARACTERISTIC mFTW70 "At present, coolant temperature rise distinction value" VALUE 0x0000864D REC_UBYTE_C 0 COMP_0035 -50 205 /begin FUNCTION_LIST KF7-450.22[1] KF7-500.1[54] /end FUNCTION_LIST /end CHARACTERISTIC
/begin CHARACTERISTIC mFTWI20 "At the time of the start, at present, coolant temperature occasion difference distinction value" VALUE 0x0000864E REC_UBYTE_C 0 COMP_0003 0 255 /begin FUNCTION_LIST KF7-450.22[1] KF7-500.1[54] /end FUNCTION_LIST /end CHARACTERISTIC
/begin CHARACTERISTIC mFULLSWON "Full SW judgement value" VALUE 0x000091C2 REC_UWORD_C 0 COMP_0005 0 7208.85 /begin FUNCTION_LIST KF7-385.1[32] /end FUNCTION_LIST /end CHARACTERISTIC
/begin CHARACTERISTIC mFULSWHYS "A hysteresis for the accelerator SW" VALUE 0x000091C4 REC_UWORD_C 0 COMP_0005 0 7208.85 /begin FUNCTION_LIST KF7-385.1[32] /end FUNCTION_LIST /end CHARACTERISTIC
/begin CHARACTERISTIC mGAFBI "F/B I gain" VALUE 0x00008655 REC_UBYTE_C 0 COMP_0082_S 0 1.275 /begin FUNCTION_LIST KF7-390.3A[15] /end FUNCTION_LIST /end CHARACTERISTIC
/begin CHARACTERISTIC mGAFBPH "F/B P gain (a high gain)" VALUE 0x00008656 REC_UBYTE_C 0 COMP_0082_S 0 1.275 /begin FUNCTION_LIST KF7-390.3A[15] /end FUNCTION_LIST /end CHARACTERISTIC
/begin CHARACTERISTIC mGAFBPI "F/B P gain (at the time of the PI control)" VALUE 0x00008657 REC_UBYTE_C 0 COMP_0082_S 0 1.275 /begin FUNCTION_LIST KF7-390.3A[15] /end FUNCTION_LIST /end CHARACTERISTIC
/begin CHARACTERISTIC mGAFBPL "F/B P gain (low gain)" VALUE 0x00008658 REC_UBYTE_C 0 COMP_0082_S 0 1.275 /begin FUNCTION_LIST KF7-390.3A[15] /end FUNCTION_LIST /end CHARACTERISTIC
/begin CHARACTERISTIC mGLHRN "Harness head difference compensation coefficient" VALUE 0x0000866B REC_UBYTE_C 0 COMP_0009 0 199.21875 /begin FUNCTION_LIST KF7-379.1[9] /end FUNCTION_LIST /end CHARACTERISTIC
/begin CHARACTERISTIC mGTENG "Engine model difference compensation coefficient" VALUE 0x0000867E REC_UBYTE_C 0 COMP_0009 0 199.21875 /begin FUNCTION_LIST KF7-379.1[9] /end FUNCTION_LIST /end CHARACTERISTIC
/begin CHARACTERISTIC mGUARDRAC "Guard DUTY judgement RAC" VALUE 0x0000920C REC_UWORD_C 0 COMP_0415_S 0 4095.9375 /begin FUNCTION_LIST KF7-378.3B[5] /end FUNCTION_LIST /end CHARACTERISTIC
/begin CHARACTERISTIC mGUARDW "Voltage guard W" VALUE 0x00008682 REC_UBYTE_C 0 COMP_0416_S 0 127.5 /begin FUNCTION_LIST KF7-378.3B[5] /end FUNCTION_LIST /end CHARACTERISTIC
/begin CHARACTERISTIC mHDTYMX1 "A/F sensor heater duty upper limit value 1" VALUE 0x00008689 REC_UBYTE_C 0 COMP_0047 0 127.5 /begin FUNCTION_LIST KF7-378.3B[5] /end FUNCTION_LIST /end CHARACTERISTIC
/begin CHARACTERISTIC mHIDTY1 "At the time of the target operation angle maximum-advance degree, DUTY ratio 1" VALUE 0x0000868E REC_UBYTE_C 0 COMP_0021 0 99.609375 /begin FUNCTION_LIST KF7-393.1C[8] /end FUNCTION_LIST /end CHARACTERISTIC
/begin CHARACTERISTIC mHIDTY2 "At the time of the target operation angle maximum-advance degree, DUTY ratio 2" VALUE 0x0000868F REC_UBYTE_C 0 COMP_0021 0 99.609375 /begin FUNCTION_LIST KF7-393.1C[8] /end FUNCTION_LIST /end CHARACTERISTIC
/begin CHARACTERISTIC mHITAR "VTC maximum-advance degree operation angle" VALUE 0x00008690 REC_UBYTE_C 0 COMP_0048 0 127.5 /begin FUNCTION_LIST KF7-393.1C[8] /end FUNCTION_LIST /end CHARACTERISTIC
/begin CHARACTERISTIC mHITIME "HIDTY1 output time" VALUE 0x00008693 REC_UBYTE_C 0 COMP_0183 0 5100 /begin FUNCTION_LIST KF7-393.1C[8] /end FUNCTION_LIST /end CHARACTERISTIC
/begin CHARACTERISTIC mHTWVSP "A high coolant temperature L/U requirement vehicle speed lower limit" VALUE 0x000086AC REC_UBYTE_C 0 COMP_0007 0 510 /begin FUNCTION_LIST KF7-385.1[32] /end FUNCTION_LIST /end CHARACTERISTIC
/begin CHARACTERISTIC mIDUTYG "F/B DUTY Integral clause gain" VALUE 0x000092DA REC_UWORD_C 0 COMP_0422_S 0 204.796875 /begin FUNCTION_LIST KF7-378.3B[5] /end FUNCTION_LIST /end CHARACTERISTIC
/begin CHARACTERISTIC mIOFAPO "APO for the urgent pushing judgement" VALUE 0x0000874A REC_UBYTE_C 0 COMP_0425 0 99.99999981 /begin FUNCTION_LIST KF7-385.1[32] /end FUNCTION_LIST /end CHARACTERISTIC
/begin CHARACTERISTIC mIOFAPOM "APO (for the M mode) for the urgent pushing judgement" VALUE 0x0000874B REC_UBYTE_C 0 COMP_0425 0 99.99999981 /begin FUNCTION_LIST KF7-385.1[32] /end FUNCTION_LIST /end CHARACTERISTIC
/begin CHARACTERISTIC mKBGLIN "Initial value for KPSBGL" VALUE 0x0000931E REC_UWORD_C 0 COMP_0032 0 255.99609375 /begin FUNCTION_LIST KF7-379.1[9] KF7-450.20[2] /end FUNCTION_LIST /end CHARACTERISTIC
/begin CHARACTERISTIC mKBVTC "For the dizzer" VALUE 0x0000878A REC_UBYTE_C 0 COMP_0048 0 127.5 /begin FUNCTION_LIST KF7-393.1C[8] /end FUNCTION_LIST /end CHARACTERISTIC
/begin CHARACTERISTIC mKBVTCL "Dizzer (the left bank)" VALUE 0x0000878B REC_UBYTE_C 0 COMP_0048 0 127.5 /begin FUNCTION_LIST KF7-393.1C[8] /end FUNCTION_LIST /end CHARACTERISTIC
/begin CHARACTERISTIC mKDATDUS "At the time of the up-shift, torque going down decrease rate coefficient" VALUE 0x00008792 REC_UBYTE_C 0 COMP_0237_S 0 0.99609375 /begin FUNCTION_LIST KF7-385.2[18] /end FUNCTION_LIST /end CHARACTERISTIC
/begin CHARACTERISTIC mKDSACTDW "Pedal pushing speed UP side filter weight coefficient" VALUE 0x00008795 REC_UBYTE_C 0 COMP_0063 0 0.99609375 /begin FUNCTION_LIST KF7-410.3[N] /end FUNCTION_LIST /end CHARACTERISTIC
/begin CHARACTERISTIC mKDSACTUP "Pedal pushing speed DOWN side filter weight coefficient" VALUE 0x00008796 REC_UBYTE_C 0 COMP_0063 0 0.99609375 /begin FUNCTION_LIST KF7-410.3[N] /end FUNCTION_LIST /end CHARACTERISTIC
/begin CHARACTERISTIC mKDSDAPO "Pedal pushing speed filter weight coefficient" VALUE 0x00008797 REC_UBYTE_C 0 COMP_0063 0 0.99609375 /begin FUNCTION_LIST KF7-410.3[N] /end FUNCTION_LIST /end CHARACTERISTIC
/begin CHARACTERISTIC mKIVTC "I-gain gain" VALUE 0x000087A8 REC_UBYTE_C 0 COMP_0329 0 1.9921875 /begin FUNCTION_LIST KF7-393.1C[8] /end FUNCTION_LIST /end CHARACTERISTIC
/begin CHARACTERISTIC mKIVTCL "I-gain gain (the left bank)" VALUE 0x000087AD REC_UBYTE_C 0 COMP_0329 0 1.9921875 /begin FUNCTION_LIST KF7-393.1C[8] /end FUNCTION_LIST /end CHARACTERISTIC
/begin CHARACTERISTIC mKTENG1 "Weight coefficient" VALUE 0x000087E6 REC_UBYTE_C 0 COMP_0063 0 0.99609375 /begin FUNCTION_LIST KF7-386.1[4] KF7-386.2[4] /end FUNCTION_LIST /end CHARACTERISTIC
/begin CHARACTERISTIC mKTEPUMP0 "Pumping loss operation coefficient" VALUE 0x00009342 REC_UWORD_C 0 COMP_0196 0 6553.5 /begin FUNCTION_LIST KF7-386.1[4] /end FUNCTION_LIST /end CHARACTERISTIC
/begin CHARACTERISTIC mKTFBYA "Target air-fuel ratio compensation coefficient" VALUE 0x000087E7 REC_UBYTE_C 0 COMP_0045 0 1.9921875 /begin FUNCTION_LIST KF7-386.1[4] /end FUNCTION_LIST /end CHARACTERISTIC
/begin CHARACTERISTIC mKTPPUMP "TP100 compensation for the pumping loss computation" VALUE 0x000087EC REC_UBYTE_C 0 COMP_0435 0 7.96875 /begin FUNCTION_LIST KF7-386.1[4] /end FUNCTION_LIST /end CHARACTERISTIC
/begin CHARACTERISTIC mKUPDTY "Duty rise coefficient" VALUE 0x0000934C REC_UWORD_C 0 COMP_0433_S 0 6553.5 /begin FUNCTION_LIST KF7-378.3B[5] /end FUNCTION_LIST /end CHARACTERISTIC
/begin CHARACTERISTIC mKV2MAX "KVCC2 upper limit value" VALUE 0x000087F1 REC_UBYTE_C 0 COMP_0044 0 1.9921875 /begin FUNCTION_LIST KF7-400.1[1] KF7-400.2[N] KF7-400.3[N] /end FUNCTION_LIST /end CHARACTERISTIC
/begin CHARACTERISTIC mKV2MIN "KVCC2 lower limit value" VALUE 0x000087F2 REC_UBYTE_C 0 COMP_0044 0 1.9921875 /begin FUNCTION_LIST KF7-400.1[1] KF7-400.2[N] KF7-400.3[N] /end FUNCTION_LIST /end CHARACTERISTIC
/begin CHARACTERISTIC mKVCCRF "VCC compensation coefficient central value" VALUE 0x00009352 REC_UWORD_C 0 COMP_0225 0 1.9988175 /begin FUNCTION_LIST KF7-400.2[N] KF7-400.3[N] /end FUNCTION_LIST /end CHARACTERISTIC
/begin CHARACTERISTIC mLGTIM "Condition stable waiting time" VALUE 0x00008811 REC_UBYTE_C 0 COMP_0014 0 2550 /begin FUNCTION_LIST KF7-400.1[1] /end FUNCTION_LIST /end CHARACTERISTIC
/begin CHARACTERISTIC mLOWDTY "At the time of the target operation angle maximum-retard degree, DUTY ratio" VALUE 0x00008826 REC_UBYTE_C 0 COMP_0021 0 99.609375 /begin FUNCTION_LIST KF7-393.1C[8] /end FUNCTION_LIST /end CHARACTERISTIC
/begin CHARACTERISTIC mLOWTAR "VTC maximum-retard degree operation angle" VALUE 0x00008827 REC_UBYTE_C 0 COMP_0048 0 127.5 /begin FUNCTION_LIST KF7-393.1C[8] /end FUNCTION_LIST /end CHARACTERISTIC
/begin CHARACTERISTIC mLRNANG "VTC maximum-retard degree angle learning limiter" VALUE 0x00008829 REC_UBYTE_C 0 COMP_0048 0 127.5 /begin FUNCTION_LIST KF7-393.1C[8] /end FUNCTION_LIST /end CHARACTERISTIC
/begin CHARACTERISTIC mLRNTIM "VTC maximum-retard degree angle learning delay" VALUE 0x0000882C REC_UBYTE_C 0 COMP_0008 0 25500 /begin FUNCTION_LIST KF7-393.1C[8] /end FUNCTION_LIST /end CHARACTERISTIC
/begin CHARACTERISTIC mLUHTW "A high coolant temperature L/U requirement coolant temperature lower limit" VALUE 0x00008832 REC_UBYTE_C 0 COMP_0035 -50 205 /begin FUNCTION_LIST KF7-385.1[32] /end FUNCTION_LIST /end CHARACTERISTIC
/begin CHARACTERISTIC mMAXMODD "The number of multiple cylinder cut cylinders" VALUE 0x00008838 REC_UBYTE_C 0 COMP_0243_S 0 84.999915 /begin FUNCTION_LIST KF7-410.12[2] /end FUNCTION_LIST /end CHARACTERISTIC
/begin CHARACTERISTIC mMBGLI "KPSBGL weight coefficient" VALUE 0x00008839 REC_UBYTE_C 0 COMP_0021 0 99.609375 /begin FUNCTION_LIST KF7-379.1[9] /end FUNCTION_LIST /end CHARACTERISTIC
/begin CHARACTERISTIC mMILNGCN "Watch mechanism unusual time fuel cut start TRIP condition" VALUE 0x00008854 REC_UBYTE_C 0 COMP_0012_S 0 255 /begin FUNCTION_LIST KF7-450.22[1] /end FUNCTION_LIST /end CHARACTERISTIC
/begin CHARACTERISTIC mMINAVLIM "MINAVTQE upper limit limitation value" VALUE 0x00008F22 REC_SWORD_C 0 COMP_0228 -3276.8 3276.7 /begin FUNCTION_LIST KF7-410.11M[4] KF7-410.11P[4] R000.1.RS_Integ_1_10_2 /end FUNCTION_LIST /end CHARACTERISTIC
/begin CHARACTERISTIC mMINAVTQF "The MINAVTQE the second element compensation coefficient" VALUE 0x000093A6 REC_UWORD_C 0 COMP_0395 0 15.999780435 /begin FUNCTION_LIST KF7-410.11M[4] KF7-410.11P[4] R000.1.RS_Integ_1_10_2 /end FUNCTION_LIST /end CHARACTERISTIC
/begin CHARACTERISTIC mMINMODD "Multiple cylinder cut operation thresholds" VALUE 0x00008855 REC_UBYTE_C 0 COMP_0243_S 0 84.999915
 /begin FUNCTION_LIST KF7-385.2[18] KF7-410.12[2] R301.1.Torque_realization_1_0_3 /end FUNCTION_LIST
/end CHARACTERISTIC
/begin CHARACTERISTIC mMKP "A data for the KSi computation" VALUE 0x0000885D REC_UBYTE_C 0 COMP_0259 0 255 /begin FUNCTION_LIST KF7-379.1[9] /end FUNCTION_LIST /end CHARACTERISTIC
/begin CHARACTERISTIC mNCHK "Region A, B judgement speed" VALUE 0x00008889 REC_UBYTE_C 0 COMP_0020 0 12750 /begin FUNCTION_LIST KF7-379.4[1] KF7-379.5[3] /end FUNCTION_LIST /end CHARACTERISTIC
/begin CHARACTERISTIC mNELMODD "Low rotation tense upper limit value" VALUE 0x000088A6 REC_UBYTE_C 0 COMP_0243_S 0 84.999915 /begin FUNCTION_LIST KF7-410.12[2] /end FUNCTION_LIST /end CHARACTERISTIC
/begin CHARACTERISTIC mO2HRDY "The rest O2 heater delay time" VALUE 0x00008910 REC_UBYTE_C 0 COMP_0049 0 255 /begin FUNCTION_LIST KF7-378.2B[6] /end FUNCTION_LIST /end CHARACTERISTIC
/begin CHARACTERISTIC mO2HRN "Rest O2 heater upper limit speed" VALUE 0x00008911 REC_UBYTE_C 0 COMP_0000 0 6375 /begin FUNCTION_LIST KF7-378.2B[6] /end FUNCTION_LIST /end CHARACTERISTIC
/begin CHARACTERISTIC mO2HRTP "The rest O2 heater upper limit TP" VALUE 0x00008916 REC_UBYTE_C 0 COMP_0001 0 31.875 /begin FUNCTION_LIST KF7-378.2B[6] /end FUNCTION_LIST /end CHARACTERISTIC
/begin CHARACTERISTIC mO2HSUMQM "The rest O2 heater on permission judgement SUMQM" VALUE 0x0000976C REC_ULONG_C 0 COMP_0068 0 4294967295 /begin FUNCTION_LIST KF7-378.2B[6] /end FUNCTION_LIST /end CHARACTERISTIC
/begin CHARACTERISTIC mO2HTCR "The rest O2 heater control prohibition catalyst estimated temperature" VALUE 0x00008917 REC_UBYTE_C 0 COMP_0062 0 1020 /begin FUNCTION_LIST KF7-378.2B[6] /end FUNCTION_LIST /end CHARACTERISTIC
/begin CHARACTERISTIC mOPRAC "Integration clause operation judgement value" VALUE 0x000093FE REC_UWORD_C 0 COMP_0415_S 0 4095.9375 /begin FUNCTION_LIST KF7-378.3B[5] /end FUNCTION_LIST /end CHARACTERISTIC
/begin CHARACTERISTIC mPDHIS "Pd pressure hysteresis" VALUE 0x00008992 REC_UBYTE_C 0 COMP_0011 0 5.1 /begin FUNCTION_LIST KF7-377.1A[19] /end FUNCTION_LIST /end CHARACTERISTIC
/begin CHARACTERISTIC mPDHIS1 "Pd pressure hysteresis" VALUE 0x00008993 REC_UBYTE_C 0 COMP_0011 0 5.1 /begin FUNCTION_LIST KF7-377.1A[19] /end FUNCTION_LIST /end CHARACTERISTIC
/begin CHARACTERISTIC mPDRFH "Radiator fan Pd pressure upper limit value" VALUE 0x0000899D REC_UBYTE_C 0 COMP_0011 0 5.1 /begin FUNCTION_LIST KF7-377.1A[19] /end FUNCTION_LIST /end CHARACTERISTIC
/begin CHARACTERISTIC mPDRFL "Radiator fan Pd pressure lower limit value" VALUE 0x0000899E REC_UBYTE_C 0 COMP_0011 0 5.1 /begin FUNCTION_LIST KF7-377.1A[19] /end FUNCTION_LIST /end CHARACTERISTIC
/begin CHARACTERISTIC mPDUTYG "F/B DUTY Proportion clause gain" VALUE 0x00009420 REC_UWORD_C 0 COMP_0422_S 0 204.796875 /begin FUNCTION_LIST KF7-378.3B[5] /end FUNCTION_LIST /end CHARACTERISTIC
/begin CHARACTERISTIC mPILMTAT "Retard limit ignition timing" VALUE 0x000081A8 REC_SBYTE_C 0 COMP_0018 -128 127 /begin FUNCTION_LIST KF7-385.2[18] R301.1.Torque_realization_1_0_3 /end FUNCTION_LIST /end CHARACTERISTIC
/begin CHARACTERISTIC mPRDRAT "At the time of the fuel cut, pre-retard rate" VALUE 0x00009438 REC_UWORD_C 0 COMP_0081 0 255.99609375 /begin FUNCTION_LIST KF7-390.3A[15] R301.5.FuelCut_1_2_2 /end FUNCTION_LIST /end CHARACTERISTIC
/begin CHARACTERISTIC mPRDTME "Torque going down control completion time" VALUE 0x000089B9 REC_UBYTE_C 0 COMP_0014 0 2550 /begin FUNCTION_LIST KF7-385.2[18] /end FUNCTION_LIST /end CHARACTERISTIC
/begin CHARACTERISTIC mPREHTWN1 "At the time of ÉhÉâÉC judgement, coolant temperature 1" VALUE 0x000089BB REC_UBYTE_C 0 COMP_0035 -50 205 /begin FUNCTION_LIST KF7-378.3B[5] /end FUNCTION_LIST /end CHARACTERISTIC
/begin CHARACTERISTIC mPREHTWN2 "At the time of ÉhÉâÉC judgement, coolant temperature 2" VALUE 0x000089BC REC_UBYTE_C 0 COMP_0035 -50 205 /begin FUNCTION_LIST KF7-378.3B[5] /end FUNCTION_LIST /end CHARACTERISTIC
/begin CHARACTERISTIC mPREHTWN3 "At the time of ÉhÉâÉC judgement, coolant temperature 3" VALUE 0x000089BD REC_UBYTE_C 0 COMP_0035 -50 205 /begin FUNCTION_LIST KF7-378.3B[5] /end FUNCTION_LIST /end CHARACTERISTIC
/begin CHARACTERISTIC mQACHG "ISC air quantity-opening area conversion coefficient" VALUE 0x00009452 REC_UWORD_C 0 COMP_0252_S 0 0.999985458 /begin FUNCTION_LIST KF7-385.3[4] /end FUNCTION_LIST /end CHARACTERISTIC
/begin CHARACTERISTIC mRDMX "EEPROM reading trial number of times" VALUE 0x00008A2D REC_UBYTE_C 0 COMP_0030 0 255 /begin FUNCTION_LIST KF7-400.2[N] /end FUNCTION_LIST /end CHARACTERISTIC
/begin CHARACTERISTIC mRDVSPL "Radiator fan vehicle speed lower limit value" VALUE 0x00008A30 REC_UBYTE_C 0 COMP_0007 0 510 /begin FUNCTION_LIST KF7-377.1A[19] /end FUNCTION_LIST /end CHARACTERISTIC
/begin CHARACTERISTIC mREGJG "A weight coefficient for the BETAD calculation" VALUE 0x00008A39 REC_UBYTE_C 0 COMP_0021 0 99.609375 /begin FUNCTION_LIST KF7-379.3[3] /end FUNCTION_LIST /end CHARACTERISTIC
/begin CHARACTERISTIC mREGJH "High-octane judgement BETAD" VALUE 0x00008F44 REC_SWORD_C 0 COMP_0078 -128 127.99609375 /begin FUNCTION_LIST KF7-379.3[3] /end FUNCTION_LIST /end CHARACTERISTIC
/begin CHARACTERISTIC mREGJL "Regular judgement BETAD" VALUE 0x00008F46 REC_SWORD_C 0 COMP_0078 -128 127.99609375 /begin FUNCTION_LIST KF7-379.3[3] /end FUNCTION_LIST /end CHARACTERISTIC
/begin CHARACTERISTIC mRELUTIME "After an urgent pushing is judged, continuous progress time" VALUE 0x0000949C REC_UWORD_C 0 COMP_0014 0 655350 /begin FUNCTION_LIST KF7-385.1[32] /end FUNCTION_LIST /end CHARACTERISTIC
/begin CHARACTERISTIC mRETLM "At the time of the idle, a relative value requirement retard side limiter" VALUE 0x000081AF REC_SBYTE_C 0 COMP_0018 -128 127 /begin FUNCTION_LIST KF7-390.1A[3] /end FUNCTION_LIST /end CHARACTERISTIC
/begin CHARACTERISTIC mRETLML "At the time of the idle, a relative value requirement retard side limiter (at the time of the PI control)" VALUE 0x000081B0 REC_SBYTE_C 0 COMP_0018 -128 127 /begin FUNCTION_LIST KF7-390.1A[3] /end FUNCTION_LIST /end CHARACTERISTIC
/begin CHARACTERISTIC mRFNADLY "A delay for the RFN compensation timing adjustment" VALUE 0x00008A69 REC_UBYTE_C 0 COMP_0157 0 255 /begin FUNCTION_LIST KF7-390.3A[15] /end FUNCTION_LIST /end CHARACTERISTIC
/begin CHARACTERISTIC mRFPDHI "Radiator fan High requirement Pd pressure" VALUE 0x00008A71 REC_UBYTE_C 0 COMP_0011 0 5.1 /begin FUNCTION_LIST KF7-377.1A[19] /end FUNCTION_LIST /end CHARACTERISTIC
/begin CHARACTERISTIC mRFTW1 "Radiator fan switching coolant temperature 1" VALUE 0x00008A75 REC_UBYTE_C 0 COMP_0035 -50 205 /begin FUNCTION_LIST KF7-377.1A[19] /end FUNCTION_LIST /end CHARACTERISTIC
/begin CHARACTERISTIC mRFTW10 "Radiator fan switching coolant temperature 10" VALUE 0x00008A76 REC_UBYTE_C 0 COMP_0035 -50 205 /begin FUNCTION_LIST KF7-377.1A[19] /end FUNCTION_LIST /end CHARACTERISTIC
/begin CHARACTERISTIC mRFTW11 "Radiator fan switching coolant temperature 11" VALUE 0x00008A77 REC_UBYTE_C 0 COMP_0035 -50 205 /begin FUNCTION_LIST KF7-377.1A[19] /end FUNCTION_LIST /end CHARACTERISTIC
/begin CHARACTERISTIC mRFTW12 "Radiator fan switching coolant temperature 12" VALUE 0x00008A78 REC_UBYTE_C 0 COMP_0035 -50 205 /begin FUNCTION_LIST KF7-377.1A[19] /end FUNCTION_LIST /end CHARACTERISTIC
/begin CHARACTERISTIC mRFTW13 "Radiator fan switching coolant temperature 13" VALUE 0x00008A79 REC_UBYTE_C 0 COMP_0035 -50 205 /begin FUNCTION_LIST KF7-377.1A[19] /end FUNCTION_LIST /end CHARACTERISTIC
/begin CHARACTERISTIC mRFTW14 "Radiator fan switching coolant temperature 14" VALUE 0x00008A7A REC_UBYTE_C 0 COMP_0035 -50 205 /begin FUNCTION_LIST KF7-377.1A[19] /end FUNCTION_LIST /end CHARACTERISTIC
/begin CHARACTERISTIC mRFTW15 "Radiator fan switching coolant temperature 15" VALUE 0x00008A7B REC_UBYTE_C 0 COMP_0035 -50 205 /begin FUNCTION_LIST KF7-377.1A[19] /end FUNCTION_LIST /end CHARACTERISTIC
/begin CHARACTERISTIC mRFTW16 "Radiator fan switching coolant temperature 16" VALUE 0x00008A7C REC_UBYTE_C 0 COMP_0035 -50 205 /begin FUNCTION_LIST KF7-377.1A[19] /end FUNCTION_LIST /end CHARACTERISTIC
/begin CHARACTERISTIC mRFTW17 "Radiator fan switching coolant temperature 17" VALUE 0x00008A7D REC_UBYTE_C 0 COMP_0035 -50 205 /begin FUNCTION_LIST KF7-377.1A[19] /end FUNCTION_LIST /end CHARACTERISTIC
/begin CHARACTERISTIC mRFTW18 "Radiator fan switching coolant temperature 18" VALUE 0x00008A7E REC_UBYTE_C 0 COMP_0035 -50 205 /begin FUNCTION_LIST KF7-377.1A[19] /end FUNCTION_LIST /end CHARACTERISTIC
/begin CHARACTERISTIC mRFTW19 "Radiator fan switching coolant temperature 19" VALUE 0x00008A7F REC_UBYTE_C 0 COMP_0035 -50 205 /begin FUNCTION_LIST KF7-377.1A[19] /end FUNCTION_LIST /end CHARACTERISTIC
/begin CHARACTERISTIC mRFTW2 "Radiator fan switching coolant temperature 2" VALUE 0x00008A80 REC_UBYTE_C 0 COMP_0035 -50 205 /begin FUNCTION_LIST KF7-377.1A[19] /end FUNCTION_LIST /end CHARACTERISTIC
/begin CHARACTERISTIC mRFTW20 "Radiator fan switching coolant temperature 20" VALUE 0x00008A81 REC_UBYTE_C 0 COMP_0035 -50 205 /begin FUNCTION_LIST KF7-377.1A[19] /end FUNCTION_LIST /end CHARACTERISTIC
/begin CHARACTERISTIC mRFTW21 "Radiator fan switching coolant temperature 21" VALUE 0x00008A82 REC_UBYTE_C 0 COMP_0035 -50 205 /begin FUNCTION_LIST KF7-377.1A[19] /end FUNCTION_LIST /end CHARACTERISTIC
/begin CHARACTERISTIC mRFTW22 "Radiator fan switching coolant temperature 22" VALUE 0x00008A83 REC_UBYTE_C 0 COMP_0035 -50 205 /begin FUNCTION_LIST KF7-377.1A[19] /end FUNCTION_LIST /end CHARACTERISTIC
/begin CHARACTERISTIC mRFTW23 "Radiator fan switching coolant temperature 23" VALUE 0x00008A84 REC_UBYTE_C 0 COMP_0035 -50 205 /begin FUNCTION_LIST KF7-377.1A[19] /end FUNCTION_LIST /end CHARACTERISTIC
/begin CHARACTERISTIC mRFTW24 "Radiator fan switching coolant temperature 24" VALUE 0x00008A85 REC_UBYTE_C 0 COMP_0035 -50 205 /begin FUNCTION_LIST KF7-377.1A[19] /end FUNCTION_LIST /end CHARACTERISTIC
/begin CHARACTERISTIC mRFTW3 "Radiator fan switching coolant temperature 3" VALUE 0x00008A86 REC_UBYTE_C 0 COMP_0035 -50 205 /begin FUNCTION_LIST KF7-377.1A[19] /end FUNCTION_LIST /end CHARACTERISTIC
/begin CHARACTERISTIC mRFTW4 "Radiator fan switching coolant temperature 4" VALUE 0x00008A87 REC_UBYTE_C 0 COMP_0035 -50 205 /begin FUNCTION_LIST KF7-377.1A[19] /end FUNCTION_LIST /end CHARACTERISTIC
/begin CHARACTERISTIC mRFTW5 "Radiator fan switching coolant temperature 5" VALUE 0x00008A88 REC_UBYTE_C 0 COMP_0035 -50 205 /begin FUNCTION_LIST KF7-377.1A[19] /end FUNCTION_LIST /end CHARACTERISTIC
/begin CHARACTERISTIC mRFTW6 "Radiator fan switching coolant temperature 6" VALUE 0x00008A89 REC_UBYTE_C 0 COMP_0035 -50 205 /begin FUNCTION_LIST KF7-377.1A[19] /end FUNCTION_LIST /end CHARACTERISTIC
/begin CHARACTERISTIC mRFTW7 "Radiator fan switching coolant temperature 7" VALUE 0x00008A8A REC_UBYTE_C 0 COMP_0035 -50 205 /begin FUNCTION_LIST KF7-377.1A[19] /end FUNCTION_LIST /end CHARACTERISTIC
/begin CHARACTERISTIC mRFTW8 "Radiator fan switching coolant temperature 8" VALUE 0x00008A8B REC_UBYTE_C 0 COMP_0035 -50 205 /begin FUNCTION_LIST KF7-377.1A[19] /end FUNCTION_LIST /end CHARACTERISTIC
/begin CHARACTERISTIC mRFTW9 "Radiator fan switching coolant temperature 9" VALUE 0x00008A8C REC_UBYTE_C 0 COMP_0035 -50 205 /begin FUNCTION_LIST KF7-377.1A[19] /end FUNCTION_LIST /end CHARACTERISTIC
/begin CHARACTERISTIC mRFTWHI "Radiator fan High requirement coolant temperature" VALUE 0x00008A8D REC_UBYTE_C 0 COMP_0035 -50 205 /begin FUNCTION_LIST KF7-377.1A[19] /end FUNCTION_LIST /end CHARACTERISTIC
/begin CHARACTERISTIC mRFTWHYS "Radiator fan coolant temperature hysteresis" VALUE 0x00008A8E REC_UBYTE_C 0 COMP_0003 0 255 /begin FUNCTION_LIST KF7-377.1A[19] /end FUNCTION_LIST /end CHARACTERISTIC
/begin CHARACTERISTIC mRO2DMXF1 "The rest O2 sensor DUTY upper limit value 1 (for 1% of ÉfÉÖÅ[ÉeÉBÅ[ resolution Noh plays)" VALUE 0x000094D8 REC_UWORD_C 0 COMP_0133_S 0 2559.9609375 /begin FUNCTION_LIST KF7-378.2B[6] /end FUNCTION_LIST /end CHARACTERISTIC
/begin CHARACTERISTIC mRO2DMXF2 "The rest O2 sensor DUTY upper limit value 2 (for 1% of ÉfÉÖÅ[ÉeÉBÅ[ resolution Noh plays)" VALUE 0x000094DA REC_UWORD_C 0 COMP_0133_S 0 2559.9609375 /begin FUNCTION_LIST KF7-378.2B[6] /end FUNCTION_LIST /end CHARACTERISTIC
/begin CHARACTERISTIC mRO2HCTD "Rear O2 heater off delay" VALUE 0x00008AB1 REC_UBYTE_C 0 COMP_0008 0 25500 /begin FUNCTION_LIST KF7-378.2B[6] R301.18.VB_short_Protection_1_0_2 /end FUNCTION_LIST /end CHARACTERISTIC
/begin CHARACTERISTIC mRO2HTWN "At the time of the low temperature start, after, O2 heater on permission coolant temperature" VALUE 0x00008AB2 REC_UBYTE_C 0 COMP_0035 -50 205 /begin FUNCTION_LIST KF7-378.2B[6] /end FUNCTION_LIST /end CHARACTERISTIC
/begin CHARACTERISTIC mRO2STINF "Value (for 1% of ÉfÉÖÅ[ÉeÉBÅ[ resolution Noh plays) with the rest O2 heater DUTY initial profit" VALUE 0x000094DC REC_UWORD_C 0 COMP_0133_S 0 2559.9609375 /begin FUNCTION_LIST KF7-378.2B[6] R301.18.VB_short_Protection_1_0_2 /end FUNCTION_LIST /end CHARACTERISTIC
/begin CHARACTERISTIC mRO2TMHMX "Rear O2 sensor duty upper limit value maintenance time" VALUE 0x00008AB6 REC_UBYTE_C 0 COMP_0008 0 25500 /begin FUNCTION_LIST KF7-378.2B[6] /end FUNCTION_LIST /end CHARACTERISTIC
/begin CHARACTERISTIC mRO2UPDTY "Rear O2 sensor duty rise coefficient" VALUE 0x00008AB7 REC_UBYTE_C 0 COMP_0459_S 0 9.9609375 /begin FUNCTION_LIST KF7-378.2B[6] /end FUNCTION_LIST /end CHARACTERISTIC
/begin CHARACTERISTIC mRTOENDOF "Gear shift completion judgement offset" VALUE 0x000094EC REC_UWORD_C 0 COMP_0255_S 0 63.99899067 /begin FUNCTION_LIST KF7-385.2[18] /end FUNCTION_LIST /end CHARACTERISTIC
/begin CHARACTERISTIC mTGRAC "ÉCÉìÉsÅ[É_ÉìÉX RAC target value" VALUE 0x0000958A REC_UWORD_C 0 COMP_0415_S 0 4095.9375 /begin FUNCTION_LIST KF7-378.3B[5] /end FUNCTION_LIST /end CHARACTERISTIC
/begin CHARACTERISTIC mTMBRKFL "Failsafe start time condition" VALUE 0x000095A8 REC_UWORD_C 0 COMP_0014 0 655350 /begin FUNCTION_LIST KF7-450.19[4] /end FUNCTION_LIST /end CHARACTERISTIC
/begin CHARACTERISTIC mTMDTIV "Idle rise requirement control quantity continuation time" VALUE 0x00008C33 REC_UBYTE_C 0 COMP_0049 0 255 /begin FUNCTION_LIST KF7-385.1[32] /end FUNCTION_LIST /end CHARACTERISTIC
/begin CHARACTERISTIC mTMDTWU "Engine heating requirement time delay" VALUE 0x000095AE REC_UWORD_C 0 COMP_0013 0 65535 /begin FUNCTION_LIST KF7-385.1[32] /end FUNCTION_LIST /end CHARACTERISTIC
/begin CHARACTERISTIC mTMHMX1 "Heater duty upper limit value maintenance time" VALUE 0x00008C53 REC_UBYTE_C 0 COMP_0008 0 25500 /begin FUNCTION_LIST KF7-378.3B[5] /end FUNCTION_LIST /end CHARACTERISTIC
/begin CHARACTERISTIC mTMTXD "A waste time" VALUE 0x00008CA9 REC_UBYTE_C 0 COMP_0014 0 2550 /begin FUNCTION_LIST KF7-385.2[18] /end FUNCTION_LIST /end CHARACTERISTIC
/begin CHARACTERISTIC mTNPRD "Pre-retard permission engine speed" VALUE 0x00008CBA REC_UBYTE_C 0 COMP_0020 0 12750 /begin FUNCTION_LIST KF7-390.3A[15] R301.5.FuelCut_1_2_2 /end FUNCTION_LIST /end CHARACTERISTIC
/begin CHARACTERISTIC mTQDH "At the time of the fuel cut, the amount of retard" VALUE 0x00008CE0 REC_UBYTE_C 0 COMP_0017 0 255 /begin FUNCTION_LIST KF7-385.2[18] KF7-385.3[4] /end FUNCTION_LIST /end CHARACTERISTIC
/begin CHARACTERISTIC mTQDYNH "T/M excessive torque going down upper limit time" VALUE 0x00008CE2 REC_UBYTE_C 0 COMP_0014 0 2550 /begin FUNCTION_LIST KF7-385.2[18] /end FUNCTION_LIST /end CHARACTERISTIC
/begin CHARACTERISTIC mTREFCPSL "Cylinder distinction clear judgement TREF periodic ratio" VALUE 0x00008CE6 REC_UBYTE_C 0 COMP_0045 0 1.9921875 /begin FUNCTION_LIST KF7-450.9A[5] /end FUNCTION_LIST /end CHARACTERISTIC
/begin CHARACTERISTIC mTTXMAX "Maximum operation time" VALUE 0x00008CFC REC_UBYTE_C 0 COMP_0014 0 2550 /begin FUNCTION_LIST KF7-410.12[2] /end FUNCTION_LIST /end CHARACTERISTIC
/begin CHARACTERISTIC mTWISCH "ISC switching coolant temperature (after the warmth, coolant temperature)" VALUE 0x00008D3A REC_UBYTE_C 0 COMP_0035 -50 205 /begin FUNCTION_LIST KF7-390.3A[15] /end FUNCTION_LIST /end CHARACTERISTIC
/begin CHARACTERISTIC mTWISCL "ISC switching coolant temperature (ó‚ space time coolant temperature)" VALUE 0x00008D3B REC_UBYTE_C 0 COMP_0035 -50 205 /begin FUNCTION_LIST KF7-390.3A[15] /end FUNCTION_LIST /end CHARACTERISTIC
/begin CHARACTERISTIC mTWKS "Knock permission coolant temperature" VALUE 0x00008D42 REC_UBYTE_C 0 COMP_0356 -40 119.375 /begin FUNCTION_LIST KF7-379.2[1] /end FUNCTION_LIST /end CHARACTERISTIC
/begin CHARACTERISTIC mTWLUINT "When heater performance requirement L/U prohibition coolant temperature application starts, coolant temperature" VALUE 0x00008D47 REC_UBYTE_C 0 COMP_0035 -50 205 /begin FUNCTION_LIST KF7-385.1[32] /end FUNCTION_LIST /end CHARACTERISTIC
/begin CHARACTERISTIC mTWNMODE1 "Heater control mode 1 switchover judgement coolant temperature" VALUE 0x00008D56 REC_UBYTE_C 0 COMP_0035 -50 205 /begin FUNCTION_LIST KF7-378.3B[5] /end FUNCTION_LIST /end CHARACTERISTIC
/begin CHARACTERISTIC mTWOD "OD schedule rise judgement coolant temperature" VALUE 0x00008D59 REC_UBYTE_C 0 COMP_0035 -50 205 /begin FUNCTION_LIST KF7-385.1[32] /end FUNCTION_LIST /end CHARACTERISTIC
/begin CHARACTERISTIC mTWODINT "OD cancellation initial coolant temperature condition" VALUE 0x00008D5A REC_UBYTE_C 0 COMP_0035 -50 205 /begin FUNCTION_LIST KF7-385.1[32] /end FUNCTION_LIST /end CHARACTERISTIC
/begin CHARACTERISTIC mTWPRD "Pre-retard permission coolant temperature" VALUE 0x00008D5F REC_UBYTE_C 0 COMP_0035 -50 205 /begin FUNCTION_LIST KF7-390.3A[15] R301.5.FuelCut_1_2_2 /end FUNCTION_LIST /end CHARACTERISTIC
/begin CHARACTERISTIC mTXNEL1 "All cylinder cut prohibition engine speed" VALUE 0x00008D7F REC_UBYTE_C 0 COMP_0006 0 3187.5 /begin FUNCTION_LIST KF7-410.12[2] /end FUNCTION_LIST /end CHARACTERISTIC
/begin CHARACTERISTIC mTXNEL2 "Fuel cut prohibition engine speed" VALUE 0x00008D80 REC_UBYTE_C 0 COMP_0006 0 3187.5 /begin FUNCTION_LIST KF7-410.12[2] /end FUNCTION_LIST /end CHARACTERISTIC
/begin CHARACTERISTIC mTXVAPL "Fuel cut prohibition accelerator open-degree" VALUE 0x00008D83 REC_UBYTE_C 0 COMP_0005 0 28.05 /begin FUNCTION_LIST KF7-410.12[2] /end FUNCTION_LIST /end CHARACTERISTIC
/begin CHARACTERISTIC mUNLOCK0 "Actual lockup release delay time threshold" VALUE 0x00008D91 REC_UBYTE_C 0 COMP_0014 0 2550 /begin FUNCTION_LIST KF7-385.1[32] /end FUNCTION_LIST /end CHARACTERISTIC
/begin CHARACTERISTIC mUSADMN "US AD conversion lower limit value" VALUE 0x00008D93 REC_UBYTE_C 0 COMP_0054 0 5100 /begin FUNCTION_LIST KF7-400.1[1] /end FUNCTION_LIST /end CHARACTERISTIC
/begin CHARACTERISTIC mUSADMX "US AD conversion upper limit value" VALUE 0x00008D94 REC_UBYTE_C 0 COMP_0054 0 5100 /begin FUNCTION_LIST KF7-400.1[1] /end FUNCTION_LIST /end CHARACTERISTIC
/begin CHARACTERISTIC mUSCNTR "US AD conversion central value" VALUE 0x00008D95 REC_UBYTE_C 0 COMP_0054 0 5100 /begin FUNCTION_LIST KF7-400.1[1] /end FUNCTION_LIST /end CHARACTERISTIC
/begin CHARACTERISTIC mVCLDUTY "During cleaning, DUTY" VALUE 0x00008DAA REC_UBYTE_C 0 COMP_0021 0 99.609375 /begin FUNCTION_LIST KF7-393.1C[8] /end FUNCTION_LIST /end CHARACTERISTIC
/begin CHARACTERISTIC mVCLNE "Cleaning mode permission engine speed" VALUE 0x00008DAB REC_UBYTE_C 0 COMP_0000 0 6375 /begin FUNCTION_LIST KF7-393.1C[8] /end FUNCTION_LIST /end CHARACTERISTIC
/begin CHARACTERISTIC mVCLTWH "Cleaning mode permission coolant temperature upper limit" VALUE 0x00008DAC REC_UBYTE_C 0 COMP_0035 -50 205 /begin FUNCTION_LIST KF7-393.1C[8] /end FUNCTION_LIST /end CHARACTERISTIC
/begin CHARACTERISTIC mVCLTWL "Cleaning mode permission coolant temperature lower limit" VALUE 0x00008DAD REC_UBYTE_C 0 COMP_0035 -50 205 /begin FUNCTION_LIST KF7-393.1C[8] /end FUNCTION_LIST /end CHARACTERISTIC
/begin CHARACTERISTIC mVEERHB "Dead-zone width for the dizzer" VALUE 0x00008DB8 REC_UBYTE_C 0 COMP_0048 0 127.5 /begin FUNCTION_LIST KF7-393.1C[8] /end FUNCTION_LIST /end CHARACTERISTIC
/begin CHARACTERISTIC mVEERHD "D dead-zone width" VALUE 0x00008DB9 REC_UBYTE_C 0 COMP_0048 0 127.5 /begin FUNCTION_LIST KF7-393.1C[8] /end FUNCTION_LIST /end CHARACTERISTIC
/begin CHARACTERISTIC mVEERHI "I-gain dead-zone width" VALUE 0x00008DBC REC_UBYTE_C 0 COMP_0048 0 127.5 /begin FUNCTION_LIST KF7-393.1C[8] /end FUNCTION_LIST /end CHARACTERISTIC
/begin CHARACTERISTIC mVEERHP "P-gain dead-zone width" VALUE 0x00008DBF REC_UBYTE_C 0 COMP_0048 0 127.5 /begin FUNCTION_LIST KF7-393.1C[8] /end FUNCTION_LIST /end CHARACTERISTIC
/begin CHARACTERISTIC mVIASN0 "Variable intake valve lower limit speed 1" VALUE 0x00008DC9 REC_UBYTE_C 0 COMP_0020 0 12750 /begin FUNCTION_LIST KF7-395.1[4] /end FUNCTION_LIST /end CHARACTERISTIC
/begin CHARACTERISTIC mVIASN1 "Variable intake valve lower limit speed" VALUE 0x00008DCA REC_UBYTE_C 0 COMP_0020 0 12750 /begin FUNCTION_LIST KF7-395.1[4] /end FUNCTION_LIST /end CHARACTERISTIC
/begin CHARACTERISTIC mVIASN2 "Variable intake valve lower limit speed" VALUE 0x00008DCB REC_UBYTE_C 0 COMP_0020 0 12750 /begin FUNCTION_LIST KF7-395.1[4] /end FUNCTION_LIST /end CHARACTERISTIC
/begin CHARACTERISTIC mVIAST1 "A variable intake dialect control upper limit TP" VALUE 0x00008DCC REC_UBYTE_C 0 COMP_0001 0 31.875 /begin FUNCTION_LIST KF7-395.1[4] /end FUNCTION_LIST /end CHARACTERISTIC
/begin CHARACTERISTIC mVIAST2 "A variable intake dialect control lower limit TP" VALUE 0x00008DCD REC_UBYTE_C 0 COMP_0001 0 31.875 /begin FUNCTION_LIST KF7-395.1[4] /end FUNCTION_LIST /end CHARACTERISTIC
/begin CHARACTERISTIC mVIASTW "A variable intake dialect judgement coolant temperature" VALUE 0x00008DCE REC_UBYTE_C 0 COMP_0035 -50 205 /begin FUNCTION_LIST KF7-395.1[4] /end FUNCTION_LIST /end CHARACTERISTIC
/begin CHARACTERISTIC mVTCFUL "VTC maximum operation angle" VALUE 0x00008E2C REC_UBYTE_C 0 COMP_0048 0 127.5 /begin FUNCTION_LIST KF7-393.1C[8] /end FUNCTION_LIST /end CHARACTERISTIC
/begin CHARACTERISTIC mVTCLHT "Cleaning time" VALUE 0x00008E31 REC_UBYTE_C 0 COMP_0053 0 255 /begin FUNCTION_LIST KF7-393.1C[8] /end FUNCTION_LIST /end CHARACTERISTIC
/begin CHARACTERISTIC mVTCLLT "Cleaning period" VALUE 0x00008E32 REC_UBYTE_C 0 COMP_0014 0 2550 /begin FUNCTION_LIST KF7-393.1C[8] /end FUNCTION_LIST /end CHARACTERISTIC
/begin CHARACTERISTIC mVTCNEL "An engine rotation lower limit for the VTC drive permission" VALUE 0x00008E3B REC_UBYTE_C 0 COMP_0006 0 3187.5 /begin FUNCTION_LIST KF7-393.1C[8] /end FUNCTION_LIST /end CHARACTERISTIC
/begin CHARACTERISTIC mVTCTIM "VTC solenoid drive DUTY period" VALUE 0x00008E4C REC_UBYTE_C 0 COMP_0366 0 25500 /begin FUNCTION_LIST KF7-393.1C[8] /end FUNCTION_LIST /end CHARACTERISTIC
/begin CHARACTERISTIC mVTCTWLL "A coolant temperature lower limit 2 for the VTC drive permission" VALUE 0x00008E55 REC_UBYTE_C 0 COMP_0035 -50 205 /begin FUNCTION_LIST KF7-393.1C[8] /end FUNCTION_LIST /end CHARACTERISTIC
/begin CHARACTERISTIC mVTCVBH "A battery voltage upper limit for the VTC drive permission" VALUE 0x00008E56 REC_UBYTE_C 0 COMP_0033 0 20400 /begin FUNCTION_LIST KF7-393.1C[8] KF7-500.6D[9] KF7-500.47B[15] /end FUNCTION_LIST /end CHARACTERISTIC
/begin CHARACTERISTIC mVTCVBL "A battery voltage lower limit for the VTC drive permission" VALUE 0x00008E59 REC_UBYTE_C 0 COMP_0033 0 20400 /begin FUNCTION_LIST KF7-393.1C[8] KF7-500.6D[9] KF7-500.47B[15] /end FUNCTION_LIST /end CHARACTERISTIC
/begin CHARACTERISTIC mVTOA "At the time of ÉhÉâÉC judgement, DUTY value" VALUE 0x00008E73 REC_UBYTE_C 0 COMP_0478_S 0 2.55 /begin FUNCTION_LIST KF7-378.3B[5] /end FUNCTION_LIST /end CHARACTERISTIC
/begin CHARACTERISTIC mWETDUTY "At the time of ÉEÉFÉbÉg judgement, DUTY value" VALUE 0x00008E90 REC_UBYTE_C 0 COMP_0047 0 127.5 /begin FUNCTION_LIST KF7-378.3B[5] /end FUNCTION_LIST /end CHARACTERISTIC
/begin CHARACTERISTIC mWETTIME "At the time of ÉEÉFÉbÉg judgement, DUTY maintenance time" VALUE 0x00008E91 REC_UBYTE_C 0 COMP_0013 0 255 /begin FUNCTION_LIST KF7-378.3B[5] /end FUNCTION_LIST /end CHARACTERISTIC
/begin CHARACTERISTIC mTENGMAP "Engine torque value map" MAP 0x0000C572 REC_UWORD_C 0 COMP_0226 -3276.8 3276.7
 /begin AXIS_DESCR FIX_AXIS NO_INPUT_QUANTITY COMP_0273_S 16 400 6400 FIX_AXIS_PAR_DIST 0 1 16 /end AXIS_DESCR
 /begin AXIS_DESCR FIX_AXIS NO_INPUT_QUANTITY COMP_0132_S 16 0 150 FIX_AXIS_PAR_DIST 0 1 16 /end AXIS_DESCR
 /begin FUNCTION_LIST KF7-386.1[4] /end FUNCTION_LIST
/end CHARACTERISTIC
/begin CHARACTERISTIC mMKDSPWR "Normalized pedal pushing quantity filter weight coefficient MAP" MAP 0x00009EAE REC_UBYTE_C 0 COMP_0063 0 0.99609375
 /begin AXIS_DESCR COM_AXIS NO_INPUT_QUANTITY COMP_0047 4 0 127.5 AXIS_PTS_REF mDSPWTBP /end AXIS_DESCR
 /begin AXIS_DESCR COM_AXIS NO_INPUT_QUANTITY COMP_0275_S 4 0 204 AXIS_PTS_REF mDSDSPBP /end AXIS_DESCR
 /begin FUNCTION_LIST KF7-410.3[N] /end FUNCTION_LIST
/end CHARACTERISTIC
/begin CHARACTERISTIC mMPTOFM "An extreme short rest time map" MAP 0x0000A5CE REC_UBYTE_C 0 COMP_0014 0 2550
 /begin AXIS_DESCR COM_AXIS NO_INPUT_QUANTITY COMP_0020 4 0 12750 AXIS_PTS_REF mTXRN /end AXIS_DESCR
 /begin AXIS_DESCR COM_AXIS NO_INPUT_QUANTITY COMP_0357 4 0 112.2 AXIS_PTS_REF mTXRTV /end AXIS_DESCR
 /begin FUNCTION_LIST KF7-410.12[2] /end FUNCTION_LIST
/end CHARACTERISTIC
/begin CHARACTERISTIC mMPTXRT "Suspension time/operation time ratio map" MAP 0x0000A5DE REC_UBYTE_C 0 COMP_0260 0 25.5
 /begin AXIS_DESCR COM_AXIS NO_INPUT_QUANTITY COMP_0020 4 0 12750 AXIS_PTS_REF mTXRN /end AXIS_DESCR
 /begin AXIS_DESCR COM_AXIS NO_INPUT_QUANTITY COMP_0357 4 0 112.2 AXIS_PTS_REF mTXRTV /end AXIS_DESCR
 /begin FUNCTION_LIST KF7-410.12[2] /end FUNCTION_LIST
/end CHARACTERISTIC
/begin CHARACTERISTIC mMRHVTI "VTC target operation angle regular compensation value computed map" MAP 0x0000A63E REC_UBYTE_C 0 COMP_0256 -64 63.5
 /begin AXIS_DESCR COM_AXIS NO_INPUT_QUANTITY COMP_0020 4 0 12750 AXIS_PTS_REF mTVTRHNI /end AXIS_DESCR
 /begin AXIS_DESCR COM_AXIS NO_INPUT_QUANTITY COMP_0009 4 0 199.21875 AXIS_PTS_REF mTVTRHITI /end AXIS_DESCR
 /begin FUNCTION_LIST KF7-393.1C[8] /end FUNCTION_LIST
/end CHARACTERISTIC
/begin CHARACTERISTIC mTDATDDS "At the time of the down-shift, torque going down rate decrease rate coefficient map" MAP 0x0000AD5E REC_UBYTE_C 0 COMP_0237_S 0 0.99609375
 /begin AXIS_DESCR COM_AXIS NO_INPUT_QUANTITY COMP_0020 4 0 12750 AXIS_PTS_REF mTDATDN /end AXIS_DESCR
 /begin AXIS_DESCR COM_AXIS NO_INPUT_QUANTITY COMP_0068 4 0 255 AXIS_PTS_REF mTDATDGP /end AXIS_DESCR
 /begin FUNCTION_LIST KF7-385.2[18] /end FUNCTION_LIST
/end CHARACTERISTIC
/begin CHARACTERISTIC mTDATDDS0 "At the time of the down-shift, torque going down decrease rate choice parameter map" MAP 0x0000AD6E REC_UBYTE_C 0 COMP_0004 0 255
 /begin AXIS_DESCR FIX_AXIS NO_INPUT_QUANTITY COMP_0276_S 4 1 4 FIX_AXIS_PAR_DIST 0 1 4 /end AXIS_DESCR
 /begin AXIS_DESCR FIX_AXIS NO_INPUT_QUANTITY COMP_0068 4 0 3 FIX_AXIS_PAR_DIST 0 1 4 /end AXIS_DESCR
 /begin FUNCTION_LIST KF7-385.2[18] /end FUNCTION_LIST
/end CHARACTERISTIC
/begin CHARACTERISTIC mMDSFACSL "SLOW driving mode factor MAP" MAP 0x00009CCE REC_UBYTE_C 0 COMP_0425 0 99.99999981
 /begin AXIS_DESCR COM_AXIS NO_INPUT_QUANTITY COMP_0047 8 0 127.5 AXIS_PTS_REF mDSPWRBP /end AXIS_DESCR
 /begin AXIS_DESCR COM_AXIS NO_INPUT_QUANTITY COMP_0047 8 0 127.5 AXIS_PTS_REF mDSACTBP /end AXIS_DESCR
 /begin FUNCTION_LIST KF7-410.3[N] /end FUNCTION_LIST
/end CHARACTERISTIC
/begin CHARACTERISTIC mMKPVTC "P-gain gain computed map" MAP 0x00009EFE REC_UBYTE_C 0 COMP_0027 0 255
 /begin AXIS_DESCR COM_AXIS NO_INPUT_QUANTITY COMP_0020 8 0 12750 AXIS_PTS_REF mVTCNEJ /end AXIS_DESCR
 /begin AXIS_DESCR COM_AXIS NO_INPUT_QUANTITY COMP_0035 8 -50 205 AXIS_PTS_REF mVTCTWJ /end AXIS_DESCR
 /begin FUNCTION_LIST KF7-393.1C[8] /end FUNCTION_LIST
/end CHARACTERISTIC
/begin CHARACTERISTIC mMKPVTCL "The left bank P-gain gain computed map" MAP 0x00009F3E REC_UBYTE_C 0 COMP_0027 0 255
 /begin AXIS_DESCR COM_AXIS NO_INPUT_QUANTITY COMP_0020 8 0 12750 AXIS_PTS_REF mVTCNEJ /end AXIS_DESCR
 /begin AXIS_DESCR COM_AXIS NO_INPUT_QUANTITY COMP_0035 8 -50 205 AXIS_PTS_REF mVTCTWJ /end AXIS_DESCR
 /begin FUNCTION_LIST KF7-393.1C[8] /end FUNCTION_LIST
/end CHARACTERISTIC
/begin CHARACTERISTIC mMPAMBFAC "The torque atomospheric pressure compensation coefficient map that engine output is possible" MAP 0x0000B5F2 REC_UWORD_C 0 COMP_0485_S 0 1599.9780435
 /begin AXIS_DESCR COM_AXIS NO_INPUT_QUANTITY COMP_0486 8 0 5119.921875 AXIS_PTS_REF mPFCAMBBP /end AXIS_DESCR
 /begin AXIS_DESCR COM_AXIS NO_INPUT_QUANTITY COMP_0065 8 0 204796.875 AXIS_PTS_REF mPFCNEBP /end AXIS_DESCR
 /begin FUNCTION_LIST KF7-410.11M[4] /end FUNCTION_LIST
/end CHARACTERISTIC
/begin CHARACTERISTIC mPIADVAT "A Pi per cent table for DUETTE" CURVE 0x0000CC60 REC_UBYTE_C 0 COMP_0032 0 0.99609375
 /begin AXIS_DESCR COM_AXIS NO_INPUT_QUANTITY COMP_0017 16 0 255 AXIS_PTS_REF mADVPIAT /end AXIS_DESCR
 /begin FUNCTION_LIST KF7-385.2[18] KF7-386.1[4] KF7-386.2[4] R301.1.Torque_realization_1_0_3 /end FUNCTION_LIST
/end CHARACTERISTIC
/begin CHARACTERISTIC mTFCRD "Fuel cut retard delay time table" CURVE 0x0000D0A6 REC_UBYTE_C 0 COMP_0008 0 25500
 /begin AXIS_DESCR FIX_AXIS NO_INPUT_QUANTITY COMP_0280_S 16 -40 110 FIX_AXIS_PAR_DIST 0 1 16 /end AXIS_DESCR
 /begin FUNCTION_LIST KF7-390.3A[15] R301.5.FuelCut_1_2_2 /end FUNCTION_LIST
/end CHARACTERISTIC
/begin CHARACTERISTIC mTKTETX "The first delay weight table" CURVE 0x0000EAE2 REC_UWORD_C 0 COMP_0294_S 0 0.999985458
 /begin AXIS_DESCR FIX_AXIS NO_INPUT_QUANTITY COMP_0271_S 16 0 6000 FIX_AXIS_PAR_DIST 0 1 16 /end AXIS_DESCR
 /begin FUNCTION_LIST KF7-385.2[18] /end FUNCTION_LIST
/end CHARACTERISTIC
/begin CHARACTERISTIC mTMAXPTQ "The torque basic value MAP that engine output is possible" CURVE 0x0000EB22 REC_UWORD_C 0 COMP_0226 -3276.8 3276.7
 /begin AXIS_DESCR COM_AXIS NO_INPUT_QUANTITY COMP_0065 16 0 204796.875 AXIS_PTS_REF mDRTQSPNE /end AXIS_DESCR
 /begin FUNCTION_LIST KF7-410.11M[4] R000.1.RS_Integ_1_10_2 /end FUNCTION_LIST
/end CHARACTERISTIC
/begin CHARACTERISTIC mTRTT "TDM table" CURVE 0x0000D892 REC_UBYTE_C 0 COMP_0017 0 255
 /begin AXIS_DESCR FIX_AXIS NO_INPUT_QUANTITY COMP_0246 16 0 93.75 FIX_AXIS_PAR_DIST 0 1 16 /end AXIS_DESCR
 /begin FUNCTION_LIST KF7-390.1A[3] /end FUNCTION_LIST
/end CHARACTERISTIC
/begin CHARACTERISTIC mTTANFAC "The torque intake air temperature compensation coefficient map that engine output is possible" CURVE 0x0000F1DE REC_UWORD_C 0 COMP_0485_S 0 1599.9780435
 /begin AXIS_DESCR COM_AXIS NO_INPUT_QUANTITY COMP_0210_S 16 -50 65485 AXIS_PTS_REF mTAFCTABP /end AXIS_DESCR
 /begin FUNCTION_LIST KF7-410.11M[4] /end FUNCTION_LIST
/end CHARACTERISTIC
/begin CHARACTERISTIC mTTTR "Base torque table" CURVE 0x0000DC12 REC_UBYTE_C 0 COMP_0009 0 199.21875
 /begin AXIS_DESCR FIX_AXIS NO_INPUT_QUANTITY COMP_0055 16 0 60 FIX_AXIS_PAR_DIST 0 1 16 /end AXIS_DESCR
 /begin FUNCTION_LIST KF7-390.1A[3] /end FUNCTION_LIST
/end CHARACTERISTIC
/begin CHARACTERISTIC mTTXNEL "Fuel cut prohibition speed table" CURVE 0x0000DC9A REC_UBYTE_C 0 COMP_0006 0 3187.5
 /begin AXIS_DESCR FIX_AXIS NO_INPUT_QUANTITY COMP_0280_S 16 -40 110 FIX_AXIS_PAR_DIST 0 1 16 /end AXIS_DESCR
 /begin FUNCTION_LIST KF7-410.12[2] /end FUNCTION_LIST
/end CHARACTERISTIC
/begin CHARACTERISTIC mTDATRETP "Before gear shift, at the time of the torque going down, torque going down rate rate of increase coefficient table" CURVE 0x0000CF3E REC_UBYTE_C 0 COMP_0237_S 0 0.99609375
 /begin AXIS_DESCR FIX_AXIS NO_INPUT_QUANTITY COMP_0276_S 4 1 4 FIX_AXIS_PAR_DIST 0 1 4 /end AXIS_DESCR
 /begin FUNCTION_LIST KF7-385.2[18] /end FUNCTION_LIST
/end CHARACTERISTIC
/begin CHARACTERISTIC mTDATRETU "Torque going down rate rate of increase coefficient table" CURVE 0x0000CF42 REC_UBYTE_C 0 COMP_0237_S 0 0.99609375
 /begin AXIS_DESCR FIX_AXIS NO_INPUT_QUANTITY COMP_0276_S 4 1 4 FIX_AXIS_PAR_DIST 0 1 4 /end AXIS_DESCR
 /begin FUNCTION_LIST KF7-385.2[18] /end FUNCTION_LIST
/end CHARACTERISTIC
/begin CHARACTERISTIC mTTDRONC "As soon as possible, torque going down rate coefficient table" CURVE 0x0000D9CA REC_UBYTE_C 0 COMP_0032 0 0.99609375
 /begin AXIS_DESCR FIX_AXIS NO_INPUT_QUANTITY COMP_0276_S 4 1 4 FIX_AXIS_PAR_DIST 0 1 4 /end AXIS_DESCR
 /begin FUNCTION_LIST KF7-385.2[18] /end FUNCTION_LIST
/end CHARACTERISTIC
/begin CHARACTERISTIC mTDAPOREF "Pedal pushing speed reference value table" CURVE 0x0000CF26 REC_UBYTE_C 0 COMP_0516_S 0 31.875
 /begin AXIS_DESCR COM_AXIS NO_INPUT_QUANTITY COMP_0275_S 8 0 204 AXIS_PTS_REF mGAPVSBP /end AXIS_DESCR
 /begin FUNCTION_LIST KF7-410.3[N] /end FUNCTION_LIST
/end CHARACTERISTIC
/begin CHARACTERISTIC mTDATDPRE "Before gear shift, at the time of the torque going down, torque going down rate decrease rate coefficient table" CURVE 0x0000CF36 REC_UBYTE_C 0 COMP_0237_S 0 0.99609375
 /begin AXIS_DESCR FIX_AXIS NO_INPUT_QUANTITY COMP_0315_S 8 10 80 FIX_AXIS_PAR_DIST 0 1 8 /end AXIS_DESCR
 /begin FUNCTION_LIST KF7-385.2[18] /end FUNCTION_LIST
/end CHARACTERISTIC
/begin CHARACTERISTIC mTKDVTC "D gain computed table" CURVE 0x0000D37A REC_UBYTE_C 0 COMP_0027 0 255
 /begin AXIS_DESCR COM_AXIS NO_INPUT_QUANTITY COMP_0020 8 0 12750 AXIS_PTS_REF mLVTCD /end AXIS_DESCR
 /begin FUNCTION_LIST KF7-393.1C[8] /end FUNCTION_LIST
/end CHARACTERISTIC
/begin CHARACTERISTIC mTKDVTCL "The left bank D gain computed table" CURVE 0x0000D3A2 REC_UBYTE_C 0 COMP_0027 0 255
 /begin AXIS_DESCR COM_AXIS NO_INPUT_QUANTITY COMP_0020 8 0 12750 AXIS_PTS_REF mLVTCD /end AXIS_DESCR
 /begin FUNCTION_LIST KF7-393.1C[8] /end FUNCTION_LIST
/end CHARACTERISTIC
/begin CHARACTERISTIC mTKMRTQ "In the KMR delay, torque compensation table" CURVE 0x0000D3EA REC_UBYTE_C 0 COMP_0063 0 0.99609375
 /begin AXIS_DESCR COM_AXIS NO_INPUT_QUANTITY COMP_0045 8 0 1.9921875 AXIS_PTS_REF mDTFBYA /end AXIS_DESCR
 /begin FUNCTION_LIST KF7-386.1[4] /end FUNCTION_LIST
/end CHARACTERISTIC
/begin CHARACTERISTIC mTTDRDSH0 "At the time of the down-shift, target torque going down rate (high-octane, NEXTGP=0)" CURVE 0x0000D992 REC_UBYTE_C 0 COMP_0063 0 0.99609375
 /begin AXIS_DESCR COM_AXIS NO_INPUT_QUANTITY COMP_0020 8 0 12750 AXIS_PTS_REF mTTDRDSN /end AXIS_DESCR
 /begin FUNCTION_LIST KF7-385.2[18] /end FUNCTION_LIST
/end CHARACTERISTIC
/begin CHARACTERISTIC mTTDRDSH1 "At the time of the down-shift, target torque going down rate (high-octane, NEXTGP=1)" CURVE 0x0000D99A REC_UBYTE_C 0 COMP_0063 0 0.99609375
 /begin AXIS_DESCR COM_AXIS NO_INPUT_QUANTITY COMP_0020 8 0 12750 AXIS_PTS_REF mTTDRDSN /end AXIS_DESCR
 /begin FUNCTION_LIST KF7-385.2[18] /end FUNCTION_LIST
/end CHARACTERISTIC
/begin CHARACTERISTIC mTTDRDSH2 "At the time of the down-shift, target torque going down rate (high-octane, NEXTGP=2)" CURVE 0x0000D9A2 REC_UBYTE_C 0 COMP_0063 0 0.99609375
 /begin AXIS_DESCR COM_AXIS NO_INPUT_QUANTITY COMP_0020 8 0 12750 AXIS_PTS_REF mTTDRDSN /end AXIS_DESCR
 /begin FUNCTION_LIST KF7-385.2[18] /end FUNCTION_LIST
/end CHARACTERISTIC
/begin CHARACTERISTIC mTTDRDSR0 "At the time of the down-shift, target torque going down rate (high-octane, NEXTGP=0)" CURVE 0x0000D9B2 REC_UBYTE_C 0 COMP_0063 0 0.99609375
 /begin AXIS_DESCR COM_AXIS NO_INPUT_QUANTITY COMP_0020 8 0 12750 AXIS_PTS_REF mTTDRDSN /end AXIS_DESCR
 /begin FUNCTION_LIST KF7-385.2[18] /end FUNCTION_LIST
/end CHARACTERISTIC
/begin CHARACTERISTIC mTTDRDSR1 "At the time of the down-shift, target torque going down rate (high-octane, NEXTGP=1)" CURVE 0x0000D9BA REC_UBYTE_C 0 COMP_0063 0 0.99609375
 /begin AXIS_DESCR COM_AXIS NO_INPUT_QUANTITY COMP_0020 8 0 12750 AXIS_PTS_REF mTTDRDSN /end AXIS_DESCR
 /begin FUNCTION_LIST KF7-385.2[18] /end FUNCTION_LIST
/end CHARACTERISTIC
/begin CHARACTERISTIC mTTDRDSR2 "At the time of the down-shift, target torque going down rate (high-octane, NEXTGP=2)" CURVE 0x0000D9C2 REC_UBYTE_C 0 COMP_0063 0 0.99609375
 /begin AXIS_DESCR COM_AXIS NO_INPUT_QUANTITY COMP_0020 8 0 12750 AXIS_PTS_REF mTTDRDSN /end AXIS_DESCR
 /begin FUNCTION_LIST KF7-385.2[18] /end FUNCTION_LIST
/end CHARACTERISTIC
/begin CHARACTERISTIC mTTDRPRH1 "Before gear shift, target torque going down rate (high-octane, NEXTGP=1)" CURVE 0x0000D9CE REC_UBYTE_C 0 COMP_0063 0 0.99609375
 /begin AXIS_DESCR FIX_AXIS NO_INPUT_QUANTITY COMP_0315_S 8 10 80 FIX_AXIS_PAR_DIST 0 1 8 /end AXIS_DESCR
 /begin FUNCTION_LIST KF7-385.2[18] /end FUNCTION_LIST
/end CHARACTERISTIC
/begin CHARACTERISTIC mTTDRPRH2 "Before gear shift, target torque going down rate (high-octane, NEXTGP=2,3)" CURVE 0x0000D9D6 REC_UBYTE_C 0 COMP_0063 0 0.99609375
 /begin AXIS_DESCR FIX_AXIS NO_INPUT_QUANTITY COMP_0315_S 8 10 80 FIX_AXIS_PAR_DIST 0 1 8 /end AXIS_DESCR
 /begin FUNCTION_LIST KF7-385.2[18] /end FUNCTION_LIST
/end CHARACTERISTIC
/begin CHARACTERISTIC mTTDRPRR1 "Before gear shift, target torque going down rate (regular, NEXTGP=1)" CURVE 0x0000D9DE REC_UBYTE_C 0 COMP_0063 0 0.99609375
 /begin AXIS_DESCR FIX_AXIS NO_INPUT_QUANTITY COMP_0315_S 8 10 80 FIX_AXIS_PAR_DIST 0 1 8 /end AXIS_DESCR
 /begin FUNCTION_LIST KF7-385.2[18] /end FUNCTION_LIST
/end CHARACTERISTIC
/begin CHARACTERISTIC mTTDRPRR2 "Before gear shift, target torque going down rate (regular, NEXTGP=2,3)" CURVE 0x0000D9E6 REC_UBYTE_C 0 COMP_0063 0 0.99609375
 /begin AXIS_DESCR FIX_AXIS NO_INPUT_QUANTITY COMP_0315_S 8 10 80 FIX_AXIS_PAR_DIST 0 1 8 /end AXIS_DESCR
 /begin FUNCTION_LIST KF7-385.2[18] /end FUNCTION_LIST
/end CHARACTERISTIC
/begin CHARACTERISTIC mTTDRUSH1 "At the time of the up-shift, target torque going down rate (high-octane, NEXTGP=1)" CURVE 0x0000D9EE REC_UBYTE_C 0 COMP_0063 0 0.99609375
 /begin AXIS_DESCR FIX_AXIS NO_INPUT_QUANTITY COMP_0315_S 8 10 80 FIX_AXIS_PAR_DIST 0 1 8 /end AXIS_DESCR
 /begin FUNCTION_LIST KF7-385.2[18] /end FUNCTION_LIST
/end CHARACTERISTIC
/begin CHARACTERISTIC mTTDRUSH2 "At the time of the up-shift, target torque going down rate (high-octane, NEXTGP=2)" CURVE 0x0000D9F6 REC_UBYTE_C 0 COMP_0063 0 0.99609375
 /begin AXIS_DESCR FIX_AXIS NO_INPUT_QUANTITY COMP_0315_S 8 10 80 FIX_AXIS_PAR_DIST 0 1 8 /end AXIS_DESCR
 /begin FUNCTION_LIST KF7-385.2[18] /end FUNCTION_LIST
/end CHARACTERISTIC
/begin CHARACTERISTIC mTTDRUSH3 "At the time of the up-shift, target torque going down rate (high-octane, NEXTGP=3)" CURVE 0x0000D9FE REC_UBYTE_C 0 COMP_0063 0 0.99609375
 /begin AXIS_DESCR FIX_AXIS NO_INPUT_QUANTITY COMP_0315_S 8 10 80 FIX_AXIS_PAR_DIST 0 1 8 /end AXIS_DESCR
 /begin FUNCTION_LIST KF7-385.2[18] /end FUNCTION_LIST
/end CHARACTERISTIC
/begin CHARACTERISTIC mTTDRUSR1 "At the time of the up-shift, target torque going down rate (regular, NEXTGP=1)" CURVE 0x0000DA06 REC_UBYTE_C 0 COMP_0063 0 0.99609375
 /begin AXIS_DESCR FIX_AXIS NO_INPUT_QUANTITY COMP_0315_S 8 10 80 FIX_AXIS_PAR_DIST 0 1 8 /end AXIS_DESCR
 /begin FUNCTION_LIST KF7-385.2[18] /end FUNCTION_LIST
/end CHARACTERISTIC
/begin CHARACTERISTIC mTTDRUSR2 "At the time of the up-shift, target torque going down rate (regular, NEXTGP=2)" CURVE 0x0000DA0E REC_UBYTE_C 0 COMP_0063 0 0.99609375
 /begin AXIS_DESCR FIX_AXIS NO_INPUT_QUANTITY COMP_0315_S 8 10 80 FIX_AXIS_PAR_DIST 0 1 8 /end AXIS_DESCR
 /begin FUNCTION_LIST KF7-385.2[18] /end FUNCTION_LIST
/end CHARACTERISTIC
/begin CHARACTERISTIC mTTDRUSR3 "At the time of the up-shift, target torque going down rate (regular, NEXTGP=3)" CURVE 0x0000DA16 REC_UBYTE_C 0 COMP_0063 0 0.99609375
 /begin AXIS_DESCR FIX_AXIS NO_INPUT_QUANTITY COMP_0315_S 8 10 80 FIX_AXIS_PAR_DIST 0 1 8 /end AXIS_DESCR
 /begin FUNCTION_LIST KF7-385.2[18] /end FUNCTION_LIST
/end CHARACTERISTIC
/begin CHARACTERISTIC mTTEFRIC "Friction torque table" CURVE 0x0000F25E REC_UWORD_C 0 COMP_0196 0 6553.5
 /begin AXIS_DESCR FIX_AXIS NO_INPUT_QUANTITY COMP_0330_S 8 800 6400 FIX_AXIS_PAR_DIST 0 1 8 /end AXIS_DESCR
 /begin FUNCTION_LIST KF7-386.1[4] /end FUNCTION_LIST
/end CHARACTERISTIC
/begin CHARACTERISTIC mTVTBASE "Neutral position DUTY ratio computed table" CURVE 0x0000DCCA REC_UBYTE_C 0 COMP_0021 0 99.609375
 /begin AXIS_DESCR FIX_AXIS NO_INPUT_QUANTITY COMP_0278_S 8 -40 100 FIX_AXIS_PAR_DIST 0 1 8 /end AXIS_DESCR
 /begin FUNCTION_LIST KF7-393.1C[8] /end FUNCTION_LIST
/end CHARACTERISTIC
/begin CHARACTERISTIC mTVTBASEL "The left bank neutral position DUTY ratio computed table" CURVE 0x0000DCD2 REC_UBYTE_C 0 COMP_0021 0 99.609375
 /begin AXIS_DESCR FIX_AXIS NO_INPUT_QUANTITY COMP_0278_S 8 -40 100 FIX_AXIS_PAR_DIST 0 1 8 /end AXIS_DESCR
 /begin FUNCTION_LIST KF7-393.1C[8] /end FUNCTION_LIST
/end CHARACTERISTIC
/begin CHARACTERISTIC mTSL "SLI table" MAP 0x0000C772 REC_UWORD_C 0 COMP_0032 0 255.99609375
 /begin AXIS_DESCR FIX_AXIS NO_INPUT_QUANTITY COMP_0205_S 8 0 7 FIX_AXIS_PAR_DIST 0 1 8 /end AXIS_DESCR
 /begin AXIS_DESCR FIX_AXIS NO_INPUT_QUANTITY COMP_0273_S 16 400 6400 FIX_AXIS_PAR_DIST 0 1 16 /end AXIS_DESCR
 /begin FUNCTION_LIST KF7-379.1[9] /end FUNCTION_LIST
/end CHARACTERISTIC
/begin CHARACTERISTIC mTDRYDUTY "At the time of ÉhÉâÉC judgement, DUTY value" CURVE 0x0000CFC2 REC_UBYTE_C 0 COMP_0047 0 127.5
 /begin AXIS_DESCR FIX_AXIS NO_INPUT_QUANTITY COMP_0205_S 4 0 3 FIX_AXIS_PAR_DIST 0 1 4 /end AXIS_DESCR
 /begin FUNCTION_LIST KF7-378.3B[5] /end FUNCTION_LIST
/end CHARACTERISTIC
/begin CHARACTERISTIC mTDRYTIME "At the time of ÉhÉâÉC judgement, DUTY maintenance time" CURVE 0x0000CFC6 REC_UBYTE_C 0 COMP_0013 0 255
 /begin AXIS_DESCR FIX_AXIS NO_INPUT_QUANTITY COMP_0205_S 4 0 3 FIX_AXIS_PAR_DIST 0 1 4 /end AXIS_DESCR
 /begin FUNCTION_LIST KF7-378.3B[5] /end FUNCTION_LIST
/end CHARACTERISTIC
/begin CHARACTERISTIC mfAFMNG "0:Not DGN  1:DGN" VALUE 0x0001020C REC_UBYTE_C 0 COMP_0283 0 1 BIT_MASK 0x0040
 /begin FUNCTION_LIST KF7-450.5[1] KF7-500.2A[29] KF7-500.7[12] KF7-525.2[6] KF7-580.1[8] /end FUNCTION_LIST
/end CHARACTERISTIC
/begin CHARACTERISTIC mfSYNCNG "0:Not DGN  1:DGN" VALUE 0x00010227 REC_UBYTE_C 0 COMP_0283 0 1 BIT_MASK 0x0080
 /begin FUNCTION_LIST KF7-450.22[1] KF7-500.2A[29] KF7-505.43[3] KF7-525.2[6] KF7-525.2S[10] /end FUNCTION_LIST
/end CHARACTERISTIC
/begin CHARACTERISTIC mfCALCNG "0:Not DGN  1:DGN" VALUE 0x00010227 REC_UBYTE_C 0 COMP_0283 0 1 BIT_MASK 0x0010
 /begin FUNCTION_LIST KF7-450.22[1] KF7-500.2A[29] KF7-505.42[2] KF7-525.2[6] KF7-525.2S[10] /end FUNCTION_LIST
/end CHARACTERISTIC
/begin CHARACTERISTIC mfTPLRNG "0:Not DGN  1:DGN" VALUE 0x0001022B REC_UBYTE_C 0 COMP_0283 0 1 BIT_MASK 0x0001
 /begin FUNCTION_LIST KF7-450.22[1] KF7-500.2A[29] KF7-505.30[6] KF7-525.2[6] KF7-525.2S[10] /end FUNCTION_LIST
/end CHARACTERISTIC
/begin CHARACTERISTIC mfBURNG "0:Not DGN  1:DGN" VALUE 0x00010230 REC_UBYTE_C 0 COMP_0283 0 1 BIT_MASK 0x0010
 /begin FUNCTION_LIST KF7-450.22[1] KF7-500.2A[29] KF7-505.24[1] KF7-525.2[6] KF7-525.2S[10] /end FUNCTION_LIST
/end CHARACTERISTIC
/begin CHARACTERISTIC mfSSOFNG "0:Not DGN  1:DGN" VALUE 0x00010230 REC_UBYTE_C 0 COMP_0283 0 1 BIT_MASK 0x0004
 /begin FUNCTION_LIST KF7-450.22[1] KF7-500.2A[29] KF7-505.25[3] KF7-525.2[6] KF7-525.2S[10] /end FUNCTION_LIST
/end CHARACTERISTIC
/begin CHARACTERISTIC mfWDTNGM "0:Not DGN  1:DGN" VALUE 0x00010231 REC_UBYTE_C 0 COMP_0283 0 1 BIT_MASK 0x0008
 /begin FUNCTION_LIST KF7-450.22[1] KF7-500.2A[29] KF7-505.18[3] KF7-525.2[6] KF7-525.2S[10] /end FUNCTION_LIST
/end CHARACTERISTIC
/begin AXIS_PTS mDSPWTBP "0.5%" 0x0000C952 NO_INPUT_QUANTITY REC_AXIS_UBYTE 0 COMP_0047 4 0 127.5 /end AXIS_PTS
/begin AXIS_PTS mDSDSPBP "0.8km/h" 0x0000C946 NO_INPUT_QUANTITY REC_AXIS_UBYTE 0 COMP_0275_S 4 0 204 /end AXIS_PTS
/begin AXIS_PTS mTXRN "50rpm" 0x0000DDDE NO_INPUT_QUANTITY REC_AXIS_UBYTE 0 COMP_0020 4 0 12750 /end AXIS_PTS
/begin AXIS_PTS mTXRTV "0.44deg" 0x0000DDE2 NO_INPUT_QUANTITY REC_AXIS_UBYTE 0 COMP_0357 4 0 112.2 /end AXIS_PTS
/begin AXIS_PTS mTVTRHNI "50rpm" 0x0000DDAA NO_INPUT_QUANTITY REC_AXIS_UBYTE 0 COMP_0020 4 0 12750 /end AXIS_PTS
/begin AXIS_PTS mTVTRHITI "100/128%" 0x0000DDA2 NO_INPUT_QUANTITY REC_AXIS_UBYTE 0 COMP_0009 4 0 199.21875 /end AXIS_PTS
/begin AXIS_PTS mTDATDN "50rpm" 0x0000CF32 NO_INPUT_QUANTITY REC_AXIS_UBYTE 0 COMP_0020 4 0 12750 /end AXIS_PTS
/begin AXIS_PTS mTDATDGP "1-" 0x0000CF2E NO_INPUT_QUANTITY REC_AXIS_UBYTE 0 COMP_0068 4 0 255 /end AXIS_PTS
/begin AXIS_PTS mDSPWRBP "0.5%" 0x0000C94A NO_INPUT_QUANTITY REC_AXIS_UBYTE 0 COMP_0047 8 0 127.5 /end AXIS_PTS
/begin AXIS_PTS mDSACTBP "0.5%" 0x0000C93E NO_INPUT_QUANTITY REC_AXIS_UBYTE 0 COMP_0047 8 0 127.5 /end AXIS_PTS
/begin AXIS_PTS mVTCNEJ "50rpm" 0x0000DE06 NO_INPUT_QUANTITY REC_AXIS_UBYTE 0 COMP_0020 8 0 12750 /end AXIS_PTS
/begin AXIS_PTS mVTCTWJ "1Åé" 0x0000DE26 NO_INPUT_QUANTITY REC_AXIS_UBYTE 0 COMP_0035 8 -50 205 /end AXIS_PTS
/begin AXIS_PTS mPFCAMBBP "20/256mv" 0x0000E30C NO_INPUT_QUANTITY REC_AXIS_UWORD 0 COMP_0486 8 0 5119.921875 /end AXIS_PTS
/begin AXIS_PTS mPFCNEBP "3.125rpm" 0x0000E31C NO_INPUT_QUANTITY REC_AXIS_UWORD 0 COMP_0065 8 0 204796.875 /end AXIS_PTS
/begin AXIS_PTS mADVPIAT "1deg" 0x0000C882 NO_INPUT_QUANTITY REC_AXIS_UBYTE 0 COMP_0017 16 0 255 /end AXIS_PTS
/begin AXIS_PTS mDRTQSPNE "3.125rpm" 0x0000E020 NO_INPUT_QUANTITY REC_AXIS_UWORD 0 COMP_0065 16 0 204796.875 /end AXIS_PTS
/begin AXIS_PTS mTAFCTABP "1Åé" 0x0000E4AA NO_INPUT_QUANTITY REC_AXIS_UWORD 0 COMP_0210_S 16 -50 65485 /end AXIS_PTS
/begin AXIS_PTS mGAPVSBP "0.8km/h" 0x0000C984 NO_INPUT_QUANTITY REC_AXIS_UBYTE 0 COMP_0275_S 8 0 204 /end AXIS_PTS
/begin AXIS_PTS mLVTCD "50rpm" 0x0000CB1F NO_INPUT_QUANTITY REC_AXIS_UBYTE 0 COMP_0020 8 0 12750 /end AXIS_PTS
/begin AXIS_PTS mDTFBYA "1/128-" 0x0000C956 NO_INPUT_QUANTITY REC_AXIS_UBYTE 0 COMP_0045 8 0 1.9921875 /end AXIS_PTS
/begin AXIS_PTS mTTDRDSN "50rpm" 0x0000D9AA NO_INPUT_QUANTITY REC_AXIS_UBYTE 0 COMP_0020 8 0 12750 /end AXIS_PTS
/begin MEASUREMENT fFDITHER "0:ã÷é~  1:ãñâ¬" UBYTE COMP_0283 1 100 0 1 BIT_MASK 0x0002 ECU_ADDRESS 0xFFFF1372 /begin FUNCTION_LIST KF7-393.1C[8] /end FUNCTION_LIST /end MEASUREMENT
/begin MEASUREMENT fRO2DYMX2 "0:è„å¿íl2îÒèoóÕ  1:è„å¿íl2èoóÕ" UBYTE COMP_0283 1 100 0 1 BIT_MASK 0x0002 ECU_ADDRESS 0xFFFF1761 /begin FUNCTION_LIST KF7-378.2B[6] /end FUNCTION_LIST /end MEASUREMENT
/begin MEASUREMENT wfETQDNR "Engine torque decrease requirement flag" UBYTE COMP_0283 1 100 0 1 BIT_MASK 0x0020 ECU_ADDRESS 0xFFFF49CE /begin FUNCTION_LIST KF7-393.1C[8] /end FUNCTION_LIST /end MEASUREMENT
/begin MEASUREMENT wfMUPSFTTD "M range up-shift torque going down requirement signal" UBYTE COMP_0283 1 100 0 1 BIT_MASK 0x0040 ECU_ADDRESS 0xFFFF49D2 /begin FUNCTION_LIST KF7-385.2[18] KF7-385.3[4] /end FUNCTION_LIST /end MEASUREMENT
/begin MEASUREMENT fAPSKD "Kick going down judgement" UBYTE COMP_0283 1 100 0 1 BIT_MASK 0x0008 ECU_ADDRESS 0xFFFF49D7 DISPLAY_IDENTIFIER Vbx_acel_pdl_kd
 /begin FUNCTION_LIST KF7-410.10[6] R000.1.RS_Integ_1_10_2 R101.1M.aps_pedin_1_2_2 R204.1.CanComm_1_9_2 R208.4.STFLW_1_2_2 R208.6.SERVO_1_2_2 R901.1.Diag_on_can_app_1_6_2 /end FUNCTION_LIST
/end MEASUREMENT
/begin MEASUREMENT fETQDNR "Engine torque decrease requirement flag" UBYTE COMP_0283 1 100 0 1 BIT_MASK 0x0020 ECU_ADDRESS 0xFFFF49DE /begin FUNCTION_LIST KF7-393.1C[8] /end FUNCTION_LIST /end MEASUREMENT
/begin MEASUREMENT fETSCLKNG "ETS clock NG flag" UBYTE COMP_0283 1 100 0 1 BIT_MASK 0x0010 ECU_ADDRESS 0xFFFF49DE /begin FUNCTION_LIST KF7-410.21[3] /end FUNCTION_LIST /end MEASUREMENT
/begin MEASUREMENT fETSIVDCA "ETS Invalid torque requirement realtime NG flag" UBYTE COMP_0283 1 100 0 1 BIT_MASK 0x0008 ECU_ADDRESS 0xFFFF49DE /begin FUNCTION_LIST KF7-410.21[3] /end FUNCTION_LIST /end MEASUREMENT
/begin MEASUREMENT fMUPSFTTD "M range up-shift torque going down requirement signal" UBYTE COMP_0283 1 100 0 1 BIT_MASK 0x0040 ECU_ADDRESS 0xFFFF49E2 /begin FUNCTION_LIST KF7-385.2[18] KF7-385.3[4] /end FUNCTION_LIST /end MEASUREMENT
/begin MEASUREMENT fASRVALID "ASR Effective flag" UBYTE COMP_0283 1 100 0 1 BIT_MASK 0x0001 ECU_ADDRESS 0xFFFF4283 DISPLAY_IDENTIFIER Vbx_asr_sp_vld
 /begin FUNCTION_LIST KF7-385.2[18] KF7-410.12[2] R104.1.brk_absct_1_2_2 R105.1.tra_atsip_1_0_1 R105.2.tra_sdfta_1_1_2 R106.5.epw_ptcxx_1_1_0 R301.1.Torque_realization_1_0_3 /end FUNCTION_LIST
/end MEASUREMENT
/begin MEASUREMENT fATAPSNG "APS Unusual signal" UBYTE COMP_0283 1 100 0 1 BIT_MASK 0x0080 ECU_ADDRESS 0xFFFF4284 /begin FUNCTION_LIST KF7-385.1[32] /end FUNCTION_LIST /end MEASUREMENT
/begin MEASUREMENT fDSACTON "Normalized pedal pushing speed operation trigger" UBYTE COMP_0283 1 100 0 1 BIT_MASK 0x0040 ECU_ADDRESS 0xFFFF4295 /begin FUNCTION_LIST KF7-410.3[N] /end FUNCTION_LIST /end MEASUREMENT
/begin MEASUREMENT fDSPWRON "Normalized pedal pushing quantity operation trigger" UBYTE COMP_0283 1 100 0 1 BIT_MASK 0x0020 ECU_ADDRESS 0xFFFF4295 /begin FUNCTION_LIST KF7-410.3[N] /end FUNCTION_LIST /end MEASUREMENT
/begin MEASUREMENT fETSIVDNG "ETS Invalid torque requirement NG flag" UBYTE COMP_0283 1 100 0 1 BIT_MASK 0x0001 ECU_ADDRESS 0xFFFF42A2 /begin FUNCTION_LIST KF7-410.21[3] /end FUNCTION_LIST /end MEASUREMENT
/begin MEASUREMENT fETSLNKCA "ETS link check realtime NG flag" UBYTE COMP_0283 1 100 0 1 BIT_MASK 0x0080 ECU_ADDRESS 0xFFFF42A3 /begin FUNCTION_LIST KF7-410.21[3] /end FUNCTION_LIST /end MEASUREMENT
/begin MEASUREMENT fETSLNKNG "ETS link check NG flag" UBYTE COMP_0283 1 100 0 1 BIT_MASK 0x0040 ECU_ADDRESS 0xFFFF42A3 /begin FUNCTION_LIST KF7-410.21[3] /end FUNCTION_LIST /end MEASUREMENT
/begin MEASUREMENT fHTWVSP "A high coolant temperature L/U requirement vehicle speed lower limit hysteresis flag" UBYTE COMP_0283 1 100 0 1 BIT_MASK 0x0001 ECU_ADDRESS 0xFFFF42C7 /begin FUNCTION_LIST KF7-385.1[32] /end FUNCTION_LIST /end MEASUREMENT
/begin MEASUREMENT fINTVAL "Interval control flag" UBYTE COMP_0283 1 100 0 1 BIT_MASK 0x0001 ECU_ADDRESS 0xFFFF42C9
 /begin FUNCTION_LIST KF7-385.2[18] KF7-410.12[2] R301.1.Torque_realization_1_0_3 /end FUNCTION_LIST
/end MEASUREMENT
/begin MEASUREMENT fLUHTW "A high coolant temperature L/U requirement coolant temperature lower limit hysteresis flag" UBYTE COMP_0283 1 100 0 1 BIT_MASK 0x0020 ECU_ADDRESS 0xFFFF42CE /begin FUNCTION_LIST KF7-385.1[32] /end FUNCTION_LIST /end MEASUREMENT
/begin MEASUREMENT fMILNGF "Watch mechanism unusual time judgement flag" UBYTE COMP_0283 1 100 0 1 BIT_MASK 0x0040 ECU_ADDRESS 0xFFFF42D5 /begin FUNCTION_LIST KF7-450.22[1] /end FUNCTION_LIST /end MEASUREMENT
/begin MEASUREMENT fTCSDGC "At the time of the TCS operation, self-diagnosis prohibition flag" UBYTE COMP_0283 1 100 0 1 BIT_MASK 0x0004 ECU_ADDRESS 0xFFFF42F2 /begin FUNCTION_LIST KF7-381.9[2] KF7-410.12[2] KF7-500.12[3] /end FUNCTION_LIST /end MEASUREMENT
/begin MEASUREMENT fTXAPH2 "TXAPH2# hysteresis flag" UBYTE COMP_0283 1 100 0 1 BIT_MASK 0x0010 ECU_ADDRESS 0xFFFF42F7 /begin FUNCTION_LIST KF7-410.12[2] /end FUNCTION_LIST /end MEASUREMENT
/begin MEASUREMENT fTXAPOH "Hysteresis flag" UBYTE COMP_0283 1 100 0 1 BIT_MASK 0x0008 ECU_ADDRESS 0xFFFF42F7 /begin FUNCTION_LIST KF7-410.12[2] /end FUNCTION_LIST /end MEASUREMENT
/begin MEASUREMENT fTXNEH "Hysteresis flag" UBYTE COMP_0283 1 100 0 1 BIT_MASK 0x0002 ECU_ADDRESS 0xFFFF42F7 /begin FUNCTION_LIST KF7-410.12[2] /end FUNCTION_LIST /end MEASUREMENT
/begin MEASUREMENT fTXNEH2 "TXNEH2# hysteresis flag" UBYTE COMP_0283 1 100 0 1 BIT_MASK 0x0001 ECU_ADDRESS 0xFFFF42F7 /begin FUNCTION_LIST KF7-410.12[2] /end FUNCTION_LIST /end MEASUREMENT
/begin MEASUREMENT fATTRQNG2 "The signal that an engine torque isn't fixed" UBYTE COMP_0283 1 100 0 1 BIT_MASK 0x0002 ECU_ADDRESS 0xFFFF4311
 /begin FUNCTION_LIST KF7-385.1[32] KF7-385.3[4] KF7-410.10[6] R204.1.CanComm_1_9_2 /end FUNCTION_LIST
/end MEASUREMENT
/begin MEASUREMENT fFREV "Engine speed judgement" UBYTE COMP_0283 1 100 0 1 BIT_MASK 0x0001 ECU_ADDRESS 0xFFFF4328 /begin FUNCTION_LIST KF7-450.22[1] KF7-500.1[54] /end FUNCTION_LIST /end MEASUREMENT
/begin MEASUREMENT fFTW70 "At present, coolant temperature rise distinction" UBYTE COMP_0283 1 100 0 1 BIT_MASK 0x0004 ECU_ADDRESS 0xFFFF432A /begin FUNCTION_LIST KF7-450.22[1] KF7-500.1[54] /end FUNCTION_LIST /end MEASUREMENT
/begin MEASUREMENT fFTWI20 "At the time of the start, at present, coolant temperature occasion difference distinction" UBYTE COMP_0283 1 100 0 1 BIT_MASK 0x0002 ECU_ADDRESS 0xFFFF432A /begin FUNCTION_LIST KF7-450.22[1] KF7-500.1[54] /end FUNCTION_LIST /end MEASUREMENT
/begin MEASUREMENT fLOWTASW "The low air temperature SW" UBYTE COMP_0283 1 100 0 1 BIT_MASK 0x0040 ECU_ADDRESS 0xFFFF4330 /begin FUNCTION_LIST KF7-385.1[32] /end FUNCTION_LIST /end MEASUREMENT
/begin MEASUREMENT fTDRYTIME "A/F ÉZÉìÉTÉhÉâÉCÉ^ÉCÉÄ setup flag" UBYTE COMP_0283 1 100 0 1 BIT_MASK 0x0008 ECU_ADDRESS 0xFFFF433C /begin FUNCTION_LIST KF7-378.3B[5] /end FUNCTION_LIST /end MEASUREMENT
/begin MEASUREMENT afONEACC "It is accelerating once, flag" UBYTE COMP_0283 1 100 0 1 BIT_MASK 0x0002 ECU_ADDRESS 0xFFFF4356 /begin FUNCTION_LIST KF7-410.19[2] /end FUNCTION_LIST /end MEASUREMENT
/begin MEASUREMENT fETSACK "ETS acknowledgement flag" UBYTE COMP_0283 1 100 0 1 BIT_MASK 0x0008 ECU_ADDRESS 0xFFFF4364 /begin FUNCTION_LIST KF7-410.21[3] /end FUNCTION_LIST /end MEASUREMENT
/begin MEASUREMENT fONEACC "It is accelerating once, flag" UBYTE COMP_0283 1 100 0 1 BIT_MASK 0x0002 ECU_ADDRESS 0xFFFF4367 /begin FUNCTION_LIST KF7-410.19[2] /end FUNCTION_LIST /end MEASUREMENT
/begin MEASUREMENT fONEACCRT "A realtime is accelerating once, flag" UBYTE COMP_0283 1 100 0 1 BIT_MASK 0x0001 ECU_ADDRESS 0xFFFF4367 /begin FUNCTION_LIST KF7-410.10[6] /end FUNCTION_LIST /end MEASUREMENT
/begin MEASUREMENT fACCACT "ACC operation flag" UBYTE COMP_0283 1 100 0 1 BIT_MASK 0x0080 ECU_ADDRESS 0xFFFF8A81 /begin FUNCTION_LIST KF7-410.10[6] /end FUNCTION_LIST /end MEASUREMENT
/begin MEASUREMENT wfDWNSFTTD "Down-shift torque going down requirement signal" UBYTE COMP_0283 1 100 0 1 BIT_MASK 0x0008 ECU_ADDRESS 0xFFFF8A83 /begin FUNCTION_LIST KF7-385.2[18] /end FUNCTION_LIST /end MEASUREMENT
/begin MEASUREMENT wfPRIRTD "Pre-retard torque going down requirement signal" UBYTE COMP_0283 1 100 0 1 BIT_MASK 0x0001 ECU_ADDRESS 0xFFFF8A84 /begin FUNCTION_LIST KF7-385.2[18] /end FUNCTION_LIST /end MEASUREMENT
/begin MEASUREMENT wfUPSFTTDS "Up-shift torque going down S requirement signal" UBYTE COMP_0283 1 100 0 1 BIT_MASK 0x0010 ECU_ADDRESS 0xFFFF8A85 /begin FUNCTION_LIST KF7-385.2[18] /end FUNCTION_LIST /end MEASUREMENT
/begin MEASUREMENT fDWNSFTTD "Down-shift torque going down requirement signal" UBYTE COMP_0283 1 100 0 1 BIT_MASK 0x0008 ECU_ADDRESS 0xFFFF8A86 /begin FUNCTION_LIST KF7-385.2[18] /end FUNCTION_LIST /end MEASUREMENT
/begin MEASUREMENT fPRIRTD "Pre-retard torque going down requirement signal" UBYTE COMP_0283 1 100 0 1 BIT_MASK 0x0001 ECU_ADDRESS 0xFFFF8A87 /begin FUNCTION_LIST KF7-385.2[18] /end FUNCTION_LIST /end MEASUREMENT
/begin MEASUREMENT fUPSFTTDS "Up-shift torque going down S requirement signal" UBYTE COMP_0283 1 100 0 1 BIT_MASK 0x0010 ECU_ADDRESS 0xFFFF8A88 /begin FUNCTION_LIST KF7-385.2[18] /end FUNCTION_LIST /end MEASUREMENT
/begin MEASUREMENT wfFSTWN "Coolant temperature sensor failsafe flag" UBYTE COMP_0283 1 100 0 1 BIT_MASK 0x0001 ECU_ADDRESS 0xFFFF8A8F
 /begin FUNCTION_LIST KF7-450.1[N] KF7-450.2[1] KF7-450.4[1] KF7-450.8[2] KF7-500.47B[15] /end FUNCTION_LIST
/end MEASUREMENT
/begin MEASUREMENT fFSTWN "Coolant temperature sensor failsafe flag" UBYTE COMP_0283 1 100 0 1 BIT_MASK 0x0001 ECU_ADDRESS 0xFFFF8A92 DISPLAY_IDENTIFIER Vbx_cf_tco
 /begin FUNCTION_LIST KF7-377.1A[19] KF7-450.1[N] KF7-450.2[1] KF7-450.4[1] KF7-450.8[2] KF7-500.47B[15] R000.1.RS_Integ_1_10_2 R203.2.crk_restx_1_0_8 R204.1.CanComm_1_9_2 /end FUNCTION_LIST
/end MEASUREMENT
/begin MEASUREMENT bfPIMAX "Maximum PI flag" UBYTE COMP_0283 1 100 0 1 BIT_MASK 0x0010 ECU_ADDRESS 0xFFFF2457 /begin FUNCTION_LIST KF7-390.1A[3] /end FUNCTION_LIST /end MEASUREMENT
/begin MEASUREMENT fFDTTDST "Torque going down control-in-progress flag" UBYTE COMP_0283 1 100 0 1 BIT_MASK 0x0080 ECU_ADDRESS 0xFFFF2459 /begin FUNCTION_LIST KF7-385.2[18] /end FUNCTION_LIST /end MEASUREMENT
/begin MEASUREMENT fFVTCLRN "VTC maximum-retard degree position learning permission flag" UBYTE COMP_0283 1 100 0 1 BIT_MASK 0x0020 ECU_ADDRESS 0xFFFF2459 /begin FUNCTION_LIST KF7-393.1C[8] /end FUNCTION_LIST /end MEASUREMENT
/begin MEASUREMENT fRFNCUT "Radiator fan cut control executive flag" UBYTE COMP_0283 1 100 0 1 BIT_MASK 0x0010 ECU_ADDRESS 0xFFFF245A /begin FUNCTION_LIST KF7-377.1A[19] KF7-450.8[2] KF7-450.14[2] KF7-580.1[8] /end FUNCTION_LIST /end MEASUREMENT
/begin MEASUREMENT fRFNDLY1 "Radiator fan delay 1 flag" UBYTE COMP_0283 1 100 0 1 BIT_MASK 0x0008 ECU_ADDRESS 0xFFFF245A /begin FUNCTION_LIST KF7-377.1A[19] /end FUNCTION_LIST /end MEASUREMENT
/begin MEASUREMENT fACADV "For the QTRQEST operation" UBYTE COMP_0283 1 100 0 1 BIT_MASK 0x0010 ECU_ADDRESS 0xFFFF2460 /begin FUNCTION_LIST KF7-390.3A[15] /end FUNCTION_LIST /end MEASUREMENT
/begin MEASUREMENT fACPDCUT "Air-conditioning cut signal output flag" UBYTE COMP_0283 1 100 0 1 BIT_MASK 0x0002 ECU_ADDRESS 0xFFFF2462 /begin FUNCTION_LIST KF7-376.4[4] /end FUNCTION_LIST /end MEASUREMENT
/begin MEASUREMENT fACPDPRS1 "The hysteresis flag of PDPREN>=ACPDPRS1# (hysteresis -HYSPR1#)" UBYTE COMP_0283 1 100 0 1 BIT_MASK 0x0001 ECU_ADDRESS 0xFFFF2462 /begin FUNCTION_LIST KF7-377.1A[19] /end FUNCTION_LIST /end MEASUREMENT
/begin MEASUREMENT fACPDPRS2 "The hysteresis flag of PDPREN>=ACPDPRS2# (hysteresis -HYSPR2#)" UBYTE COMP_0283 1 100 0 1 BIT_MASK 0x0080 ECU_ADDRESS 0xFFFF2463 /begin FUNCTION_LIST KF7-377.1A[19] /end FUNCTION_LIST /end MEASUREMENT
/begin MEASUREMENT fACPDPRS3 "The hysteresis flag of PDPREN>=ACPDPRS3# (hysteresis -HYSPR3#)" UBYTE COMP_0283 1 100 0 1 BIT_MASK 0x0040 ECU_ADDRESS 0xFFFF2463 /begin FUNCTION_LIST KF7-377.1A[19] /end FUNCTION_LIST /end MEASUREMENT
/begin MEASUREMENT fACVSP1 "The hysteresis flag of VSP>=ACVSP1# (hysteresis -HYSVSP#)" UBYTE COMP_0283 1 100 0 1 BIT_MASK 0x0001 ECU_ADDRESS 0xFFFF2463 /begin FUNCTION_LIST KF7-377.1A[19] /end FUNCTION_LIST /end MEASUREMENT
/begin MEASUREMENT fACVSP2 "The hysteresis flag of VSP>=ACVSP2# (hysteresis -HYSVSP#)" UBYTE COMP_0283 1 100 0 1 BIT_MASK 0x0080 ECU_ADDRESS 0xFFFF2464 /begin FUNCTION_LIST KF7-377.1A[19] /end FUNCTION_LIST /end MEASUREMENT
/begin MEASUREMENT fACVSP3 "The hysteresis flag of VSP>=ACVSP3# (hysteresis -HYSVSP#)" UBYTE COMP_0283 1 100 0 1 BIT_MASK 0x0040 ECU_ADDRESS 0xFFFF2464 /begin FUNCTION_LIST KF7-377.1A[19] /end FUNCTION_LIST /end MEASUREMENT
/begin MEASUREMENT fATFULLSW "Accelerator full switch signal" UBYTE COMP_0283 1 100 0 1 BIT_MASK 0x0040 ECU_ADDRESS 0xFFFF2466 /begin FUNCTION_LIST KF7-385.1[32] /end FUNCTION_LIST /end MEASUREMENT
/begin MEASUREMENT fATTRQNG "The signal that an output torque isn't fixed" UBYTE COMP_0283 1 100 0 1 BIT_MASK 0x0010 ECU_ADDRESS 0xFFFF2466 /begin FUNCTION_LIST KF7-385.3[4] /end FUNCTION_LIST /end MEASUREMENT
/begin MEASUREMENT fDEVTMP0 "The hysteresis flag of DEVATMP>=DEVTMP0# (hysteresis -HYSTMP#)" UBYTE COMP_0283 1 100 0 1 BIT_MASK 0x0008 ECU_ADDRESS 0xFFFF246C /begin FUNCTION_LIST KF7-377.1A[19] /end FUNCTION_LIST /end MEASUREMENT
/begin MEASUREMENT fDEVTMP1 "The hysteresis flag of DEVATMP>=DEVTMP1# (hysteresis -HYSTMP#)" UBYTE COMP_0283 1 100 0 1 BIT_MASK 0x0004 ECU_ADDRESS 0xFFFF246C /begin FUNCTION_LIST KF7-377.1A[19] /end FUNCTION_LIST /end MEASUREMENT
/begin MEASUREMENT fDEVTMP2 "The hysteresis flag of DEVATMP>=DEVTMP2# (hysteresis -HYSTMP#)" UBYTE COMP_0283 1 100 0 1 BIT_MASK 0x0002 ECU_ADDRESS 0xFFFF246C /begin FUNCTION_LIST KF7-377.1A[19] /end FUNCTION_LIST /end MEASUREMENT
/begin MEASUREMENT fDLGAPO "L/U prohibition accelerator open-degree hysteresis flag" UBYTE COMP_0283 1 100 0 1 BIT_MASK 0x0040 ECU_ADDRESS 0xFFFF246D /begin FUNCTION_LIST KF7-385.1[32] /end FUNCTION_LIST /end MEASUREMENT
/begin MEASUREMENT fDLGVSP "L/U prohibition vehicle speed hysteresis flag" UBYTE COMP_0283 1 100 0 1 BIT_MASK 0x0010 ECU_ADDRESS 0xFFFF246D /begin FUNCTION_LIST KF7-385.1[32] /end FUNCTION_LIST /end MEASUREMENT
/begin MEASUREMENT fDLURPM "Hysteresis flag" UBYTE COMP_0283 1 100 0 1 BIT_MASK 0x0004 ECU_ADDRESS 0xFFFF246D /begin FUNCTION_LIST KF7-385.1[32] /end FUNCTION_LIST /end MEASUREMENT
/begin MEASUREMENT fDLVSP1 "Hysteresis flag" UBYTE COMP_0283 1 100 0 1 BIT_MASK 0x0080 ECU_ADDRESS 0xFFFF246E /begin FUNCTION_LIST KF7-385.1[32] /end FUNCTION_LIST /end MEASUREMENT
/begin MEASUREMENT fDTFCN "Hysteresis flag" UBYTE COMP_0283 1 100 0 1 BIT_MASK 0x0001 ECU_ADDRESS 0xFFFF246E /begin FUNCTION_LIST KF7-385.1[32] KF7-385.2[18] /end FUNCTION_LIST /end MEASUREMENT
/begin MEASUREMENT fDTWLUI "Hysteresis flag" UBYTE COMP_0283 1 100 0 1 BIT_MASK 0x0004 ECU_ADDRESS 0xFFFF246F /begin FUNCTION_LIST KF7-385.1[32] /end FUNCTION_LIST /end MEASUREMENT
/begin MEASUREMENT fDTWLUI2 "A coolant temperature judgement flag for the heater performance improvement control" UBYTE COMP_0283 1 100 0 1 BIT_MASK 0x0002 ECU_ADDRESS 0xFFFF246F /begin FUNCTION_LIST KF7-385.1[32] /end FUNCTION_LIST /end MEASUREMENT
/begin MEASUREMENT fDYNAPO "An urgent pushing judgement flag" UBYTE COMP_0283 1 100 0 1 BIT_MASK 0x0008 ECU_ADDRESS 0xFFFF2470 /begin FUNCTION_LIST KF7-385.1[32] /end FUNCTION_LIST /end MEASUREMENT
/begin MEASUREMENT fFDTFCSEL "Torque going down control choice flag" UBYTE COMP_0283 1 100 0 1 BIT_MASK 0x0008 ECU_ADDRESS 0xFFFF2479 /begin FUNCTION_LIST KF7-385.2[18] R301.1.Torque_realization_1_0_3 /end FUNCTION_LIST /end MEASUREMENT
/begin MEASUREMENT fFDTTD "Torque going down control permission signal output condition formation flag" UBYTE COMP_0283 1 100 0 1 BIT_MASK 0x0001 ECU_ADDRESS 0xFFFF2479 /begin FUNCTION_LIST KF7-385.1[32] KF7-385.2[18] /end FUNCTION_LIST /end MEASUREMENT
/begin MEASUREMENT fFODINH "At the time of the low coolant temperature, OD prohibition signal" UBYTE COMP_0283 1 100 0 1 BIT_MASK 0x0004 ECU_ADDRESS 0xFFFF247F /begin FUNCTION_LIST KF7-385.1[32] /end FUNCTION_LIST /end MEASUREMENT
/begin MEASUREMENT fFTQTNDYN "T/M requirement excessive torque control condition" UBYTE COMP_0283 1 100 0 1 BIT_MASK 0x0080 ECU_ADDRESS 0xFFFF2484 /begin FUNCTION_LIST KF7-385.2[18] /end FUNCTION_LIST /end MEASUREMENT
/begin MEASUREMENT fFVTCKT "VTC maximum-retard degree fixed judgement flag" UBYTE COMP_0283 1 100 0 1 BIT_MASK 0x0040 ECU_ADDRESS 0xFFFF2485 /begin FUNCTION_LIST KF7-393.1C[8] /end FUNCTION_LIST /end MEASUREMENT
/begin MEASUREMENT fHITIME "HIDTY1# maintenance time set" UBYTE COMP_0283 1 100 0 1 BIT_MASK 0x0040 ECU_ADDRESS 0xFFFF2487 /begin FUNCTION_LIST KF7-393.1C[8] /end FUNCTION_LIST /end MEASUREMENT
/begin MEASUREMENT fKNSTCL "Knock learning clear condition formation" UBYTE COMP_0283 1 100 0 1 BIT_MASK 0x0004 ECU_ADDRESS 0xFFFF248B /begin FUNCTION_LIST KF7-379.2[1] KF7-379.4[1] /end FUNCTION_LIST /end MEASUREMENT
/begin MEASUREMENT fO2HRDY "The rest O2 heater on delay condition judgement" UBYTE COMP_0283 1 100 0 1 BIT_MASK 0x0040 ECU_ADDRESS 0xFFFF2491 /begin FUNCTION_LIST KF7-378.2B[6] /end FUNCTION_LIST /end MEASUREMENT
/begin MEASUREMENT fO2HRN "The rest O2 heater control rotation lower limit condition" UBYTE COMP_0283 1 100 0 1 BIT_MASK 0x0020 ECU_ADDRESS 0xFFFF2491 /begin FUNCTION_LIST KF7-378.2B[6] /end FUNCTION_LIST /end MEASUREMENT
/begin MEASUREMENT fO2HRTP "The rest O2 heater control pulse width lower limit condition" UBYTE COMP_0283 1 100 0 1 BIT_MASK 0x0010 ECU_ADDRESS 0xFFFF2491 /begin FUNCTION_LIST KF7-378.2B[6] /end FUNCTION_LIST /end MEASUREMENT
/begin MEASUREMENT fO2HTCR "The rest O2 heater on delay condition judgement" UBYTE COMP_0283 1 100 0 1 BIT_MASK 0x0004 ECU_ADDRESS 0xFFFF2491 /begin FUNCTION_LIST KF7-378.2B[6] /end FUNCTION_LIST /end MEASUREMENT
/begin MEASUREMENT fPDRFH "Hysteresis flag" UBYTE COMP_0283 1 100 0 1 BIT_MASK 0x0001 ECU_ADDRESS 0xFFFF2494 /begin FUNCTION_LIST KF7-377.1A[19] /end FUNCTION_LIST /end MEASUREMENT
/begin MEASUREMENT fPDRFL "Hysteresis flag" UBYTE COMP_0283 1 100 0 1 BIT_MASK 0x0080 ECU_ADDRESS 0xFFFF2495 /begin FUNCTION_LIST KF7-377.1A[19] /end FUNCTION_LIST /end MEASUREMENT
/begin MEASUREMENT fPIMAXd "Maximum PI flag d" UBYTE COMP_0283 1 100 0 1 BIT_MASK 0x0080 ECU_ADDRESS 0xFFFF2496 /begin FUNCTION_LIST KF7-390.1A[3] /end FUNCTION_LIST /end MEASUREMENT
/begin MEASUREMENT fREQLUP "Lockup requirement condition judgement" UBYTE COMP_0283 1 100 0 1 BIT_MASK 0x0020 ECU_ADDRESS 0xFFFF2499 /begin FUNCTION_LIST KF7-385.1[32] /end FUNCTION_LIST /end MEASUREMENT
/begin MEASUREMENT fRFNDLY2 "Radiator fan delay 2 flag" UBYTE COMP_0283 1 100 0 1 BIT_MASK 0x0008 ECU_ADDRESS 0xFFFF2499 /begin FUNCTION_LIST KF7-377.1A[19] /end FUNCTION_LIST /end MEASUREMENT
/begin MEASUREMENT fRFPDHI "Radiator fan High requirement PD pressure flag" UBYTE COMP_0283 1 100 0 1 BIT_MASK 0x0002 ECU_ADDRESS 0xFFFF2499 /begin FUNCTION_LIST KF7-377.1A[19] /end FUNCTION_LIST /end MEASUREMENT
/begin MEASUREMENT fRFTWHI "Radiator fan High requirement coolant temperature flag" UBYTE COMP_0283 1 100 0 1 BIT_MASK 0x0080 ECU_ADDRESS 0xFFFF249A /begin FUNCTION_LIST KF7-377.1A[19] /end FUNCTION_LIST /end MEASUREMENT
/begin MEASUREMENT fRO2DTYCH "Rear O2 sensor duty switching requirement flag" UBYTE COMP_0283 1 100 0 1 BIT_MASK 0x0008 ECU_ADDRESS 0xFFFF249A /begin FUNCTION_LIST KF7-378.2B[6] /end FUNCTION_LIST /end MEASUREMENT
/begin MEASUREMENT fSUMQM40 "SUMQM40 operation permission flag" UBYTE COMP_0283 1 100 0 1 BIT_MASK 0x0020 ECU_ADDRESS 0xFFFF249D /begin FUNCTION_LIST KF7-378.2B[6] /end FUNCTION_LIST /end MEASUREMENT
/begin MEASUREMENT fTWKS "A hysteresis flag for the estimated learning region computation" UBYTE COMP_0283 1 100 0 1 BIT_MASK 0x0080 ECU_ADDRESS 0xFFFF24A2 /begin FUNCTION_LIST KF7-379.2[1] /end FUNCTION_LIST /end MEASUREMENT
/begin MEASUREMENT fTWNFAN1 "The hysteresis flag of TWN>=TWNFAN1# (hysteresis -HYSTWN#)" UBYTE COMP_0283 1 100 0 1 BIT_MASK 0x0020 ECU_ADDRESS 0xFFFF24A2 /begin FUNCTION_LIST KF7-377.1A[19] /end FUNCTION_LIST /end MEASUREMENT
/begin MEASUREMENT fTWNFAN2 "The hysteresis flag of TWN>=TWNFAN2# (hysteresis -HYSTWN#)" UBYTE COMP_0283 1 100 0 1 BIT_MASK 0x0010 ECU_ADDRESS 0xFFFF24A2 /begin FUNCTION_LIST KF7-377.1A[19] /end FUNCTION_LIST /end MEASUREMENT
/begin MEASUREMENT fTWNFAN3 "The hysteresis flag of TWN>=TWNFAN3# (hysteresis -HYSTWN#)" UBYTE COMP_0283 1 100 0 1 BIT_MASK 0x0008 ECU_ADDRESS 0xFFFF24A2 /begin FUNCTION_LIST KF7-377.1A[19] /end FUNCTION_LIST /end MEASUREMENT
/begin MEASUREMENT fVCLEAN "Cleaning mode control judgement flag" UBYTE COMP_0283 1 100 0 1 BIT_MASK 0x0004 ECU_ADDRESS 0xFFFF24A4 /begin FUNCTION_LIST KF7-393.1C[8] /end FUNCTION_LIST /end MEASUREMENT
/begin MEASUREMENT fVCLNE "Cleaning mode permission speed flag" UBYTE COMP_0283 1 100 0 1 BIT_MASK 0x0002 ECU_ADDRESS 0xFFFF24A4 /begin FUNCTION_LIST KF7-393.1C[8] /end FUNCTION_LIST /end MEASUREMENT
/begin MEASUREMENT fVTCNEL "An engine rotation lower limit hysteresis flag for the VTC condition" UBYTE COMP_0283 1 100 0 1 BIT_MASK 0x0001 ECU_ADDRESS 0xFFFF24A7 /begin FUNCTION_LIST KF7-393.1C[8] /end FUNCTION_LIST /end MEASUREMENT
/begin MEASUREMENT fVTCTWLL "A coolant temperature lower limit 2 hysteresis flag for the VTC condition" UBYTE COMP_0283 1 100 0 1 BIT_MASK 0x0008 ECU_ADDRESS 0xFFFF24A9 /begin FUNCTION_LIST KF7-393.1C[8] /end FUNCTION_LIST /end MEASUREMENT
/begin MEASUREMENT fVCLNDT "Cleaning executive flag" UBYTE COMP_0283 1 100 0 1 BIT_MASK 0x0080 ECU_ADDRESS 0xFFFF24AE /begin FUNCTION_LIST KF7-393.1C[8] /end FUNCTION_LIST /end MEASUREMENT
/begin MEASUREMENT fFSTVO "Throttle sensor failsafe flag" UBYTE COMP_0283 1 100 0 1 BIT_MASK 0x0040 ECU_ADDRESS 0xFFFF24B9 /begin FUNCTION_LIST KF7-450.7[2] /end FUNCTION_LIST /end MEASUREMENT
/begin MEASUREMENT fADVFB "For the QADVFB operation" UBYTE COMP_0283 1 100 0 1 BIT_MASK 0x0020 ECU_ADDRESS 0xFFFF24C1 /begin FUNCTION_LIST KF7-390.3A[15] /end FUNCTION_LIST /end MEASUREMENT
/begin MEASUREMENT fIDELAY1 "ADV CLOSED control switchover flag" UBYTE COMP_0283 1 100 0 1 BIT_MASK 0x0020 ECU_ADDRESS 0xFFFF24C3 /begin FUNCTION_LIST KF7-390.3A[15] /end FUNCTION_LIST /end MEASUREMENT
/begin MEASUREMENT afFD3LU "At the time of the high coolant temperature, D3LU requirement signal" UBYTE COMP_0283 1 100 0 1 BIT_MASK 0x0080 ECU_ADDRESS 0xFFFF24CF /begin FUNCTION_LIST KF7-385.1[32] /end FUNCTION_LIST /end MEASUREMENT
/begin MEASUREMENT afFDTLIN "Lockup permission signal output control condition formation flag" UBYTE COMP_0283 1 100 0 1 BIT_MASK 0x0040 ECU_ADDRESS 0xFFFF24CF /begin FUNCTION_LIST KF7-385.1[32] /end FUNCTION_LIST /end MEASUREMENT
/begin MEASUREMENT afFDTLIN2 "Lockup permission signal output control condition formation flag" UBYTE COMP_0283 1 100 0 1 BIT_MASK 0x0020 ECU_ADDRESS 0xFFFF24CF /begin FUNCTION_LIST KF7-385.1[32] /end FUNCTION_LIST /end MEASUREMENT
/begin MEASUREMENT afISCADVL "Ignition timing operation allowable occasion judgement flag L" UBYTE COMP_0283 1 100 0 1 BIT_MASK 0x0002 ECU_ADDRESS 0xFFFF24D0 /begin FUNCTION_LIST KF7-390.3A[15] /end FUNCTION_LIST /end MEASUREMENT
/begin MEASUREMENT afVCSHOT "Cleaning mode requirement judgement flag" UBYTE COMP_0283 1 100 0 1 BIT_MASK 0x0010 ECU_ADDRESS 0xFFFF24D2 /begin FUNCTION_LIST KF7-393.1C[8] /end FUNCTION_LIST /end MEASUREMENT
/begin MEASUREMENT afVIAS "Variable intake dialect control" UBYTE COMP_0283 1 100 0 1 BIT_MASK 0x0008 ECU_ADDRESS 0xFFFF24D2 /begin FUNCTION_LIST KF7-395.1[4] KF7-500.2A[29] KF7-500.56[2] KF7-580.1[8] /end FUNCTION_LIST /end MEASUREMENT
/begin MEASUREMENT fFD3LU "At the time of the high coolant temperature, D3LU requirement signal" UBYTE COMP_0283 1 100 0 1 BIT_MASK 0x0080 ECU_ADDRESS 0xFFFF24D6 /begin FUNCTION_LIST KF7-385.1[32] KF7-410.10[6] /end FUNCTION_LIST /end MEASUREMENT
/begin MEASUREMENT fFDTLIN "Lockup permission signal output control condition formation flag" UBYTE COMP_0283 1 100 0 1 BIT_MASK 0x0040 ECU_ADDRESS 0xFFFF24D6 /begin FUNCTION_LIST KF7-385.1[32] KF7-410.10[6] /end FUNCTION_LIST /end MEASUREMENT
/begin MEASUREMENT fFDTLIN2 "Lockup permission signal output control condition formation flag" UBYTE COMP_0283 1 100 0 1 BIT_MASK 0x0020 ECU_ADDRESS 0xFFFF24D6 /begin FUNCTION_LIST KF7-385.1[32] KF7-410.10[6] /end FUNCTION_LIST /end MEASUREMENT
/begin MEASUREMENT fISCADVL "Ignition timing operation allowable occasion judgement flag L" UBYTE COMP_0283 1 100 0 1 BIT_MASK 0x0002 ECU_ADDRESS 0xFFFF24D7 /begin FUNCTION_LIST KF7-390.3A[15] /end FUNCTION_LIST /end MEASUREMENT
/begin MEASUREMENT fVCSHOT "Cleaning mode requirement judgement flag" UBYTE COMP_0283 1 100 0 1 BIT_MASK 0x0010 ECU_ADDRESS 0xFFFF24D9 /begin FUNCTION_LIST KF7-393.1C[8] /end FUNCTION_LIST /end MEASUREMENT
/begin MEASUREMENT fVIAS "Variable intake dialect control" UBYTE COMP_0283 1 100 0 1 BIT_MASK 0x0008 ECU_ADDRESS 0xFFFF24D9 /begin FUNCTION_LIST KF7-395.1[4] KF7-500.2A[29] KF7-500.56[2] KF7-580.1[8] /end FUNCTION_LIST /end MEASUREMENT
/begin MEASUREMENT fFVTTWN "Drive permission coolant temperature flag" UBYTE COMP_0283 1 100 0 1 BIT_MASK 0x0040 ECU_ADDRESS 0xFFFFB7E0 /begin FUNCTION_LIST KF7-393.1C[8] /end FUNCTION_LIST /end MEASUREMENT
/begin MEASUREMENT fLRNANG "BASOFS limiter flag" UBYTE COMP_0283 1 100 0 1 BIT_MASK 0x0040 ECU_ADDRESS 0xFFFFB7E1 /begin FUNCTION_LIST KF7-393.1C[8] /end FUNCTION_LIST /end MEASUREMENT
/begin MEASUREMENT tAFHCTDD "A/F sensor heater control permission judgement delay" UBYTE COMP_0201_S 1 100 0 255 ECU_ADDRESS 0xFFFF436E /begin FUNCTION_LIST KF7-378.3B[5] /end FUNCTION_LIST /end MEASUREMENT
/begin MEASUREMENT tFSTVO "TVO failsafe condition continuation timer" UBYTE COMP_0201_S 1 100 0 255 ECU_ADDRESS 0xFFFF4391 /begin FUNCTION_LIST KF7-450.7[2] /end FUNCTION_LIST /end MEASUREMENT
/begin MEASUREMENT tFSTWN "TWN failsafe condition continuation timer" UBYTE COMP_0201_S 1 100 0 255 ECU_ADDRESS 0xFFFF4392
 /begin FUNCTION_LIST KF7-450.1[N] KF7-450.2[1] KF7-450.4[1] KF7-450.8[2] KF7-500.47B[15] /end FUNCTION_LIST
/end MEASUREMENT
/begin MEASUREMENT tTDRYTIME "The early days Duty maintenance time" UBYTE COMP_0201_S 1 100 0 255 ECU_ADDRESS 0xFFFF43FA /begin FUNCTION_LIST KF7-378.3B[5] /end FUNCTION_LIST /end MEASUREMENT
/begin MEASUREMENT tTMRDON "After the key off, radiator fan on timer" UBYTE COMP_0201_S 1 100 0 255 ECU_ADDRESS 0xFFFF441D /begin FUNCTION_LIST KF7-377.1A[19] /end FUNCTION_LIST /end MEASUREMENT
/begin MEASUREMENT tWETTIME "At the time of ÉEÉFÉbÉg judgement, DUTY maintenance time" UBYTE COMP_0201_S 1 100 0 255 ECU_ADDRESS 0xFFFF443E /begin FUNCTION_LIST KF7-378.3B[5] /end FUNCTION_LIST /end MEASUREMENT
/begin MEASUREMENT tCSBDLY "POS backup control start delay" UBYTE COMP_0202_S 1 100 0 255 ECU_ADDRESS 0xFFFF445F /begin FUNCTION_LIST KF7-450.9A[5] /end FUNCTION_LIST /end MEASUREMENT
/begin MEASUREMENT tSTNGTIM "Engine stop cylinder distinction failure judgement time" UBYTE COMP_0202_S 1 100 0 255 ECU_ADDRESS 0xFFFF44C1 /begin FUNCTION_LIST KF7-450.9A[5] /end FUNCTION_LIST /end MEASUREMENT
/begin MEASUREMENT tTMHDTYI "The early days Duty value maintenance time" UBYTE COMP_0202_S 1 100 0 255 ECU_ADDRESS 0xFFFF451F /begin FUNCTION_LIST KF7-378.3B[5] /end FUNCTION_LIST /end MEASUREMENT
/begin MEASUREMENT tTMHMX1 "Heater duty upper limit value maintenance time" UBYTE COMP_0202_S 1 100 0 255 ECU_ADDRESS 0xFFFF4521 /begin FUNCTION_LIST KF7-378.3B[5] /end FUNCTION_LIST /end MEASUREMENT
/begin MEASUREMENT tVTCSTOF "C-VTC initial tense permission condition progress time timer" UBYTE COMP_0202_S 1 100 0 255 ECU_ADDRESS 0xFFFF4587 /begin FUNCTION_LIST KF7-393.1C[8] /end FUNCTION_LIST /end MEASUREMENT
/begin MEASUREMENT tDDGNTC "Self-diagnosis reopening delay timer" UBYTE COMP_0203_S 1 100 0 255 ECU_ADDRESS 0xFFFF45DD /begin FUNCTION_LIST KF7-381.9[2] KF7-410.12[2] /end FUNCTION_LIST /end MEASUREMENT
/begin MEASUREMENT tDLGDLY "L/U prohibition delay timer" UWORD COMP_0203_S 1 100 0 65535 ECU_ADDRESS 0xFFFF46E0 /begin FUNCTION_LIST KF7-385.1[32] /end FUNCTION_LIST /end MEASUREMENT
/begin MEASUREMENT tTMDTIV "Idle rise requirement control continuation time" UBYTE COMP_0201_S 1 100 0 255 ECU_ADDRESS 0xFFFF2509 /begin FUNCTION_LIST KF7-385.1[32] /end FUNCTION_LIST /end MEASUREMENT
/begin MEASUREMENT tADVSTDLY "ADV F/B Start delay (After it starts.)" UBYTE COMP_0202_S 1 100 0 255 ECU_ADDRESS 0xFFFF2526 /begin FUNCTION_LIST KF7-390.3A[15] /end FUNCTION_LIST /end MEASUREMENT
/begin MEASUREMENT tCYLCLTM "Cylinder distinction clear permission time" UBYTE COMP_0202_S 1 100 0 255 ECU_ADDRESS 0xFFFF2532 /begin FUNCTION_LIST KF7-450.9A[5] /end FUNCTION_LIST /end MEASUREMENT
/begin MEASUREMENT tDLYLON "Lockup continuation time for the lean judgement" UBYTE COMP_0202_S 1 100 0 255 ECU_ADDRESS 0xFFFF2537 /begin FUNCTION_LIST KF7-385.1[32] /end FUNCTION_LIST /end MEASUREMENT
/begin MEASUREMENT tENSTDLYT "Engine operating time delay" UBYTE COMP_0202_S 1 100 0 255 ECU_ADDRESS 0xFFFF2540 /begin FUNCTION_LIST KF7-378.3B[5] /end FUNCTION_LIST /end MEASUREMENT
/begin MEASUREMENT tFCRD "FCRD judgement timer" UBYTE COMP_0202_S 1 100 0 255 ECU_ADDRESS 0xFFFF254D /begin FUNCTION_LIST KF7-390.3A[15] R301.5.FuelCut_1_2_2 /end FUNCTION_LIST /end MEASUREMENT
/begin MEASUREMENT tIDELAY1 "ADV CLOSED switchover timer" UBYTE COMP_0202_S 1 100 0 255 ECU_ADDRESS 0xFFFF2555 /begin FUNCTION_LIST KF7-390.3A[15] /end FUNCTION_LIST /end MEASUREMENT
/begin MEASUREMENT tLRNTIM "VTC maximum-retard degree position learning prohibition time" UBYTE COMP_0202_S 1 100 0 255 ECU_ADDRESS 0xFFFF2569 /begin FUNCTION_LIST KF7-393.1C[8] /end FUNCTION_LIST /end MEASUREMENT
/begin MEASUREMENT tRO2HCTD "Rear O2 heater off delay" UBYTE COMP_0202_S 1 100 0 255 ECU_ADDRESS 0xFFFF2583 /begin FUNCTION_LIST KF7-378.2B[6] /end FUNCTION_LIST /end MEASUREMENT
/begin MEASUREMENT tYRTIME "Roll-back release time" UBYTE COMP_0202_S 1 100 0 255 ECU_ADDRESS 0xFFFF25C1 /begin FUNCTION_LIST KF7-450.9A[5] /end FUNCTION_LIST /end MEASUREMENT
/begin MEASUREMENT tADDBTIM "Dizzer addition start time timer" UBYTE COMP_0203_S 1 100 0 255 ECU_ADDRESS 0xFFFF25C9 /begin FUNCTION_LIST KF7-393.1C[8] /end FUNCTION_LIST /end MEASUREMENT
/begin MEASUREMENT tDTDTMR "DTDTMR judgement timer" UBYTE COMP_0203_S 1 100 0 255 ECU_ADDRESS 0xFFFF25F9 /begin FUNCTION_LIST KF7-385.2[18] /end FUNCTION_LIST /end MEASUREMENT
/begin MEASUREMENT tDTDTMRU "DTDTMRU judgement timer" UBYTE COMP_0203_S 1 100 0 255 ECU_ADDRESS 0xFFFF25FA /begin FUNCTION_LIST KF7-385.2[18] /end FUNCTION_LIST /end MEASUREMENT
/begin MEASUREMENT tPRDTME "Torque going down control completion time timer" UBYTE COMP_0203_S 1 100 0 255 ECU_ADDRESS 0xFFFF261E /begin FUNCTION_LIST KF7-385.2[18] /end FUNCTION_LIST /end MEASUREMENT
/begin MEASUREMENT tRFNDLY1 "Radiator fan delay 1 timer" UBYTE COMP_0203_S 1 100 0 255 ECU_ADDRESS 0xFFFF2628 /begin FUNCTION_LIST KF7-377.1A[19] /end FUNCTION_LIST /end MEASUREMENT
/begin MEASUREMENT tRFNDLY2 "Radiator fan delay 2 timer" UBYTE COMP_0203_S 1 100 0 255 ECU_ADDRESS 0xFFFF2629 /begin FUNCTION_LIST KF7-377.1A[19] /end FUNCTION_LIST /end MEASUREMENT
/begin MEASUREMENT tVTCDLY "VTC target angle switching delay" UBYTE COMP_0203_S 1 100 0 255 ECU_ADDRESS 0xFFFF2681 /begin FUNCTION_LIST KF7-393.1C[8] /end FUNCTION_LIST /end MEASUREMENT
/begin MEASUREMENT tVTCLLT "Cleaning period" UBYTE COMP_0203_S 1 100 0 255 ECU_ADDRESS 0xFFFF2685 /begin FUNCTION_LIST KF7-393.1C[8] /end FUNCTION_LIST /end MEASUREMENT
/begin MEASUREMENT tTMDTWU "Engine heating requirement time delay" UWORD COMP_0201_S 1 100 0 65535 ECU_ADDRESS 0xFFFF26BA /begin FUNCTION_LIST KF7-385.1[32] /end FUNCTION_LIST /end MEASUREMENT
/begin MEASUREMENT tHITIME "HIDTY1# time maintenance timer" UWORD COMP_0203_S 1 100 0 65535 ECU_ADDRESS 0xFFFF26CC /begin FUNCTION_LIST KF7-393.1C[8] /end FUNCTION_LIST /end MEASUREMENT
/begin MEASUREMENT tRELUTIME "Progress time after the urgent pushing judgement" UWORD COMP_0203_S 1 100 0 65535 ECU_ADDRESS 0xFFFF26D0 /begin FUNCTION_LIST KF7-385.1[32] /end FUNCTION_LIST /end MEASUREMENT
/begin MEASUREMENT tTMBRKFL "A timer for the failsafe start time condition" UWORD COMP_0203_S 1 100 0 65535 ECU_ADDRESS 0xFFFF26D6 /begin FUNCTION_LIST KF7-450.19[4] /end FUNCTION_LIST /end MEASUREMENT
/begin MEASUREMENT avATRET "The amount of DUETTE retard" UWORD COMP_0081 1 100 0 255.99609375 ECU_ADDRESS 0xFFFF2302
 /begin FUNCTION_LIST KF7-385.2[18] KF7-385.3[4] KF7-386.2[4] KF7-390.1A[3] KF7-390.3A[15] /end FUNCTION_LIST
/end MEASUREMENT
/begin MEASUREMENT avPILOCK "At the time of the urgent slowdown, torque compensation" UBYTE COMP_0009 1 100 0 199.21875 ECU_ADDRESS 0xFFFF2344 /begin FUNCTION_LIST KF7-385.1[32] KF7-386.2[4] KF7-390.1A[3] KF7-390.3A[15] /end FUNCTION_LIST /end MEASUREMENT
/begin MEASUREMENT avRFNOUT "Radiator fan output value" UBYTE COMP_0004 1 100 0 255 ECU_ADDRESS 0xFFFF234E /begin FUNCTION_LIST KF7-377.1A[19] KF7-580.1[8] /end FUNCTION_LIST /end MEASUREMENT
/begin MEASUREMENT avRO2HDTY "Rear O2 sensor heater duty" UWORD COMP_0133_S 1 100 0 2559.9609375 ECU_ADDRESS 0xFFFF2354 /begin FUNCTION_LIST KF7-378.2B[6] KF7-500.25A[7] /end FUNCTION_LIST /end MEASUREMENT
/begin MEASUREMENT avTEFRIC "Brake torque equivalent friction" UWORD COMP_0196 1 100 0 6553.5 ECU_ADDRESS 0xFFFF235C /begin FUNCTION_LIST KF7-385.2[18] KF7-386.1[4] KF7-386.2[4] /end FUNCTION_LIST /end MEASUREMENT
/begin MEASUREMENT avTHOKI "Engine accessory load torque" UWORD COMP_0196 1 100 0 6553.5 ECU_ADDRESS 0xFFFF2362 /begin FUNCTION_LIST KF7-385.2[18] KF7-386.1[4] KF7-386.2[4] KF7-386.3[8] /end FUNCTION_LIST /end MEASUREMENT
/begin MEASUREMENT avTRQREF1 "After a waste time treatment for the common FAST torque going down, target torque" SWORD COMP_0228 1 100 -3276.8 3276.7 ECU_ADDRESS 0xFFFF2392 /begin FUNCTION_LIST KF7-385.2[18] /end FUNCTION_LIST /end MEASUREMENT
/begin MEASUREMENT avVTCDUTY "VTC solenoid drive DUTY ratio" UBYTE COMP_0021 1 100 0 99.609375 ECU_ADDRESS 0xFFFF23A0 /begin FUNCTION_LIST KF7-393.1C[8] KF7-450.50[10] KF7-500.47B[15] KF7-580.1[8] /end FUNCTION_LIST /end MEASUREMENT
/begin MEASUREMENT avVTCDUTY_R#1 "VTC solenoid drive DUTY ratio" UBYTE COMP_0021 1 100 0 99.609375 ECU_ADDRESS 0xFFFF23A0 /begin FUNCTION_LIST KF7-393.1C[8] KF7-450.50[10] KF7-500.47B[15] KF7-580.1[8] /end FUNCTION_LIST /end MEASUREMENT
/begin MEASUREMENT avVTCDUTY_R#2 "VTC solenoid drive DUTY ratio" UBYTE COMP_0021 1 100 0 99.609375 ECU_ADDRESS 0xFFFF23A1 /begin FUNCTION_LIST KF7-393.1C[8] KF7-450.50[10] KF7-500.47B[15] KF7-580.1[8] /end FUNCTION_LIST /end MEASUREMENT
/begin MEASUREMENT bvKLMRT "BETA retard limiter" UBYTE COMP_0017 1 100 0 255 ECU_ADDRESS 0xFFFF22D2 /begin FUNCTION_LIST KF7-379.5[3] KF7-450.20[2] /end FUNCTION_LIST /end MEASUREMENT
/begin MEASUREMENT bvPIISC "Idle stabilization torque compensation value" UBYTE COMP_0009 1 100 0 199.21875 ECU_ADDRESS 0xFFFF22DC /begin FUNCTION_LIST KF7-386.2[4] KF7-390.1A[3] KF7-390.3A[15] /end FUNCTION_LIST /end MEASUREMENT
/begin MEASUREMENT vAAPOCK "Accelerator opening area" UWORD COMP_0042 1 100 0 52.428 ECU_ADDRESS 0xFFFF10C4 /begin FUNCTION_LIST KF7-385.3[4] /end FUNCTION_LIST /end MEASUREMENT
/begin MEASUREMENT vACPDNE "Pd pressure status" UBYTE COMP_0068 1 100 0 255 ECU_ADDRESS 0xFFFF10EB /begin FUNCTION_LIST KF7-377.1A[19] /end FUNCTION_LIST /end MEASUREMENT
/begin MEASUREMENT vACVSPNE "Vehicle speed status" UBYTE COMP_0068 1 100 0 255 ECU_ADDRESS 0xFFFF10EE /begin FUNCTION_LIST KF7-377.1A[19] /end FUNCTION_LIST /end MEASUREMENT
/begin MEASUREMENT vAFSHDTY "A/F sensor heater duty" UWORD COMP_0419 1 100 0 6553.5 ECU_ADDRESS 0xFFFF48B0
 /begin FUNCTION_LIST KF7-378.3B[5] KF7-500.59[6] KF7-580.1[8] R901.1.Diag_on_can_app_1_6_2 /end FUNCTION_LIST
/end MEASUREMENT
/begin MEASUREMENT vAFSHDTY_R#1 "A/F sensor heater duty" UWORD COMP_0419 1 100 0 6553.5 ECU_ADDRESS 0xFFFF48B0
 /begin FUNCTION_LIST KF7-378.3B[5] KF7-500.59[6] KF7-580.1[8] R901.1.Diag_on_can_app_1_6_2 /end FUNCTION_LIST
/end MEASUREMENT
/begin MEASUREMENT vAFSHDTY_R#2 "A/F sensor heater duty" UWORD COMP_0419 1 100 0 6553.5 ECU_ADDRESS 0xFFFF48B2
 /begin FUNCTION_LIST KF7-378.3B[5] KF7-500.59[6] KF7-580.1[8] R901.1.Diag_on_can_app_1_6_2 /end FUNCTION_LIST
/end MEASUREMENT
/begin MEASUREMENT vALOADCK "Compensation torque equivalent throttle opening area" UWORD COMP_0372 1 100 0 52.428 ECU_ADDRESS 0xFFFF112C /begin FUNCTION_LIST KF7-385.3[4] /end FUNCTION_LIST /end MEASUREMENT
/begin MEASUREMENT vAPHYASCD "After the hysteresis addition, open-degree order value" UWORD COMP_0005 1 100 0 7208.85 ECU_ADDRESS 0xFFFF1E1A /begin FUNCTION_LIST KF7-410.20[N] /end FUNCTION_LIST /end MEASUREMENT
/begin MEASUREMENT vAPOSTR "After compensation, accelerator pedal ratio" UWORD COMP_0362_S 1 100 0 8191.875 ECU_ADDRESS 0xFFFF2878
 /begin FUNCTION_LIST KF7-410.19[2] KF7-500.2A[29] KF7-505.17[3] R000.1.RS_Integ_1_10_2 R301.21.SafetyLevel2_1_0_2 /end FUNCTION_LIST
/end MEASUREMENT
/begin MEASUREMENT vATAPO "Accelerator open-degree signal" UBYTE COMP_0378 1 100 0 100.000000065 ECU_ADDRESS 0xFFFF48E4 /begin FUNCTION_LIST KF7-385.1[32] /end FUNCTION_LIST /end MEASUREMENT
/begin MEASUREMENT vATRET "The amount of DUETTE retard" UWORD COMP_0081 1 100 0 255.99609375 ECU_ADDRESS 0xFFFF23B0
 /begin FUNCTION_LIST KF7-385.2[18] KF7-385.3[4] KF7-386.2[4] KF7-390.1A[3] KF7-390.3A[15] R301.1.Torque_realization_1_0_3 /end FUNCTION_LIST
/end MEASUREMENT
/begin MEASUREMENT vATRETLIM "Target torque going down rate equivalent point â¡ time" SBYTE COMP_0018 1 100 -128 127 ECU_ADDRESS 0xFFFF1184 /begin FUNCTION_LIST KF7-385.2[18] R301.1.Torque_realization_1_0_3 /end FUNCTION_LIST /end MEASUREMENT
/begin MEASUREMENT vAVTVO "Target torque equivalent opening area" UWORD COMP_0372 1 100 0 52.428 ECU_ADDRESS 0xFFFF119A /begin FUNCTION_LIST KF7-385.3[4] /end FUNCTION_LIST /end MEASUREMENT
/begin MEASUREMENT vBASLRN "VTC maximum-retard degree angle learning value" UBYTE COMP_0048 1 100 0 127.5 ECU_ADDRESS 0xFFFFA286 /begin FUNCTION_LIST KF7-393.1C[8] /end FUNCTION_LIST /end MEASUREMENT
/begin MEASUREMENT vBASLRN3 "VTC maximum-retard degree position learning value" UBYTE COMP_0048 1 100 0 127.5 ECU_ADDRESS 0xFFFFA287 /begin FUNCTION_LIST KF7-393.1C[8] /end FUNCTION_LIST /end MEASUREMENT
/begin MEASUREMENT vBASLRN3_R#1 "VTC maximum-retard degree position learning value" UBYTE COMP_0048 1 100 0 127.5 ECU_ADDRESS 0xFFFFA287 /begin FUNCTION_LIST KF7-393.1C[8] /end FUNCTION_LIST /end MEASUREMENT
/begin MEASUREMENT vBASLRN3_R#2 "VTC maximum-retard degree position learning value" UBYTE COMP_0048 1 100 0 127.5 ECU_ADDRESS 0xFFFFA288 /begin FUNCTION_LIST KF7-393.1C[8] /end FUNCTION_LIST /end MEASUREMENT
/begin MEASUREMENT vBASOFS "The amount of VTC maximum-retard degree angle deviation" UBYTE COMP_0256 1 100 -64 63.5 ECU_ADDRESS 0xFFFF11AA /begin FUNCTION_LIST KF7-393.1C[8] /end FUNCTION_LIST /end MEASUREMENT
/begin MEASUREMENT vBASOFS3 "The amount of VTC maximum-retard degree position deviation" UBYTE COMP_0256 1 100 -64 63.5 ECU_ADDRESS 0xFFFF11AD /begin FUNCTION_LIST KF7-393.1C[8] /end FUNCTION_LIST /end MEASUREMENT
/begin MEASUREMENT vBASOFS3_R#1 "The amount of VTC maximum-retard degree position deviation" UBYTE COMP_0256 1 100 -64 63.5 ECU_ADDRESS 0xFFFF11AD /begin FUNCTION_LIST KF7-393.1C[8] /end FUNCTION_LIST /end MEASUREMENT
/begin MEASUREMENT vBASOFS3_R#2 "The amount of VTC maximum-retard degree position deviation" UBYTE COMP_0256 1 100 -64 63.5 ECU_ADDRESS 0xFFFF11AE /begin FUNCTION_LIST KF7-393.1C[8] /end FUNCTION_LIST /end MEASUREMENT
/begin MEASUREMENT vBCAMCNT1 "Between PhaseRHs, the number of PhaseLH input" UBYTE COMP_0068 1 100 0 255 ECU_ADDRESS 0xFFFF1FA0 /begin FUNCTION_LIST KF7-450.9A[5] /end FUNCTION_LIST /end MEASUREMENT
/begin MEASUREMENT vBCAMCNT2 "Between PhaseLHs, the number of PhaseRH input" UBYTE COMP_0068 1 100 0 255 ECU_ADDRESS 0xFFFF1FA1 /begin FUNCTION_LIST KF7-450.9A[5] /end FUNCTION_LIST /end MEASUREMENT
/begin MEASUREMENT vBETAA "Knock control learning value" SWORD COMP_0078 1 100 -128 127.99609375 ECU_ADDRESS 0xFFFF100C /begin FUNCTION_LIST KF7-379.3[3] KF7-379.4[1] KF7-379.5[3] /end FUNCTION_LIST /end MEASUREMENT
/begin MEASUREMENT vBETAB "Knock control learning value" SWORD COMP_0078 1 100 -128 127.99609375 ECU_ADDRESS 0xFFFF100E /begin FUNCTION_LIST KF7-379.3[3] KF7-379.4[1] KF7-379.5[3] /end FUNCTION_LIST /end MEASUREMENT
/begin MEASUREMENT vBETAC "Knock control learning value" SWORD COMP_0078 1 100 -128 127.99609375 ECU_ADDRESS 0xFFFF1010 /begin FUNCTION_LIST KF7-379.4[1] KF7-379.5[3] R301.7.KHOT_1_0_2 /end FUNCTION_LIST /end MEASUREMENT
/begin MEASUREMENT vBETACAL "In front of the limiter, the amount of knock control" SWORD COMP_0078 1 100 -128 127.99609375 ECU_ADDRESS 0xFFFF11C0 /begin FUNCTION_LIST KF7-379.5[3] KF7-450.20[2] /end FUNCTION_LIST /end MEASUREMENT
/begin MEASUREMENT vBETAD "Knock control value for the high-octane/regular judgement" SWORD COMP_0078 1 100 -128 127.99609375 ECU_ADDRESS 0xFFFF11C2 /begin FUNCTION_LIST KF7-379.3[3] /end FUNCTION_LIST /end MEASUREMENT
/begin MEASUREMENT vBREFCAM1 "After #5, the number of PhaseLH input" UBYTE COMP_0068 1 100 0 255 ECU_ADDRESS 0xFFFF1FA8 /begin FUNCTION_LIST KF7-450.9A[5] /end FUNCTION_LIST /end MEASUREMENT
/begin MEASUREMENT vBREFCAM2 "After #2, the number of PhaseRH input" UBYTE COMP_0068 1 100 0 255 ECU_ADDRESS 0xFFFF1FA9 /begin FUNCTION_LIST KF7-450.9A[5] /end FUNCTION_LIST /end MEASUREMENT
/begin MEASUREMENT vCCPWTSP "Cruise-control powertrain setpoint" UWORD COMP_0362_S 1 100 0 8191.875 ECU_ADDRESS 0xFFFF1E66 /begin FUNCTION_LIST KF7-410.19[2] KF7-410.20[N] /end FUNCTION_LIST /end MEASUREMENT
/begin MEASUREMENT vCNT4KAI1 "CAMCNT1 past four times memory value" UBYTE COMP_0068 1 100 0 255 ECU_ADDRESS 0xFFFF11F5 /begin FUNCTION_LIST KF7-450.9A[5] KF7-500.6D[9] /end FUNCTION_LIST /end MEASUREMENT
/begin MEASUREMENT vCNT4KAI2 "CAMCNT2 past four times memory value" UBYTE COMP_0068 1 100 0 255 ECU_ADDRESS 0xFFFF11F6 /begin FUNCTION_LIST KF7-450.9A[5] KF7-500.6D[9] /end FUNCTION_LIST /end MEASUREMENT
/begin MEASUREMENT vCYLBUP "Phase trouble tense business cylinder distinction value" UBYTE COMP_0567_S 1 100 0 255 ECU_ADDRESS 0xFFFFA2CF /begin FUNCTION_LIST KF7-450.9A[5] /end FUNCTION_LIST /end MEASUREMENT
/begin MEASUREMENT vDATRETD "The torque going down rate rate of increase" UWORD COMP_0383_S 1 100 0 0.999985458 ECU_ADDRESS 0xFFFF122C /begin FUNCTION_LIST KF7-385.2[18] /end FUNCTION_LIST /end MEASUREMENT
/begin MEASUREMENT vDATRETU "The torque going down rate rate of increase" UWORD COMP_0383_S 1 100 0 0.999985458 ECU_ADDRESS 0xFFFF122E /begin FUNCTION_LIST KF7-385.2[18] /end FUNCTION_LIST /end MEASUREMENT
/begin MEASUREMENT vDINPNE "At the time of L/U, engine rotation slowdown occasion equivalent value" UWORD COMP_0392_S 1 100 0 65535 ECU_ADDRESS 0xFFFF126C /begin FUNCTION_LIST KF7-385.1[32] /end FUNCTION_LIST /end MEASUREMENT
/begin MEASUREMENT vDLUNE "L/U prohibition engine speed (at the time of A/C off)" UWORD COMP_0000 1 100 0 1638375 ECU_ADDRESS 0xFFFF127C /begin FUNCTION_LIST KF7-385.1[32] /end FUNCTION_LIST /end MEASUREMENT
/begin MEASUREMENT vDLURPM "Coast L/U prohibition engine speed" UBYTE COMP_0000 1 100 0 6375 ECU_ADDRESS 0xFFFF127E /begin FUNCTION_LIST KF7-385.1[32] /end FUNCTION_LIST /end MEASUREMENT
/begin MEASUREMENT vDLVSP2S "A/C SW At the time of on, L/U prohibition vehicle speed" UBYTE COMP_0007 1 100 0 510 ECU_ADDRESS 0xFFFF127F /begin FUNCTION_LIST KF7-385.1[32] /end FUNCTION_LIST /end MEASUREMENT
/begin MEASUREMENT vDRPWTSP "Driver powertrain setpoint" UWORD COMP_0362_S 1 100 0 8191.875 ECU_ADDRESS 0xFFFF41EC /begin FUNCTION_LIST KF7-410.3[N] KF7-410.10[6] R000.1.RS_Integ_1_10_2 /end FUNCTION_LIST /end MEASUREMENT
/begin MEASUREMENT vDRPWTSP2 "Driver powertrain setpoint 2" UWORD COMP_0362_S 1 100 0 8191.875 ECU_ADDRESS 0xFFFF3C10 /begin FUNCTION_LIST KF7-410.10[6] /end FUNCTION_LIST /end MEASUREMENT
/begin MEASUREMENT vDRTQSP "Driver requirement engine torque" SWORD COMP_0228 1 100 -3276.8 3276.7 ECU_ADDRESS 0xFFFF2AA2
 /begin FUNCTION_LIST KF7-410.3[N] KF7-500.2A[29] KF7-505.54[2] R000.1.RS_Integ_1_10_2 R301.21.SafetyLevel2_1_0_2 /end FUNCTION_LIST
/end MEASUREMENT
/begin MEASUREMENT vDRVMDFAC "Driving mode factor" UBYTE COMP_0425 1 100 0 99.99999981 ECU_ADDRESS 0xFFFF41EE /begin FUNCTION_LIST KF7-410.3[N] R000.1.RS_Integ_1_10_2 /end FUNCTION_LIST /end MEASUREMENT
/begin MEASUREMENT vDSACT "Normalized pedal pushing speed" UBYTE COMP_0047 1 100 0 127.5 ECU_ADDRESS 0xFFFF2AA9 /begin FUNCTION_LIST KF7-410.3[N] /end FUNCTION_LIST /end MEASUREMENT
/begin MEASUREMENT vDSACT0 "Normalized pedal pushing speed (the front to deal with a filter)" UWORD COMP_0047 1 100 0 32767.5 ECU_ADDRESS 0xFFFF2AAA /begin FUNCTION_LIST KF7-410.3[N] /end FUNCTION_LIST /end MEASUREMENT
/begin MEASUREMENT vDSDAPO "Accelerator pedal speed (the front to deal with a filter)" UWORD COMP_0516_S 1 100 0 8191.875 ECU_ADDRESS 0xFFFF2AAC /begin FUNCTION_LIST KF7-410.3[N] /end FUNCTION_LIST /end MEASUREMENT
/begin MEASUREMENT vDSDAPOF "Accelerator pedal speed" UWORD COMP_0516_S 1 100 0 8191.875 ECU_ADDRESS 0xFFFF2AAE /begin FUNCTION_LIST KF7-410.3[N] /end FUNCTION_LIST /end MEASUREMENT
/begin MEASUREMENT vDSDMFSL "SLOW driving mode factor" UBYTE COMP_0425 1 100 0 99.99999981 ECU_ADDRESS 0xFFFF2AB0 /begin FUNCTION_LIST KF7-410.3[N] /end FUNCTION_LIST /end MEASUREMENT
/begin MEASUREMENT vDSPWR "The amount of normalized pedal pushing" UBYTE COMP_0047 1 100 0 127.5 ECU_ADDRESS 0xFFFF2AB4 /begin FUNCTION_LIST KF7-410.3[N] /end FUNCTION_LIST /end MEASUREMENT
/begin MEASUREMENT vDSPWR0 "Normalized pedal pushing quantity (the front to deal with a filter)" UWORD COMP_0047 1 100 0 32767.5 ECU_ADDRESS 0xFFFF2AB6 /begin FUNCTION_LIST KF7-410.3[N] /end FUNCTION_LIST /end MEASUREMENT
/begin MEASUREMENT vENGTIME "ÉEÉFÉbÉg/ÉhÉâÉC judgement engine operating time" UBYTE COMP_0013 1 100 0 255 ECU_ADDRESS 0xFFFFB5F0 /begin FUNCTION_LIST KF7-378.3B[5] /end FUNCTION_LIST /end MEASUREMENT
/begin MEASUREMENT vERGOPDL "Driver powertrain setpoint (8bit) for the CAN transmission" UBYTE COMP_0068 1 100 0 255 ECU_ADDRESS 0xFFFF3CB5 /begin FUNCTION_LIST KF7-410.10[6] /end FUNCTION_LIST /end MEASUREMENT
/begin MEASUREMENT vETSCLOCK "ETS clock" UBYTE COMP_0068 1 100 0 255 ECU_ADDRESS 0xFFFF380E /begin FUNCTION_LIST KF7-410.21[3] /end FUNCTION_LIST /end MEASUREMENT
/begin MEASUREMENT vETSTQCTT "ETS_TorqueControl reception interval counter" UBYTE COMP_0014 1 100 0 2550 ECU_ADDRESS 0xFFFF4939 /begin FUNCTION_LIST KF7-410.21[3] /end FUNCTION_LIST /end MEASUREMENT
/begin MEASUREMENT vFANAC "Air-conditioning system cooling requirement" UBYTE COMP_0027 1 100 0 255 ECU_ADDRESS 0xFFFF135A /begin FUNCTION_LIST KF7-377.1A[19] /end FUNCTION_LIST /end MEASUREMENT
/begin MEASUREMENT vFANACMAX "Air-conditioning system cooling maximum requirement" UBYTE COMP_0027 1 100 0 255 ECU_ADDRESS 0xFFFF135B /begin FUNCTION_LIST KF7-377.1A[19] /end FUNCTION_LIST /end MEASUREMENT
/begin MEASUREMENT vFANBASE "Air-conditioning system cooling basic requirement" UBYTE COMP_0027 1 100 0 255 ECU_ADDRESS 0xFFFF135C /begin FUNCTION_LIST KF7-377.1A[19] /end FUNCTION_LIST /end MEASUREMENT
/begin MEASUREMENT vFANTW "Engine system cooling requirement" UBYTE COMP_0027 1 100 0 255 ECU_ADDRESS 0xFFFF135D /begin FUNCTION_LIST KF7-377.1A[19] /end FUNCTION_LIST /end MEASUREMENT
/begin MEASUREMENT vFBDUTY "F/B DUTY value" UWORD COMP_0419 1 100 0 6553.5 ECU_ADDRESS 0xFFFF3CC2 /begin FUNCTION_LIST KF7-378.3B[5] /end FUNCTION_LIST /end MEASUREMENT
/begin MEASUREMENT vFCATE "The number of DUETTE target fuel cut cylinders" UBYTE COMP_0071_S 1 100 0 84.999999915 ECU_ADDRESS 0xFFFF2D13
 /begin FUNCTION_LIST KF7-385.2[18] KF7-385.3[4] KF7-386.2[4] KF7-410.12[2] KF7-500.21[19] R301.1.Torque_realization_1_0_3 /end FUNCTION_LIST
/end MEASUREMENT
/begin MEASUREMENT vFCATLIM "The number of target torque going down rate equivalent fuel cut cylinders" UBYTE COMP_0071_S 1 100 0 84.999999915 ECU_ADDRESS 0xFFFF1365 /begin FUNCTION_LIST KF7-385.2[18] R301.1.Torque_realization_1_0_3 /end FUNCTION_LIST /end MEASUREMENT
/begin MEASUREMENT vFCMOD "Fuel cut mode" UBYTE COMP_0251 1 100 0 255 ECU_ADDRESS 0xFFFF26E5 /begin FUNCTION_LIST KF7-381.9[2] KF7-410.12[2] /end FUNCTION_LIST /end MEASUREMENT
/begin MEASUREMENT vFCPRDT "Time for the pre retard start time decision" UBYTE COMP_0014 1 100 0 2550 ECU_ADDRESS 0xFFFF136A /begin FUNCTION_LIST KF7-390.3A[15] R301.5.FuelCut_1_2_2 /end FUNCTION_LIST /end MEASUREMENT
/begin MEASUREMENT vFCRETPI "At the time of the fuel cut, retard torque going down car" UBYTE COMP_0063 1 100 0 0.99609375 ECU_ADDRESS 0xFFFF136B /begin FUNCTION_LIST KF7-385.2[18] /end FUNCTION_LIST /end MEASUREMENT
/begin MEASUREMENT vFCYLADV "CYLBUP compensation flag" UBYTE COMP_0283 1 100 0 255 ECU_ADDRESS 0xFFFFA3BD /begin FUNCTION_LIST KF7-450.9A[5] /end FUNCTION_LIST /end MEASUREMENT
/begin MEASUREMENT vFCYLSTP "CYLBUP renewal stop flag" UBYTE COMP_0283 1 100 0 255 ECU_ADDRESS 0xFFFF1370 /begin FUNCTION_LIST KF7-450.9A[5] /end FUNCTION_LIST /end MEASUREMENT
/begin MEASUREMENT vFDTYUP "Air-conditioning ó‚ power UP requirement" UBYTE COMP_0027 1 100 0 255 ECU_ADDRESS 0xFFFF137B /begin FUNCTION_LIST KF7-377.1A[19] /end FUNCTION_LIST /end MEASUREMENT
/begin MEASUREMENT vFLGCRNG "Engine stop cylinder distinction failure flag" UBYTE COMP_0283 1 100 0 255 ECU_ADDRESS 0xFFFFA422 /begin FUNCTION_LIST KF7-450.9A[5] /end FUNCTION_LIST /end MEASUREMENT
/begin MEASUREMENT vGAFBI2 "Ignition timing F/B I gain" UBYTE COMP_0082_S 1 100 0 1.275 ECU_ADDRESS 0xFFFF1FD5 /begin FUNCTION_LIST KF7-390.3A[15] /end FUNCTION_LIST /end MEASUREMENT
/begin MEASUREMENT vGAFBP "Ignition timing F/B P gain" UBYTE COMP_0082_S 1 100 0 1.275 ECU_ADDRESS 0xFFFF1FD6 /begin FUNCTION_LIST KF7-390.3A[15] /end FUNCTION_LIST /end MEASUREMENT
/begin MEASUREMENT vGAFBP2 "Ignition timing F/B P gain" UBYTE COMP_0082_S 1 100 0 1.275 ECU_ADDRESS 0xFFFF1FD7 /begin FUNCTION_LIST KF7-390.3A[15] /end FUNCTION_LIST /end MEASUREMENT
/begin MEASUREMENT vGDUTY "Electric power guard DUTY value" UWORD COMP_0419 1 100 0 6553.5 ECU_ADDRESS 0xFFFF3D9C /begin FUNCTION_LIST KF7-378.3B[5] /end FUNCTION_LIST /end MEASUREMENT
/begin MEASUREMENT vHDTYINI "A/F sensor heater duty initial value" UBYTE COMP_0047 1 100 0 127.5 ECU_ADDRESS 0xFFFF3DA1 /begin FUNCTION_LIST KF7-378.3B[5] /end FUNCTION_LIST /end MEASUREMENT
/begin MEASUREMENT vIDUTYG "F/B DUTY integral clause" UWORD COMP_0422_S 1 100 0 204.796875 ECU_ADDRESS 0xFFFF3DAA /begin FUNCTION_LIST KF7-378.3B[5] /end FUNCTION_LIST /end MEASUREMENT
/begin MEASUREMENT vITACTE "ITAC for the torque operation" UWORD COMP_0108_S 1 100 0 159.970935 ECU_ADDRESS 0xFFFF14B6 /begin FUNCTION_LIST KF7-386.1[4] /end FUNCTION_LIST /end MEASUREMENT
/begin MEASUREMENT vKDL "Knock frequency element" UWORD COMP_0032 1 100 0 255.99609375 ECU_ADDRESS 0xFFFF2066 /begin FUNCTION_LIST KF7-379.1[9] KF7-379.6[N] /end FUNCTION_LIST /end MEASUREMENT
/begin MEASUREMENT vKDL_R#1 "Knock frequency element" UWORD COMP_0032 1 100 0 255.99609375 ECU_ADDRESS 0xFFFF2066 /begin FUNCTION_LIST KF7-379.1[9] KF7-379.6[N] /end FUNCTION_LIST /end MEASUREMENT
/begin MEASUREMENT vKDL_R#2 "Knock frequency element" UWORD COMP_0032 1 100 0 255.99609375 ECU_ADDRESS 0xFFFF2068 /begin FUNCTION_LIST KF7-379.1[9] KF7-379.6[N] /end FUNCTION_LIST /end MEASUREMENT
/begin MEASUREMENT vKDL_R#3 "Knock frequency element" UWORD COMP_0032 1 100 0 255.99609375 ECU_ADDRESS 0xFFFF206A /begin FUNCTION_LIST KF7-379.1[9] KF7-379.6[N] /end FUNCTION_LIST /end MEASUREMENT
/begin MEASUREMENT vKDL_R#4 "Knock frequency element" UWORD COMP_0032 1 100 0 255.99609375 ECU_ADDRESS 0xFFFF206C /begin FUNCTION_LIST KF7-379.1[9] KF7-379.6[N] /end FUNCTION_LIST /end MEASUREMENT
/begin MEASUREMENT vKDL_R#5 "Knock frequency element" UWORD COMP_0032 1 100 0 255.99609375 ECU_ADDRESS 0xFFFF206E /begin FUNCTION_LIST KF7-379.1[9] KF7-379.6[N] /end FUNCTION_LIST /end MEASUREMENT
/begin MEASUREMENT vKDL_R#6 "Knock frequency element" UWORD COMP_0032 1 100 0 255.99609375 ECU_ADDRESS 0xFFFF2070 /begin FUNCTION_LIST KF7-379.1[9] KF7-379.6[N] /end FUNCTION_LIST /end MEASUREMENT
/begin MEASUREMENT vKDL_R#7 "Knock frequency element" UWORD COMP_0032 1 100 0 255.99609375 ECU_ADDRESS 0xFFFF2072 /begin FUNCTION_LIST KF7-379.1[9] KF7-379.6[N] /end FUNCTION_LIST /end MEASUREMENT
/begin MEASUREMENT vKDL_R#8 "Knock frequency element" UWORD COMP_0032 1 100 0 255.99609375 ECU_ADDRESS 0xFFFF2074 /begin FUNCTION_LIST KF7-379.1[9] KF7-379.6[N] /end FUNCTION_LIST /end MEASUREMENT
/begin MEASUREMENT vKDLMON "A label for the monitor by knock frequency element cylinder" UWORD COMP_0032 1 100 0 255.99609375 ECU_ADDRESS 0xFFFF2076 /begin FUNCTION_LIST KF7-379.6[N] /end FUNCTION_LIST /end MEASUREMENT
/begin MEASUREMENT vKDLW "Knock frequency element" UWORD COMP_0032 1 100 0 255.99609375 ECU_ADDRESS 0xFFFF20D6 /begin FUNCTION_LIST KF7-379.1[9] /end FUNCTION_LIST /end MEASUREMENT
/begin MEASUREMENT vKDLW_R#1 "Knock frequency element" UWORD COMP_0032 1 100 0 255.99609375 ECU_ADDRESS 0xFFFF20D6 /begin FUNCTION_LIST KF7-379.1[9] /end FUNCTION_LIST /end MEASUREMENT
/begin MEASUREMENT vKDLW_R#2 "Knock frequency element" UWORD COMP_0032 1 100 0 255.99609375 ECU_ADDRESS 0xFFFF20D8 /begin FUNCTION_LIST KF7-379.1[9] /end FUNCTION_LIST /end MEASUREMENT
/begin MEASUREMENT vKDLW_R#3 "Knock frequency element" UWORD COMP_0032 1 100 0 255.99609375 ECU_ADDRESS 0xFFFF20DA /begin FUNCTION_LIST KF7-379.1[9] /end FUNCTION_LIST /end MEASUREMENT
/begin MEASUREMENT vKDLW_R#4 "Knock frequency element" UWORD COMP_0032 1 100 0 255.99609375 ECU_ADDRESS 0xFFFF20DC /begin FUNCTION_LIST KF7-379.1[9] /end FUNCTION_LIST /end MEASUREMENT
/begin MEASUREMENT vKDLW_R#5 "Knock frequency element" UWORD COMP_0032 1 100 0 255.99609375 ECU_ADDRESS 0xFFFF20DE /begin FUNCTION_LIST KF7-379.1[9] /end FUNCTION_LIST /end MEASUREMENT
/begin MEASUREMENT vKDLW_R#6 "Knock frequency element" UWORD COMP_0032 1 100 0 255.99609375 ECU_ADDRESS 0xFFFF20E0 /begin FUNCTION_LIST KF7-379.1[9] /end FUNCTION_LIST /end MEASUREMENT
/begin MEASUREMENT vKDLW_R#7 "Knock frequency element" UWORD COMP_0032 1 100 0 255.99609375 ECU_ADDRESS 0xFFFF20E2 /begin FUNCTION_LIST KF7-379.1[9] /end FUNCTION_LIST /end MEASUREMENT
/begin MEASUREMENT vKDLW_R#8 "Knock frequency element" UWORD COMP_0032 1 100 0 255.99609375 ECU_ADDRESS 0xFFFF20E4 /begin FUNCTION_LIST KF7-379.1[9] /end FUNCTION_LIST /end MEASUREMENT
/begin MEASUREMENT vKDVTC "D gain" UBYTE COMP_0027 1 100 0 255 ECU_ADDRESS 0xFFFF14C6 /begin FUNCTION_LIST KF7-393.1C[8] /end FUNCTION_LIST /end MEASUREMENT
/begin MEASUREMENT vKDVTC_R#1 "D gain" UBYTE COMP_0027 1 100 0 255 ECU_ADDRESS 0xFFFF14C6 /begin FUNCTION_LIST KF7-393.1C[8] /end FUNCTION_LIST /end MEASUREMENT
/begin MEASUREMENT vKDVTC_R#2 "D gain" UBYTE COMP_0027 1 100 0 255 ECU_ADDRESS 0xFFFF14C7 /begin FUNCTION_LIST KF7-393.1C[8] /end FUNCTION_LIST /end MEASUREMENT
/begin MEASUREMENT vKNCNT "The number of knock counts" UBYTE COMP_0030 1 100 0 255 ECU_ADDRESS 0xFFFF20E6 /begin FUNCTION_LIST KF7-379.1[9] KF7-379.5[3] /end FUNCTION_LIST /end MEASUREMENT
/begin MEASUREMENT vKNKSL "Knock slice level" UWORD COMP_0032 1 100 0 255.99609375 ECU_ADDRESS 0xFFFF20E8 /begin FUNCTION_LIST KF7-379.1[9] /end FUNCTION_LIST /end MEASUREMENT
/begin MEASUREMENT vKNOCKCYL "A label for the monitor by knock judgement cylinder" UBYTE COMP_0004 1 100 0 255 ECU_ADDRESS 0xFFFF20F4 /begin FUNCTION_LIST KF7-379.6[N] /end FUNCTION_LIST /end MEASUREMENT
/begin MEASUREMENT vKNSCNT "Knock sampling number of times" UWORD COMP_0030 1 100 0 65535 ECU_ADDRESS 0xFFFF20F6 /begin FUNCTION_LIST KF7-379.1[9] /end FUNCTION_LIST /end MEASUREMENT
/begin MEASUREMENT vKNSEQ "Sequence number of times" UBYTE COMP_0030 1 100 0 255 ECU_ADDRESS 0xFFFF20F8 /begin FUNCTION_LIST KF7-379.1[9] /end FUNCTION_LIST /end MEASUREMENT
/begin MEASUREMENT vKP "A knock index number by the frequency" SLONG COMP_0415 1 100 -8388608 8388607.99609375 ECU_ADDRESS 0xFFFF20FC /begin FUNCTION_LIST KF7-379.1[9] /end FUNCTION_LIST /end MEASUREMENT
/begin MEASUREMENT vKP_R#1 "A knock index number by the frequency" SLONG COMP_0415 1 100 -8388608 8388607.99609375 ECU_ADDRESS 0xFFFF20FC /begin FUNCTION_LIST KF7-379.1[9] /end FUNCTION_LIST /end MEASUREMENT
/begin MEASUREMENT vKP_R#2 "A knock index number by the frequency" SLONG COMP_0415 1 100 -8388608 8388607.99609375 ECU_ADDRESS 0xFFFF2100 /begin FUNCTION_LIST KF7-379.1[9] /end FUNCTION_LIST /end MEASUREMENT
/begin MEASUREMENT vKP_R#3 "A knock index number by the frequency" SLONG COMP_0415 1 100 -8388608 8388607.99609375 ECU_ADDRESS 0xFFFF2104 /begin FUNCTION_LIST KF7-379.1[9] /end FUNCTION_LIST /end MEASUREMENT
/begin MEASUREMENT vKP_R#4 "A knock index number by the frequency" SLONG COMP_0415 1 100 -8388608 8388607.99609375 ECU_ADDRESS 0xFFFF2108 /begin FUNCTION_LIST KF7-379.1[9] /end FUNCTION_LIST /end MEASUREMENT
/begin MEASUREMENT vKP_R#5 "A knock index number by the frequency" SLONG COMP_0415 1 100 -8388608 8388607.99609375 ECU_ADDRESS 0xFFFF210C /begin FUNCTION_LIST KF7-379.1[9] /end FUNCTION_LIST /end MEASUREMENT
/begin MEASUREMENT vKP_R#6 "A knock index number by the frequency" SLONG COMP_0415 1 100 -8388608 8388607.99609375 ECU_ADDRESS 0xFFFF2110 /begin FUNCTION_LIST KF7-379.1[9] /end FUNCTION_LIST /end MEASUREMENT
/begin MEASUREMENT vKP_R#7 "A knock index number by the frequency" SLONG COMP_0415 1 100 -8388608 8388607.99609375 ECU_ADDRESS 0xFFFF2114 /begin FUNCTION_LIST KF7-379.1[9] /end FUNCTION_LIST /end MEASUREMENT
/begin MEASUREMENT vKP_R#8 "A knock index number by the frequency" SLONG COMP_0415 1 100 -8388608 8388607.99609375 ECU_ADDRESS 0xFFFF2118 /begin FUNCTION_LIST KF7-379.1[9] /end FUNCTION_LIST /end MEASUREMENT
/begin MEASUREMENT vKPSBGL "Knock back ground level" UWORD COMP_0032 1 100 0 255.99609375 ECU_ADDRESS 0xFFFF211C /begin FUNCTION_LIST KF7-379.1[9] KF7-450.20[2] /end FUNCTION_LIST /end MEASUREMENT
/begin MEASUREMENT vKPVTC "P-gain gain" UBYTE COMP_0027 1 100 0 255 ECU_ADDRESS 0xFFFF14EB /begin FUNCTION_LIST KF7-393.1C[8] /end FUNCTION_LIST /end MEASUREMENT
/begin MEASUREMENT vKPVTC_R#1 "P-gain gain" UBYTE COMP_0027 1 100 0 255 ECU_ADDRESS 0xFFFF14EB /begin FUNCTION_LIST KF7-393.1C[8] /end FUNCTION_LIST /end MEASUREMENT
/begin MEASUREMENT vKPVTC_R#2 "P-gain gain" UBYTE COMP_0027 1 100 0 255 ECU_ADDRESS 0xFFFF14EC /begin FUNCTION_LIST KF7-393.1C[8] /end FUNCTION_LIST /end MEASUREMENT
/begin MEASUREMENT vKS "Knock index number" ULONG COMP_0454 1 100 -8388608 8388607.99609375 ECU_ADDRESS 0xFFFF217C /begin FUNCTION_LIST KF7-379.1[9] KF7-400.5[3] /end FUNCTION_LIST /end MEASUREMENT
/begin MEASUREMENT vKS_R#1 "Knock index number" ULONG COMP_0454 1 100 -8388608 8388607.99609375 ECU_ADDRESS 0xFFFF217C /begin FUNCTION_LIST KF7-379.1[9] KF7-400.5[3] /end FUNCTION_LIST /end MEASUREMENT
/begin MEASUREMENT vKS_R#2 "Knock index number" ULONG COMP_0454 1 100 -8388608 8388607.99609375 ECU_ADDRESS 0xFFFF2180 /begin FUNCTION_LIST KF7-379.1[9] KF7-400.5[3] /end FUNCTION_LIST /end MEASUREMENT
/begin MEASUREMENT vKS_R#3 "Knock index number" ULONG COMP_0454 1 100 -8388608 8388607.99609375 ECU_ADDRESS 0xFFFF2184 /begin FUNCTION_LIST KF7-379.1[9] KF7-400.5[3] /end FUNCTION_LIST /end MEASUREMENT
/begin MEASUREMENT vKS_R#4 "Knock index number" ULONG COMP_0454 1 100 -8388608 8388607.99609375 ECU_ADDRESS 0xFFFF2188 /begin FUNCTION_LIST KF7-379.1[9] KF7-400.5[3] /end FUNCTION_LIST /end MEASUREMENT
/begin MEASUREMENT vKS_R#5 "Knock index number" ULONG COMP_0454 1 100 -8388608 8388607.99609375 ECU_ADDRESS 0xFFFF218C /begin FUNCTION_LIST KF7-379.1[9] KF7-400.5[3] /end FUNCTION_LIST /end MEASUREMENT
/begin MEASUREMENT vKS_R#6 "Knock index number" ULONG COMP_0454 1 100 -8388608 8388607.99609375 ECU_ADDRESS 0xFFFF2190 /begin FUNCTION_LIST KF7-379.1[9] KF7-400.5[3] /end FUNCTION_LIST /end MEASUREMENT
/begin MEASUREMENT vKS_R#7 "Knock index number" ULONG COMP_0454 1 100 -8388608 8388607.99609375 ECU_ADDRESS 0xFFFF2194 /begin FUNCTION_LIST KF7-379.1[9] KF7-400.5[3] /end FUNCTION_LIST /end MEASUREMENT
/begin MEASUREMENT vKS_R#8 "Knock index number" ULONG COMP_0454 1 100 -8388608 8388607.99609375 ECU_ADDRESS 0xFFFF2198 /begin FUNCTION_LIST KF7-379.1[9] KF7-400.5[3] /end FUNCTION_LIST /end MEASUREMENT
/begin MEASUREMENT vKTRQREF "A first-ordered filter weight coefficient for the common FAST torque going down" UWORD COMP_0290 1 100 0 0.999985458 ECU_ADDRESS 0xFFFF1504 /begin FUNCTION_LIST KF7-385.2[18] /end FUNCTION_LIST /end MEASUREMENT
/begin MEASUREMENT vLUREQSF "Lockup request status" UBYTE COMP_0068 1 100 0 255 ECU_ADDRESS 0xFFFF3DEA /begin FUNCTION_LIST KF7-410.10[6] /end FUNCTION_LIST /end MEASUREMENT
/begin MEASUREMENT vMAXAVFAC "The torque environment compensation coefficient that engine output is possible" UWORD COMP_0485_S 1 100 0 1599.9780435 ECU_ADDRESS 0xFFFF2EF6 /begin FUNCTION_LIST KF7-410.11M[4] R301.20.AmbientComp_1_0_2 /end FUNCTION_LIST /end MEASUREMENT
/begin MEASUREMENT vMAXAVTQ "The torque maximum value that engine output is possible" SWORD COMP_0228 1 100 -3276.8 3276.7 ECU_ADDRESS 0xFFFF4202
 /begin FUNCTION_LIST KF7-410.3[N] KF7-410.10[6] KF7-410.11M[4] R000.1.RS_Integ_1_10_2 /end FUNCTION_LIST
/end MEASUREMENT
/begin MEASUREMENT vMAXPOSTQ "The torque basic value that engine output is possible" SWORD COMP_0228 1 100 -3276.8 3276.7 ECU_ADDRESS 0xFFFF2EF8 /begin FUNCTION_LIST KF7-410.11M[4] R000.1.RS_Integ_1_10_2 /end FUNCTION_LIST /end MEASUREMENT
/begin MEASUREMENT vMBTZURE "MBT The amount of deviation" UBYTE COMP_0017 1 100 0 255 ECU_ADDRESS 0xFFFF21BD /begin FUNCTION_LIST KF7-390.1A[3] /end FUNCTION_LIST /end MEASUREMENT
/begin MEASUREMENT vMILNGCN "Watch mechanism wrong point TRIP counter" UBYTE COMP_0012_S 1 100 0 255 ECU_ADDRESS 0xFFFFA638 /begin FUNCTION_LIST KF7-450.22[1] R000.4.EepAlloc_1_2_2 /end FUNCTION_LIST /end MEASUREMENT
/begin MEASUREMENT vMINAVTQ "The torque minimum value that engine output is possible" SWORD COMP_0228 1 100 -3276.8 3276.7 ECU_ADDRESS 0xFFFF420C DISPLAY_IDENTIFIER Vxx_min_avl_tqe
 /begin FUNCTION_LIST KF7-410.10[6] KF7-410.11M[4] R000.1.RS_Integ_1_10_2 R204.1.CanComm_1_9_2 /end FUNCTION_LIST
/end MEASUREMENT
/begin MEASUREMENT vMNAVTQ_S "The torque minimum value (vice-operation part) that engine output is possible" SWORD COMP_0228 1 100 -3276.8 3276.7 ECU_ADDRESS 0xFFFF34F8 /begin FUNCTION_LIST KF7-410.11P[4] R000.1.RS_Integ_1_10_2 /end FUNCTION_LIST /end MEASUREMENT
/begin MEASUREMENT vNFCUT "The number of fuel cut cylinders" UBYTE COMP_0129_S 1 100 0 255 ECU_ADDRESS 0xFFFF15DC /begin FUNCTION_LIST KF7-386.1[4] /end FUNCTION_LIST /end MEASUREMENT
/begin MEASUREMENT vNFCUTAT "Fuel cut cylinder number (the number except for FCAT)" UBYTE COMP_0129_S 1 100 0 255 ECU_ADDRESS 0xFFFF15DD /begin FUNCTION_LIST KF7-386.2[4] /end FUNCTION_LIST /end MEASUREMENT
/begin MEASUREMENT vNSETCK "Idle speed temporary target value" UBYTE COMP_0006 1 100 0 3187.5 ECU_ADDRESS 0xFFFF15F4 /begin FUNCTION_LIST KF7-385.1[32] KF7-385.3[4] /end FUNCTION_LIST /end MEASUREMENT
/begin MEASUREMENT vNSTTBLCK "After the upper limit limiter treatment, NSETTBL" UBYTE COMP_0006 1 100 0 3187.5 ECU_ADDRESS 0xFFFF15FA /begin FUNCTION_LIST KF7-385.1[32] KF7-385.3[4] /end FUNCTION_LIST /end MEASUREMENT
/begin MEASUREMENT vOUTRV350 "Before 350mS, output shaft speed" UWORD COMP_0443 1 100 0 65535 ECU_ADDRESS 0xFFFF1632 /begin FUNCTION_LIST KF7-385.1[32] /end FUNCTION_LIST /end MEASUREMENT
/begin MEASUREMENT vPAMBFAC "The torque atomospheric pressure compensation coefficient that engine output is possible" UWORD COMP_0485_S 1 100 0 1599.9780435 ECU_ADDRESS 0xFFFF3068 /begin FUNCTION_LIST KF7-410.11M[4] /end FUNCTION_LIST /end MEASUREMENT
/begin MEASUREMENT vPDUTYG "F/B DUTY proportion clause" UWORD COMP_0615_S 1 100 -102.4 102.396875 ECU_ADDRESS 0xFFFF3E28 /begin FUNCTION_LIST KF7-378.3B[5] /end FUNCTION_LIST /end MEASUREMENT
/begin MEASUREMENT vPERR "The amount of VTC operation angle deviation" UBYTE COMP_0256 1 100 -64 63.5 ECU_ADDRESS 0xFFFF1024 /begin FUNCTION_LIST KF7-393.1C[8] /end FUNCTION_LIST /end MEASUREMENT
/begin MEASUREMENT vPERR3 "The amount of VTC operation angle deviation" UBYTE COMP_0256 1 100 -64 63.5 ECU_ADDRESS 0xFFFF1027 /begin FUNCTION_LIST KF7-393.1C[8] /end FUNCTION_LIST /end MEASUREMENT
/begin MEASUREMENT vPERR3_R#1 "The amount of VTC operation angle deviation" UBYTE COMP_0256 1 100 -64 63.5 ECU_ADDRESS 0xFFFF1027 /begin FUNCTION_LIST KF7-393.1C[8] /end FUNCTION_LIST /end MEASUREMENT
/begin MEASUREMENT vPERR3_R#2 "The amount of VTC operation angle deviation" UBYTE COMP_0256 1 100 -64 63.5 ECU_ADDRESS 0xFFFF1028 /begin FUNCTION_LIST KF7-393.1C[8] /end FUNCTION_LIST /end MEASUREMENT
/begin MEASUREMENT vPIDDTY "PID control quantity (DUTY)" ULONG COMP_0490 1 100 -50.00004632576 25550.0236665029 ECU_ADDRESS 0xFFFF1688 /begin FUNCTION_LIST KF7-393.1C[8] /end FUNCTION_LIST /end MEASUREMENT
/begin MEASUREMENT vPIDDTY_R#1 "PID control quantity (DUTY)" ULONG COMP_0490 1 100 -50.00004632576 25550.0236665029 ECU_ADDRESS 0xFFFF1688 /begin FUNCTION_LIST KF7-393.1C[8] /end FUNCTION_LIST /end MEASUREMENT
/begin MEASUREMENT vPIDDTY_R#2 "PID control quantity (DUTY)" ULONG COMP_0490 1 100 -50.00004632576 25550.0236665029 ECU_ADDRESS 0xFFFF168C /begin FUNCTION_LIST KF7-393.1C[8] /end FUNCTION_LIST /end MEASUREMENT
/begin MEASUREMENT vPILOCK "At the time of the urgent slowdown, torque compensation" UBYTE COMP_0009 1 100 0 199.21875 ECU_ADDRESS 0xFFFF23F2 /begin FUNCTION_LIST KF7-385.1[32] KF7-386.2[4] KF7-390.1A[3] KF7-390.3A[15] /end FUNCTION_LIST /end MEASUREMENT
/begin MEASUREMENT vPTDPWTSP "PTD driver powertrain setpoint" UWORD COMP_0362_S 1 100 0 8191.875 ECU_ADDRESS 0xFFFF4958 /begin FUNCTION_LIST KF7-410.19[2] /end FUNCTION_LIST /end MEASUREMENT
/begin MEASUREMENT vQADVFB "The amount of ignition timing F/B compensation" SBYTE COMP_0277 1 100 -128 127 ECU_ADDRESS 0xFFFF21FE
 /begin FUNCTION_LIST KF7-390.3A[15] KF7-450.1[N] KF7-450.2[1] KF7-450.3[1] KF7-450.4[1] KF7-580.1[8] /end FUNCTION_LIST
/end MEASUREMENT
/begin MEASUREMENT vQADVFBP "ADV F/B compensation quantity (P-gain)" SBYTE COMP_0277 1 100 -128 127 ECU_ADDRESS 0xFFFF2200 /begin FUNCTION_LIST KF7-390.3A[15] /end FUNCTION_LIST /end MEASUREMENT
/begin MEASUREMENT vQADVFF "The amount of ignition timing F/F compensation" SBYTE COMP_0277 1 100 -128 127 ECU_ADDRESS 0xFFFF16B2 /begin FUNCTION_LIST KF7-390.3A[15] /end FUNCTION_LIST /end MEASUREMENT
/begin MEASUREMENT vQADVISC "The amount of idle stabilization ignition timing compensation" SBYTE COMP_0277 1 100 -128 127 ECU_ADDRESS 0xFFFF2201 /begin FUNCTION_LIST KF7-390.3A[15] KF7-580.1[8] /end FUNCTION_LIST /end MEASUREMENT
/begin MEASUREMENT vQTRQAC "A/C load torque" UBYTE COMP_0051 1 100 0 255 ECU_ADDRESS 0xFFFF1706 /begin FUNCTION_LIST KF7-390.3A[15] /end FUNCTION_LIST /end MEASUREMENT
/begin MEASUREMENT vQTRQALT "Alternator load torque" UBYTE COMP_0051 1 100 0 255 ECU_ADDRESS 0xFFFF1707 /begin FUNCTION_LIST KF7-390.3A[15] /end FUNCTION_LIST /end MEASUREMENT
/begin MEASUREMENT vQTRQEST "For the accessory load torque" UBYTE COMP_0051 1 100 0 255 ECU_ADDRESS 0xFFFF1708 /begin FUNCTION_LIST KF7-390.3A[15] /end FUNCTION_LIST /end MEASUREMENT
/begin MEASUREMENT vQTRQQLD "A torque U P-gain by the air F/F" UBYTE COMP_0051 1 100 0 255 ECU_ADDRESS 0xFFFF1709 /begin FUNCTION_LIST KF7-390.3A[15] /end FUNCTION_LIST /end MEASUREMENT
/begin MEASUREMENT vQTRQQLD0 "A variable for the QTRQQLD operation" UBYTE COMP_0051 1 100 0 255 ECU_ADDRESS 0xFFFF1033 /begin FUNCTION_LIST KF7-390.3A[15] /end FUNCTION_LIST /end MEASUREMENT
/begin MEASUREMENT vQTRQQLD1 "A variable for the QTRQQLD operation" UBYTE COMP_0051 1 100 0 255 ECU_ADDRESS 0xFFFF170A /begin FUNCTION_LIST KF7-390.3A[15] /end FUNCTION_LIST /end MEASUREMENT
/begin MEASUREMENT vQTRQRFN "Radiator fan load torque" UBYTE COMP_0051 1 100 0 255 ECU_ADDRESS 0xFFFF170B /begin FUNCTION_LIST KF7-390.3A[15] /end FUNCTION_LIST /end MEASUREMENT
/begin MEASUREMENT vQTWCK "Coolant temperature compensation air flow-quantity" UBYTE COMP_0493 1 100 0 1020 ECU_ADDRESS 0xFFFF170D /begin FUNCTION_LIST KF7-385.1[32] KF7-385.3[4] /end FUNCTION_LIST /end MEASUREMENT
/begin MEASUREMENT vRATIOBF "RATIO buffer" UWORD COMP_0450 1 100 0 63.999056205 ECU_ADDRESS 0xFFFF1714 /begin FUNCTION_LIST KF7-385.2[18] /end FUNCTION_LIST /end MEASUREMENT
/begin MEASUREMENT vRATIOTR "RATIO progress value" UWORD COMP_0450 1 100 0 63.999056205 ECU_ADDRESS 0xFFFF171C /begin FUNCTION_LIST KF7-385.2[18] /end FUNCTION_LIST /end MEASUREMENT
/begin MEASUREMENT vRAWPDL "An accelerator pedal ratio (8bit) for the CAN transmission" UBYTE COMP_0068 1 100 0 255 ECU_ADDRESS 0xFFFF3E3F /begin FUNCTION_LIST KF7-410.10[6] /end FUNCTION_LIST /end MEASUREMENT
/begin MEASUREMENT vRECNR "L/U Fuel recover rotation for the release judgement" UBYTE COMP_0000 1 100 0 6375 ECU_ADDRESS 0xFFFF1727 /begin FUNCTION_LIST KF7-385.1[32] /end FUNCTION_LIST /end MEASUREMENT
/begin MEASUREMENT vREVDLTD "A degree of a slowdown for the urgent slowdown judgement" UWORD COMP_0618_S 1 100 0 187.24280097 ECU_ADDRESS 0xFFFF1740 /begin FUNCTION_LIST KF7-385.1[32] /end FUNCTION_LIST /end MEASUREMENT
/begin MEASUREMENT vRFNADV "A variable for the QTRQEST operation" UBYTE COMP_0004 1 100 0 255 ECU_ADDRESS 0xFFFF1746 /begin FUNCTION_LIST KF7-390.3A[15] /end FUNCTION_LIST /end MEASUREMENT
/begin MEASUREMENT vRFNOUT "Radiator fan output value" UBYTE COMP_0004 1 100 0 255 ECU_ADDRESS 0xFFFF23FC /begin FUNCTION_LIST KF7-377.1A[19] KF7-580.1[8] R301.3.FanAftPwl_1_0_4 /end FUNCTION_LIST /end MEASUREMENT
/begin MEASUREMENT vRFNOUT0 "A variable for the radiator fan relay timing adjustment" UBYTE COMP_0004 1 100 0 255 ECU_ADDRESS 0xFFFF1748 /begin FUNCTION_LIST KF7-377.1A[19] /end FUNCTION_LIST /end MEASUREMENT
/begin MEASUREMENT vRFNSW "Radiator fan switching control variable" UBYTE COMP_0004 1 100 0 255 ECU_ADDRESS 0xFFFF174A /begin FUNCTION_LIST KF7-377.1A[19] KF7-580.1[8] R000.1.RS_Integ_1_10_2 /end FUNCTION_LIST /end MEASUREMENT
/begin MEASUREMENT vRKS "Knock index number" SLONG COMP_0415 1 100 -8388608 8388607.99609375 ECU_ADDRESS 0xFFFF2210 /begin FUNCTION_LIST KF7-379.1[9] /end FUNCTION_LIST /end MEASUREMENT
/begin MEASUREMENT vRKS_R#1 "Knock index number" SLONG COMP_0415 1 100 -8388608 8388607.99609375 ECU_ADDRESS 0xFFFF2210 /begin FUNCTION_LIST KF7-379.1[9] /end FUNCTION_LIST /end MEASUREMENT
/begin MEASUREMENT vRKS_R#2 "Knock index number" SLONG COMP_0415 1 100 -8388608 8388607.99609375 ECU_ADDRESS 0xFFFF2214 /begin FUNCTION_LIST KF7-379.1[9] /end FUNCTION_LIST /end MEASUREMENT
/begin MEASUREMENT vRKS_R#3 "Knock index number" SLONG COMP_0415 1 100 -8388608 8388607.99609375 ECU_ADDRESS 0xFFFF2218 /begin FUNCTION_LIST KF7-379.1[9] /end FUNCTION_LIST /end MEASUREMENT
/begin MEASUREMENT vRKS_R#4 "Knock index number" SLONG COMP_0415 1 100 -8388608 8388607.99609375 ECU_ADDRESS 0xFFFF221C /begin FUNCTION_LIST KF7-379.1[9] /end FUNCTION_LIST /end MEASUREMENT
/begin MEASUREMENT vRKS_R#5 "Knock index number" SLONG COMP_0415 1 100 -8388608 8388607.99609375 ECU_ADDRESS 0xFFFF2220 /begin FUNCTION_LIST KF7-379.1[9] /end FUNCTION_LIST /end MEASUREMENT
/begin MEASUREMENT vRKS_R#6 "Knock index number" SLONG COMP_0415 1 100 -8388608 8388607.99609375 ECU_ADDRESS 0xFFFF2224 /begin FUNCTION_LIST KF7-379.1[9] /end FUNCTION_LIST /end MEASUREMENT
/begin MEASUREMENT vRKS_R#7 "Knock index number" SLONG COMP_0415 1 100 -8388608 8388607.99609375 ECU_ADDRESS 0xFFFF2228 /begin FUNCTION_LIST KF7-379.1[9] /end FUNCTION_LIST /end MEASUREMENT
/begin MEASUREMENT vRKS_R#8 "Knock index number" SLONG COMP_0415 1 100 -8388608 8388607.99609375 ECU_ADDRESS 0xFFFF222C /begin FUNCTION_LIST KF7-379.1[9] /end FUNCTION_LIST /end MEASUREMENT
/begin MEASUREMENT vRO2CNT "RO2HDTY operation number of times" UBYTE COMP_0030 1 100 0 255 ECU_ADDRESS 0xFFFF175E /begin FUNCTION_LIST KF7-378.2B[6] /end FUNCTION_LIST /end MEASUREMENT
/begin MEASUREMENT vRO2HDTY "Rear O2 sensor heater duty" UWORD COMP_0133_S 1 100 0 2559.9609375 ECU_ADDRESS 0xFFFF2402
 /begin FUNCTION_LIST KF7-378.2B[6] KF7-500.25A[7] R301.18.VB_short_Protection_1_0_2 R901.1.Diag_on_can_app_1_6_2 /end FUNCTION_LIST
/end MEASUREMENT
/begin MEASUREMENT vRO2TMHMX "Rear O2 sensor heater duty upper limit value maintenance counter" UBYTE COMP_0068 1 100 0 255 ECU_ADDRESS 0xFFFF176A /begin FUNCTION_LIST KF7-378.2B[6] /end FUNCTION_LIST /end MEASUREMENT
/begin MEASUREMENT vRO2VBHOS "Rear O2 sensor heater duty VB compensation coefficient" UBYTE COMP_0009 1 100 0 199.21875 ECU_ADDRESS 0xFFFF176C /begin FUNCTION_LIST KF7-378.2B[6] /end FUNCTION_LIST /end MEASUREMENT
/begin MEASUREMENT vSTNGTIM "Engine stop cylinder distinction failure judgement threshold" UBYTE COMP_0008 1 100 0 25500 ECU_ADDRESS 0xFFFF3216 /begin FUNCTION_LIST KF7-450.9A[5] /end FUNCTION_LIST /end MEASUREMENT
/begin MEASUREMENT vSUMQM20 "QM integration value (20sec)" ULONG COMP_0068 1 100 0 4294967295 ECU_ADDRESS 0xFFFF17D4 /begin FUNCTION_LIST KF7-378.2B[6] /end FUNCTION_LIST /end MEASUREMENT
/begin MEASUREMENT vSUMQM20Z "QM integration Z value (20sec)" ULONG COMP_0068 1 100 0 4294967295 ECU_ADDRESS 0xFFFF17D8 /begin FUNCTION_LIST KF7-378.2B[6] /end FUNCTION_LIST /end MEASUREMENT
/begin MEASUREMENT vSUMQM40 "QM integration value (40sec)" ULONG COMP_0068 1 100 0 4294967295 ECU_ADDRESS 0xFFFF17DC /begin FUNCTION_LIST KF7-378.2B[6] /end FUNCTION_LIST /end MEASUREMENT
/begin MEASUREMENT vTACTRQ "Air-conditioning load torque" UWORD COMP_0196 1 100 0 6553.5 ECU_ADDRESS 0xFFFF17E4
 /begin FUNCTION_LIST KF7-386.3[8] R000.1.RS_Integ_1_10_2 R301.6.IscAirflow_1_4_5 /end FUNCTION_LIST
/end MEASUREMENT
/begin MEASUREMENT vTADNVCK "Normalized opening area" ULONG COMP_0008_S 1 100 0 0.1679332212345 ECU_ADDRESS 0xFFFF17F4 /begin FUNCTION_LIST KF7-385.3[4] /end FUNCTION_LIST /end MEASUREMENT
/begin MEASUREMENT vTALTRQ "Alternator load torque" UWORD COMP_0196 1 100 0 6553.5 ECU_ADDRESS 0xFFFF1802 /begin FUNCTION_LIST KF7-386.3[8] R000.1.RS_Integ_1_10_2 /end FUNCTION_LIST /end MEASUREMENT
/begin MEASUREMENT vTANFAC "The torque intake air temperature compensation coefficient that engine output is possible" UWORD COMP_0485_S 1 100 0 1599.9780435 ECU_ADDRESS 0xFFFF32B0 /begin FUNCTION_LIST KF7-410.11M[4] /end FUNCTION_LIST /end MEASUREMENT
/begin MEASUREMENT vTB "Base torque" UBYTE COMP_0009 1 100 0 199.21875 ECU_ADDRESS 0xFFFF223D /begin FUNCTION_LIST KF7-390.1A[3] /end FUNCTION_LIST /end MEASUREMENT
/begin MEASUREMENT vTCOLD "At the time of the cold, ISC compensation U P-gain torque" UBYTE COMP_0021_S 1 100 -100 410 ECU_ADDRESS 0xFFFF1F1D /begin FUNCTION_LIST KF7-385.1[32] /end FUNCTION_LIST /end MEASUREMENT
/begin MEASUREMENT vTCSMDD1 "After the failsafe treatment, control mode" UBYTE COMP_0071_S 1 100 0 84.999999915 ECU_ADDRESS 0xFFFF32CE /begin FUNCTION_LIST KF7-386.2[4] KF7-410.12[2] /end FUNCTION_LIST /end MEASUREMENT
/begin MEASUREMENT vTCSMDD15 "After the failsafe treatment, control mode" UBYTE COMP_0071_S 1 100 0 84.999999915 ECU_ADDRESS 0xFFFF32CF /begin FUNCTION_LIST KF7-410.12[2] /end FUNCTION_LIST /end MEASUREMENT
/begin MEASUREMENT vTCSMDD2 "A final control mode" UBYTE COMP_0071_S 1 100 0 84.999999915 ECU_ADDRESS 0xFFFF32D0 /begin FUNCTION_LIST KF7-410.12[2] /end FUNCTION_LIST /end MEASUREMENT
/begin MEASUREMENT vTCSMOD "The number of fuel cut requirement cylinders" UBYTE COMP_0071_S 1 100 0 84.999999915 ECU_ADDRESS 0xFFFF32D1 /begin FUNCTION_LIST KF7-410.12[2] /end FUNCTION_LIST /end MEASUREMENT
/begin MEASUREMENT vTD "Going down torque" UBYTE COMP_0009 1 100 0 199.21875 ECU_ADDRESS 0xFFFF224D /begin FUNCTION_LIST KF7-390.1A[3] KF7-580.1[8] /end FUNCTION_LIST /end MEASUREMENT
/begin MEASUREMENT vTDATDGP "TDATDDS reference parameter" UBYTE COMP_0068 1 100 0 255 ECU_ADDRESS 0xFFFF182A /begin FUNCTION_LIST KF7-385.2[18] /end FUNCTION_LIST /end MEASUREMENT
/begin MEASUREMENT vTDLIMPI "Target torque going down rate equivalent Pi per cent rate" UBYTE COMP_0032 1 100 0 0.99609375 ECU_ADDRESS 0xFFFF182B /begin FUNCTION_LIST KF7-385.2[18] /end FUNCTION_LIST /end MEASUREMENT
/begin MEASUREMENT vTDM "Going down torque timing" UBYTE COMP_0017 1 100 0 255 ECU_ADDRESS 0xFFFF224E /begin FUNCTION_LIST KF7-390.1A[3] /end FUNCTION_LIST /end MEASUREMENT
/begin MEASUREMENT vTDRAT "Torque going down rate" UWORD COMP_0101 1 100 0 0.999985458 ECU_ADDRESS 0xFFFF182E /begin FUNCTION_LIST KF7-385.2[18] /end FUNCTION_LIST /end MEASUREMENT
/begin MEASUREMENT vTDRATBF "TDRAT buffer" UWORD COMP_0290 1 100 0 0.999985458 ECU_ADDRESS 0xFFFF1830 /begin FUNCTION_LIST KF7-385.2[18] /end FUNCTION_LIST /end MEASUREMENT
/begin MEASUREMENT vTDRATPI "Target Pi rate" UBYTE COMP_0032 1 100 0 0.99609375 ECU_ADDRESS 0xFFFF1832
 /begin FUNCTION_LIST KF7-385.2[18] KF7-410.12[2] R301.1.Torque_realization_1_0_3 /end FUNCTION_LIST
/end MEASUREMENT
/begin MEASUREMENT vTDRATPIH "After the hysteresis treatment, target Pi rate" UBYTE COMP_0032 1 100 0 0.99609375 ECU_ADDRESS 0xFFFF183A /begin FUNCTION_LIST KF7-410.12[2] /end FUNCTION_LIST /end MEASUREMENT
/begin MEASUREMENT vTDRCOMPI "Common FAST torque going down Pi rate" UBYTE COMP_0063 1 100 0 0.99609375 ECU_ADDRESS 0xFFFF183B /begin FUNCTION_LIST KF7-385.2[18] R301.1.Torque_realization_1_0_3 /end FUNCTION_LIST /end MEASUREMENT
/begin MEASUREMENT vTDRDYN "T/M requirement excessive torque going down rate" UWORD COMP_0290 1 100 0 0.999985458 ECU_ADDRESS 0xFFFF183C /begin FUNCTION_LIST KF7-385.2[18] /end FUNCTION_LIST /end MEASUREMENT
/begin MEASUREMENT vTDRFIN "A final torque going down rate" UWORD COMP_0290 1 100 0 0.999985458 ECU_ADDRESS 0xFFFF183E /begin FUNCTION_LIST KF7-385.2[18] /end FUNCTION_LIST /end MEASUREMENT
/begin MEASUREMENT vTDRFINPI "DUETTE torque going down Pi rate" UBYTE COMP_0063 1 100 0 0.99609375 ECU_ADDRESS 0xFFFF1840 /begin FUNCTION_LIST KF7-385.2[18] /end FUNCTION_LIST /end MEASUREMENT
/begin MEASUREMENT vTDRONC "Target torque going down rate equivalent Pi per cent rate" UBYTE COMP_0032 1 100 0 0.99609375 ECU_ADDRESS 0xFFFF1841 /begin FUNCTION_LIST KF7-385.2[18] /end FUNCTION_LIST /end MEASUREMENT
/begin MEASUREMENT vTDRTACAN "Target torque going down rate" UBYTE COMP_0063 1 100 0 0.99609375 ECU_ADDRESS 0xFFFF497A /begin FUNCTION_LIST KF7-385.2[18] /end FUNCTION_LIST /end MEASUREMENT
/begin MEASUREMENT vTDRTARG "Target torque going down rate" UBYTE COMP_0063 1 100 0 0.99609375 ECU_ADDRESS 0xFFFF32D9 /begin FUNCTION_LIST KF7-385.2[18] /end FUNCTION_LIST /end MEASUREMENT
/begin MEASUREMENT vTDRYTIME "The early days Duty maintenance time" UBYTE COMP_0013 1 100 0 255 ECU_ADDRESS 0xFFFF3F45 /begin FUNCTION_LIST KF7-378.3B[5] /end FUNCTION_LIST /end MEASUREMENT
/begin MEASUREMENT vTEFRIC "Brake torque equivalent friction" UWORD COMP_0196 1 100 0 6553.5 ECU_ADDRESS 0xFFFF240A
 /begin FUNCTION_LIST KF7-385.2[18] KF7-386.1[4] KF7-386.2[4] KF7-410.10[6] KF7-410.11M[4] R000.1.RS_Integ_1_10_2 R301.1.Torque_realization_1_0_3 /end FUNCTION_LIST
/end MEASUREMENT
/begin MEASUREMENT vTEFRIC0 "The all throttles full-close equivalent friction" UWORD COMP_0196 1 100 0 6553.5 ECU_ADDRESS 0xFFFF1890 /begin FUNCTION_LIST KF7-386.1[4] /end FUNCTION_LIST /end MEASUREMENT
/begin MEASUREMENT vTEFRICS "At the time of the torque going down control start, torque going down friction" UWORD COMP_0196 1 100 0 6553.5 ECU_ADDRESS 0xFFFF1892 /begin FUNCTION_LIST KF7-385.2[18] /end FUNCTION_LIST /end MEASUREMENT
/begin MEASUREMENT vTENG10 "Engine torque basic value" SWORD COMP_0228 1 100 -3276.8 3276.7 ECU_ADDRESS 0xFFFF1898 /begin FUNCTION_LIST KF7-386.1[4] /end FUNCTION_LIST /end MEASUREMENT
/begin MEASUREMENT vTENG11 "Engine torque (after air-fuel ratio compensation)" SWORD COMP_0228 1 100 -3276.8 3276.7 ECU_ADDRESS 0xFFFF189A /begin FUNCTION_LIST KF7-386.1[4] KF7-386.2[4] /end FUNCTION_LIST /end MEASUREMENT
/begin MEASUREMENT vTENG12 "Pi torque (after ignition compensation)" SWORD COMP_0228 1 100 -3276.8 3276.7 ECU_ADDRESS 0xFFFF189C /begin FUNCTION_LIST KF7-386.1[4] /end FUNCTION_LIST /end MEASUREMENT
/begin MEASUREMENT vTENG13 "Engine torque (After a fuel cut is compensated.)" SWORD COMP_0228 1 100 -3276.8 3276.7 ECU_ADDRESS 0xFFFF189E /begin FUNCTION_LIST KF7-386.1[4] /end FUNCTION_LIST /end MEASUREMENT
/begin MEASUREMENT vTENG22 "An engine torque (after ignition timing compensation) without DUETTE compensation" SWORD COMP_0228 1 100 -3276.8 3276.7 ECU_ADDRESS 0xFFFF18A2 /begin FUNCTION_LIST KF7-385.2[18] KF7-386.2[4] R301.1.Torque_realization_1_0_3 /end FUNCTION_LIST /end MEASUREMENT
/begin MEASUREMENT vTENG23 "An engine torque (After a fuel cut is compensated.) without DUETTE compensation" SWORD COMP_0228 1 100 -3276.8 3276.7 ECU_ADDRESS 0xFFFF18A4 /begin FUNCTION_LIST KF7-386.2[4] /end FUNCTION_LIST /end MEASUREMENT
/begin MEASUREMENT vTENG24 "An engine torque (After delay is compensated.) without DUETTE compensation" SWORD COMP_0228 1 100 -3276.8 3276.7 ECU_ADDRESS 0xFFFF18A6 /begin FUNCTION_LIST KF7-385.2[18] KF7-386.2[4] /end FUNCTION_LIST /end MEASUREMENT
/begin MEASUREMENT vTENG24S "At the time of the torque going down control start, engine torque" SWORD COMP_0228 1 100 -3276.8 3276.7 ECU_ADDRESS 0xFFFF18A8 /begin FUNCTION_LIST KF7-385.2[18] /end FUNCTION_LIST /end MEASUREMENT
/begin MEASUREMENT vTEPUMP "Brake torque equivalent pumping loss" UWORD COMP_0196 1 100 0 6553.5 ECU_ADDRESS 0xFFFF18AA /begin FUNCTION_LIST KF7-386.1[4] /end FUNCTION_LIST /end MEASUREMENT
/begin MEASUREMENT vTFANTRQ "Radiator fan load torque" UWORD COMP_0196 1 100 0 6553.5 ECU_ADDRESS 0xFFFF18AC /begin FUNCTION_LIST KF7-386.3[8] /end FUNCTION_LIST /end MEASUREMENT
/begin MEASUREMENT vTHOKI "Engine accessory load torque" UWORD COMP_0196 1 100 0 6553.5 ECU_ADDRESS 0xFFFF2410
 /begin FUNCTION_LIST KF7-385.2[18] KF7-386.1[4] KF7-386.2[4] KF7-386.3[8] KF7-410.10[6] KF7-410.11M[4] R000.1.RS_Integ_1_10_2 R301.1.Torque_realization_1_0_3 /end FUNCTION_LIST
/end MEASUREMENT
/begin MEASUREMENT vTMBUTW "At the time of the backup, coolant temperature rise timer" UBYTE COMP_0511 1 100 0 1530 ECU_ADDRESS 0xFFFF1F22 /begin FUNCTION_LIST KF7-450.8[2] /end FUNCTION_LIST /end MEASUREMENT
/begin MEASUREMENT vTMTXOF "Fuel cut suspension time timer" UWORD COMP_0014 1 100 0 655350 ECU_ADDRESS 0xFFFF337C /begin FUNCTION_LIST KF7-410.12[2] /end FUNCTION_LIST /end MEASUREMENT
/begin MEASUREMENT vTMTXON "Fuel cut operation time timer" UBYTE COMP_0014 1 100 0 2550 ECU_ADDRESS 0xFFFF337E /begin FUNCTION_LIST KF7-410.12[2] /end FUNCTION_LIST /end MEASUREMENT
/begin MEASUREMENT vTOFMIN "Extreme short rest time" UBYTE COMP_0014 1 100 0 2550 ECU_ADDRESS 0xFFFF337F /begin FUNCTION_LIST KF7-410.12[2] /end FUNCTION_LIST /end MEASUREMENT
/begin MEASUREMENT vTPSTRQ "P/S load torque" UWORD COMP_0196 1 100 0 6553.5 ECU_ADDRESS 0xFFFF198E /begin FUNCTION_LIST KF7-386.3[8] /end FUNCTION_LIST /end MEASUREMENT
/begin MEASUREMENT vTQ12ARBT "ARBIT A former torque to deal with" UWORD COMP_0637_S 1 100 -400 32367.5 ECU_ADDRESS 0xFFFF3F7A /begin FUNCTION_LIST KF7-410.10[6] /end FUNCTION_LIST /end MEASUREMENT
/begin MEASUREMENT vTQ12ENG "Engine torque estimated value" UWORD COMP_0637_S 1 100 -400 32367.5 ECU_ADDRESS 0xFFFF3F80
 /begin FUNCTION_LIST KF7-410.10[6] R204.1.CanComm_1_9_2 R901.1.Diag_on_can_app_1_6_2 /end FUNCTION_LIST
/end MEASUREMENT
/begin MEASUREMENT vTQ12ENG2 "Engine torque estimated value without DUETTE compensation" UWORD COMP_0637_S 1 100 -400 32367.5 ECU_ADDRESS 0xFFFF3F82 /begin FUNCTION_LIST KF7-410.10[6] /end FUNCTION_LIST /end MEASUREMENT
/begin MEASUREMENT vTQ12ETS "ETS requirement SLOW torque" UWORD COMP_0636_S 1 100 -400 32367.5 ECU_ADDRESS 0xFFFF3F84 /begin FUNCTION_LIST KF7-410.21[3] /end FUNCTION_LIST /end MEASUREMENT
/begin MEASUREMENT vTQ12FRIC "Brake torque equivalent friction" UWORD COMP_0637_S 1 100 -400 32367.5 ECU_ADDRESS 0xFFFF3F86 /begin FUNCTION_LIST KF7-410.10[6] R204.1.CanComm_1_9_2 /end FUNCTION_LIST /end MEASUREMENT
/begin MEASUREMENT vTQ12WOGB "AGB A former torque to require" UWORD COMP_0637_S 1 100 -400 32367.5 ECU_ADDRESS 0xFFFF3F8A /begin FUNCTION_LIST KF7-410.10[6] /end FUNCTION_LIST /end MEASUREMENT
/begin MEASUREMENT vTQ8ARBT "ARBIT A former torque (8bit) to deal with" UBYTE COMP_0638_S 1 100 -100 410 ECU_ADDRESS 0xFFFF3F8E /begin FUNCTION_LIST KF7-410.10[6] /end FUNCTION_LIST /end MEASUREMENT
/begin MEASUREMENT vTQ8ENG "Engine torque estimated value (8bit)" UBYTE COMP_0638_S 1 100 -100 410 ECU_ADDRESS 0xFFFF3F8F /begin FUNCTION_LIST KF7-410.10[6] /end FUNCTION_LIST /end MEASUREMENT
/begin MEASUREMENT vTQ8FRIC "Brake torque equivalent friction (8bit)" UBYTE COMP_0638_S 1 100 -100 410 ECU_ADDRESS 0xFFFF3F90 /begin FUNCTION_LIST KF7-410.10[6] /end FUNCTION_LIST /end MEASUREMENT
/begin MEASUREMENT vTQ8MAXAV "The torque maximum value (8bit) that engine output is possible" UBYTE COMP_0638_S 1 100 -100 410 ECU_ADDRESS 0xFFFF3F91 /begin FUNCTION_LIST KF7-410.10[6] /end FUNCTION_LIST /end MEASUREMENT
/begin MEASUREMENT vTQ8MINAV "The torque minimum value (8bit) that engine output is possible" UBYTE COMP_0638_S 1 100 -100 410 ECU_ADDRESS 0xFFFF3F92 /begin FUNCTION_LIST KF7-410.10[6] /end FUNCTION_LIST /end MEASUREMENT
/begin MEASUREMENT vTQ8WOGB "AGB A former torque (8bit) to require" UBYTE COMP_0638_S 1 100 -100 410 ECU_ADDRESS 0xFFFF3F93 /begin FUNCTION_LIST KF7-410.10[6] /end FUNCTION_LIST /end MEASUREMENT
/begin MEASUREMENT vTQENGLOS "Total friction torque" SWORD COMP_0228 1 100 -3276.8 3276.7 ECU_ADDRESS 0xFFFF33B0
 /begin FUNCTION_LIST KF7-410.11M[4] KF7-410.11P[4] R000.1.RS_Integ_1_10_2 R301.20.AmbientComp_1_0_2 /end FUNCTION_LIST
/end MEASUREMENT
/begin MEASUREMENT vTQH0CKLT "A basic volume flow-quantity ratio" UWORD COMP_0146 1 100 0 99.998480265 ECU_ADDRESS 0xFFFF19A2 /begin FUNCTION_LIST KF7-385.3[4] /end FUNCTION_LIST /end MEASUREMENT
/begin MEASUREMENT vTQH0IF "After the inverse filter, torque QH0 conversion value" UWORD COMP_0146 1 100 0 99.998480265 ECU_ADDRESS 0xFFFF19A4 /begin FUNCTION_LIST KF7-385.3[4] /end FUNCTION_LIST /end MEASUREMENT
/begin MEASUREMENT vTQRETAT "The amount of high response torque ignition timing compensation except for the amount of DUETTE retard" SBYTE COMP_0018 1 100 -128 127 ECU_ADDRESS 0xFFFF8A55 /begin FUNCTION_LIST KF7-386.2[4] /end FUNCTION_LIST /end MEASUREMENT
/begin MEASUREMENT vTQWOAGB "AGB A former torque to require" SWORD COMP_0228 1 100 -3276.8 3276.7 ECU_ADDRESS 0xFFFF4252 /begin FUNCTION_LIST KF7-410.10[6] /end FUNCTION_LIST /end MEASUREMENT
/begin MEASUREMENT vTQWOARBT "ARBIT A former torque to deal with" SWORD COMP_0228 1 100 -3276.8 3276.7 ECU_ADDRESS 0xFFFF4254 /begin FUNCTION_LIST KF7-410.10[6] /end FUNCTION_LIST /end MEASUREMENT
/begin MEASUREMENT vTREFCP "TREF periodic ratio" UBYTE COMP_0045 1 100 0 1.9921875 ECU_ADDRESS 0xFFFF2264 /begin FUNCTION_LIST KF7-450.9A[5] /end FUNCTION_LIST /end MEASUREMENT
/begin MEASUREMENT vTRQREF "Torque going down reference torque" SWORD COMP_0228 1 100 -3276.8 3276.7 ECU_ADDRESS 0xFFFF33F0 /begin FUNCTION_LIST KF7-385.2[18] R301.1.Torque_realization_1_0_3 /end FUNCTION_LIST /end MEASUREMENT
/begin MEASUREMENT vTRQREF0 "After the first-ordered filter treatment for the common FAST torque going down, target torque" SWORD COMP_0228 1 100 -3276.8 3276.7 ECU_ADDRESS 0xFFFF19C6 /begin FUNCTION_LIST KF7-385.2[18] /end FUNCTION_LIST /end MEASUREMENT
/begin MEASUREMENT vTRQREF1 "After a waste time treatment for the common FAST torque going down, target torque" SWORD COMP_0228 1 100 -3276.8 3276.7 ECU_ADDRESS 0xFFFF2440 /begin FUNCTION_LIST KF7-385.2[18] /end FUNCTION_LIST /end MEASUREMENT
/begin MEASUREMENT vTTEPFAST "The final PTD requirement FAST torque" SWORD COMP_0228 1 100 -3276.8 3276.7 ECU_ADDRESS 0xFFFF19F2
 /begin FUNCTION_LIST KF7-385.2[18] R000.1.RS_Integ_1_10_2 R301.1.Torque_realization_1_0_3 /end FUNCTION_LIST
/end MEASUREMENT
/begin MEASUREMENT vTWNFAN "Coolant temperature status" UBYTE COMP_0068 1 100 0 255 ECU_ADDRESS 0xFFFF1A43 /begin FUNCTION_LIST KF7-377.1A[19] /end FUNCTION_LIST /end MEASUREMENT
/begin MEASUREMENT vTXFCAD "At the time of the TCS operation, the amount of retard" UWORD COMP_0081 1 100 0 255.99609375 ECU_ADDRESS 0xFFFF343A /begin FUNCTION_LIST KF7-386.2[4] KF7-410.12[2] /end FUNCTION_LIST /end MEASUREMENT
/begin MEASUREMENT vTXNEL3 "TCS prohibition engine speed" UBYTE COMP_0006 1 100 0 3187.5 ECU_ADDRESS 0xFFFF343C /begin FUNCTION_LIST KF7-410.12[2] /end FUNCTION_LIST /end MEASUREMENT
/begin MEASUREMENT vTXRATE "Suspension time/operation time ratio" UBYTE COMP_0388 1 100 0 25.5 ECU_ADDRESS 0xFFFF343D /begin FUNCTION_LIST KF7-410.12[2] /end FUNCTION_LIST /end MEASUREMENT
/begin MEASUREMENT vUSR "AFM output voltage raw-value" UWORD COMP_0023 1 100 0 327675 ECU_ADDRESS 0xFFFF1A5E /begin FUNCTION_LIST KF7-400.1[1] KF7-400.5[3] /end FUNCTION_LIST /end MEASUREMENT
/begin MEASUREMENT vUSSM "AFM output voltage value in total" UWORD COMP_0023 1 100 0 327675 ECU_ADDRESS 0xFFFF3442 /begin FUNCTION_LIST KF7-400.1[1] /end FUNCTION_LIST /end MEASUREMENT
/begin MEASUREMENT vVBR "Battery voltage raw-value (8bit)" UBYTE COMP_0033 1 100 0 20400 ECU_ADDRESS 0xFFFF1F5B /begin FUNCTION_LIST KF7-400.5[3] /end FUNCTION_LIST /end MEASUREMENT
/begin MEASUREMENT vVFPCM "FPCM D/R voltage" UBYTE COMP_0118 1 100 0 10200 ECU_ADDRESS 0xFFFF3FB9 /begin FUNCTION_LIST KF7-400.5[3] /end FUNCTION_LIST /end MEASUREMENT
/begin MEASUREMENT vVFPCMR "The FPCM voltage VCC adjustment-less-ization front" UBYTE COMP_0118 1 100 0 10200 ECU_ADDRESS 0xFFFF3FBA /begin FUNCTION_LIST KF7-400.5[3] /end FUNCTION_LIST /end MEASUREMENT
/begin MEASUREMENT vVMOTR "The motor power supply voltage VCC adjustment-less-ization front" UBYTE COMP_0033 1 100 0 20400 ECU_ADDRESS 0xFFFF3FDE /begin FUNCTION_LIST KF7-400.5[3] /end FUNCTION_LIST /end MEASUREMENT
/begin MEASUREMENT vVO2 "O2 sensor voltage" UBYTE COMP_0104 1 100 0 2550 ECU_ADDRESS 0xFFFF8A5C
 /begin FUNCTION_LIST KF7-400.5[3] KF7-500.1[54] KF7-500.21[19] KF7-500.39[5] KF7-505.26[2] KF7-580.1[8] R301.4.AfFeedback_1_0_1 R901.1.Diag_on_can_app_1_6_2 R904.1.Gst_on_can_1_0_1 /end FUNCTION_LIST
/end MEASUREMENT
/begin MEASUREMENT vVO2_R#1 "O2 sensor voltage" UBYTE COMP_0104 1 100 0 2550 ECU_ADDRESS 0xFFFF8A5C
 /begin FUNCTION_LIST KF7-400.5[3] KF7-500.1[54] KF7-500.21[19] KF7-500.39[5] KF7-505.26[2] KF7-580.1[8] R301.4.AfFeedback_1_0_1 R901.1.Diag_on_can_app_1_6_2 R904.1.Gst_on_can_1_0_1 /end FUNCTION_LIST
/end MEASUREMENT
/begin MEASUREMENT vVO2_R#2 "O2 sensor voltage" UBYTE COMP_0104 1 100 0 2550 ECU_ADDRESS 0xFFFF8A5D
 /begin FUNCTION_LIST KF7-400.5[3] KF7-500.1[54] KF7-500.21[19] KF7-500.39[5] KF7-505.26[2] KF7-580.1[8] R301.4.AfFeedback_1_0_1 R901.1.Diag_on_can_app_1_6_2 R904.1.Gst_on_can_1_0_1 /end FUNCTION_LIST
/end MEASUREMENT
/begin MEASUREMENT vVS "After compensation, battery voltage" UWORD COMP_0054 1 100 0 1310700 ECU_ADDRESS 0xFFFF1A9A /begin FUNCTION_LIST KF7-400.1[1] KF7-400.3[N] KF7-500.16[4] /end FUNCTION_LIST /end MEASUREMENT
/begin MEASUREMENT vVSR "Battery voltage raw-value" UWORD COMP_0054 1 100 0 1310700 ECU_ADDRESS 0xFFFF1AA2 /begin FUNCTION_LIST KF7-400.1[1] /end FUNCTION_LIST /end MEASUREMENT
/begin MEASUREMENT vVSSM "Battery voltage value in total" UWORD COMP_0054 1 100 0 1310700 ECU_ADDRESS 0xFFFF34A0 /begin FUNCTION_LIST KF7-400.1[1] /end FUNCTION_LIST /end MEASUREMENT
/begin MEASUREMENT vVTBASE "VTC solenoid neutral position DUTY ratio" UBYTE COMP_0021 1 100 0 99.609375 ECU_ADDRESS 0xFFFF1AA4 /begin FUNCTION_LIST KF7-393.1C[8] /end FUNCTION_LIST /end MEASUREMENT
/begin MEASUREMENT vVTBASEL "The left bank VTC solenoid neutral position DUTY ratio" UBYTE COMP_0021 1 100 0 99.609375 ECU_ADDRESS 0xFFFF1AA5 /begin FUNCTION_LIST KF7-393.1C[8] /end FUNCTION_LIST /end MEASUREMENT
/begin MEASUREMENT vVTCB "The amount of dizzer control" UBYTE COMP_0256 1 100 -64 63.5 ECU_ADDRESS 0xFFFF1AA7 /begin FUNCTION_LIST KF7-393.1C[8] /end FUNCTION_LIST /end MEASUREMENT
/begin MEASUREMENT vVTCB3 "The amount of dizzer control" UBYTE COMP_0256 1 100 -64 63.5 ECU_ADDRESS 0xFFFF1AAA /begin FUNCTION_LIST KF7-393.1C[8] /end FUNCTION_LIST /end MEASUREMENT
/begin MEASUREMENT vVTCB3_R#1 "The amount of dizzer control" UBYTE COMP_0256 1 100 -64 63.5 ECU_ADDRESS 0xFFFF1AAA /begin FUNCTION_LIST KF7-393.1C[8] /end FUNCTION_LIST /end MEASUREMENT
/begin MEASUREMENT vVTCB3_R#2 "The amount of dizzer control" UBYTE COMP_0256 1 100 -64 63.5 ECU_ADDRESS 0xFFFF1AAB /begin FUNCTION_LIST KF7-393.1C[8] /end FUNCTION_LIST /end MEASUREMENT
/begin MEASUREMENT vVTCD "The amount of D control" UBYTE COMP_0256 1 100 -64 63.5 ECU_ADDRESS 0xFFFF1AB0 /begin FUNCTION_LIST KF7-393.1C[8] /end FUNCTION_LIST /end MEASUREMENT
/begin MEASUREMENT vVTCD3 "The amount of D control" UBYTE COMP_0256 1 100 -64 63.5 ECU_ADDRESS 0xFFFF1AB3 /begin FUNCTION_LIST KF7-393.1C[8] /end FUNCTION_LIST /end MEASUREMENT
/begin MEASUREMENT vVTCD3_R#1 "The amount of D control" UBYTE COMP_0256 1 100 -64 63.5 ECU_ADDRESS 0xFFFF1AB3 /begin FUNCTION_LIST KF7-393.1C[8] /end FUNCTION_LIST /end MEASUREMENT
/begin MEASUREMENT vVTCD3_R#2 "The amount of D control" UBYTE COMP_0256 1 100 -64 63.5 ECU_ADDRESS 0xFFFF1AB4 /begin FUNCTION_LIST KF7-393.1C[8] /end FUNCTION_LIST /end MEASUREMENT
/begin MEASUREMENT vVTCDTY "VTC solenoid drive DUTY ratio (the front which compensates a battery voltage)" ULONG COMP_0525 1 100 0 25600.0237128287 ECU_ADDRESS 0xFFFF1AE0 /begin FUNCTION_LIST KF7-393.1C[8] /end FUNCTION_LIST /end MEASUREMENT
/begin MEASUREMENT vVTCDTY_R#1 "VTC solenoid drive DUTY ratio (the front which compensates a battery voltage)" ULONG COMP_0525 1 100 0 25600.0237128287 ECU_ADDRESS 0xFFFF1AE0 /begin FUNCTION_LIST KF7-393.1C[8] /end FUNCTION_LIST /end MEASUREMENT
/begin MEASUREMENT vVTCDTY_R#2 "VTC solenoid drive DUTY ratio (the front which compensates a battery voltage)" ULONG COMP_0525 1 100 0 25600.0237128287 ECU_ADDRESS 0xFFFF1AE4 /begin FUNCTION_LIST KF7-393.1C[8] /end FUNCTION_LIST /end MEASUREMENT
/begin MEASUREMENT vVTCDUTY "VTC solenoid drive DUTY ratio" UBYTE COMP_0021 1 100 0 99.609375 ECU_ADDRESS 0xFFFF244E
 /begin FUNCTION_LIST KF7-393.1C[8] KF7-450.50[10] KF7-500.47B[15] KF7-580.1[8] R901.1.Diag_on_can_app_1_6_2 /end FUNCTION_LIST
/end MEASUREMENT
/begin MEASUREMENT vVTCDUTY_R#1 "VTC solenoid drive DUTY ratio" UBYTE COMP_0021 1 100 0 99.609375 ECU_ADDRESS 0xFFFF244E
 /begin FUNCTION_LIST KF7-393.1C[8] KF7-450.50[10] KF7-500.47B[15] KF7-580.1[8] R901.1.Diag_on_can_app_1_6_2 /end FUNCTION_LIST
/end MEASUREMENT
/begin MEASUREMENT vVTCDUTY_R#2 "VTC solenoid drive DUTY ratio" UBYTE COMP_0021 1 100 0 99.609375 ECU_ADDRESS 0xFFFF244F
 /begin FUNCTION_LIST KF7-393.1C[8] KF7-450.50[10] KF7-500.47B[15] KF7-580.1[8] R901.1.Diag_on_can_app_1_6_2 /end FUNCTION_LIST
/end MEASUREMENT
/begin MEASUREMENT vVTCI "The amount of I-gain control" ULONG COMP_0526 1 100 -63.99996198912 32703.9805688109 ECU_ADDRESS 0xFFFF1B08 /begin FUNCTION_LIST KF7-393.1C[8] /end FUNCTION_LIST /end MEASUREMENT
/begin MEASUREMENT vVTCI3 "The amount of I-gain control" ULONG COMP_0526 1 100 -63.99996198912 32703.9805688109 ECU_ADDRESS 0xFFFF1B14 /begin FUNCTION_LIST KF7-393.1C[8] /end FUNCTION_LIST /end MEASUREMENT
/begin MEASUREMENT vVTCI3_R#1 "The amount of I-gain control" ULONG COMP_0526 1 100 -63.99996198912 32703.9805688109 ECU_ADDRESS 0xFFFF1B14 /begin FUNCTION_LIST KF7-393.1C[8] /end FUNCTION_LIST /end MEASUREMENT
/begin MEASUREMENT vVTCI3_R#2 "The amount of I-gain control" ULONG COMP_0526 1 100 -63.99996198912 32703.9805688109 ECU_ADDRESS 0xFFFF1B18 /begin FUNCTION_LIST KF7-393.1C[8] /end FUNCTION_LIST /end MEASUREMENT
/begin MEASUREMENT vVTCP "The amount of P-gain control" UWORD COMP_0653_S 1 100 -64.00016384 63.99821071 ECU_ADDRESS 0xFFFF1B72 /begin FUNCTION_LIST KF7-393.1C[8] /end FUNCTION_LIST /end MEASUREMENT
/begin MEASUREMENT vVTCP3 "The amount of P-gain control" UWORD COMP_0653_S 1 100 -64.00016384 63.99821071 ECU_ADDRESS 0xFFFF1B78 /begin FUNCTION_LIST KF7-393.1C[8] /end FUNCTION_LIST /end MEASUREMENT
/begin MEASUREMENT vVTCP3_R#1 "The amount of P-gain control" UWORD COMP_0653_S 1 100 -64.00016384 63.99821071 ECU_ADDRESS 0xFFFF1B78 /begin FUNCTION_LIST KF7-393.1C[8] /end FUNCTION_LIST /end MEASUREMENT
/begin MEASUREMENT vVTCP3_R#2 "The amount of P-gain control" UWORD COMP_0653_S 1 100 -64.00016384 63.99821071 ECU_ADDRESS 0xFFFF1B7A /begin FUNCTION_LIST KF7-393.1C[8] /end FUNCTION_LIST /end MEASUREMENT
/begin MEASUREMENT vVTCPID "PID control quantity (angle)" ULONG COMP_0530 1 100 -64.0000458752 32704.0234345978 ECU_ADDRESS 0xFFFF1B84 /begin FUNCTION_LIST KF7-393.1C[8] /end FUNCTION_LIST /end MEASUREMENT
/begin MEASUREMENT vVTCPID3 "PID control quantity (angle)" ULONG COMP_0530 1 100 -64.0000458752 32704.0234345978 ECU_ADDRESS 0xFFFF1B90 /begin FUNCTION_LIST KF7-393.1C[8] /end FUNCTION_LIST /end MEASUREMENT
/begin MEASUREMENT vVTCPID3_R#1 "PID control quantity (angle)" ULONG COMP_0530 1 100 -64.0000458752 32704.0234345978 ECU_ADDRESS 0xFFFF1B90 /begin FUNCTION_LIST KF7-393.1C[8] /end FUNCTION_LIST /end MEASUREMENT
/begin MEASUREMENT vVTCPID3_R#2 "PID control quantity (angle)" ULONG COMP_0530 1 100 -64.0000458752 32704.0234345978 ECU_ADDRESS 0xFFFF1B94 /begin FUNCTION_LIST KF7-393.1C[8] /end FUNCTION_LIST /end MEASUREMENT
/begin MEASUREMENT vVTCSTCT "C-VTC initial tense permission judgement counter" UBYTE COMP_0030 1 100 0 255 ECU_ADDRESS 0xFFFF2296 /begin FUNCTION_LIST KF7-393.1C[8] /end FUNCTION_LIST /end MEASUREMENT
/begin MEASUREMENT vVTVO "Target torque equivalent throttle open-degree for CK" UBYTE COMP_0531 1 100 0 100.000035 ECU_ADDRESS 0xFFFF1C0C /begin FUNCTION_LIST KF7-385.3[4] /end FUNCTION_LIST /end MEASUREMENT
/begin MEASUREMENT vVVTVO "Target torque equivalent throttle open-degree" UWORD COMP_0130 1 100 0 1802.2125 ECU_ADDRESS 0xFFFF1C0E /begin FUNCTION_LIST KF7-385.3[4] /end FUNCTION_LIST /end MEASUREMENT
/begin MEASUREMENT wvAFSHDTY "A/F sensor heater duty" UWORD COMP_0419 1 100 0 6553.5 ECU_ADDRESS 0xFFFF47AE /begin FUNCTION_LIST KF7-378.3B[5] KF7-500.59[6] KF7-580.1[8] /end FUNCTION_LIST /end MEASUREMENT
/begin MEASUREMENT wvAFSHDTY_R#1 "A/F sensor heater duty" UWORD COMP_0419 1 100 0 6553.5 ECU_ADDRESS 0xFFFF47AE /begin FUNCTION_LIST KF7-378.3B[5] KF7-500.59[6] KF7-580.1[8] /end FUNCTION_LIST /end MEASUREMENT
/begin MEASUREMENT wvAFSHDTY_R#2 "A/F sensor heater duty" UWORD COMP_0419 1 100 0 6553.5 ECU_ADDRESS 0xFFFF47B0 /begin FUNCTION_LIST KF7-378.3B[5] KF7-500.59[6] KF7-580.1[8] /end FUNCTION_LIST /end MEASUREMENT
/begin MEASUREMENT wvATAPO "Accelerator open-degree signal" UBYTE COMP_0378 1 100 0 100.000000065 ECU_ADDRESS 0xFFFF47E2 /begin FUNCTION_LIST KF7-385.1[32] /end FUNCTION_LIST /end MEASUREMENT
/begin MEASUREMENT wvPTDPWTSP "Driver powertrain setpoint (PTD)" UWORD COMP_0362_S 1 100 0 8191.875 ECU_ADDRESS 0xFFFF4856 /begin FUNCTION_LIST KF7-410.19[2] /end FUNCTION_LIST /end MEASUREMENT
/begin MEASUREMENT wvTDRTACAN "Target torque going down rate" UBYTE COMP_0063 1 100 0 0.99609375 ECU_ADDRESS 0xFFFF4878 /begin FUNCTION_LIST KF7-385.2[18] /end FUNCTION_LIST /end MEASUREMENT
/begin MEASUREMENT wvTQRETAT "The amount of high response torque ignition timing compensation except for the amount of DUETTE retard" SBYTE COMP_0018 1 100 -128 127 ECU_ADDRESS 0xFFFF8A1D /begin FUNCTION_LIST KF7-386.2[4] /end FUNCTION_LIST /end MEASUREMENT
/begin MEASUREMENT wvVO2 "O2 sensor voltage" UBYTE COMP_0104 1 100 0 2550 ECU_ADDRESS 0xFFFF8A24
 /begin FUNCTION_LIST KF7-400.5[3] KF7-500.1[54] KF7-500.21[19] KF7-500.39[5] KF7-505.26[2] KF7-580.1[8] /end FUNCTION_LIST
/end MEASUREMENT
/begin MEASUREMENT wvVO2_R#1 "O2 sensor voltage" UBYTE COMP_0104 1 100 0 2550 ECU_ADDRESS 0xFFFF8A24
 /begin FUNCTION_LIST KF7-400.5[3] KF7-500.1[54] KF7-500.21[19] KF7-500.39[5] KF7-505.26[2] KF7-580.1[8] /end FUNCTION_LIST
/end MEASUREMENT
/begin MEASUREMENT wvVO2_R#2 "O2 sensor voltage" UBYTE COMP_0104 1 100 0 2550 ECU_ADDRESS 0xFFFF8A25
 /begin FUNCTION_LIST KF7-400.5[3] KF7-500.1[54] KF7-500.21[19] KF7-500.39[5] KF7-505.26[2] KF7-580.1[8] /end FUNCTION_LIST
/end MEASUREMENT
/begin MEASUREMENT SYNCNG "RAM value SYNCNG" UBYTE COMP_0068 1 100 0 255 ECU_ADDRESS 0xFFFF9CC0
 /begin FUNCTION_LIST KF7-450.22[1] KF7-500.2A[29] KF7-505.43[3] KF7-525.2[6] KF7-525.2S[10] R000.3.RS_SelfDiagflags_1_1_2 /end FUNCTION_LIST
/end MEASUREMENT
/begin MEASUREMENT CALCNG "RAM value CALCNG" UBYTE COMP_0068 1 100 0 255 ECU_ADDRESS 0xFFFF9CC9
 /begin FUNCTION_LIST KF7-450.22[1] KF7-500.2A[29] KF7-505.42[2] KF7-525.2[6] KF7-525.2S[10] R000.3.RS_SelfDiagflags_1_1_2 /end FUNCTION_LIST
/end MEASUREMENT
/begin MEASUREMENT BURNG "RAM value BURNG" UBYTE COMP_0068 1 100 0 255 ECU_ADDRESS 0xFFFF9D0B
 /begin FUNCTION_LIST KF7-450.22[1] KF7-500.2A[29] KF7-505.24[1] KF7-525.2[6] KF7-525.2S[10] /end FUNCTION_LIST
/end MEASUREMENT
/begin MEASUREMENT SSOFNG "RAM value SSOFNG" UBYTE COMP_0068 1 100 0 255 ECU_ADDRESS 0xFFFF9D0E
 /begin FUNCTION_LIST KF7-450.22[1] KF7-500.2A[29] KF7-505.25[3] KF7-525.2[6] KF7-525.2S[10] R000.3.RS_SelfDiagflags_1_1_2 /end FUNCTION_LIST
/end MEASUREMENT
/begin MEASUREMENT WDTNGM "RAM value WDTNGM" UBYTE COMP_0068 1 100 0 255 ECU_ADDRESS 0xFFFF9D1A
 /begin FUNCTION_LIST KF7-450.22[1] KF7-500.2A[29] KF7-505.18[3] KF7-525.2[6] KF7-525.2S[10] R000.3.RS_SelfDiagflags_1_1_2 /end FUNCTION_LIST
/end MEASUREMENT
/begin MEASUREMENT vCALCNG "RAM value vCALCNG" UWORD COMP_0068 1 100 0 65535 ECU_ADDRESS 0xFFFF9CCA
 /begin FUNCTION_LIST KF7-450.22[1] KF7-500.2A[29] KF7-505.42[2] KF7-525.2[6] KF7-525.2S[10] /end FUNCTION_LIST
/end MEASUREMENT
/begin MEASUREMENT vBURNG "RAM value vBURNG" UWORD COMP_0068 1 100 0 65535 ECU_ADDRESS 0xFFFF9D0C
 /begin FUNCTION_LIST KF7-450.22[1] KF7-500.2A[29] KF7-505.24[1] KF7-525.2[6] KF7-525.2S[10] /end FUNCTION_LIST
/end MEASUREMENT
/* COMPU_METHOD --------------------------------------------------------- */
/begin COMPU_METHOD COMP_0017 "1deg" RAT_FUNC "%8.2" "deg" COEFFS 0 1 0 0 0 1 /end COMPU_METHOD
/begin COMPU_METHOD COMP_0205_S "fixed axis Long" RAT_FUNC "%8.2" "Long" COEFFS 0 1 0 0 0 1 /end COMPU_METHOD
/begin COMPU_METHOD COMP_0290 "1/65536-" RAT_FUNC "%8.6" "-" COEFFS 0 1 0 0 0 0.0000152588 /end COMPU_METHOD
/begin COMPU_METHOD COMP_0068 "1-" RAT_FUNC "%8.2" "-" COEFFS 0 1 0 0 0 1 /end COMPU_METHOD
/begin COMPU_METHOD COMP_0004 "1Å|" RAT_FUNC "%8.2" "Å|" COEFFS 0 1 0 0 0 1 /end COMPU_METHOD
/begin COMPU_METHOD COMP_0023 "5mV" RAT_FUNC "%8.2" "mV" COEFFS 0 1 0 0 0 5 /end COMPU_METHOD
/begin COMPU_METHOD COMP_0429 "1km/h" RAT_FUNC "%8.2" "km/h" COEFFS 0 1 0 0 0 1 /end COMPU_METHOD
/begin COMPU_METHOD COMP_0045 "1/128-" RAT_FUNC "%8.4" "-" COEFFS 0 1 0 0 0 0.0078125 /end COMPU_METHOD
/begin COMPU_METHOD COMP_0001 "1/8ms" RAT_FUNC "%8.2" "ms" COEFFS 0 1 0 0 0 0.125 /end COMPU_METHOD
/begin COMPU_METHOD COMP_0020 "50rpm" RAT_FUNC "%8.2" "rpm" COEFFS 0 1 0 0 0 50 /end COMPU_METHOD
/begin COMPU_METHOD COMP_0002 "0.35deg" RAT_FUNC "%8.2" "deg" COEFFS 0 1 0 0 0 0.35 /end COMPU_METHOD
/begin COMPU_METHOD COMP_0003 "1Åé" RAT_FUNC "%8.2" "Åé" COEFFS 0 1 0 0 0 1 /end COMPU_METHOD
/begin COMPU_METHOD COMP_0014 "10ms" RAT_FUNC "%8.2" "ms" COEFFS 0 1 0 0 0 10 /end COMPU_METHOD
/begin COMPU_METHOD COMP_0006 "12.5rpm" RAT_FUNC "%8.2" "rpm" COEFFS 0 1 0 0 0 12.5 /end COMPU_METHOD
/begin COMPU_METHOD COMP_0008 "100ms" RAT_FUNC "%8.2" "ms" COEFFS 0 1 0 0 0 100 /end COMPU_METHOD
/begin COMPU_METHOD COMP_0196 "0.1Nm" RAT_FUNC "%8.2" "Nm" COEFFS 0 1 0 0 0 0.1 /end COMPU_METHOD
/begin COMPU_METHOD COMP_0009 "100/128%" RAT_FUNC "%8.2" "%" COEFFS 0 1 0 0 0 0.78125 /end COMPU_METHOD
/begin COMPU_METHOD COMP_0013 "1s" RAT_FUNC "%8.2" "s" COEFFS 0 1 0 0 0 1 /end COMPU_METHOD
/begin COMPU_METHOD COMP_0000 "25rpm" RAT_FUNC "%8.2" "rpm" COEFFS 0 1 0 0 0 25 /end COMPU_METHOD
/begin COMPU_METHOD COMP_0047 "0.5%" RAT_FUNC "%8.2" "%" COEFFS 0 1 0 0 0 0.5 /end COMPU_METHOD
/begin COMPU_METHOD COMP_0486 "20/256mv" RAT_FUNC "%8.3" "mv" COEFFS 0 1 0 0 0 0.078125 /end COMPU_METHOD
/begin COMPU_METHOD COMP_0436 "0.1km/h" RAT_FUNC "%8.2" "km/h" COEFFS 0 1 0 0 0 0.1 /end COMPU_METHOD
/begin COMPU_METHOD COMP_0018 "1deg" RAT_FUNC "%8.2" "deg" COEFFS 0 1 0 0 0 1 /end COMPU_METHOD
/begin COMPU_METHOD COMP_0081 "1/256deg" RAT_FUNC "%8.4" "deg" COEFFS 0 1 0 0 0 0.00390625 /end COMPU_METHOD
/begin COMPU_METHOD COMP_0007 "2km/h" RAT_FUNC "%8.2" "km/h" COEFFS 0 1 0 0 0 2 /end COMPU_METHOD
/begin COMPU_METHOD COMP_0021 "100/256%" RAT_FUNC "%8.2" "%" COEFFS 0 1 0 0 0 0.390625 /end COMPU_METHOD
/begin COMPU_METHOD COMP_0033 "80mV" RAT_FUNC "%8.2" "mV" COEFFS 0 1 0 0 0 80 /end COMPU_METHOD
/begin COMPU_METHOD COMP_0027 "1%" RAT_FUNC "%8.2" "%" COEFFS 0 1 0 0 0 1 /end COMPU_METHOD
/begin COMPU_METHOD COMP_0049 "1sec" RAT_FUNC "%8.2" "sec" COEFFS 0 1 0 0 0 1 /end COMPU_METHOD
/begin COMPU_METHOD COMP_0032 "1/256Å|" RAT_FUNC "%8.4" "Å|" COEFFS 0 1 0 0 0 0.00390625 /end COMPU_METHOD
/begin COMPU_METHOD COMP_0063 "1/256-" RAT_FUNC "%8.4" "-" COEFFS 0 1 0 0 0 0.00390625 /end COMPU_METHOD
/begin COMPU_METHOD COMP_0130 "0.0275deg" RAT_FUNC "%8.3" "deg" COEFFS 0 1 0 0 0 0.0275 /end COMPU_METHOD
/begin COMPU_METHOD COMP_0030 "1âÒ" RAT_FUNC "%8.2" "âÒ" COEFFS 0 1 0 0 0 1 /end COMPU_METHOD
/begin COMPU_METHOD COMP_0443 "1rpm" RAT_FUNC "%8.2" "rpm" COEFFS 0 1 0 0 0 1 /end COMPU_METHOD
/begin COMPU_METHOD COMP_0005 "0.11deg" RAT_FUNC "%8.2" "deg" COEFFS 0 1 0 0 0 0.11 /end COMPU_METHOD
/begin COMPU_METHOD COMP_0362_S "0.125%" RAT_FUNC "%8.2" "%" COEFFS 0 1 0 0 0 0.125 /end COMPU_METHOD
/begin COMPU_METHOD COMP_0183 "20ms" RAT_FUNC "%8.2" "ms" COEFFS 0 1 0 0 0 20 /end COMPU_METHOD
/begin COMPU_METHOD COMP_0044 "1/128Å|" RAT_FUNC "%8.4" "Å|" COEFFS 0 1 0 0 0 0.0078125 /end COMPU_METHOD
/begin COMPU_METHOD COMP_0048 "64/128degCA" RAT_FUNC "%8.2" "degCA" COEFFS 0 1 0 0 0 0.5 /end COMPU_METHOD
/begin COMPU_METHOD COMP_0054 "20mV" RAT_FUNC "%8.2" "mV" COEFFS 0 1 0 0 0 20 /end COMPU_METHOD
/begin COMPU_METHOD COMP_0419 "0.1%" RAT_FUNC "%8.2" "%" COEFFS 0 1 0 0 0 0.1 /end COMPU_METHOD
/begin COMPU_METHOD COMP_0055 "4deg" RAT_FUNC "%8.2" "deg" COEFFS 0 1 0 0 0 4 /end COMPU_METHOD
/begin COMPU_METHOD COMP_0035 "X-50Åé" RAT_FUNC "%8.2" "Åé" COEFFS 0 1 50 0 0 1 /end COMPU_METHOD
/begin COMPU_METHOD COMP_0383_S "1/655361/10ms" RAT_FUNC "%8.6" "1/10ms" COEFFS 0 1 0 0 0 0.0000152588 /end COMPU_METHOD
/begin COMPU_METHOD COMP_0228 "0.1Nm" RAT_FUNC "%8.2" "Nm" COEFFS 0 1 0 0 0 0.1 /end COMPU_METHOD
/begin COMPU_METHOD COMP_0078 "1/256deg" RAT_FUNC "%8.4" "deg" COEFFS 0 1 0 0 0 0.00390625 /end COMPU_METHOD
/begin COMPU_METHOD COMP_0392_S "1rpm/50ms" RAT_FUNC "%8.2" "rpm/50ms" COEFFS 0 1 0 0 0 1 /end COMPU_METHOD
/begin COMPU_METHOD COMP_0051 "1L/min" RAT_FUNC "%8.2" "L/min" COEFFS 0 1 0 0 0 1 /end COMPU_METHOD
/begin COMPU_METHOD COMP_0101 "1/65536Å|" RAT_FUNC "%8.6" "Å|" COEFFS 0 1 0 0 0 0.0000152588 /end COMPU_METHOD
/begin COMPU_METHOD COMP_0425 "100/255%" RAT_FUNC "%8.2" "%" COEFFS 0 1 0 0 0 0.392156862 /end COMPU_METHOD
/begin COMPU_METHOD COMP_0400_S "62.5Nm.rpm" RAT_FUNC "%8.2" "Nm.rpm" COEFFS 0 1 0 0 0 62.5 /end COMPU_METHOD
/begin COMPU_METHOD COMP_0083 "1/256deg/10ms" RAT_FUNC "%8.4" "deg/10ms" COEFFS 0 1 0 0 0 0.00390625 /end COMPU_METHOD
/begin COMPU_METHOD COMP_0104 "10mV" RAT_FUNC "%8.2" "mV" COEFFS 0 1 0 0 0 10 /end COMPU_METHOD
/begin COMPU_METHOD COMP_0256 "64/128degCA" RAT_FUNC "%8.2" "degCA" COEFFS 0 1 64 0 0 0.5 /end COMPU_METHOD
/begin COMPU_METHOD COMP_0277 "1L/min" RAT_FUNC "%8.2" "L/min" COEFFS 0 1 0 0 0 1 /end COMPU_METHOD
/begin COMPU_METHOD COMP_0450 "1/1024-" RAT_FUNC "%8.5" "-" COEFFS 0 1 0 0 0 0.000976563 /end COMPU_METHOD
/begin COMPU_METHOD COMP_0082_S "L/min/rpmL/min/rp" RAT_FUNC "%8.4" "L/min/rp" COEFFS 0 1 0 0 0 0.005 /end COMPU_METHOD
/begin COMPU_METHOD COMP_0415_S "38368É∂" RAT_FUNC "%8.3" "É∂" COEFFS 0 1 0 0 0 0.0625 /end COMPU_METHOD
/begin COMPU_METHOD COMP_0416_S "0.5W" RAT_FUNC "%8.2" "W" COEFFS 0 1 0 0 0 0.5 /end COMPU_METHOD
/begin COMPU_METHOD COMP_0422_S "0.1/32%" RAT_FUNC "%8.4" "%" COEFFS 0 1 0 0 0 0.003125 /end COMPU_METHOD
/begin COMPU_METHOD COMP_0062 "4Åé" RAT_FUNC "%8.2" "Åé" COEFFS 0 1 0 0 0 4 /end COMPU_METHOD
/begin COMPU_METHOD COMP_0237_S "1/2561/10ms" RAT_FUNC "%8.4" "1/10ms" COEFFS 0 1 0 0 0 0.00390625 /end COMPU_METHOD
/begin COMPU_METHOD COMP_0329 "2/256%" RAT_FUNC "%8.4" "%" COEFFS 0 1 0 0 0 0.0078125 /end COMPU_METHOD
/begin COMPU_METHOD COMP_0435 "1/32-" RAT_FUNC "%8.3" "-" COEFFS 0 1 0 0 0 0.03125 /end COMPU_METHOD
/begin COMPU_METHOD COMP_0433_S "0.1%/100ms" RAT_FUNC "%8.2" "%/100ms" COEFFS 0 1 0 0 0 0.1 /end COMPU_METHOD
/begin COMPU_METHOD COMP_0225 "1/(128*256)Å|" RAT_FUNC "%8.6" "Å|" COEFFS 0 1 0 0 0 0.0000305 /end COMPU_METHOD
/begin COMPU_METHOD COMP_0146 "100/256/256%" RAT_FUNC "%8.4" "%" COEFFS 0 1 0 0 0 0.001525879 /end COMPU_METHOD
/begin COMPU_METHOD COMP_0133_S "%%" RAT_FUNC "%8.3" "%" COEFFS 0 1 0 0 0 0.0390625 /end COMPU_METHOD
/begin COMPU_METHOD COMP_0243_S "37259cyl" RAT_FUNC "%8.2" "cyl" COEFFS 0 1 0 0 0 0.333333 /end COMPU_METHOD
/begin COMPU_METHOD COMP_0012_S "TRIPTRIP" RAT_FUNC "%8.2" "TRIP" COEFFS 0 1 0 0 0 1 /end COMPU_METHOD
/begin COMPU_METHOD COMP_0395 "1/4096-" RAT_FUNC "%8.5" "-" COEFFS 0 1 0 0 0 0.000244141 /end COMPU_METHOD
/begin COMPU_METHOD COMP_0259 "1å¬" RAT_FUNC "%8.2" "å¬" COEFFS 0 1 0 0 0 1 /end COMPU_METHOD
/begin COMPU_METHOD COMP_0011 "0.02MPa" RAT_FUNC "%8.3" "MPa" COEFFS 0 1 0 0 0 0.02 /end COMPU_METHOD
/begin COMPU_METHOD COMP_0252_S "1/65536cm**2/L/" RAT_FUNC "%8.6" "cm**2/L/" COEFFS 0 1 0 0 0 0.0000152588 /end COMPU_METHOD
/begin COMPU_METHOD COMP_0065 "3.125rpm" RAT_FUNC "%8.2" "rpm" COEFFS 0 1 0 0 0 3.125 /end COMPU_METHOD
/begin COMPU_METHOD COMP_0132_S "%%" RAT_FUNC "%8.2" "%" COEFFS 0 1 0 0 0 10 /end COMPU_METHOD
/begin COMPU_METHOD COMP_0356 "0.625X-40Åé" RAT_FUNC "%8.2" "Åé" COEFFS 0 1 40 0 0 0.625 /end COMPU_METHOD
/begin COMPU_METHOD COMP_0157 "1ref" RAT_FUNC "%8.2" "ref" COEFFS 0 1 0 0 0 1 /end COMPU_METHOD
/begin COMPU_METHOD COMP_0459_S "10/256%/100ms" RAT_FUNC "%8.3" "%/100ms" COEFFS 0 1 0 0 0 0.0390625 /end COMPU_METHOD
/begin COMPU_METHOD COMP_0255_S "1/1024-" RAT_FUNC "%8.5" "-" COEFFS 0 1 0 0 0 0.000976562 /end COMPU_METHOD
/begin COMPU_METHOD COMP_0388 "0.1-" RAT_FUNC "%8.2" "-" COEFFS 0 1 0 0 0 0.1 /end COMPU_METHOD
/begin COMPU_METHOD COMP_0372 "0.0008cm2" RAT_FUNC "%8.5" "cm2" COEFFS 0 1 0 0 0 0.0008 /end COMPU_METHOD
/begin COMPU_METHOD COMP_0210_S "1Åé" RAT_FUNC "%8.2" "Åé" COEFFS 0 1 50 0 0 1 /end COMPU_METHOD
/begin COMPU_METHOD COMP_0053 "1ms" RAT_FUNC "%8.2" "ms" COEFFS 0 1 0 0 0 1 /end COMPU_METHOD
/begin COMPU_METHOD COMP_0366 "100É S" RAT_FUNC "%8.2" "É S" COEFFS 0 1 0 0 0 100 /end COMPU_METHOD
/begin COMPU_METHOD COMP_0478_S "0.01V/A" RAT_FUNC "%8.3" "V/A" COEFFS 0 1 0 0 0 0.01 /end COMPU_METHOD
/begin COMPU_METHOD COMP_0226 "0.1Nm" RAT_FUNC "%8.2" "Nm" COEFFS 0 1 3276.8 0 0 0.1 /end COMPU_METHOD
/begin COMPU_METHOD COMP_0273_S "fixed axis rpm" RAT_FUNC "%8.2" "rpm" COEFFS 0 1 -400 0 0 400 /end COMPU_METHOD
/begin COMPU_METHOD COMP_0275_S "0.8km/h" RAT_FUNC "%8.2" "km/h" COEFFS 0 1 0 0 0 0.8 /end COMPU_METHOD
/begin COMPU_METHOD COMP_0357 "0.44deg" RAT_FUNC "%8.2" "deg" COEFFS 0 1 0 0 0 0.44 /end COMPU_METHOD
/begin COMPU_METHOD COMP_0260 "0.1Å|" RAT_FUNC "%8.2" "Å|" COEFFS 0 1 0 0 0 0.1 /end COMPU_METHOD
/begin COMPU_METHOD COMP_0276_S "fixed axis -" RAT_FUNC "%8.2" "-" COEFFS 0 1 -1 0 0 1 /end COMPU_METHOD
/begin COMPU_METHOD COMP_0278_S "fixed axis Åé" RAT_FUNC "%8.2" "Åé" COEFFS 0 1 40 0 0 20 /end COMPU_METHOD
/begin COMPU_METHOD COMP_0271_S "fixed axis rpm" RAT_FUNC "%8.2" "rpm" COEFFS 0 1 0 0 0 400 /end COMPU_METHOD
/begin COMPU_METHOD COMP_0485_S "100/4096%" RAT_FUNC "%8.3" "%" COEFFS 0 1 0 0 0 0.0244141 /end COMPU_METHOD
/begin COMPU_METHOD COMP_0280_S "fixed axis Åé" RAT_FUNC "%8.2" "Åé" COEFFS 0 1 40 0 0 10 /end COMPU_METHOD
/begin COMPU_METHOD COMP_0042 "0.0008cm**2" RAT_FUNC "%8.5" "cm**2" COEFFS 0 1 0 0 0 0.0008 /end COMPU_METHOD
/begin COMPU_METHOD COMP_0246 "100/16%" RAT_FUNC "%8.2" "%" COEFFS 0 1 0 0 0 6.25 /end COMPU_METHOD
/begin COMPU_METHOD COMP_0294_S "1/65536NULL" RAT_FUNC "%8.6" "NULL" COEFFS 0 1 0 0 0 0.0000152588 /end COMPU_METHOD
/begin COMPU_METHOD COMP_0493 "4l/min" RAT_FUNC "%8.2" "l/min" COEFFS 0 1 0 0 0 4 /end COMPU_METHOD
/begin COMPU_METHOD COMP_0516_S "0.125%/sec" RAT_FUNC "%8.2" "%/sec" COEFFS 0 1 0 0 0 0.125 /end COMPU_METHOD
/begin COMPU_METHOD COMP_0315_S "fixed axis deg" RAT_FUNC "%8.2" "deg" COEFFS 0 1 -10 0 0 10 /end COMPU_METHOD
/begin COMPU_METHOD COMP_0330_S "fixed axis rpm" RAT_FUNC "%8.2" "rpm" COEFFS 0 1 -800 0 0 800 /end COMPU_METHOD
/begin COMPU_METHOD COMP_0283 "1flag" RAT_FUNC "%8.2" "flag" COEFFS 0 1 0 0 0 1 /end COMPU_METHOD
/begin COMPU_METHOD COMP_0201_S "1s1s" RAT_FUNC "%8.2" "1s" COEFFS 0 1 0 0 0 1 /end COMPU_METHOD
/begin COMPU_METHOD COMP_0202_S "100ms100ms" RAT_FUNC "%8.2" "100ms" COEFFS 0 1 0 0 0 1 /end COMPU_METHOD
/begin COMPU_METHOD COMP_0203_S "10ms10ms" RAT_FUNC "%8.2" "10ms" COEFFS 0 1 0 0 0 1 /end COMPU_METHOD
/begin COMPU_METHOD COMP_0378 "100/255%" RAT_FUNC "%8.2" "%" COEFFS 0 1 0 0 0 0.392156863 /end COMPU_METHOD
/begin COMPU_METHOD COMP_0251 "1cyl" RAT_FUNC "%8.2" "cyl" COEFFS 0 1 0 0 0 1 /end COMPU_METHOD
/begin COMPU_METHOD COMP_0021_S "NmNm" RAT_FUNC "%8.2" "Nm" COEFFS 0 1 100 0 0 2 /end COMPU_METHOD
/begin COMPU_METHOD COMP_0118 "40mV" RAT_FUNC "%8.2" "mV" COEFFS 0 1 0 0 0 40 /end COMPU_METHOD
/begin COMPU_METHOD COMP_0567_S "cyl(BITà íu)cyl(BIT" RAT_FUNC "%8.2" "cyl(BIT" COEFFS 0 1 0 0 0 1 /end COMPU_METHOD
/begin COMPU_METHOD COMP_0415 "1/256Å|" RAT_FUNC "%8.4" "Å|" COEFFS 0 1 0 0 0 0.00390625 /end COMPU_METHOD
/begin COMPU_METHOD COMP_0071_S "cylcyl" RAT_FUNC "%8.2" "cyl" COEFFS 0 1 0 0 0 0.333333333 /end COMPU_METHOD
/begin COMPU_METHOD COMP_0108_S "%%" RAT_FUNC "%8.4" "%" COEFFS 0 1 0 0 0 0.002441 /end COMPU_METHOD
/begin COMPU_METHOD COMP_0454 "(1/256)X-2147483648Å|" RAT_FUNC "%8.4" "Å|" COEFFS 0 1 8388608 0 0 0.00390625 /end COMPU_METHOD
/begin COMPU_METHOD COMP_0129_S "CYLCYL" RAT_FUNC "%8.2" "CYL" COEFFS 0 1 0 0 0 1 /end COMPU_METHOD
/begin COMPU_METHOD COMP_0615_S "%%" RAT_FUNC "%8.4" "%" COEFFS 0 1 102.4 0 0 0.003125 /end COMPU_METHOD
/begin COMPU_METHOD COMP_0490 "50/(128*256*256)%" RAT_FUNC "%8.6" "%" COEFFS 0 1 50.00004632576 0 0 0.00000596047 /end COMPU_METHOD
/begin COMPU_METHOD COMP_0618_S "rpm/msrpm/ms" RAT_FUNC "%8.4" "rpm/ms" COEFFS 0 1 0 0 0 0.002857142 /end COMPU_METHOD
/begin COMPU_METHOD COMP_0008_S "cm**2/rpm/cccm**2/rp" RAT_FUNC "%8.6" "cm**2/rp" COEFFS 0 1 0 0 0 0.0000000000391 /end COMPU_METHOD
/begin COMPU_METHOD COMP_0511 "6s" RAT_FUNC "%8.2" "s" COEFFS 0 1 0 0 0 6 /end COMPU_METHOD
/begin COMPU_METHOD COMP_0636_S "NmNm" RAT_FUNC "%8.2" "Nm" COEFFS 0 1 400 0 0 0.5 /end COMPU_METHOD
/begin COMPU_METHOD COMP_0637_S "NmNm" RAT_FUNC "%8.2" "Nm" COEFFS 0 1 400 0 0 0.5 /end COMPU_METHOD
/begin COMPU_METHOD COMP_0638_S "NmNm" RAT_FUNC "%8.2" "Nm" COEFFS 0 1 100 0 0 2 /end COMPU_METHOD
/begin COMPU_METHOD COMP_0525 "100/(256*256*256)%" RAT_FUNC "%8.6" "%" COEFFS 0 1 0 0 0 0.00000596047 /end COMPU_METHOD
/begin COMPU_METHOD COMP_0526 "64/(128Å~256Å~256)degCA" RAT_FUNC "%8.6" "degCA" COEFFS 0 1 63.99996198912 0 0 0.00000762939 /end COMPU_METHOD
/begin COMPU_METHOD COMP_0653_S "degCAdegCA" RAT_FUNC "%8.4" "degCA" COEFFS 0 1 64.00016384 0 0 0.00195313 /end COMPU_METHOD
/begin COMPU_METHOD COMP_0530 "64/(128*256*256)degCA" RAT_FUNC "%8.6" "degCA" COEFFS 0 1 64.0000458752 0 0 0.0000076294 /end COMPU_METHOD
/begin COMPU_METHOD COMP_0531 "100/255%" RAT_FUNC "%8.2" "%" COEFFS 0 1 0 0 0 0.392157 /end COMPU_METHOD
/* RECORD_LAYOUT ------------------------------------------------------ */
/begin RECORD_LAYOUT REC_UBYTE_C FNC_VALUES 1 UBYTE COLUMN_DIR DIRECT /end RECORD_LAYOUT
/begin RECORD_LAYOUT REC_UWORD_C FNC_VALUES 1 UWORD COLUMN_DIR DIRECT /end RECORD_LAYOUT
/begin RECORD_LAYOUT REC_SWORD_C FNC_VALUES 1 SWORD COLUMN_DIR DIRECT /end RECORD_LAYOUT
/begin RECORD_LAYOUT REC_SBYTE_C FNC_VALUES 1 SBYTE COLUMN_DIR DIRECT /end RECORD_LAYOUT
/begin RECORD_LAYOUT REC_ULONG_C FNC_VALUES 1 ULONG COLUMN_DIR DIRECT /end RECORD_LAYOUT
/begin RECORD_LAYOUT REC_AXIS_UBYTE AXIS_PTS_X 1 UBYTE INDEX_INCR DIRECT /end RECORD_LAYOUT
/begin RECORD_LAYOUT REC_AXIS_UWORD AXIS_PTS_X 1 UWORD INDEX_INCR DIRECT /end RECORD_LAYOUT
/end MODULE
/end PROJECT
