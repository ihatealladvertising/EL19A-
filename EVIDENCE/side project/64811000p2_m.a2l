/* NISSAN ASAP2 definition file generated by RB4-ASAP2 GENERATOR */
/* Generated date and time 2007/10/10 17:11:02 */
/* Ç±ÇÃASAP2ÉtÉ@ÉCÉãÇÕÅASH7058RFCCópÇ≈Ç∑ÅB SH7058FCCÇÃECMÇ…ÇÕégÇ¶Ç‹ÇπÇÒÅB*/
ASAP2_VERSION 1 3_BETA
/begin PROJECT TK_X91_EUR_VC ""
/* project ID Ç… car_eng_desti_lot */
/* comment Ç… Par.scomment */
/begin HEADER "" /* key HEADER ++ "comment" Ç… Par.scomment */ PROJECT_NO TK_X91_EUR_VC /* key PROJECT_NO ++ project number Ç… car_eng_desti_lot */ VERSION "7V4YHZEB2" /* key VERSION ++ version number Ç… mProgver */ /end HEADER
/begin MODULE DIM ""
/* key MODULE ++ ASAP device ID ++ "comment" */
/begin MOD_PAR "" VERSION "7V4YHZEB2" /* ADDR_EPK 0xFFFF */ EPK "" CUSTOMER_NO "" USER "" PHONE_NO "" ECU "VP3K or COMMON" CPU_TYPE "SH7058RFCC NO EXTERNAL ROM"
 /begin MEMORY_SEGMENT /* Internal Vector start_address area_size */ code1 "Vector" CODE FLASH INTERN 0x00000000 0x00000400 -1 -1 -1 -1 -1 /end MEMORY_SEGMENT
 /begin MEMORY_SEGMENT /* Internal Data start_address area_size */ data1 "Data" DATA FLASH INTERN 0x00000400 0x000FFC00 -1 -1 -1 -1 -1 /end MEMORY_SEGMENT
 /begin MEMORY_SEGMENT /* Internal DISTAB13 Address Table start_address area_size */ var1 "DISTAB Address Table" VARIABLES RAM INTERN 0xFFFF0000 0x000001F4 -1 -1 -1 -1 -1 /end MEMORY_SEGMENT
 /begin MEMORY_SEGMENT /* Internal DISTAB13 Data Buffer Table start_address area_size */ var2 "DISTAB Output Buffer" VARIABLES RAM INTERN 0xFFFF0000 0x0000BFFF -1 -1 -1 -1 -1 /end MEMORY_SEGMENT
 /begin CALIBRATION_METHOD "FixedSizeMoveableEmuRAM" /* Method name */ 1 /* Method version */ /begin CALIBRATION_HANDLE 0 0xFFFB0000 0x4000 /end CALIBRATION_HANDLE /begin CALIBRATION_HANDLE 1 0xFFFB4000 0x4000 /end CALIBRATION_HANDLE /begin CALIBRATION_HANDLE 2 0xFFFB8000 0x4000 /end CALIBRATION_HANDLE /begin CALIBRATION_HANDLE 3 0xFFFBC000 0x4000 /end CALIBRATION_HANDLE /begin CALIBRATION_HANDLE 4 0xFFFC0000 0x4000 /end CALIBRATION_HANDLE /begin CALIBRATION_HANDLE 5 0xFFFC4000 0x4000 /end CALIBRATION_HANDLE /begin CALIBRATION_HANDLE 6 0xFFFC8000 0x4000 /end CALIBRATION_HANDLE /begin CALIBRATION_HANDLE 7 0xFFFCC000 0x4000 /end CALIBRATION_HANDLE /begin CALIBRATION_HANDLE 8 0xFFFD0000 0x4000 /end CALIBRATION_HANDLE /begin CALIBRATION_HANDLE 9 0xFFFD4000 0x4000 /end CALIBRATION_HANDLE /begin CALIBRATION_HANDLE 10 0xFFFD8000 0x4000 /end CALIBRATION_HANDLE /begin CALIBRATION_HANDLE 11 0xFFFDC000 0x4000 /end CALIBRATION_HANDLE /begin CALIBRATION_HANDLE 12 0xFFFE0000 0x4000 /end CALIBRATION_HANDLE /begin CALIBRATION_HANDLE 13 0xFFFE4000 0x4000 /end CALIBRATION_HANDLE /begin CALIBRATION_HANDLE 14 0xFFFE8000 0x4000 /end CALIBRATION_HANDLE /begin CALIBRATION_HANDLE 15 0xFFFEC000 0x4000 /end CALIBRATION_HANDLE /end CALIBRATION_METHOD
/end MOD_PAR
/begin IF_DATA ETK
 /begin TP_BLOB 0x1000001 /* Version Number */ 0x0 /* Project base address (offset) */ 0x0 /* ETKP: RESET_CFG parameter, don't care */
  /begin DISTAB_CFG 0xD /* Type of display table (display table 13) */ 0x0122 /* Data type of display table, 1 = Byte 2 = Word 2 = Word */ 0x1 /* Byte order 1 = high first, 2 = low first */ 0xFFFF0000 /* Trigger segment address, don't care */ 0x1020100 /* Trigger configuration */ TRG_MOD /*Id:*/ 0x0 /*trg_mod:*/ 0x27 0x0 0x0 0x0 /end DISTAB_CFG
  RESERVED_DISTAB_MEMORY /*start address*/ 0xFFFF0000 /*size*/ 0x01F4 INTERN -1 -1 -1 -1 -1 ETK_CFG 0x84 0x04 0x10 0xFF 0xFF 0x46 0x4C 0x53 0x48 0x04 0xFF 0xFF 0xFF 0xFF 0xFF 0xFF 0xFF 0xFF 0xFF 0xFF 0xFF 0xFF 0xFF 0xFF 0xFF 0xFF 0xFF 0xFF 0xFF 0xFF 0xFF 0xFF 0xFF 0xFF 0xFF 0xFF 0xFF /end TP_BLOB
 /begin SOURCE /* Description of first display table */ "Ref" 103 1 QP_BLOB 1 0xE8 0xFFFF0000 0xFFFF01F4 0xFFFF062C 0 0 0 /end SOURCE
 /begin SOURCE /* Description of second display table */ "4ms" 3 4 QP_BLOB 2 0x168 0xFFFF007C 0xFFFF02DC 0xFFFF0630 4 0 0 /end SOURCE
 /begin SOURCE /* Description of third display table */ "10ms" 4 1 QP_BLOB 3 0x168 0xFFFF0138 0xFFFF0444 0xFFFF0634 10 0 0 /end SOURCE
/end IF_DATA
/begin MOD_COMMON "" DEPOSIT ABSOLUTE BYTE_ORDER MSB_FIRST /* ﬁ≤ƒµ∞¿ﬁ∞Ç™ÿÃﬂ⁄∞ΩÇ≥ÇÍÇÈ */ /end MOD_COMMON
/* Ç±Ç±Ç…ÅAê∂ê¨Ç≥ÇÍÇΩ‹∞∏Ãß≤ŸèÓïÒÇë}ì¸ÅB*/ /* CHARACTERISTIC ------------------------------------------------------- */
/begin FUNCTION KF7-0.2[145] "List of flag allocations" /end FUNCTION
/begin FUNCTION KF7-301.1[7] "Intake air quantity " /end FUNCTION
/begin FUNCTION KF7-301.4[3] "Rear O2 sensor" /end FUNCTION
/begin FUNCTION KF7-301.6[1] "Rear O2 heater current monitor value" /end FUNCTION
/begin FUNCTION KF7-301.7[1] "Battery voltage" /end FUNCTION
/begin FUNCTION KF7-301.8M[3] "Coolant temperature sensor" /end FUNCTION
/begin FUNCTION KF7-301.8P[3] "Coolant temperature TW_S generating section (redundant section) input" /end FUNCTION
/begin FUNCTION KF7-301.13[1] "Pd pressure sensor" /end FUNCTION
/begin FUNCTION KF7-301.15[4] "Knock sensor" /end FUNCTION
/begin FUNCTION KF7-301.16[5] "Intake air temperature sensor" /end FUNCTION
/begin FUNCTION KF7-301.18[5] "Front A/F sensor" /end FUNCTION
/begin FUNCTION KF7-301.19[8] "Absolute pressure sensor voltage" /end FUNCTION
/begin FUNCTION KF7-301.21[1] "Purge control-related items" /end FUNCTION
/begin FUNCTION KF7-301.25[11] "ETC throttle related matters (for 1CPU)" /end FUNCTION
/begin CHARACTERISTIC mAFCH "#NAME?" VALUE 0x00008FAE REC_UWORD_C 0 COMP_0023 0 327675 /begin FUNCTION_LIST KF7-301.18[5] /end FUNCTION_LIST /end CHARACTERISTIC
/begin CHARACTERISTIC mAFCL "#NAME?" VALUE 0x00008FB0 REC_UWORD_C 0 COMP_0023 0 327675 /begin FUNCTION_LIST KF7-301.18[5] /end FUNCTION_LIST /end CHARACTERISTIC
/begin CHARACTERISTIC mAFCLT1 "Condition A judgement delay" VALUE 0x00008208 REC_UBYTE_C 0 COMP_0250 0 1020 /begin FUNCTION_LIST KF7-301.1[7] /end FUNCTION_LIST /end CHARACTERISTIC
/begin CHARACTERISTIC mAFCLT2 "Condition A delay (right after IGNSWON, judgement)" VALUE 0x00008209 REC_UBYTE_C 0 COMP_0014 0 2550 /begin FUNCTION_LIST KF7-301.1[7] /end FUNCTION_LIST /end CHARACTERISTIC
/begin CHARACTERISTIC mAFCLTV "At the time of the AFM start, surge judgement throttle open-degree" VALUE 0x0000820A REC_UBYTE_C 0 COMP_0002 0 89.25 /begin FUNCTION_LIST KF7-301.1[7] /end FUNCTION_LIST /end CHARACTERISTIC
/begin CHARACTERISTIC mAFCLVB "VB decline judgement voltage" VALUE 0x0000820B REC_UBYTE_C 0 COMP_0033 0 20400 /begin FUNCTION_LIST KF7-301.1[7] /end FUNCTION_LIST /end CHARACTERISTIC
/begin CHARACTERISTIC mAFMCL1 "At the time of the AFM start, surge judgement voltage" VALUE 0x00008FC6 REC_UWORD_C 0 COMP_0023 0 327675 /begin FUNCTION_LIST KF7-301.1[7] /end FUNCTION_LIST /end CHARACTERISTIC
/begin CHARACTERISTIC mAFMCL2 "At the time of the AFM start, surge judgement voltage" VALUE 0x00008FC8 REC_UWORD_C 0 COMP_0023 0 327675 /begin FUNCTION_LIST KF7-301.1[7] /end FUNCTION_LIST /end CHARACTERISTIC
/begin CHARACTERISTIC mAFPC "A/F sensor voltage central value" VALUE 0x00008FD2 REC_UWORD_C 0 COMP_0370 0 163837.5 /begin FUNCTION_LIST KF7-301.18[5] KF7-313C.1[36] /end FUNCTION_LIST /end CHARACTERISTIC
/begin CHARACTERISTIC mAPSVH "(MainCPU) APS output normality range upper limit" VALUE 0x0000906E REC_UWORD_C 0 COMP_0023 0 327675 /begin FUNCTION_LIST KF7-301.25[11] KF7-505.2[9] /end FUNCTION_LIST /end CHARACTERISTIC
/begin CHARACTERISTIC mAPSVL "(MainCPU) APS output normality range lower limit" VALUE 0x00009072 REC_UWORD_C 0 COMP_0023 0 327675 /begin FUNCTION_LIST KF7-301.25[11] KF7-505.2[9] /end FUNCTION_LIST /end CHARACTERISTIC
/begin CHARACTERISTIC mAVPRR "Absolute pressure sensor voltage weighted average coefficient" VALUE 0x000082A0 REC_UBYTE_C 0 COMP_0044 0 1.9921875 /begin FUNCTION_LIST KF7-301.19[8] /end FUNCTION_LIST /end CHARACTERISTIC
/begin CHARACTERISTIC mCTTAN1 "At least, intake air temperature judgement criteria" VALUE 0x0000838F REC_UBYTE_C 0 COMP_0016 0 255 /begin FUNCTION_LIST KF7-301.16[5] /end FUNCTION_LIST /end CHARACTERISTIC
/begin CHARACTERISTIC mDDLTAN "DELTANn condition upper limit" VALUE 0x000083E9 REC_UBYTE_C 0 COMP_0003 0 255 /begin FUNCTION_LIST KF7-301.16[5] /end FUNCTION_LIST /end CHARACTERISTIC
/begin CHARACTERISTIC mDOFST1 "DOFST (QH0 âﬂëÂ business)" VALUE 0x00008499 REC_UBYTE_C 0 COMP_0061 0 1275 /begin FUNCTION_LIST KF7-301.25[11] /end FUNCTION_LIST /end CHARACTERISTIC
/begin CHARACTERISTIC mDOFST2 "DOFST (QH0 big business)" VALUE 0x0000849A REC_UBYTE_C 0 COMP_0061 0 1275 /begin FUNCTION_LIST KF7-301.25[11] /end FUNCTION_LIST /end CHARACTERISTIC
/begin CHARACTERISTIC mDOFST3 "DOFST (QH0 small business)" VALUE 0x0000849B REC_UBYTE_C 0 COMP_0061 0 1275 /begin FUNCTION_LIST KF7-301.25[11] /end FUNCTION_LIST /end CHARACTERISTIC
/begin CHARACTERISTIC mDOFST4 "DOFST (QH0 âﬂè¨ business)" VALUE 0x0000849C REC_UBYTE_C 0 COMP_0061 0 1275 /begin FUNCTION_LIST KF7-301.25[11] /end FUNCTION_LIST /end CHARACTERISTIC
/begin CHARACTERISTIC mENSTSP "At the time of the engine stall, TWF time constant" VALUE 0x00008547 REC_UBYTE_C 0 COMP_0149 0 0.12451191 /begin FUNCTION_LIST KF7-301.8M[3] /end FUNCTION_LIST /end CHARACTERISTIC
/begin CHARACTERISTIC mEVPKJU "vEVPR average coefficient" VALUE 0x00008594 REC_UBYTE_C 0 COMP_0004 0 255 /begin FUNCTION_LIST KF7-301.21[1] /end FUNCTION_LIST /end CHARACTERISTIC
/begin CHARACTERISTIC mFCTSP "At the time of F/C, TWF time constant" VALUE 0x000085F2 REC_UBYTE_C 0 COMP_0149 0 0.12451191 /begin FUNCTION_LIST KF7-301.8M[3] /end FUNCTION_LIST /end CHARACTERISTIC
/begin CHARACTERISTIC mGKTVMN "Offset learning lower limit value" VALUE 0x00008669 REC_UBYTE_C 0 COMP_0061 0 1275 /begin FUNCTION_LIST KF7-301.25[11] /end FUNCTION_LIST /end CHARACTERISTIC
/begin CHARACTERISTIC mGKTVMX "Offset learning upper limit value" VALUE 0x0000866A REC_UBYTE_C 0 COMP_0061 0 1275 /begin FUNCTION_LIST KF7-301.25[11] /end FUNCTION_LIST /end CHARACTERISTIC
/begin CHARACTERISTIC mIDAPSOFS "Soft IDLE judgement offset value" VALUE 0x0000927E REC_UWORD_C 0 COMP_0023 0 327675
 /begin FUNCTION_LIST KF7-301.25[11] KF7-301.25M[5] KF7-301.25P[5] R000.1.RS_Integ_1_10_2 /end FUNCTION_LIST
/end CHARACTERISTIC
/begin CHARACTERISTIC mINOFST "Offset learning initial value" VALUE 0x00008736 REC_UBYTE_C 0 COMP_0061 0 1275 /begin FUNCTION_LIST KF7-301.25[11] /end FUNCTION_LIST /end CHARACTERISTIC
/begin CHARACTERISTIC mKAIMIN "Full-close position learning minimum value" VALUE 0x00009318 REC_UWORD_C 0 COMP_0023 0 327675 /begin FUNCTION_LIST KF7-301.25[11] /end FUNCTION_LIST /end CHARACTERISTIC
/begin CHARACTERISTIC mKAIVRT "VRO2 compensation release delay" VALUE 0x0000877F REC_UBYTE_C 0 COMP_0008 0 25500 /begin FUNCTION_LIST KF7-301.4[3] /end FUNCTION_LIST /end CHARACTERISTIC
/begin CHARACTERISTIC mLDTVL "DOFST judgement level" VALUE 0x00008800 REC_UBYTE_C 0 COMP_0032 0 0.99609375 /begin FUNCTION_LIST KF7-301.25[11] /end FUNCTION_LIST /end CHARACTERISTIC
/begin CHARACTERISTIC mLRUPLT1 "TPS1 full-close position learning value upper limit limiter" VALUE 0x0000938A REC_UWORD_C 0 COMP_0061 0 327675 /begin FUNCTION_LIST KF7-301.25[11] /end FUNCTION_LIST /end CHARACTERISTIC
/begin CHARACTERISTIC mLRUPLT2 "TPS2 full-close position learning value upper limit limiter" VALUE 0x0000938C REC_UWORD_C 0 COMP_0061 0 327675 /begin FUNCTION_LIST KF7-301.25[11] /end FUNCTION_LIST /end CHARACTERISTIC
/begin CHARACTERISTIC mLRUPLT4B "TPS1, four times full-close position learning value upper limit limiter" VALUE 0x0000938E REC_UWORD_C 0 COMP_0061 0 327675 /begin FUNCTION_LIST KF7-301.25[11] /end FUNCTION_LIST /end CHARACTERISTIC
/begin CHARACTERISTIC mLVB "Sensor voltage trust threshold" VALUE 0x00008835 REC_UBYTE_C 0 COMP_0033 0 20400 /begin FUNCTION_LIST KF7-301.19[8] /end FUNCTION_LIST /end CHARACTERISTIC
/begin CHARACTERISTIC mNPD "Pd pressure weighted average value" VALUE 0x000088D6 REC_UBYTE_C 0 COMP_0032 0 0.99609375 /begin FUNCTION_LIST KF7-301.13[1] /end FUNCTION_LIST /end CHARACTERISTIC
/begin CHARACTERISTIC mNSETD "NEUTD At the time of off, NSET00 upper limit value" VALUE 0x000088EA REC_UBYTE_C 0 COMP_0006 0 3187.5
 /begin FUNCTION_LIST KF7-0.2[145] KF7-330.4A[53] KF7-385.1[32] KF7-385.3[4] KF7-450.1[N] KF7-450.2[1] KF7-450.3[1] KF7-450.4[1] KF7-500.1[54] /end FUNCTION_LIST
/end CHARACTERISTIC
/begin CHARACTERISTIC mNSETN "NSET00 lower limit value" VALUE 0x000088EF REC_UBYTE_C 0 COMP_0006 0 3187.5
 /begin FUNCTION_LIST KF7-301.25[11] KF7-304.2[21] KF7-304.10[1] KF7-312.2A[16] KF7-330.3[6] KF7-330.4A[53] KF7-330.5[53] KF7-330.7A[1] KF7-330.8[1] KF7-330.9[8] KF7-351.1[16] KF7-351.2[17] KF7-385.1[32] KF7-385.3[4] KF7-390.3A[15] KF7-410.11M[4] KF7-410.11P[4] KF7-450.1[N] KF7-450.2[1] KF7-450.3[1] KF7-450.4[1] KF7-580.1[8] R000.1.RS_Integ_1_10_2 R301.6.IscAirflow_1_4_5 /end FUNCTION_LIST
/end CHARACTERISTIC
/begin CHARACTERISTIC mO2ADTL "VO2L sampling timing" VALUE 0x00008903 REC_UBYTE_C 0 COMP_0004 0 255 /begin FUNCTION_LIST KF7-301.18[5] /end FUNCTION_LIST /end CHARACTERISTIC
/begin CHARACTERISTIC mO2ADTR "VO2R sampling timing" VALUE 0x00008904 REC_UBYTE_C 0 COMP_0004 0 255 /begin FUNCTION_LIST KF7-301.18[5] /end FUNCTION_LIST /end CHARACTERISTIC
/begin CHARACTERISTIC mONOFCR "Electric current compensation time limit" VALUE 0x00008950 REC_UBYTE_C 0 COMP_0267 0 65280 /begin FUNCTION_LIST KF7-301.21[1] KF7-500.30[8] /end FUNCTION_LIST /end CHARACTERISTIC
/begin CHARACTERISTIC mPAMB0 "Reference atomospheric pressure" VALUE 0x00009406 REC_UWORD_C 0 COMP_0050 0 5119.921875 /begin FUNCTION_LIST KF7-0.2[145] KF7-301.19[8] KF7-312.1C[N] /end FUNCTION_LIST /end CHARACTERISTIC
/begin CHARACTERISTIC mPAMBIS "Atomospheric pressure renewal permission dead-zone" VALUE 0x00008975 REC_UBYTE_C 0 COMP_0054 0 5100 /begin FUNCTION_LIST KF7-301.19[8] /end FUNCTION_LIST /end CHARACTERISTIC
/begin CHARACTERISTIC mPAMBRT "An atomospheric pressure is returned, rate" VALUE 0x00008977 REC_UBYTE_C 0 COMP_0054 0 5100 /begin FUNCTION_LIST KF7-301.19[8] /end FUNCTION_LIST /end CHARACTERISTIC
/begin CHARACTERISTIC mPDOFST "Pd pressure sensor offset voltage" VALUE 0x00009414 REC_UWORD_C 0 COMP_0023 0 327675 /begin FUNCTION_LIST KF7-301.13[1] /end FUNCTION_LIST /end CHARACTERISTIC
/begin CHARACTERISTIC mPRESVM "Absolute pressure sensor compensation minimum voltage" VALUE 0x000089BE REC_UBYTE_C 0 COMP_0104 0 2550 /begin FUNCTION_LIST KF7-301.19[8] /end FUNCTION_LIST /end CHARACTERISTIC
/begin CHARACTERISTIC mRACACT "Activated judgement ÉCÉìÉsÅ[É_ÉìÉX value" VALUE 0x00009472 REC_UWORD_C 0 COMP_0415_S 0 4095.9375 /begin FUNCTION_LIST KF7-301.18[5] KF7-378.3B[5] /end FUNCTION_LIST /end CHARACTERISTIC
/begin CHARACTERISTIC mRACAL "After the activated judgement, ÉCÉìÉsÅ[É_ÉìÉX value change rate limiter" VALUE 0x00009474 REC_UWORD_C 0 COMP_0447_S 0 4095.9375 /begin FUNCTION_LIST KF7-301.18[5] /end FUNCTION_LIST /end CHARACTERISTIC
/begin CHARACTERISTIC mRACBL "In front of the activated judgement, ÉCÉìÉsÅ[É_ÉìÉX value change rate limiter" VALUE 0x00009476 REC_UWORD_C 0 COMP_0447_S 0 4095.9375 /begin FUNCTION_LIST KF7-301.18[5] /end FUNCTION_LIST /end CHARACTERISTIC
/begin CHARACTERISTIC mRACH "ÉCÉìÉsÅ[É_ÉìÉX value maximum value" VALUE 0x00009478 REC_UWORD_C 0 COMP_0415_S 0 4095.9375 /begin FUNCTION_LIST KF7-301.18[5] KF7-378.3B[5] /end FUNCTION_LIST /end CHARACTERISTIC
/begin CHARACTERISTIC mRACL "ÉCÉìÉsÅ[É_ÉìÉX value minimum value" VALUE 0x0000947A REC_UWORD_C 0 COMP_0415_S 0 4095.9375 /begin FUNCTION_LIST KF7-301.18[5] /end FUNCTION_LIST /end CHARACTERISTIC
/begin CHARACTERISTIC mRELR "Compensation decline coefficient" VALUE 0x0000949A REC_UWORD_C 0 COMP_0146 0 99.998480265 /begin FUNCTION_LIST KF7-301.1[7] /end FUNCTION_LIST /end CHARACTERISTIC
/begin CHARACTERISTIC mRESTM "Reset compensation time" VALUE 0x00008A43 REC_UBYTE_C 0 COMP_0250 0 1020 /begin FUNCTION_LIST KF7-301.1[7] /end FUNCTION_LIST /end CHARACTERISTIC
/begin CHARACTERISTIC mRESVB "At the time of resetting, voltage representative value" VALUE 0x00008A4B REC_UBYTE_C 0 COMP_0033 0 20400 /begin FUNCTION_LIST KF7-301.1[7] /end FUNCTION_LIST /end CHARACTERISTIC
/begin CHARACTERISTIC mRPDGIN "Pressure-voltage conversion coefficient" VALUE 0x00008AC9 REC_UBYTE_C 0 COMP_0285 0 0.00255 /begin FUNCTION_LIST KF7-301.13[1] /end FUNCTION_LIST /end CHARACTERISTIC
/begin CHARACTERISTIC mTAN0 "A degree of a reference intake air temperature" VALUE 0x00008B73 REC_UBYTE_C 0 COMP_0035 -50 205 /begin FUNCTION_LIST KF7-301.16[5] KF7-312.1C[N] /end FUNCTION_LIST /end CHARACTERISTIC
/begin CHARACTERISTIC mTANOFL "At the time of the intake air temperature offset quantity cold start judgement" VALUE 0x00008B7A REC_UBYTE_C 0 COMP_0003 0 255 /begin FUNCTION_LIST KF7-301.16[5] /end FUNCTION_LIST /end CHARACTERISTIC
/begin CHARACTERISTIC mTANOFS "Intake air temperature offset value" VALUE 0x00008B7B REC_UBYTE_C 0 COMP_0003 0 255 /begin FUNCTION_LIST KF7-301.16[5] /end FUNCTION_LIST /end CHARACTERISTIC
/begin CHARACTERISTIC mTDGKTVO "GKTVO learning delay" VALUE 0x00008B9E REC_UBYTE_C 0 COMP_0014 0 2550 /begin FUNCTION_LIST KF7-301.25[11] /end FUNCTION_LIST /end CHARACTERISTIC
/begin CHARACTERISTIC mTGTVG "A TP->QH0 gain for offset learning" VALUE 0x00008BDA REC_UBYTE_C 0 COMP_0315 0 24.90075 /begin FUNCTION_LIST KF7-301.25[11] KF7-351.3[11] /end FUNCTION_LIST /end CHARACTERISTIC
/begin CHARACTERISTIC mTIPDOF "At the time of A/C relay off, Pd pressure balance pressure detection delay" VALUE 0x00008BF8 REC_UBYTE_C 0 COMP_0008 0 25500 /begin FUNCTION_LIST KF7-301.13[1] KF7-330.5[53] /end FUNCTION_LIST /end CHARACTERISTIC
/begin CHARACTERISTIC mTMTAN1 "Vehicle speed condition delay" VALUE 0x00008CA5 REC_UBYTE_C 0 COMP_0013 0 255 /begin FUNCTION_LIST KF7-301.16[5] /end FUNCTION_LIST /end CHARACTERISTIC
/begin CHARACTERISTIC mTMTAN2 "Starter switch condition delay" VALUE 0x00008CA6 REC_UBYTE_C 0 COMP_0013 0 255 /begin FUNCTION_LIST KF7-301.16[5] /end FUNCTION_LIST /end CHARACTERISTIC
/begin CHARACTERISTIC mTVINTS "Throttle full-close position learning initial value" VALUE 0x00009636 REC_UWORD_C 0 COMP_0061 0 327675 /begin FUNCTION_LIST KF7-301.25[11] KF7-304.10[1] KF7-500.38A[4] /end FUNCTION_LIST /end CHARACTERISTIC
/begin CHARACTERISTIC mTWAOFS "A difference in a degree of an intake air temperature offset quantity switching coolant temperature intake air temperature" VALUE 0x00008D1A REC_UBYTE_C 0 COMP_0003 0 255 /begin FUNCTION_LIST KF7-301.16[5] /end FUNCTION_LIST /end CHARACTERISTIC
/begin CHARACTERISTIC mTWIOFS "Intake air temperature offset value cold start" VALUE 0x00008D38 REC_UBYTE_C 0 COMP_0035 -50 205 /begin FUNCTION_LIST KF7-301.16[5] /end FUNCTION_LIST /end CHARACTERISTIC
/begin CHARACTERISTIC mTWTAH "Coolant temperature condition upper limit" VALUE 0x00008D6F REC_UBYTE_C 0 COMP_0035 -50 205 /begin FUNCTION_LIST KF7-301.16[5] /end FUNCTION_LIST /end CHARACTERISTIC
/begin CHARACTERISTIC mTWTAL "Coolant temperature condition lower limit" VALUE 0x00008D70 REC_UBYTE_C 0 COMP_0035 -50 205 /begin FUNCTION_LIST KF7-301.16[5] /end FUNCTION_LIST /end CHARACTERISTIC
/begin CHARACTERISTIC mUS14V "At the time of the amount of reference air, output voltage" VALUE 0x00009640 REC_UWORD_C 0 COMP_0023 0 327675 /begin FUNCTION_LIST KF7-301.1[7] /end FUNCTION_LIST /end CHARACTERISTIC
/begin CHARACTERISTIC mUSOFS "US offset (for the adjustment)" VALUE 0x00009646 REC_UWORD_C 0 COMP_0023 0 327675 /begin FUNCTION_LIST KF7-301.1[7] /end FUNCTION_LIST /end CHARACTERISTIC
/begin CHARACTERISTIC mVEREND "ë“Çø, ÇØ logic completion judgement time" VALUE 0x00008DC3 REC_UBYTE_C 0 COMP_0008 0 25500 /begin FUNCTION_LIST KF7-301.1[7] /end FUNCTION_LIST /end CHARACTERISTIC
/begin CHARACTERISTIC mVERINI "VERR initial value" VALUE 0x00009654 REC_UWORD_C 0 COMP_0023 0 327675 /begin FUNCTION_LIST KF7-301.1[7] /end FUNCTION_LIST /end CHARACTERISTIC
/begin CHARACTERISTIC mVHW "Heating energy integration offset" VALUE 0x00008DC8 REC_UBYTE_C 0 COMP_0033 0 20400 /begin FUNCTION_LIST KF7-301.1[7] /end FUNCTION_LIST /end CHARACTERISTIC
/begin CHARACTERISTIC mVOL "Engine displacement" VALUE 0x00008DDF REC_UBYTE_C 0 COMP_0362 0 6375
 /begin FUNCTION_LIST KF7-0.2[145] KF7-304.1B[5] KF7-304.9[2] KF7-340.1M[8] KF7-340.1P[7] KF7-340.2M[2] KF7-340.2P[1] KF7-340.8M[8] KF7-350.4M[14] KF7-350.4P[13] KF7-351.3[11] KF7-385.3[4] KF7-410.11M[4] KF7-410.17M[5] R000.1.RS_Integ_1_10_2 R301.20.AmbientComp_1_0_2 /end FUNCTION_LIST
/end CHARACTERISTIC
/begin CHARACTERISTIC mVRHOSH "VRO2 compensation start voltage (Rich side)" VALUE 0x00008DEF REC_UBYTE_C 0 COMP_0104 0 2550 /begin FUNCTION_LIST KF7-301.4[3] /end FUNCTION_LIST /end CHARACTERISTIC
/begin CHARACTERISTIC mVRHOSL "VRO2 compensation start voltage (Lean side)" VALUE 0x00008DF0 REC_UBYTE_C 0 COMP_0104 0 2550 /begin FUNCTION_LIST KF7-301.4[3] /end FUNCTION_LIST /end CHARACTERISTIC
/begin CHARACTERISTIC mVSPTAN "Vehicle speed condition lower limit" VALUE 0x00008E1D REC_UBYTE_C 0 COMP_0007 0 510 /begin FUNCTION_LIST KF7-301.16[5] /end FUNCTION_LIST /end CHARACTERISTIC
/begin CHARACTERISTIC mTTVOFI "Full-close position coolant temperature compensation table" CURVE 0x0000DC2A REC_UBYTE_C 0 COMP_0023 0 1275
 /begin AXIS_DESCR FIX_AXIS NO_INPUT_QUANTITY COMP_0280_S 16 -40 110 FIX_AXIS_PAR_DIST 0 1 16 /end AXIS_DESCR
 /begin FUNCTION_LIST KF7-301.25[11] /end FUNCTION_LIST
/end CHARACTERISTIC
/begin CHARACTERISTIC mTTGTVO "Opening area => target throttle open-degree conversion table" CURVE 0x0000F35E REC_UWORD_C 0 COMP_0130 0 1802.2125
 /begin AXIS_DESCR COM_AXIS NO_INPUT_QUANTITY COMP_0041 32 0 52.428 AXIS_PTS_REF mATGTVO /end AXIS_DESCR
 /begin FUNCTION_LIST KF7-301.25[11] KF7-304.9[2] KF7-340.1M[8] KF7-340.1P[7] KF7-340.2M[2] KF7-340.2P[1] KF7-340.8M[8] KF7-340.8P[8] KF7-350.1M[5] KF7-350.4M[14] KF7-350.4P[13] KF7-351.3[11] KF7-385.3[4] KF7-410.11M[4] KF7-410.11P[4] KF7-410.17M[5] KF7-410.17P[1] KF7-500.7[12] R000.1.RS_Integ_1_10_2 R301.20.AmbientComp_1_0_2 /end FUNCTION_LIST
/end CHARACTERISTIC
/begin CHARACTERISTIC mTTWN "Coolant temperature normalized table" CURVE 0x0000DC7A REC_UBYTE_C 0 COMP_0035 -50 205
 /begin AXIS_DESCR FIX_AXIS NO_INPUT_QUANTITY COMP_0302_S 32 0 4960 FIX_AXIS_PAR_DIST 0 1 32 /end AXIS_DESCR
 /begin FUNCTION_LIST KF7-301.8M[3] KF7-301.16[5] KF7-500.1[54] /end FUNCTION_LIST
/end CHARACTERISTIC
/begin CHARACTERISTIC mQTBL "Inhalation air quantity conversion table" CURVE 0x0000E36C REC_UWORD_C 0 COMP_0004 0 65535
 /begin AXIS_DESCR FIX_AXIS NO_INPUT_QUANTITY COMP_0311_S 64 0 5.04 FIX_AXIS_PAR_DIST 0 1 64 /end AXIS_DESCR
 /begin FUNCTION_LIST KF7-301.1[7] /end FUNCTION_LIST
/end CHARACTERISTIC
/begin CHARACTERISTIC mTFLTSP "TWF change time constant table" CURVE 0x0000D0C6 REC_UBYTE_C 0 COMP_0149 0 0.12451191
 /begin AXIS_DESCR FIX_AXIS NO_INPUT_QUANTITY COMP_0324_S 8 0 0.875 FIX_AXIS_PAR_DIST 0 1 8 /end AXIS_DESCR
 /begin FUNCTION_LIST KF7-301.8M[3] /end FUNCTION_LIST
/end CHARACTERISTIC
/begin CHARACTERISTIC mTINWFT "TWF initial value table" CURVE 0x0000D29A REC_UBYTE_C 0 COMP_0323 -200 118.75
 /begin AXIS_DESCR FIX_AXIS NO_INPUT_QUANTITY COMP_0278_S 8 -40 100 FIX_AXIS_PAR_DIST 0 1 8 /end AXIS_DESCR
 /begin FUNCTION_LIST KF7-301.8M[3] /end FUNCTION_LIST
/end CHARACTERISTIC
/begin CHARACTERISTIC mTTMHOS "Element, lead initial temperature compensation value table" CURVE 0x0000DAB2 REC_UBYTE_C 0 COMP_0021 0 99.609375
 /begin AXIS_DESCR COM_AXIS NO_INPUT_QUANTITY COMP_0250 8 0 1020 AXIS_PTS_REF mLTMHOS /end AXIS_DESCR
 /begin FUNCTION_LIST KF7-301.1[7] /end FUNCTION_LIST
/end CHARACTERISTIC
/begin CHARACTERISTIC mTTVBHOS "A VB compensation value table to face in the US ÇÕÇËÇ¬Ç´ time" CURVE 0x0000DC22 REC_UBYTE_C 0 COMP_0021 0 99.609375
 /begin AXIS_DESCR COM_AXIS NO_INPUT_QUANTITY COMP_0096_S 8 0 326400000 AXIS_PTS_REF mLVBHOS /end AXIS_DESCR
 /begin FUNCTION_LIST KF7-301.1[7] /end FUNCTION_LIST
/end CHARACTERISTIC
/begin CHARACTERISTIC mCANFLG "ROM inclusion byte" VALUE 0x000082D8 REC_UBYTE_C 0 COMP_0283 0 255 /begin FUNCTION_LIST KF7-0.2[145] /end FUNCTION_LIST /end CHARACTERISTIC
/begin CHARACTERISTIC mfACPDCUT "Meter CAN #PDCUT output excuse flag" VALUE 0x000082D8 REC_UBYTE_C 0 COMP_0283 0 1 BIT_MASK 0x0040 /begin FUNCTION_LIST KF7-0.2[145] KF7-376.4[4] /end FUNCTION_LIST /end CHARACTERISTIC
/begin CHARACTERISTIC mfMETCAN3 "Meter CAN VSP" VALUE 0x000082D8 REC_UBYTE_C 0 COMP_0283 0 1 BIT_MASK 0x0008 /begin FUNCTION_LIST KF7-0.2[145] KF7-303.1[14] KF7-330.4A[53] /end FUNCTION_LIST /end CHARACTERISTIC
/begin CHARACTERISTIC mfMETCAN1 "Related to the meter CAN A/C Åy others Åz" VALUE 0x000082D8 REC_UBYTE_C 0 COMP_0283 0 1 BIT_MASK 0x0002 /begin FUNCTION_LIST KF7-0.2[145] KF7-330.4A[53] KF7-330.5[53] /end FUNCTION_LIST /end CHARACTERISTIC
/begin CHARACTERISTIC mfMETCAN "(HTASW is removed.) related to the meter CAN A/C" VALUE 0x000082D8 REC_UBYTE_C 0 COMP_0283 0 1 BIT_MASK 0x0001 /begin FUNCTION_LIST KF7-0.2[145] KF7-302.6A[4] KF7-376.4[4] /end FUNCTION_LIST /end CHARACTERISTIC
/begin CHARACTERISTIC mCOMMON "ROM flag inclusion byte" VALUE 0x00008350 REC_UBYTE_C 0 COMP_0283 0 255
 /begin FUNCTION_LIST KF7-0.2[145] KF7-302.5M[10] KF7-303.1[14] KF7-385.2[18] KF7-410.10[6] KF7-410.11M[4] KF7-410.11P[4] R000.1.RS_Integ_1_10_2 R301.1.Torque_realization_1_0_3 R301.11.INJDiag_1_1_2 /end FUNCTION_LIST
/end CHARACTERISTIC
/begin CHARACTERISTIC mfSWREFTRQ "Ignition timing retard torque going down reference torque choice flag" VALUE 0x00008350 REC_UBYTE_C 0 COMP_0283 0 1 BIT_MASK 0x0020 /begin FUNCTION_LIST KF7-0.2[145] KF7-385.2[18] R301.1.Torque_realization_1_0_3 /end FUNCTION_LIST /end CHARACTERISTIC
/begin CHARACTERISTIC mfRENAULT "Renault specifications choice switch" VALUE 0x00008350 REC_UBYTE_C 0 COMP_0283 0 1 BIT_MASK 0x0001
 /begin FUNCTION_LIST KF7-0.2[145] KF7-302.5M[10] KF7-303.1[14] KF7-410.10[6] KF7-410.11M[4] KF7-410.11P[4] KF7-580.1[8] R000.1.RS_Integ_1_10_2 R301.11.INJDiag_1_1_2 /end FUNCTION_LIST
/end CHARACTERISTIC
/begin CHARACTERISTIC mCSBUID "ROM inclusion byte" VALUE 0x00008370 REC_UBYTE_C 0 COMP_0283 0 255 /begin FUNCTION_LIST KF7-0.2[145] KF7-311.1A[21] KF7-450.9A[5] /end FUNCTION_LIST /end CHARACTERISTIC
/begin CHARACTERISTIC mfCSBU "C/S backup excuse" VALUE 0x00008370 REC_UBYTE_C 0 COMP_0283 0 1 BIT_MASK 0x0001 /begin FUNCTION_LIST KF7-0.2[145] KF7-450.9A[5] /end FUNCTION_LIST /end CHARACTERISTIC
/begin CHARACTERISTIC mETCLHM "At the time of an ETC sensor one-fold trouble, LH treatment flag" VALUE 0x0000855D REC_UBYTE_C 0 COMP_0283 0 255 /begin FUNCTION_LIST KF7-0.2[145] KF7-450.50[10] R000.1.RS_Integ_1_10_2 /end FUNCTION_LIST /end CHARACTERISTIC
/begin CHARACTERISTIC mfAPSSLH "APS At the time of the single trouble, LH executive flag" VALUE 0x0000855D REC_UBYTE_C 0 COMP_0283 0 1 BIT_MASK 0x0080 /begin FUNCTION_LIST KF7-0.2[145] KF7-450.50[10] R000.1.RS_Integ_1_10_2 /end FUNCTION_LIST /end CHARACTERISTIC
/begin CHARACTERISTIC mfTPSSLH "TPS At the time of the single trouble, LH executive flag" VALUE 0x0000855D REC_UBYTE_C 0 COMP_0283 0 1 BIT_MASK 0x0040 /begin FUNCTION_LIST KF7-0.2[145] KF7-450.50[10] /end FUNCTION_LIST /end CHARACTERISTIC
/begin CHARACTERISTIC mfEOBDSW "MIL configuration" VALUE 0x000085D4 REC_UBYTE_C 0 COMP_0283 0 1 BIT_MASK 0x0020 DISPLAY_IDENTIFIER Cbx_mux_mil_cfm
 /begin FUNCTION_LIST KF7-0.2[145] R000.2.RS_ROMflags_1_10_3 R903.1.milmgtx_1_0_2 /end FUNCTION_LIST
/end CHARACTERISTIC
/begin CHARACTERISTIC mFATAS "ROM inclusion byte" VALUE 0x000085D5 REC_UBYTE_C 0 COMP_0283 0 255 /begin FUNCTION_LIST KF7-0.2[145] /end FUNCTION_LIST /end CHARACTERISTIC
/begin CHARACTERISTIC mfFTASAC "At the time of A/C panel SW on, learning switch flag" VALUE 0x000085D5 REC_UBYTE_C 0 COMP_0283 0 1 BIT_MASK 0x0008 /begin FUNCTION_LIST KF7-0.2[145] KF7-351.2[17] /end FUNCTION_LIST /end CHARACTERISTIC
/begin CHARACTERISTIC mfFFRQTAS "Friction learning control switch flag" VALUE 0x000085D5 REC_UBYTE_C 0 COMP_0283 0 1 BIT_MASK 0x0004
 /begin FUNCTION_LIST KF7-0.2[145] KF7-350.4P[13] KF7-351.1[16] KF7-351.2[17] KF7-351.3[11] KF7-580.1[8] /end FUNCTION_LIST
/end CHARACTERISTIC
/begin CHARACTERISTIC mFLGPTN "VTC control choice flag" VALUE 0x0000860D REC_UBYTE_C 0 COMP_0283 0 255 /begin FUNCTION_LIST KF7-0.2[145] KF7-393.1C[8] /end FUNCTION_LIST /end CHARACTERISTIC
/begin CHARACTERISTIC mfDTYFLG "Wind up countermeasure control excuse switching" VALUE 0x0000860D REC_UBYTE_C 0 COMP_0283 0 1 BIT_MASK 0x0080 /begin FUNCTION_LIST KF7-0.2[145] KF7-393.1C[8] /end FUNCTION_LIST /end CHARACTERISTIC
/begin CHARACTERISTIC mfROGFLG "Dizzer control /PID control switching" VALUE 0x0000860D REC_UBYTE_C 0 COMP_0283 0 1 BIT_MASK 0x0040 /begin FUNCTION_LIST KF7-0.2[145] KF7-393.1C[8] /end FUNCTION_LIST /end CHARACTERISTIC
/begin CHARACTERISTIC mfFFULVTC "At the time of the full increase, a flag for VTC" VALUE 0x0000860D REC_UBYTE_C 0 COMP_0283 0 1 BIT_MASK 0x0001 /begin FUNCTION_LIST KF7-0.2[145] KF7-393.1C[8] /end FUNCTION_LIST /end CHARACTERISTIC
/begin CHARACTERISTIC mFMASK "A knock frequency element removal for the switching flag" VALUE 0x00008610 REC_UBYTE_C 0 COMP_0283 0 255 /begin FUNCTION_LIST KF7-0.2[145] /end FUNCTION_LIST /end CHARACTERISTIC
/begin CHARACTERISTIC mFPROMA "flag" VALUE 0x00008621 REC_UBYTE_C 0 COMP_0283 0 255 /begin FUNCTION_LIST KF7-0.2[145] /end FUNCTION_LIST /end CHARACTERISTIC
/begin CHARACTERISTIC mfBUCLR "The initial value switching flag of BURAM" VALUE 0x00008621 REC_UBYTE_C 0 COMP_0283 0 1 BIT_MASK 0x0004 /begin FUNCTION_LIST KF7-0.2[145] KF7-305.14[2] R000.4.EepAlloc_1_2_2 /end FUNCTION_LIST /end CHARACTERISTIC
/begin CHARACTERISTIC mID "ROM inclusion byte" VALUE 0x000086E7 REC_UBYTE_C 0 COMP_0283 0 255
 /begin FUNCTION_LIST KF7-0.2[145] KF7-302.5M[10] KF7-304.1B[5] KF7-305.4BM[31] KF7-312.6[34] KF7-313C.1[36] KF7-379.2[1] KF7-500.24[10] KF7-500.25A[7] KF7-500.69[25] KF7-560.1[N] KF7-580.1[8] R301.4.AfFeedback_1_0_1 /end FUNCTION_LIST
/end CHARACTERISTIC
/begin CHARACTERISTIC mfFCOVR "The existence of the CO adjustment volume" VALUE 0x000086E7 REC_UBYTE_C 0 COMP_0283 0 1 BIT_MASK 0x0020
 /begin FUNCTION_LIST KF7-0.2[145] KF7-304.1B[5] KF7-313C.1[36] KF7-314.1F[1] KF7-500.24[10] KF7-500.25A[7] /end FUNCTION_LIST
/end CHARACTERISTIC
/begin CHARACTERISTIC mfFINCA "A choice flag for INCA" VALUE 0x000086E7 REC_UBYTE_C 0 COMP_0283 0 1 BIT_MASK 0x0002
 /begin FUNCTION_LIST KF7-0.2[145] KF7-305.14[2] KF7-460.1[6] KF7-560.1[N] R000.4.EepAlloc_1_2_2 /end FUNCTION_LIST
/end CHARACTERISTIC
/begin CHARACTERISTIC mIDOS "ROM inclusion byte" VALUE 0x000086F9 REC_UBYTE_C 0 COMP_0283 0 255 /begin FUNCTION_LIST KF7-0.2[145] KF7-305.5[3] KF7-330.5[53] KF7-377.1A[19] /end FUNCTION_LIST /end CHARACTERISTIC
/begin CHARACTERISTIC mfFFTASW "There is ISC air-conditioning compensation TASW, flag" VALUE 0x000086F9 REC_UBYTE_C 0 COMP_0283 0 1 BIT_MASK 0x0080 /begin FUNCTION_LIST KF7-0.2[145] /end FUNCTION_LIST /end CHARACTERISTIC
/begin CHARACTERISTIC mfFAFICD "A flag with PWST interlock FICD compensation" VALUE 0x000086F9 REC_UBYTE_C 0 COMP_0283 0 1 BIT_MASK 0x0020 /begin FUNCTION_LIST KF7-0.2[145] KF7-330.5[53] /end FUNCTION_LIST /end CHARACTERISTIC
/begin CHARACTERISTIC mfFTCS "TCS control switching flag" VALUE 0x000086F9 REC_UBYTE_C 0 COMP_0283 0 1 BIT_MASK 0x0004 /begin FUNCTION_LIST KF7-0.2[145] /end FUNCTION_LIST /end CHARACTERISTIC
/begin CHARACTERISTIC mfFLNBRN "Control switching flag" VALUE 0x000086F9 REC_UBYTE_C 0 COMP_0283 0 1 BIT_MASK 0x0001
 /begin FUNCTION_LIST KF7-0.2[145] KF7-311.1A[21] KF7-312.2A[16] KF7-320A.9[9] KF7-379.2[1] KF7-379.4[1] KF7-379.5[3] R301.10.TITM_1_0_2 /end FUNCTION_LIST
/end CHARACTERISTIC
/begin CHARACTERISTIC mIDOS2 "ROM inclusion byte" VALUE 0x000086FA REC_UBYTE_C 0 COMP_0283 0 255
 /begin FUNCTION_LIST KF7-0.2[145] KF7-312.6[34] KF7-320A.1[6] KF7-340.5P[2] KF7-340.9M[3] KF7-340.9P[3] KF7-360.9M[43] KF7-360.9P[22] KF7-376.2[21] KF7-385.1[32] KF7-410.19[2] KF7-505.47[3] R000.1.RS_Integ_1_10_2 R301.8.Inverse_filter_1_1_3 R301.23.ADV_calculation_1_1_2 /end FUNCTION_LIST
/end CHARACTERISTIC
/begin CHARACTERISTIC mfECVT "CVT car choice flag" VALUE 0x000086FA REC_UBYTE_C 0 COMP_0283 0 1 BIT_MASK 0x0080
 /begin FUNCTION_LIST KF7-0.2[145] KF7-302.6A[4] KF7-312.6[34] KF7-320A.1[6] KF7-320A.2[3] KF7-330.5[53] KF7-330.9[8] KF7-340.5P[2] KF7-340.7[4] KF7-340.9M[3] KF7-340.9P[3] KF7-360.7M[9] KF7-360.7P[8] KF7-360.8M[4] KF7-360.9M[43] KF7-360.9P[22] KF7-376.2[21] KF7-385.1[32] KF7-385.2[18] KF7-385.3[4] KF7-410.19[2] KF7-505.47[3] R000.1.RS_Integ_1_10_2 R301.8.Inverse_filter_1_1_3 R301.23.ADV_calculation_1_1_2 /end FUNCTION_LIST
/end CHARACTERISTIC
/begin CHARACTERISTIC mfFDUET "DUETTE control switching flag" VALUE 0x000086FA REC_UBYTE_C 0 COMP_0283 0 1 BIT_MASK 0x0040 /begin FUNCTION_LIST KF7-0.2[145] KF7-330.4A[53] KF7-385.1[32] /end FUNCTION_LIST /end CHARACTERISTIC
/begin CHARACTERISTIC mIDOS3 "ROM inclusion byte" VALUE 0x000086FB REC_UBYTE_C 0 COMP_0283 0 255
 /begin FUNCTION_LIST KF7-0.2[145] KF7-320A.15[4] KF7-330.5[53] KF7-390.3A[15] R301.5.FuelCut_1_2_2 R301.23.ADV_calculation_1_1_2 /end FUNCTION_LIST
/end CHARACTERISTIC
/begin CHARACTERISTIC mfFLCFCA "During FCADV switching" VALUE 0x000086FB REC_UBYTE_C 0 COMP_0283 0 1 BIT_MASK 0x0080 /begin FUNCTION_LIST KF7-0.2[145] KF7-390.3A[15] R301.5.FuelCut_1_2_2 /end FUNCTION_LIST /end CHARACTERISTIC
/begin CHARACTERISTIC mfCMADVC "Non-L/UP phase control excuse" VALUE 0x000086FB REC_UBYTE_C 0 COMP_0283 0 1 BIT_MASK 0x0040 /begin FUNCTION_LIST KF7-0.2[145] KF7-320A.15[4] R301.23.ADV_calculation_1_1_2 /end FUNCTION_LIST /end CHARACTERISTIC
/begin CHARACTERISTIC mfPWSTV "Power steering valve excuse flag" VALUE 0x000086FB REC_UBYTE_C 0 COMP_0283 0 1 BIT_MASK 0x0008 /begin FUNCTION_LIST KF7-0.2[145] KF7-330.5[53] /end FUNCTION_LIST /end CHARACTERISTIC
/begin CHARACTERISTIC mfFACPDS "A/C Pd pressure sensor excuse choice" VALUE 0x000086FB REC_UBYTE_C 0 COMP_0283 0 1 BIT_MASK 0x0004
 /begin FUNCTION_LIST KF7-0.2[145] KF7-330.5[53] KF7-376.1[6] KF7-376.4[4] KF7-377.1A[19] /end FUNCTION_LIST
/end CHARACTERISTIC
/begin CHARACTERISTIC mIDOS4 "Specifications switching flag" VALUE 0x000086FC REC_UBYTE_C 0 COMP_0283 0 255
 /begin FUNCTION_LIST KF7-0.2[145] KF7-301.28[2] KF7-311.1A[21] KF7-312.1C[N] KF7-320A.1[6] KF7-330.4A[53] KF7-330.5[53] KF7-395.1[4] KF7-500.1[54] R000.1.RS_Integ_1_10_2 R301.6.IscAirflow_1_4_5 R301.23.ADV_calculation_1_1_2 R301.27.PWST_detection_1_0_2 /end FUNCTION_LIST
/end CHARACTERISTIC
/begin CHARACTERISTIC mfFBAROS "Atomospheric pressure sensor excuse" VALUE 0x000086FC REC_UBYTE_C 0 COMP_0283 0 1 BIT_MASK 0x0010 /begin FUNCTION_LIST KF7-0.2[145] KF7-500.1[54] /end FUNCTION_LIST /end CHARACTERISTIC
/begin CHARACTERISTIC mfPSS "P/S oil pressure sensor specifications choice flag" VALUE 0x000086FC REC_UBYTE_C 0 COMP_0283 0 1 BIT_MASK 0x0008
 /begin FUNCTION_LIST KF7-0.2[145] KF7-301.28[2] KF7-330.4A[53] KF7-330.5[53] R000.1.RS_Integ_1_10_2 R301.6.IscAirflow_1_4_5 R301.27.PWST_detection_1_0_2 /end FUNCTION_LIST
/end CHARACTERISTIC
/begin CHARACTERISTIC mfFISCV "At the time of the ECM internal organs ISCVvol use, un-use, switching flag" VALUE 0x000086FC REC_UBYTE_C 0 COMP_0283 0 1 BIT_MASK 0x0001 /begin FUNCTION_LIST KF7-0.2[145] KF7-330.4A[53] KF7-500.26[17] /end FUNCTION_LIST /end CHARACTERISTIC
/begin CHARACTERISTIC mIDOS5 "Specifications switching flag" VALUE 0x000086FD REC_UBYTE_C 0 COMP_0283 0 255
 /begin FUNCTION_LIST KF7-0.2[145] KF7-312.6[34] KF7-330.4A[53] KF7-360.9M[43] KF7-379.3[3] R000.1.RS_Integ_1_10_2 /end FUNCTION_LIST
/end CHARACTERISTIC
/begin CHARACTERISTIC mfREGGASI "Regular adaptation car specifications choice flag" VALUE 0x000086FD REC_UBYTE_C 0 COMP_0283 0 1 BIT_MASK 0x0080 /begin FUNCTION_LIST KF7-0.2[145] KF7-379.3[3] /end FUNCTION_LIST /end CHARACTERISTIC
/begin CHARACTERISTIC mfTASEN "Intake air temperature sensor specifications choice flag" VALUE 0x000086FD REC_UBYTE_C 0 COMP_0283 0 1 BIT_MASK 0x0001
 /begin FUNCTION_LIST KF7-0.2[145] KF7-330.4A[53] KF7-360.9M[43] R000.1.RS_Integ_1_10_2 /end FUNCTION_LIST
/end CHARACTERISTIC
/begin CHARACTERISTIC mIDSCI "ROM inclusion byte" VALUE 0x000086FF REC_UBYTE_C 0 COMP_0283 0 255 /begin FUNCTION_LIST KF7-0.2[145] /end FUNCTION_LIST /end CHARACTERISTIC
/begin CHARACTERISTIC mfFGVARI "Gear position variable control executive permission flag" VALUE 0x000086FF REC_UBYTE_C 0 COMP_0283 0 1 BIT_MASK 0x0008 /begin FUNCTION_LIST KF7-0.2[145] /end FUNCTION_LIST /end CHARACTERISTIC
/begin CHARACTERISTIC mfFPSR "PSR control switching flag" VALUE 0x000086FF REC_UBYTE_C 0 COMP_0283 0 1 BIT_MASK 0x0002 /begin FUNCTION_LIST KF7-0.2[145] KF7-312.6[34] /end FUNCTION_LIST /end CHARACTERISTIC
/begin CHARACTERISTIC mMFPRMM "Misfire judgement-type choice flag" VALUE 0x0000884F REC_UBYTE_C 0 COMP_0283 0 255 /begin FUNCTION_LIST KF7-0.2[145] KF7-500.26[17] /end FUNCTION_LIST /end CHARACTERISTIC
/begin CHARACTERISTIC mfKTIUSE "TINT compensation permission" VALUE 0x0000884F REC_UBYTE_C 0 COMP_0283 0 1 BIT_MASK 0x0080 /begin FUNCTION_LIST KF7-0.2[145] KF7-500.26[17] /end FUNCTION_LIST /end CHARACTERISTIC
/begin CHARACTERISTIC mO2S "O2 sensor position" VALUE 0x00008923 REC_UBYTE_C 0 COMP_0283 0 255 /begin FUNCTION_LIST KF7-0.2[145] R904.1.Gst_on_can_1_0_1 /end FUNCTION_LIST /end CHARACTERISTIC
/begin CHARACTERISTIC mfFO2B2 "Bank 2, sensor 1 O2/S excuse flag" VALUE 0x00008923 REC_UBYTE_C 0 COMP_0283 0 1 BIT_MASK 0x0010 /begin FUNCTION_LIST KF7-0.2[145] /end FUNCTION_LIST /end CHARACTERISTIC
/begin CHARACTERISTIC mOBDSW "OBD function choice flag" VALUE 0x0000892B REC_UBYTE_C 0 COMP_0283 0 255
 /begin FUNCTION_LIST KF7-0.2[145] KF7-301.19[8] KF7-314.1F[1] KF7-500.21[19] R904.1.Gst_on_can_1_0_1 /end FUNCTION_LIST
/end CHARACTERISTIC
/begin CHARACTERISTIC mfCJST2 "It is chosen repeatedly." VALUE 0x0000892B REC_UBYTE_C 0 COMP_0283 0 1 BIT_MASK 0x0080 /begin FUNCTION_LIST KF7-0.2[145] KF7-500.21[19] /end FUNCTION_LIST /end CHARACTERISTIC
/begin CHARACTERISTIC mfFLEET "FLEET experiment car" VALUE 0x0000892B REC_UBYTE_C 0 COMP_0283 0 1 BIT_MASK 0x0020 /begin FUNCTION_LIST KF7-0.2[145] KF7-500.21[19] /end FUNCTION_LIST /end CHARACTERISTIC
/begin CHARACTERISTIC mfFCATS "Stage choice" VALUE 0x0000892B REC_UBYTE_C 0 COMP_0283 0 1 BIT_MASK 0x0010 /begin FUNCTION_LIST KF7-0.2[145] KF7-500.21[19] /end FUNCTION_LIST /end CHARACTERISTIC
/begin CHARACTERISTIC mfCATDGN "Experiment choice" VALUE 0x0000892B REC_UBYTE_C 0 COMP_0283 0 1 BIT_MASK 0x0004 /begin FUNCTION_LIST KF7-0.2[145] KF7-500.21[19] /end FUNCTION_LIST /end CHARACTERISTIC
/begin CHARACTERISTIC mfFMRKMR "The whole area reflection learning value KMR region addition switch" VALUE 0x0000892B REC_UBYTE_C 0 COMP_0283 0 1 BIT_MASK 0x0002 /begin FUNCTION_LIST KF7-0.2[145] KF7-314.1F[1] /end FUNCTION_LIST /end CHARACTERISTIC
/begin CHARACTERISTIC mOBDSW2 "OBD function choice flag" VALUE 0x0000892C REC_UBYTE_C 0 COMP_0283 0 255 /begin FUNCTION_LIST KF7-0.2[145] KF7-301.19[8] KF7-330.5[53] KF7-351.3[11] /end FUNCTION_LIST /end CHARACTERISTIC
/begin CHARACTERISTIC mfFEVAP5 "Line pressure sensor switching flag" VALUE 0x0000892C REC_UBYTE_C 0 COMP_0283 0 1 BIT_MASK 0x0080 /begin FUNCTION_LIST KF7-0.2[145] KF7-301.19[8] KF7-330.5[53] KF7-351.3[11] /end FUNCTION_LIST /end CHARACTERISTIC
/begin CHARACTERISTIC mOBDSW3 "OBD function choice flag" VALUE 0x0000892D REC_UBYTE_C 0 COMP_0283 0 255 /begin FUNCTION_LIST KF7-0.2[145] KF7-301.19[8] KF7-500.21[19] /end FUNCTION_LIST /end CHARACTERISTIC
/begin CHARACTERISTIC mfPAMB00 "Atomospheric pressure reference value PAMB00 fixed switching flag" VALUE 0x0000892D REC_UBYTE_C 0 COMP_0283 0 1 BIT_MASK 0x0040 /begin FUNCTION_LIST KF7-0.2[145] KF7-301.19[8] /end FUNCTION_LIST /end CHARACTERISTIC
/begin CHARACTERISTIC mfEVF2NG "Judgement criteria switching flag" VALUE 0x0000892D REC_UBYTE_C 0 COMP_0283 0 1 BIT_MASK 0x0010 /begin FUNCTION_LIST KF7-0.2[145] /end FUNCTION_LIST /end CHARACTERISTIC
/begin CHARACTERISTIC mOBDSW4 "OBD function choice flag" VALUE 0x0000892E REC_UBYTE_C 0 COMP_0283 0 255 /begin FUNCTION_LIST KF7-0.2[145] /end FUNCTION_LIST /end CHARACTERISTIC
/begin CHARACTERISTIC mfFMRKMR2 "KBLRC addition prohibition condition choice flag" VALUE 0x0000892E REC_UBYTE_C 0 COMP_0283 0 1 BIT_MASK 0x0010 /begin FUNCTION_LIST KF7-0.2[145] /end FUNCTION_LIST /end CHARACTERISTIC
/begin CHARACTERISTIC mOSCSW "ROM inclusion byte" VALUE 0x0000895F REC_UBYTE_C 0 COMP_0283 0 255 /begin FUNCTION_LIST KF7-0.2[145] KF7-313C.11B[1] /end FUNCTION_LIST /end CHARACTERISTIC
/begin CHARACTERISTIC mfCATCNG "Catalyst diagnosis slice setup region switching" VALUE 0x0000895F REC_UBYTE_C 0 COMP_0283 0 1 BIT_MASK 0x0080 /begin FUNCTION_LIST KF7-0.2[145] KF7-313C.1[36] /end FUNCTION_LIST /end CHARACTERISTIC
/begin CHARACTERISTIC mfPREDAF "The existence of the SMC prediction A/F" VALUE 0x0000895F REC_UBYTE_C 0 COMP_0283 0 1 BIT_MASK 0x0040 /begin FUNCTION_LIST KF7-0.2[145] KF7-313C.1[36] /end FUNCTION_LIST /end CHARACTERISTIC
/begin CHARACTERISTIC mfOSCBANK "A control choice flag for the bank" VALUE 0x0000895F REC_UBYTE_C 0 COMP_0283 0 1 BIT_MASK 0x0020 /begin FUNCTION_LIST KF7-0.2[145] /end FUNCTION_LIST /end CHARACTERISTIC
/begin CHARACTERISTIC mfAFIDLESW "IDLE SW enable, disable switching flag" VALUE 0x0000895F REC_UBYTE_C 0 COMP_0283 0 1 BIT_MASK 0x0010 /begin FUNCTION_LIST KF7-0.2[145] /end FUNCTION_LIST /end CHARACTERISTIC
/begin CHARACTERISTIC mfAFVSEL "A/F voltage sampling periodic choice flag" VALUE 0x0000895F REC_UBYTE_C 0 COMP_0283 0 1 BIT_MASK 0x0008 /begin FUNCTION_LIST KF7-0.2[145] /end FUNCTION_LIST /end CHARACTERISTIC
/begin CHARACTERISTIC mfAFDCHG "Time switching, slice switching choice flag" VALUE 0x0000895F REC_UBYTE_C 0 COMP_0283 0 1 BIT_MASK 0x0004 /begin FUNCTION_LIST KF7-0.2[145] /end FUNCTION_LIST /end CHARACTERISTIC
/begin CHARACTERISTIC mfAFDTGCLP "Target A/F It is fixed on mABFCMV." VALUE 0x0000895F REC_UBYTE_C 0 COMP_0283 0 1 BIT_MASK 0x0002 /begin FUNCTION_LIST KF7-0.2[145] /end FUNCTION_LIST /end CHARACTERISTIC
/begin CHARACTERISTIC mfAFDSEL "Alpha form, Target form choice flag" VALUE 0x0000895F REC_UBYTE_C 0 COMP_0283 0 1 BIT_MASK 0x0001 /begin FUNCTION_LIST KF7-0.2[145] /end FUNCTION_LIST /end CHARACTERISTIC
/begin CHARACTERISTIC mPLTFRM "ROM inclusion byte" VALUE 0x000089AB REC_UBYTE_C 0 COMP_0283 0 255
 /begin FUNCTION_LIST KF7-0.2[145] KF7-312.2A[16] KF7-360.9M[43] KF7-360.9P[22] KF7-385.2[18] KF7-410.10[6] R301.9.Target_Equivalent_Ratio_1_0_2 /end FUNCTION_LIST
/end CHARACTERISTIC
/begin CHARACTERISTIC mfPWTSPFAL "ErgonomicPedal Invalid treatment choice SW" VALUE 0x000089AB REC_UBYTE_C 0 COMP_0283 0 1 BIT_MASK 0x0004 /begin FUNCTION_LIST KF7-0.2[145] KF7-410.10[6] /end FUNCTION_LIST /end CHARACTERISTIC
/begin CHARACTERISTIC mfFLAG8TRQ "8bit torque CAN choice flag" VALUE 0x000089AB REC_UBYTE_C 0 COMP_0283 0 1 BIT_MASK 0x0002 /begin FUNCTION_LIST KF7-0.2[145] KF7-410.10[6] /end FUNCTION_LIST /end CHARACTERISTIC
/begin CHARACTERISTIC mPTDSW "PTD specifications choice SW" VALUE 0x000089F0 REC_UBYTE_C 0 COMP_0283 0 255
 /begin FUNCTION_LIST KF7-0.2[145] KF7-340.1M[8] KF7-340.1P[7] KF7-340.3M[1] KF7-340.3P[2] KF7-340.5[4] KF7-340.5P[2] KF7-340.6M[2] KF7-340.6P[2] KF7-340.7[4] KF7-340.8M[8] KF7-340.8P[8] KF7-340.13[4] KF7-360.7M[9] KF7-360.7P[8] KF7-410.19[2] KF7-505.47[3] KF7-505.49[3] R301.20.AmbientComp_1_0_2 /end FUNCTION_LIST
/end CHARACTERISTIC
/begin CHARACTERISTIC mfTTE_ON "Torque TTE control choice flag" VALUE 0x000089F0 REC_UBYTE_C 0 COMP_0283 0 1 BIT_MASK 0x0040
 /begin FUNCTION_LIST KF7-0.2[145] KF7-410.17M[5] KF7-410.17P[1] R301.20.AmbientComp_1_0_2 /end FUNCTION_LIST
/end CHARACTERISTIC
/begin CHARACTERISTIC mfTFD_ON "Drive power TFD control choice flag" VALUE 0x000089F0 REC_UBYTE_C 0 COMP_0283 0 1 BIT_MASK 0x0020
 /begin FUNCTION_LIST KF7-0.2[145] KF7-340.3M[1] KF7-340.3P[2] KF7-340.5[4] KF7-340.5P[2] KF7-340.6M[2] KF7-340.6P[2] KF7-340.8M[8] KF7-340.8P[8] KF7-340.13[4] KF7-410.19[2] KF7-505.47[3] KF7-505.49[3] /end FUNCTION_LIST
/end CHARACTERISTIC
/begin CHARACTERISTIC mfTFDCVT "A drive power choice flag for the CVT transmission" VALUE 0x000089F0 REC_UBYTE_C 0 COMP_0283 0 1 BIT_MASK 0x0004 /begin FUNCTION_LIST KF7-0.2[145] KF7-340.7[4] KF7-340.8M[8] KF7-340.8P[8] /end FUNCTION_LIST /end CHARACTERISTIC
/begin CHARACTERISTIC mfPTD_ON "Drive power demand control ON/ off flag" VALUE 0x000089F0 REC_UBYTE_C 0 COMP_0283 0 1 BIT_MASK 0x0001 /begin FUNCTION_LIST KF7-0.2[145] KF7-340.7[4] /end FUNCTION_LIST /end CHARACTERISTIC
/begin CHARACTERISTIC mPTDSW2 "PTD related control choice SW inclusion byte" VALUE 0x000089F1 REC_UBYTE_C 0 COMP_0283 0 255
 /begin FUNCTION_LIST KF7-0.2[145] KF7-340.1M[8] KF7-340.5P[2] KF7-340.8M[8] KF7-340.8P[8] KF7-410.19[2] /end FUNCTION_LIST
/end CHARACTERISTIC
/begin CHARACTERISTIC mfFNETQHOS "Speed torque compensation control ON/ off flag" VALUE 0x000089F1 REC_UBYTE_C 0 COMP_0283 0 1 BIT_MASK 0x0020 /begin FUNCTION_LIST KF7-0.2[145] KF7-340.8M[8] KF7-340.8P[8] /end FUNCTION_LIST /end CHARACTERISTIC
/begin CHARACTERISTIC mfFHHTQHOS "Highlands, heat ground compensation control ON/ off flag" VALUE 0x000089F1 REC_UBYTE_C 0 COMP_0283 0 1 BIT_MASK 0x0010 /begin FUNCTION_LIST KF7-0.2[145] KF7-340.1M[8] KF7-340.1P[7] /end FUNCTION_LIST /end CHARACTERISTIC
/begin CHARACTERISTIC mfFZADDFD "A control ON/ off flag for the area attribute" VALUE 0x000089F1 REC_UBYTE_C 0 COMP_0283 0 1 BIT_MASK 0x0002 /begin FUNCTION_LIST KF7-0.2[145] KF7-340.8M[8] KF7-340.8P[8] /end FUNCTION_LIST /end CHARACTERISTIC
/begin CHARACTERISTIC mfFADDFD "A control ON/ off flag for the running resistance" VALUE 0x000089F1 REC_UBYTE_C 0 COMP_0283 0 1 BIT_MASK 0x0001 /begin FUNCTION_LIST KF7-0.2[145] KF7-340.8M[8] KF7-340.8P[8] /end FUNCTION_LIST /end CHARACTERISTIC
/begin CHARACTERISTIC mSOBDSW "OBD function choice flag 2" VALUE 0x00008B16 REC_UBYTE_C 0 COMP_0283 0 255
 /begin FUNCTION_LIST KF7-0.2[145] KF7-313C.4[3] KF7-313C.5[3] KF7-500.24[10] KF7-500.26[17] KF7-500.74B[5] KF7-580.1[8] /end FUNCTION_LIST
/end CHARACTERISTIC
/begin CHARACTERISTIC mfEVPLNP "A leak-down release condition distinction for the evapo" VALUE 0x00008B16 REC_UBYTE_C 0 COMP_0283 0 1 BIT_MASK 0x0080 /begin FUNCTION_LIST KF7-0.2[145] /end FUNCTION_LIST /end CHARACTERISTIC
/begin CHARACTERISTIC mfFROSEL "A distinction for the evapo" VALUE 0x00008B16 REC_UBYTE_C 0 COMP_0283 0 1 BIT_MASK 0x0040 /begin FUNCTION_LIST KF7-0.2[145] KF7-500.24[10] KF7-580.1[8] /end FUNCTION_LIST /end CHARACTERISTIC
/begin CHARACTERISTIC mfAFSDIAG "A/F sensor response diagnosis form choice flag" VALUE 0x00008B16 REC_UBYTE_C 0 COMP_0283 0 1 BIT_MASK 0x0020 /begin FUNCTION_LIST KF7-0.2[145] KF7-500.74B[5] /end FUNCTION_LIST /end CHARACTERISTIC
/begin CHARACTERISTIC mfMFSTSW "A misfire diagnosis for the switching flag" VALUE 0x00008B16 REC_UBYTE_C 0 COMP_0283 0 1 BIT_MASK 0x0008 /begin FUNCTION_LIST KF7-0.2[145] KF7-500.26[17] /end FUNCTION_LIST /end CHARACTERISTIC
/begin CHARACTERISTIC mfGSTM8 "A flag for the GST mode 8" VALUE 0x00008B16 REC_UBYTE_C 0 COMP_0283 0 1 BIT_MASK 0x0004 /begin FUNCTION_LIST KF7-0.2[145] /end FUNCTION_LIST /end CHARACTERISTIC
/begin CHARACTERISTIC mfGSTM67 "GST mode 6, a flag for 7" VALUE 0x00008B16 REC_UBYTE_C 0 COMP_0283 0 1 BIT_MASK 0x0002 /begin FUNCTION_LIST KF7-0.2[145] /end FUNCTION_LIST /end CHARACTERISTIC
/begin CHARACTERISTIC mfRATECLR "Prohibition of permission/of the Rate law counter clear treatment" VALUE 0x00008B16 REC_UBYTE_C 0 COMP_0283 0 1 BIT_MASK 0x0001 /begin FUNCTION_LIST KF7-0.2[145] /end FUNCTION_LIST /end CHARACTERISTIC
/begin CHARACTERISTIC mSOBSW2 "OBD function choice flag" VALUE 0x00008B17 REC_UBYTE_C 0 COMP_0283 0 255 /begin FUNCTION_LIST KF7-0.2[145] KF7-500.24[10] KF7-500.74[11] /end FUNCTION_LIST /end CHARACTERISTIC
/begin CHARACTERISTIC mfRO2OUS "RrO2/S response time diagnosis stage 2 diagnosis execution judgement" VALUE 0x00008B17 REC_UBYTE_C 0 COMP_0283 0 1 BIT_MASK 0x0080 /begin FUNCTION_LIST KF7-0.2[145] KF7-500.24[10] /end FUNCTION_LIST /end CHARACTERISTIC
/begin CHARACTERISTIC mfRO2IZS "RrO2/S Unusual voltage diagnosis stage 2 diagnosis execution judgement" VALUE 0x00008B17 REC_UBYTE_C 0 COMP_0283 0 1 BIT_MASK 0x0040 /begin FUNCTION_LIST KF7-0.2[145] KF7-500.24[10] /end FUNCTION_LIST /end CHARACTERISTIC
/begin CHARACTERISTIC mfAFSMF "Misfire diagnosis NG éû learning permission flag" VALUE 0x00008B17 REC_UBYTE_C 0 COMP_0283 0 1 BIT_MASK 0x0020 /begin FUNCTION_LIST KF7-0.2[145] KF7-313C.4[3] /end FUNCTION_LIST /end CHARACTERISTIC
/begin CHARACTERISTIC mfHOSMF "Misfire diagnosis NG éû learning permission flag" VALUE 0x00008B17 REC_UBYTE_C 0 COMP_0283 0 1 BIT_MASK 0x0010 /begin FUNCTION_LIST KF7-0.2[145] KF7-313C.5[3] /end FUNCTION_LIST /end CHARACTERISTIC
/begin CHARACTERISTIC mfHOSKIN "HOSCMAX learning prohibition flag" VALUE 0x00008B17 REC_UBYTE_C 0 COMP_0283 0 1 BIT_MASK 0x0008 /begin FUNCTION_LIST KF7-0.2[145] KF7-313C.5[3] /end FUNCTION_LIST /end CHARACTERISTIC
/begin CHARACTERISTIC mfAFHZLR "A/F sensor LR response diagnosis judgement" VALUE 0x00008B17 REC_UBYTE_C 0 COMP_0283 0 1 BIT_MASK 0x0001 /begin FUNCTION_LIST KF7-0.2[145] KF7-500.74[11] /end FUNCTION_LIST /end CHARACTERISTIC
/begin CHARACTERISTIC mSpecADV "ROM inclusion byte" VALUE 0x00008B60 REC_UBYTE_C 0 COMP_0283 0 255
 /begin FUNCTION_LIST KF7-0.2[145] KF7-379.3[3] KF7-385.1[32] KF7-385.2[18] KF7-390.3A[15] KF7-500.12[3] /end FUNCTION_LIST
/end CHARACTERISTIC
/begin CHARACTERISTIC mfFKNK "Knock control switching flag" VALUE 0x00008B60 REC_UBYTE_C 0 COMP_0283 0 1 BIT_MASK 0x0080 /begin FUNCTION_LIST KF7-0.2[145] KF7-379.2[1] KF7-379.3[3] KF7-500.12[3] /end FUNCTION_LIST /end CHARACTERISTIC
/begin CHARACTERISTIC mfFREGDT "At the time of the regular judgement, DUETTE control flag" VALUE 0x00008B60 REC_UBYTE_C 0 COMP_0283 0 1 BIT_MASK 0x0040 /begin FUNCTION_LIST KF7-0.2[145] KF7-385.1[32] KF7-385.2[18] /end FUNCTION_LIST /end CHARACTERISTIC
/begin CHARACTERISTIC mfKNKTYP2 "Single 2 gain, twin 2 gain choice flag" VALUE 0x00008B60 REC_UBYTE_C 0 COMP_0283 0 1 BIT_MASK 0x0008 /begin FUNCTION_LIST KF7-0.2[145] KF7-301.15[4] KF7-379.1[9] KF7-500.12[3] /end FUNCTION_LIST /end CHARACTERISTIC
/begin CHARACTERISTIC mfADVFB "At the time of the N-D select, retard limitation" VALUE 0x00008B60 REC_UBYTE_C 0 COMP_0283 0 1 BIT_MASK 0x0004 /begin FUNCTION_LIST KF7-0.2[145] KF7-390.3A[15] /end FUNCTION_LIST /end CHARACTERISTIC
/begin CHARACTERISTIC mfFFULTRM "At the time of the full increase, trimming-map compensation judgement" VALUE 0x00008B60 REC_UBYTE_C 0 COMP_0283 0 1 BIT_MASK 0x0002 /begin FUNCTION_LIST KF7-0.2[145] KF7-320A.9[9] /end FUNCTION_LIST /end CHARACTERISTIC
/begin CHARACTERISTIC mSpecDIRCT "ROM inclusion byte" VALUE 0x00008B62 REC_UBYTE_C 0 COMP_0283 0 255
 /begin FUNCTION_LIST KF7-0.2[145] KF7-302.5M[10] KF7-304.1B[5] KF7-312.6[34] KF7-320A.1[6] KF7-320A.9[9] KF7-340.3P[2] KF7-340.5P[2] KF7-340.6P[2] KF7-340.8P[8] KF7-340.9M[3] KF7-340.9P[3] KF7-360.9M[43] KF7-360.9P[22] KF7-376.2[21] KF7-385.1[32] KF7-385.2[18] KF7-410.19[2] KF7-410.20[N] KF7-500.6D[9] R000.1.RS_Integ_1_10_2 R301.5.FuelCut_1_2_2 R301.6.IscAirflow_1_4_5 R301.8.Inverse_filter_1_1_3 R301.12.ClutchSwDiag_1_0_1 R301.20.AmbientComp_1_0_2 R301.23.ADV_calculation_1_1_2 R301.28.StarterSwitch_1_0_2 /end FUNCTION_LIST
/end CHARACTERISTIC
/begin CHARACTERISTIC mfATMT "A/T car, M/T car distinction flag" VALUE 0x00008B62 REC_UBYTE_C 0 COMP_0283 0 1 BIT_MASK 0x0080 DISPLAY_IDENTIFIER Cbx_gbx_conf
 /begin FUNCTION_LIST KF7-0.2[145] KF7-302.4MA[13] KF7-302.5M[10] KF7-302.6A[4] KF7-303.1[14] KF7-312.6[34] KF7-320A.1[6] KF7-320A.2[3] KF7-330.4A[53] KF7-330.5[53] KF7-340.3M[1] KF7-340.3P[2] KF7-340.5P[2] KF7-340.6M[2] KF7-340.6P[2] KF7-340.8M[8] KF7-340.8P[8] KF7-340.9M[3] KF7-340.9P[3] KF7-360.9M[43] KF7-360.9P[22] KF7-376.2[21] KF7-385.1[32] KF7-385.2[18] KF7-410.19[2] KF7-500.6D[9] R000.1.RS_Integ_1_10_2 R108.1.dls_gbrat_vmm_1_1_5 R204.1.CanComm_1_9_2 R301.5.FuelCut_1_2_2 R301.6.IscAirflow_1_4_5 R301.8.Inverse_filter_1_1_3 R301.12.ClutchSwDiag_1_0_1 R301.20.AmbientComp_1_0_2 R301.23.ADV_calculation_1_1_2 R301.26.Dashpot_DandN_1_0_2 R301.28.StarterSwitch_1_0_2 /end FUNCTION_LIST
/end CHARACTERISTIC
/begin CHARACTERISTIC mfFATTRQ "Torque control switching flag" VALUE 0x00008B62 REC_UBYTE_C 0 COMP_0283 0 1 BIT_MASK 0x0010
 /begin FUNCTION_LIST KF7-0.2[145] KF7-360.9M[43] KF7-360.9P[22] KF7-385.2[18] KF7-386.1[4] KF7-386.2[4] /end FUNCTION_LIST
/end CHARACTERISTIC
/begin CHARACTERISTIC mfATTNS "AT turbine sensor excuse judgement" VALUE 0x00008B62 REC_UBYTE_C 0 COMP_0283 0 1 BIT_MASK 0x0008 /begin FUNCTION_LIST KF7-0.2[145] KF7-312.6[34] KF7-330.9[8] /end FUNCTION_LIST /end CHARACTERISTIC
/begin CHARACTERISTIC mfRATIOFB "Ratio F/B control choice flag" VALUE 0x00008B62 REC_UBYTE_C 0 COMP_0283 0 1 BIT_MASK 0x0004 /begin FUNCTION_LIST KF7-0.2[145] /end FUNCTION_LIST /end CHARACTERISTIC
/begin CHARACTERISTIC mfREGHOS "There is TENG regular compensation, no" VALUE 0x00008B62 REC_UBYTE_C 0 COMP_0283 0 1 BIT_MASK 0x0002 /begin FUNCTION_LIST KF7-0.2[145] KF7-320A.9[9] /end FUNCTION_LIST /end CHARACTERISTIC
/begin CHARACTERISTIC mfCOADJ "A CO adjustment control excuse by the CONSULT communication" VALUE 0x00008B62 REC_UBYTE_C 0 COMP_0283 0 1 BIT_MASK 0x0001 /begin FUNCTION_LIST KF7-0.2[145] KF7-304.1B[5] /end FUNCTION_LIST /end CHARACTERISTIC
/begin CHARACTERISTIC mSpecEGI "ROM inclusion byte" VALUE 0x00008B63 REC_UBYTE_C 0 COMP_0283 0 255 /begin FUNCTION_LIST KF7-0.2[145] /end FUNCTION_LIST /end CHARACTERISTIC
/begin CHARACTERISTIC mfISCKH "KATHOS choice flag" VALUE 0x00008B63 REC_UBYTE_C 0 COMP_0283 0 1 BIT_MASK 0x0004 /begin FUNCTION_LIST KF7-0.2[145] KF7-312.4A[6] KF7-312.4C[4] /end FUNCTION_LIST /end CHARACTERISTIC
/begin CHARACTERISTIC mSpecOTHER "ROM inclusion byte" VALUE 0x00008B64 REC_UBYTE_C 0 COMP_0283 0 255 /begin FUNCTION_LIST KF7-0.2[145] KF7-351.3[11] R000.1.RS_Integ_1_10_2 /end FUNCTION_LIST /end CHARACTERISTIC
/begin CHARACTERISTIC mfFALRN "An off-line idle learning lambda control condition" VALUE 0x00008B64 REC_UBYTE_C 0 COMP_0283 0 1 BIT_MASK 0x0080 /begin FUNCTION_LIST KF7-0.2[145] KF7-351.1[16] /end FUNCTION_LIST /end CHARACTERISTIC
/begin CHARACTERISTIC mfFQINT "Off-line idle learning flag #FQLRN initial value" VALUE 0x00008B64 REC_UBYTE_C 0 COMP_0283 0 1 BIT_MASK 0x0040 /begin FUNCTION_LIST KF7-0.2[145] KF7-351.3[11] R000.1.RS_Integ_1_10_2 /end FUNCTION_LIST /end CHARACTERISTIC
/begin CHARACTERISTIC mSpecVARI "ROM inclusion byte" VALUE 0x00008B65 REC_UBYTE_C 0 COMP_0283 0 255 /begin FUNCTION_LIST KF7-0.2[145] KF7-460.1[6] /end FUNCTION_LIST /end CHARACTERISTIC
/begin CHARACTERISTIC mfVADV "Ignition variable control requirement flag" VALUE 0x00008B65 REC_UBYTE_C 0 COMP_0283 0 1 BIT_MASK 0x0080 /begin FUNCTION_LIST KF7-0.2[145] KF7-460.1[6] /end FUNCTION_LIST /end CHARACTERISTIC
/begin CHARACTERISTIC mfVKNK "An ignition variable control requirement flag by the cylinder" VALUE 0x00008B65 REC_UBYTE_C 0 COMP_0283 0 1 BIT_MASK 0x0040 /begin FUNCTION_LIST KF7-0.2[145] KF7-460.1[6] /end FUNCTION_LIST /end CHARACTERISTIC
/begin CHARACTERISTIC mfFVKTRM "KTRM variable control requirement flag" VALUE 0x00008B65 REC_UBYTE_C 0 COMP_0283 0 1 BIT_MASK 0x0020 /begin FUNCTION_LIST KF7-0.2[145] KF7-313C.1[36] KF7-314.1F[1] KF7-460.1[6] /end FUNCTION_LIST /end CHARACTERISTIC
/begin CHARACTERISTIC mfVEGR "-" VALUE 0x00008B65 REC_UBYTE_C 0 COMP_0283 0 1 BIT_MASK 0x0010 /begin FUNCTION_LIST KF7-0.2[145] KF7-460.1[6] KF7-580.1[8] /end FUNCTION_LIST /end CHARACTERISTIC
/begin CHARACTERISTIC mfVVTC "-" VALUE 0x00008B65 REC_UBYTE_C 0 COMP_0283 0 1 BIT_MASK 0x0002 /begin FUNCTION_LIST KF7-0.2[145] KF7-460.1[6] /end FUNCTION_LIST /end CHARACTERISTIC
/begin CHARACTERISTIC mfANADEG "Digital variable control switching flag" VALUE 0x00008B65 REC_UBYTE_C 0 COMP_0283 0 1 BIT_MASK 0x0001 /begin FUNCTION_LIST KF7-0.2[145] KF7-460.1[6] /end FUNCTION_LIST /end CHARACTERISTIC
/begin CHARACTERISTIC mSWASCD "ASCD specifications choice SW" VALUE 0x00008B4E REC_UBYTE_C 0 COMP_0283 0 255
 /begin FUNCTION_LIST KF7-0.2[145] KF7-301.25M[5] KF7-301.25P[5] KF7-340.8M[8] KF7-340.8P[8] KF7-410.10[6] KF7-410.20[N] KF7-505.27[4] /end FUNCTION_LIST
/end CHARACTERISTIC
/begin CHARACTERISTIC mfFLGACC "ACC choice SW" VALUE 0x00008B4E REC_UBYTE_C 0 COMP_0283 0 1 BIT_MASK 0x0002
 /begin FUNCTION_LIST KF7-0.2[145] KF7-340.8M[8] KF7-340.8P[8] KF7-410.10[6] KF7-505.27[4] /end FUNCTION_LIST
/end CHARACTERISTIC
/begin CHARACTERISTIC mfFASCD "ASCD executive flag" VALUE 0x00008B4E REC_UBYTE_C 0 COMP_0283 0 1 BIT_MASK 0x0001
 /begin FUNCTION_LIST KF7-0.2[145] KF7-301.25M[5] KF7-301.25P[5] KF7-340.8M[8] KF7-340.8P[8] KF7-410.10[6] KF7-410.20[N] /end FUNCTION_LIST
/end CHARACTERISTIC
/begin CHARACTERISTIC mSWASCD2 "ASCD control for the choice SW" VALUE 0x00008B4F REC_UBYTE_C 0 COMP_0283 0 255 /begin FUNCTION_LIST KF7-0.2[145] KF7-340.5[4] KF7-410.10[6] KF7-410.19[2] /end FUNCTION_LIST /end CHARACTERISTIC
/begin CHARACTERISTIC mfPTDASCD "At the time of ASCD, PTD open-degree operation switching flag" VALUE 0x00008B4F REC_UBYTE_C 0 COMP_0283 0 1 BIT_MASK 0x0040 /begin FUNCTION_LIST KF7-0.2[145] KF7-340.5[4] KF7-410.19[2] /end FUNCTION_LIST /end CHARACTERISTIC
/begin CHARACTERISTIC mSWDOS "DOS control switching SW" VALUE 0x00008B50 REC_UBYTE_C 0 COMP_0283 0 255 /begin FUNCTION_LIST KF7-0.2[145] KF7-301.4[3] /end FUNCTION_LIST /end CHARACTERISTIC
/begin CHARACTERISTIC mfF2IN1 "O2/S system choice" VALUE 0x00008B50 REC_UBYTE_C 0 COMP_0283 0 1 BIT_MASK 0x0004 /begin FUNCTION_LIST KF7-0.2[145] KF7-301.4[3] KF7-500.21[19] /end FUNCTION_LIST /end CHARACTERISTIC
/begin CHARACTERISTIC mSWDSA "ROM flag inclusion byte" VALUE 0x00008B51 REC_UBYTE_C 0 COMP_0283 0 255 /begin FUNCTION_LIST KF7-0.2[145] KF7-410.3[N] /end FUNCTION_LIST /end CHARACTERISTIC
/begin CHARACTERISTIC mfDSASW "Driving mode factor manual setup flag" VALUE 0x00008B51 REC_UBYTE_C 0 COMP_0283 0 1 BIT_MASK 0x0020 /begin FUNCTION_LIST KF7-0.2[145] KF7-410.3[N] /end FUNCTION_LIST /end CHARACTERISTIC
/begin CHARACTERISTIC mfSWAPOFAC "Normalized pedal pushing speed operation pedal condition choice flag" VALUE 0x00008B51 REC_UBYTE_C 0 COMP_0283 0 1 BIT_MASK 0x0010 /begin FUNCTION_LIST KF7-0.2[145] KF7-410.3[N] /end FUNCTION_LIST /end CHARACTERISTIC
/begin CHARACTERISTIC mSWETD "ROM flag inclusion byte" VALUE 0x00008B52 REC_UBYTE_C 0 COMP_0283 0 255 /begin FUNCTION_LIST KF7-0.2[145] KF7-301.25[11] KF7-351.1[16] /end FUNCTION_LIST /end CHARACTERISTIC
/begin CHARACTERISTIC mfFETDEN "Control switching flag" VALUE 0x00008B52 REC_UBYTE_C 0 COMP_0283 0 1 BIT_MASK 0x0001 /begin FUNCTION_LIST KF7-0.2[145] KF7-301.25[11] KF7-351.1[16] KF7-351.2[17] /end FUNCTION_LIST /end CHARACTERISTIC
/begin CHARACTERISTIC mSWETD3 "ROM flag inclusion byte" VALUE 0x00008B54 REC_UBYTE_C 0 COMP_0283 0 255 /begin FUNCTION_LIST KF7-0.2[145] KF7-304.9[2] KF7-304.13[N] KF7-351.3[11] /end FUNCTION_LIST /end CHARACTERISTIC
/begin CHARACTERISTIC mfQH0ETD "QH0 operation for the choice flag" VALUE 0x00008B54 REC_UBYTE_C 0 COMP_0283 0 1 BIT_MASK 0x0040 /begin FUNCTION_LIST KF7-0.2[145] KF7-304.9[2] KF7-304.13[N] /end FUNCTION_LIST /end CHARACTERISTIC
/begin CHARACTERISTIC mSWREG "ROM inclusion byte" VALUE 0x00008B57 REC_UBYTE_C 0 COMP_0283 0 255 /begin FUNCTION_LIST KF7-0.2[145] KF7-312.6[34] KF7-460.1[6] /end FUNCTION_LIST /end CHARACTERISTIC
/begin CHARACTERISTIC mfOVH_FC "At the time of the overheat, fuel cut control flag" VALUE 0x00008B57 REC_UBYTE_C 0 COMP_0283 0 1 BIT_MASK 0x0080 /begin FUNCTION_LIST KF7-0.2[145] KF7-312.6[34] /end FUNCTION_LIST /end CHARACTERISTIC
/begin CHARACTERISTIC mfFCHVER "ETD adoption engine variable control switching flag" VALUE 0x00008B57 REC_UBYTE_C 0 COMP_0283 0 1 BIT_MASK 0x0010 /begin FUNCTION_LIST KF7-0.2[145] KF7-312.6[34] KF7-460.1[6] /end FUNCTION_LIST /end CHARACTERISTIC
/begin CHARACTERISTIC mfFVTFA0 "TFBYA0 variable control switching flag" VALUE 0x00008B57 REC_UBYTE_C 0 COMP_0283 0 1 BIT_MASK 0x0002 /begin FUNCTION_LIST KF7-0.2[145] KF7-313C.1[36] KF7-314.1F[1] KF7-460.1[6] /end FUNCTION_LIST /end CHARACTERISTIC
/begin CHARACTERISTIC mfFVTIM "TITM variable control switching flag" VALUE 0x00008B57 REC_UBYTE_C 0 COMP_0283 0 1 BIT_MASK 0x0001 /begin FUNCTION_LIST KF7-0.2[145] KF7-460.1[6] /end FUNCTION_LIST /end CHARACTERISTIC
/begin CHARACTERISTIC mSWREG2 "Control executive switching flag" VALUE 0x00008B58 REC_UBYTE_C 0 COMP_0283 0 255 /begin FUNCTION_LIST KF7-0.2[145] KF7-305.1[7] KF7-330.1M[3] KF7-360.9M[43] /end FUNCTION_LIST /end CHARACTERISTIC
/begin CHARACTERISTIC mfAPOTD "Torque going down control executive flag" VALUE 0x00008B58 REC_UBYTE_C 0 COMP_0283 0 1 BIT_MASK 0x0080 /begin FUNCTION_LIST KF7-0.2[145] KF7-360.9M[43] /end FUNCTION_LIST /end CHARACTERISTIC
/begin CHARACTERISTIC mfFTASEEP "ISCLRC EEPROM writing choice" VALUE 0x00008B58 REC_UBYTE_C 0 COMP_0283 0 1 BIT_MASK 0x0040 /begin FUNCTION_LIST KF7-0.2[145] KF7-305.1[7] KF7-305.4AM[10] /end FUNCTION_LIST /end CHARACTERISTIC
/begin CHARACTERISTIC mfFVTCS "TCS fuel cut variable control flag" VALUE 0x00008B58 REC_UBYTE_C 0 COMP_0283 0 1 BIT_MASK 0x0010 /begin FUNCTION_LIST KF7-0.2[145] /end FUNCTION_LIST /end CHARACTERISTIC
/begin CHARACTERISTIC mSWREG3 "Specifications switching flag inclusion ROM" VALUE 0x00008B59 REC_UBYTE_C 0 COMP_0283 0 255 /begin FUNCTION_LIST KF7-0.2[145] KF7-312.2A[16] R301.8.Inverse_filter_1_1_3 /end FUNCTION_LIST /end CHARACTERISTIC
/begin CHARACTERISTIC mfVINV "Control excuse switching for tuning" VALUE 0x00008B59 REC_UBYTE_C 0 COMP_0283 0 1 BIT_MASK 0x0040 /begin FUNCTION_LIST KF7-0.2[145] KF7-360.8M[4] R301.8.Inverse_filter_1_1_3 /end FUNCTION_LIST /end CHARACTERISTIC
/begin CHARACTERISTIC mfSTFSARI "APOFS   Shaft conversion treatment flag" VALUE 0x00008B59 REC_UBYTE_C 0 COMP_0283 0 1 BIT_MASK 0x0002 /begin FUNCTION_LIST KF7-0.2[145] KF7-360.7M[9] /end FUNCTION_LIST /end CHARACTERISTIC
/begin CHARACTERISTIC mSWSOFS "Specifications switching flag" VALUE 0x00008B5A REC_UBYTE_C 0 COMP_0283 0 255 /begin FUNCTION_LIST KF7-0.2[145] KF7-304.1B[5] KF7-312.3A[27] /end FUNCTION_LIST /end CHARACTERISTIC
/begin CHARACTERISTIC mfMKSCV "SCV use choice" VALUE 0x00008B5A REC_UBYTE_C 0 COMP_0283 0 1 BIT_MASK 0x0040 /begin FUNCTION_LIST KF7-0.2[145] KF7-312.3A[27] /end FUNCTION_LIST /end CHARACTERISTIC
/begin CHARACTERISTIC mfSTPKUB "At the time of the start, an unburned advantage, stop flag" VALUE 0x00008B5A REC_UBYTE_C 0 COMP_0283 0 1 BIT_MASK 0x0010 /begin FUNCTION_LIST KF7-0.2[145] KF7-312.3A[27] /end FUNCTION_LIST /end CHARACTERISTIC
/begin CHARACTERISTIC mSWVDC "VDC switching" VALUE 0x00008B5B REC_UBYTE_C 0 COMP_0283 0 255
 /begin FUNCTION_LIST KF7-0.2[145] KF7-302.5M[10] KF7-312.6[34] KF7-360.7M[9] KF7-360.9M[43] KF7-385.1[32] KF7-385.2[18] KF7-410.12[2] KF7-410.21[3] /end FUNCTION_LIST
/end CHARACTERISTIC
/begin CHARACTERISTIC mfKT "Toroidal CVT car choice flag" VALUE 0x00008B5B REC_UBYTE_C 0 COMP_0283 0 1 BIT_MASK 0x0080
 /begin FUNCTION_LIST KF7-0.2[145] KF7-302.5M[10] KF7-312.6[34] KF7-360.7M[9] KF7-360.9M[43] KF7-360.9P[22] KF7-385.3[4] KF7-505.26[2] /end FUNCTION_LIST
/end CHARACTERISTIC
/begin CHARACTERISTIC mfTRQ4WDSW "Switching of the electric 4WD drive protection control excuse" VALUE 0x00008B5B REC_UBYTE_C 0 COMP_0283 0 1 BIT_MASK 0x0040 /begin FUNCTION_LIST KF7-0.2[145] KF7-360.9M[43] KF7-410.21[3] /end FUNCTION_LIST /end CHARACTERISTIC
/begin CHARACTERISTIC mfJK "The car choice flag for the drive protection of JK (CVT)" VALUE 0x00008B5B REC_UBYTE_C 0 COMP_0283 0 1 BIT_MASK 0x0010
 /begin FUNCTION_LIST KF7-0.2[145] KF7-312.6[34] KF7-360.9M[43] KF7-385.1[32] KF7-385.2[18] KF7-385.3[4] KF7-500.2A[29] /end FUNCTION_LIST
/end CHARACTERISTIC
/begin CHARACTERISTIC mfMU "T/M choice flag" VALUE 0x00008B5B REC_UBYTE_C 0 COMP_0283 0 1 BIT_MASK 0x0008
 /begin FUNCTION_LIST KF7-0.2[145] KF7-360.9M[43] KF7-385.1[32] KF7-385.2[18] KF7-500.2A[29] /end FUNCTION_LIST
/end CHARACTERISTIC
/begin CHARACTERISTIC mfFCTCS "TCS form choice flag" VALUE 0x00008B5B REC_UBYTE_C 0 COMP_0283 0 1 BIT_MASK 0x0002
 /begin FUNCTION_LIST KF7-0.2[145] KF7-312.6[34] KF7-385.2[18] KF7-386.1[4] KF7-386.2[4] KF7-410.12[2] /end FUNCTION_LIST
/end CHARACTERISTIC
/begin CHARACTERISTIC mTRIPSWS "2TRIP diagnosis flag" VALUE 0x00008CE9 REC_UBYTE_C 0 COMP_0283 0 255 /begin FUNCTION_LIST KF7-0.2[145] KF7-505.31[5] KF7-505.33[8] /end FUNCTION_LIST /end CHARACTERISTIC
/begin CHARACTERISTIC mfNG1DEFLT "Default mechanism diagnosis 2TRIP flag" VALUE 0x00008CE9 REC_UBYTE_C 0 COMP_0283 0 1 BIT_MASK 0x0004 /begin FUNCTION_LIST KF7-0.2[145] KF7-505.33[8] /end FUNCTION_LIST /end CHARACTERISTIC
/begin CHARACTERISTIC mfNG1SPRG2 "IGNOFF return spring diagnosis 2TRIP flag" VALUE 0x00008CE9 REC_UBYTE_C 0 COMP_0283 0 1 BIT_MASK 0x0002 /begin FUNCTION_LIST KF7-0.2[145] KF7-505.33[8] /end FUNCTION_LIST /end CHARACTERISTIC
/begin CHARACTERISTIC mfNG1SPRG1 "IGNON return spring diagnosis 2TRIP flag" VALUE 0x00008CE9 REC_UBYTE_C 0 COMP_0283 0 1 BIT_MASK 0x0001 /begin FUNCTION_LIST KF7-0.2[145] KF7-505.33[8] /end FUNCTION_LIST /end CHARACTERISTIC
/begin CHARACTERISTIC mVP3KROM "ROM inclusion byte" VALUE 0x00008DE1 REC_UBYTE_C 0 COMP_0283 0 255 /begin FUNCTION_LIST KF7-0.2[145] KF7-304.2[21] R902.2.DiagMiscell_1_3_5 /end FUNCTION_LIST /end CHARACTERISTIC
/begin CHARACTERISTIC mfMILGSTIM "At the time of KeyON, MIL specifications choice flag" VALUE 0x00008DE1 REC_UBYTE_C 0 COMP_0283 0 1 BIT_MASK 0x0040 /begin FUNCTION_LIST KF7-0.2[145] KF7-500.1[54] R902.2.DiagMiscell_1_3_5 /end FUNCTION_LIST /end CHARACTERISTIC
/begin CHARACTERISTIC mfAFMDGSEL "A mass airflow meter function diagnosis for the choice flag" VALUE 0x00008DE1 REC_UBYTE_C 0 COMP_0283 0 1 BIT_MASK 0x0020 /begin FUNCTION_LIST KF7-0.2[145] KF7-500.7[12] /end FUNCTION_LIST /end CHARACTERISTIC
/begin CHARACTERISTIC mfWOTTP "WOT adoption/non-adoption choice" VALUE 0x00008DE1 REC_UBYTE_C 0 COMP_0283 0 1 BIT_MASK 0x0010 /begin FUNCTION_LIST KF7-0.2[145] KF7-304.2[21] KF7-500.1[54] /end FUNCTION_LIST /end CHARACTERISTIC
/begin AXIS_PTS mATGTVO "0.0008cm^2" 0x0000DF3A NO_INPUT_QUANTITY REC_AXIS_UWORD 0 COMP_0041 32 0 52.428 /end AXIS_PTS
/begin AXIS_PTS mLTMHOS "4ms" 0x0000CB0F NO_INPUT_QUANTITY REC_AXIS_UBYTE 0 COMP_0250 8 0 1020 /end AXIS_PTS
/begin AXIS_PTS mLVBHOS "1.28*10^6mV^2" 0x0000CB17 NO_INPUT_QUANTITY REC_AXIS_UBYTE 0 COMP_0096_S 8 0 326400000 /end AXIS_PTS
/begin MEASUREMENT wfLRNCNG "(SubCPU) The flag which unusually judges full-close position learning value" UBYTE COMP_0283 1 100 0 1 BIT_MASK 0x0040 ECU_ADDRESS 0xFFFF49C0 /begin FUNCTION_LIST KF7-301.25[11] KF7-505.33[8] /end FUNCTION_LIST /end MEASUREMENT
/begin MEASUREMENT fLRNCNG "(SubCPU) The flag which unusually judges full-close position learning value" UBYTE COMP_0283 1 100 0 1 BIT_MASK 0x0040 ECU_ADDRESS 0xFFFF49C1 /begin FUNCTION_LIST KF7-301.25[11] KF7-505.33[8] /end FUNCTION_LIST /end MEASUREMENT
/begin MEASUREMENT wfIGNSW "Ignition switch" UBYTE COMP_0283 1 100 0 1 BIT_MASK 0x0008 ECU_ADDRESS 0xFFFF49C2
 /begin FUNCTION_LIST KF7-301.1[7] KF7-301.25[11] KF7-302.3M[1] KF7-302.4MA[13] KF7-304.2[21] KF7-305.4AM[10] KF7-305.4BM[31] KF7-305.14[2] KF7-320A.19[7] KF7-330.5[53] KF7-340.11[4] KF7-340.13[4] KF7-350.1M[5] KF7-350.1P[4] KF7-350.4M[14] KF7-351.3[11] KF7-360.4[14] KF7-360.9M[43] KF7-377.1A[19] KF7-385.2[18] KF7-393.1C[8] KF7-450.22[1] KF7-450.50[10] KF7-500.1[54] KF7-500.7[12] KF7-500.10[3] KF7-500.38A[4] KF7-500.44[3] KF7-500.47B[15] KF7-500.69[25] KF7-500.76[8] KF7-505.9[3] KF7-505.10[2] KF7-505.15[4] KF7-505.16[1] KF7-505.17[3] KF7-505.18[3] KF7-505.32[6] KF7-505.33[8] KF7-505.34[3] KF7-505.38[4] KF7-505.47[3] KF7-505.49[3] KF7-505.50[1] KF7-505.51[2] KF7-505.52[1] KF7-505.53[1] KF7-505.54[2] KF7-525.2[6] KF7-525.2S[10] KF7-580.1[8] /end FUNCTION_LIST
/end MEASUREMENT
/begin MEASUREMENT wfPWST "P/S SW" UBYTE COMP_0283 1 100 0 1 BIT_MASK 0x0004 ECU_ADDRESS 0xFFFF49C2
 /begin FUNCTION_LIST KF7-0.2[145] KF7-301.28[2] KF7-302.2M[3] KF7-330.5[53] KF7-351.3[11] /end FUNCTION_LIST
/end MEASUREMENT
/begin MEASUREMENT wfSTSW "Starter SW" UBYTE COMP_0283 1 100 0 1 BIT_MASK 0x0002 ECU_ADDRESS 0xFFFF49C2
 /begin FUNCTION_LIST KF7-0.2[145] KF7-301.25[11] KF7-302.4MA[13] KF7-304.2[21] KF7-304.4B[2] KF7-305.1[7] KF7-312.2A[16] KF7-313C.1[36] KF7-314.1F[1] KF7-320A.19[7] KF7-320A.20[2] KF7-330.4A[53] KF7-330.5[53] KF7-340.11[4] KF7-351.1[16] KF7-351.2[17] KF7-376.2[21] KF7-377.1A[19] KF7-378.2B[6] KF7-385.2[18] KF7-410.12[2] KF7-500.7[12] KF7-500.26[17] KF7-500.38A[4] KF7-500.47B[15] KF7-505.2[9] KF7-505.9[3] KF7-505.15[4] KF7-505.22[3] KF7-505.32[6] KF7-505.47[3] KF7-505.49[3] KF7-525.2[6] R301.19.ISC_PID_cont_1_0_2 /end FUNCTION_LIST
/end MEASUREMENT
/begin MEASUREMENT fIGNSW "Ignition switch" UBYTE COMP_0283 1 100 0 1 BIT_MASK 0x0008 ECU_ADDRESS 0xFFFF49C3 DISPLAY_IDENTIFIER Vbx_igk
 /begin FUNCTION_LIST KF7-301.1[7] KF7-301.25[11] KF7-302.3M[1] KF7-302.4MA[13] KF7-304.2[21] KF7-305.4AM[10] KF7-305.4BM[31] KF7-305.14[2] KF7-320A.19[7] KF7-330.5[53] KF7-340.11[4] KF7-340.13[4] KF7-350.1M[5] KF7-350.1P[4] KF7-350.4M[14] KF7-351.3[11] KF7-360.4[14] KF7-360.9M[43] KF7-377.1A[19] KF7-385.2[18] KF7-393.1C[8] KF7-410.21[3] KF7-450.22[1] KF7-450.50[10] KF7-500.1[54] KF7-500.7[12] KF7-500.10[3] KF7-500.38A[4] KF7-500.44[3] KF7-500.47B[15] KF7-500.69[25] KF7-500.76[8] KF7-505.9[3] KF7-505.10[2] KF7-505.15[4] KF7-505.16[1] KF7-505.17[3] KF7-505.18[3] KF7-505.32[6] KF7-505.33[8] KF7-505.34[3] KF7-505.38[4] KF7-505.47[3] KF7-505.49[3] KF7-505.50[1] KF7-505.51[2] KF7-505.52[1] KF7-505.53[1] KF7-505.54[2] KF7-525.2[6] KF7-525.2S[10] KF7-580.1[8] R000.1.RS_Integ_1_10_2 R201.1.stp_mngtx_1_2_2 R203.2.crk_restx_1_0_8 R204.1.CanComm_1_9_2 R206.2.ECU_Repro_1_0_3 R208.1.SWTCH_1_1_7 R208.9.SAFETYX_1_3_2 R301.1.Torque_realization_1_0_3 R301.3.FanAftPwl_1_0_4 R301.11.INJDiag_1_1_2 R301.13.FFDforDiagOnCAN_1_1_3 R301.15.PurgeValveVB_shortDiag_1_0_2 R301.16.FrontO2H_VB_shortDiag_1_0_2 R301.17.RearO2H_VB_shortDiag_1_0_2 R301.21.SafetyLevel2_1_0_2 R901.1.Diag_on_can_app_1_6_2 R903.1.milmgtx_1_0_2 Rxxx.1.Diagnostic_cycle_1_0_1 Rxxx.2.Integration_Diagnostic_cycle_1_1_1 /end FUNCTION_LIST
/end MEASUREMENT
/begin MEASUREMENT fPWST "-" UBYTE COMP_0283 1 100 0 1 BIT_MASK 0x0004 ECU_ADDRESS 0xFFFF49C3
 /begin FUNCTION_LIST KF7-0.2[145] KF7-301.28[2] KF7-302.2M[3] KF7-330.5[53] KF7-351.3[11] R000.1.RS_Integ_1_10_2 R301.27.PWST_detection_1_0_2 /end FUNCTION_LIST
/end MEASUREMENT
/begin MEASUREMENT fSTSW "Starter SW" UBYTE COMP_0283 1 100 0 1 BIT_MASK 0x0002 ECU_ADDRESS 0xFFFF49C3
 /begin FUNCTION_LIST KF7-0.2[145] KF7-301.25[11] KF7-302.4MA[13] KF7-304.2[21] KF7-304.4B[2] KF7-305.1[7] KF7-312.2A[16] KF7-314.1F[1] KF7-320A.19[7] KF7-320A.20[2] KF7-330.4A[53] KF7-330.5[53] KF7-340.11[4] KF7-351.1[16] KF7-351.2[17] KF7-376.2[21] KF7-377.1A[19] KF7-378.2B[6] KF7-385.2[18] KF7-410.12[2] KF7-500.7[12] KF7-500.26[17] KF7-500.38A[4] KF7-500.47B[15] KF7-505.2[9] KF7-505.9[3] KF7-505.15[4] KF7-505.22[3] KF7-505.32[6] KF7-505.47[3] KF7-505.49[3] KF7-525.2[6] R107.1.iss_ariss_1_0_4 R301.1.Torque_realization_1_0_3 R301.3.FanAftPwl_1_0_4 R301.5.FuelCut_1_2_2 R301.6.IscAirflow_1_4_5 R301.11.INJDiag_1_1_2 R301.15.PurgeValveVB_shortDiag_1_0_2 R301.16.FrontO2H_VB_shortDiag_1_0_2 R301.17.RearO2H_VB_shortDiag_1_0_2 R301.21.SafetyLevel2_1_0_2 R301.28.StarterSwitch_1_0_2 /end FUNCTION_LIST
/end MEASUREMENT
/begin MEASUREMENT wfCRUISE2 "After the ASCD permission, in the cruise, flag" UBYTE COMP_0283 1 100 0 1 BIT_MASK 0x0002 ECU_ADDRESS 0xFFFF49CA
 /begin FUNCTION_LIST KF7-0.2[145] KF7-301.25M[5] KF7-301.25P[5] KF7-340.1M[8] KF7-340.1P[7] KF7-340.5[4] KF7-340.5P[2] KF7-340.8M[8] KF7-340.8P[8] KF7-340.15[3] KF7-340.16[4] KF7-410.10[6] KF7-410.19[2] KF7-410.20[N] /end FUNCTION_LIST
/end MEASUREMENT
/begin MEASUREMENT wfFTANOK "At least, intake air temperature operation flag" UBYTE COMP_0283 1 100 0 1 BIT_MASK 0x0020 ECU_ADDRESS 0xFFFF49CF /begin FUNCTION_LIST KF7-301.16[5] KF7-500.21[19] /end FUNCTION_LIST /end MEASUREMENT
/begin MEASUREMENT wfLRNEND "(The main thing) full-close position learning completion flag" UBYTE COMP_0283 1 100 0 1 BIT_MASK 0x0004 ECU_ADDRESS 0xFFFF49D1 /begin FUNCTION_LIST KF7-301.25[11] KF7-305.4AM[10] KF7-360.4[14] KF7-505.33[8] /end FUNCTION_LIST /end MEASUREMENT
/begin MEASUREMENT wfTPSLRN "During (the sub-side) full-close learning, judgement flag" UBYTE COMP_0283 1 100 0 1 BIT_MASK 0x0001 ECU_ADDRESS 0xFFFF49D4 /begin FUNCTION_LIST KF7-301.25[11] KF7-360.1[12] KF7-505.32[6] /end FUNCTION_LIST /end MEASUREMENT
/begin MEASUREMENT fCRUISE2 "After the ASCD permission, in the cruise, flag" UBYTE COMP_0283 1 100 0 1 BIT_MASK 0x0002 ECU_ADDRESS 0xFFFF49DA
 /begin FUNCTION_LIST KF7-0.2[145] KF7-301.25M[5] KF7-301.25P[5] KF7-340.1M[8] KF7-340.1P[7] KF7-340.5[4] KF7-340.5P[2] KF7-340.8M[8] KF7-340.8P[8] KF7-340.15[3] KF7-340.16[4] KF7-410.10[6] KF7-410.17M[5] KF7-410.17P[1] KF7-410.19[2] KF7-410.20[N] R301.20.AmbientComp_1_0_2 /end FUNCTION_LIST
/end MEASUREMENT
/begin MEASUREMENT fFTANOK "At least, intake air temperature operation flag" UBYTE COMP_0283 1 100 0 1 BIT_MASK 0x0020 ECU_ADDRESS 0xFFFF49DF /begin FUNCTION_LIST KF7-301.16[5] KF7-500.21[19] /end FUNCTION_LIST /end MEASUREMENT
/begin MEASUREMENT fLRNEND "(The main thing) full-close position learning completion flag" UBYTE COMP_0283 1 100 0 1 BIT_MASK 0x0004 ECU_ADDRESS 0xFFFF49E1 /begin FUNCTION_LIST KF7-301.25[11] KF7-305.4AM[10] KF7-360.4[14] KF7-505.33[8] /end FUNCTION_LIST /end MEASUREMENT
/begin MEASUREMENT fTPSLRN "During (the sub-side) full-close learning, judgement flag" UBYTE COMP_0283 1 100 0 1 BIT_MASK 0x0001 ECU_ADDRESS 0xFFFF49E4 /begin FUNCTION_LIST KF7-301.25[11] KF7-360.1[12] KF7-505.32[6] /end FUNCTION_LIST /end MEASUREMENT
/begin MEASUREMENT bfFQLRN "An off-line idle learning, low speed air quantity learn rapid mode trigger flag" UBYTE COMP_0283 1 100 0 1 BIT_MASK 0x0080 ECU_ADDRESS 0xFFFF4274
 /begin FUNCTION_LIST KF7-0.2[145] KF7-330.4A[53] KF7-351.1[16] KF7-351.2[17] KF7-351.3[11] KF7-377.1A[19] KF7-500.38A[4] KF7-580.1[8] R301.19.ISC_PID_cont_1_0_2 /end FUNCTION_LIST
/end MEASUREMENT
/begin MEASUREMENT bfNG "MC command NG flag" UBYTE COMP_0283 1 100 0 1 BIT_MASK 0x0040 ECU_ADDRESS 0xFFFF4276
 /begin FUNCTION_LIST KF7-0.2[145] KF7-301.19[8] KF7-301.25[11] KF7-303.5A[9] KF7-303.6M[5] KF7-304.1B[5] KF7-304.2[21] KF7-305.1[7] KF7-305.4AM[10] KF7-305.4BM[31] KF7-305.14[2] KF7-312.3A[27] KF7-312.4A[6] KF7-312.4C[4] KF7-312.6[34] KF7-313C.1[36] KF7-313C.2[4] KF7-313C.4[3] KF7-313C.5[3] KF7-313C.6[5] KF7-314.1F[1] KF7-320A.3[N] KF7-320A.9[9] KF7-330.4A[53] KF7-330.5[53] KF7-330.7A[1] KF7-340.7[4] KF7-351.1[16] KF7-351.2[17] KF7-351.3[11] KF7-371.1E[15] KF7-376.1[6] KF7-376.2[21] KF7-393.1C[8] KF7-400.1[1] KF7-400.2[N] KF7-410.21[3] KF7-450.1[N] KF7-450.2[1] KF7-450.5[1] KF7-450.7[2] KF7-450.14[2] KF7-450.20[2] KF7-450.50[10] KF7-500.1[54] KF7-500.2A[29] KF7-500.6D[9] KF7-500.7[12] KF7-500.8[5] KF7-500.10[3] KF7-500.12[3] KF7-500.16[4] KF7-500.20B[4] KF7-500.21[19] KF7-500.24[10] KF7-500.25A[7] KF7-500.26[17] KF7-500.28[4] KF7-500.30[8] KF7-500.38A[4] KF7-500.39[5] KF7-500.44[3] KF7-500.47B[15] KF7-500.51[3] KF7-500.56[2] KF7-500.59[6] KF7-500.60[5] KF7-500.69[25] KF7-500.73[1] KF7-500.74[11] KF7-500.74B[5] KF7-500.75[4] KF7-500.76[8] KF7-505.2[9] KF7-505.9[3] KF7-505.10[2] KF7-505.12[6] KF7-505.15[4] KF7-505.16[1] KF7-505.17[3] KF7-505.18[3] KF7-505.19[1] KF7-505.22[3] KF7-505.23[2] KF7-505.24[1] KF7-505.25[3] KF7-505.26[2] KF7-505.27[4] KF7-505.28[1] KF7-505.29[4] KF7-505.30[6] KF7-505.31[5] KF7-505.32[6] KF7-505.33[8] KF7-505.34[3] KF7-505.35[2] KF7-505.36[2] KF7-505.37[1] KF7-505.38[4] KF7-505.39[2] KF7-505.40[1] KF7-505.41[2] KF7-505.42[2] KF7-505.43[3] KF7-505.47[3] KF7-505.49[3] KF7-505.50[1] KF7-505.51[2] KF7-505.52[1] KF7-505.53[1] KF7-505.54[2] KF7-505.90[N] KF7-525.1[4] KF7-580.1[8] /end FUNCTION_LIST
/end MEASUREMENT
/begin MEASUREMENT fETCON "Throttle control permission flag" UBYTE COMP_0283 1 100 0 1 BIT_MASK 0x0010 ECU_ADDRESS 0xFFFF4277
 /begin FUNCTION_LIST KF7-301.25[11] KF7-340.7[4] KF7-350.4M[14] KF7-350.4P[13] KF7-351.3[11] KF7-360.1[12] KF7-360.4[14] KF7-385.3[4] KF7-450.50[10] KF7-505.2[9] KF7-505.10[2] KF7-505.15[4] KF7-505.16[1] KF7-505.17[3] KF7-505.30[6] KF7-505.32[6] KF7-505.33[8] KF7-505.50[1] KF7-505.51[2] KF7-505.52[1] KF7-505.53[1] KF7-505.54[2] KF7-525.2[6] R000.1.RS_Integ_1_10_2 R301.21.SafetyLevel2_1_0_2 /end FUNCTION_LIST
/end MEASUREMENT
/begin MEASUREMENT fCNTLRNCH "The experience flag of the normal engine rotation and the ETC control" UBYTE COMP_0283 1 100 0 1 BIT_MASK 0x0008 ECU_ADDRESS 0xFFFF428C /begin FUNCTION_LIST KF7-301.25[11] KF7-505.30[6] /end FUNCTION_LIST /end MEASUREMENT
/begin MEASUREMENT fDELTAN "The first flag" UBYTE COMP_0283 1 100 0 1 BIT_MASK 0x0008 ECU_ADDRESS 0xFFFF4319 /begin FUNCTION_LIST KF7-301.16[5] /end FUNCTION_LIST /end MEASUREMENT
/begin MEASUREMENT fFAPSNG "APS open trouble" UBYTE COMP_0283 1 100 0 1 BIT_MASK 0x0002 ECU_ADDRESS 0xFFFF4325 /begin FUNCTION_LIST KF7-301.25[11] /end FUNCTION_LIST /end MEASUREMENT
/begin MEASUREMENT fIDONCHPR "Soft idle judgement normality spare flag" UBYTE COMP_0283 1 100 0 1 BIT_MASK 0x0001 ECU_ADDRESS 0xFFFF432B /begin FUNCTION_LIST KF7-301.25[11] /end FUNCTION_LIST /end MEASUREMENT
/begin MEASUREMENT fTAMNBU "The first flag" UBYTE COMP_0283 1 100 0 1 BIT_MASK 0x0080 ECU_ADDRESS 0xFFFF433C /begin FUNCTION_LIST KF7-301.16[5] /end FUNCTION_LIST /end MEASUREMENT
/begin MEASUREMENT fTANBMN "The first flag" UBYTE COMP_0283 1 100 0 1 BIT_MASK 0x0040 ECU_ADDRESS 0xFFFF433C
 /begin FUNCTION_LIST KF7-301.16[5] KF7-500.1[54] KF7-500.8[5] KF7-500.21[19] KF7-500.26[17] KF7-500.30[8] KF7-500.38A[4] KF7-500.39[5] KF7-500.60[5] KF7-580.1[8] /end FUNCTION_LIST
/end MEASUREMENT
/begin MEASUREMENT fTMTAN2 "And, after the vehicle speed condition formation, delay time progress" UBYTE COMP_0283 1 100 0 1 BIT_MASK 0x0008 ECU_ADDRESS 0xFFFF433D /begin FUNCTION_LIST KF7-301.16[5] /end FUNCTION_LIST /end MEASUREMENT
/begin MEASUREMENT fTPSLRNC "(The sub-side) full-close position condition flag" UBYTE COMP_0283 1 100 0 1 BIT_MASK 0x0040 ECU_ADDRESS 0xFFFF433E /begin FUNCTION_LIST KF7-301.25[11] /end FUNCTION_LIST /end MEASUREMENT
/begin MEASUREMENT fTWINTR "TWINTR value renewal condition judgement" UBYTE COMP_0283 1 100 0 1 BIT_MASK 0x0020 ECU_ADDRESS 0xFFFF433F /begin FUNCTION_LIST KF7-301.8M[3] /end FUNCTION_LIST /end MEASUREMENT
/begin MEASUREMENT fVSPTAN "And, after the vehicle speed condition formation, delay time progress" UBYTE COMP_0283 1 100 0 1 BIT_MASK 0x0004 ECU_ADDRESS 0xFFFF4341 /begin FUNCTION_LIST KF7-301.16[5] /end FUNCTION_LIST /end MEASUREMENT
/begin MEASUREMENT afACSIG "ACSIG terminal output flag" UBYTE COMP_0283 1 100 0 1 BIT_MASK 0x0040 ECU_ADDRESS 0xFFFF434A /begin FUNCTION_LIST KF7-0.2[145] /end FUNCTION_LIST /end MEASUREMENT
/begin MEASUREMENT fACSIG "ACSIG terminal output flag" UBYTE COMP_0283 1 100 0 1 BIT_MASK 0x0040 ECU_ADDRESS 0xFFFF435B /begin FUNCTION_LIST KF7-0.2[145] /end FUNCTION_LIST /end MEASUREMENT
/begin MEASUREMENT wfENGRUN "During the engine rotation, judgement flag" UBYTE COMP_0283 1 100 0 1 BIT_MASK 0x0004 ECU_ADDRESS 0xFFFF8A83
 /begin FUNCTION_LIST KF7-301.25[11] KF7-302.4MA[13] KF7-330.5[53] KF7-360.4[14] KF7-360.9M[43] KF7-377.1A[19] KF7-500.1[54] KF7-500.47B[15] KF7-505.10[2] KF7-505.16[1] KF7-505.17[3] KF7-505.27[4] KF7-505.33[8] KF7-505.50[1] KF7-505.51[2] KF7-505.52[1] KF7-505.53[1] KF7-505.54[2] /end FUNCTION_LIST
/end MEASUREMENT
/begin MEASUREMENT wfIDLE "IDLE SW" UBYTE COMP_0283 1 100 0 1 BIT_MASK 0x0001 ECU_ADDRESS 0xFFFF8A83
 /begin FUNCTION_LIST KF7-0.2[145] KF7-301.25[11] KF7-301.25M[5] KF7-302.6A[4] KF7-303.1[14] KF7-304.3[2] KF7-312.2A[16] KF7-312.3A[27] KF7-312.4A[6] KF7-312.4C[4] KF7-312.6[34] KF7-313C.11B[1] KF7-314.1F[1] KF7-320A.1[6] KF7-320A.2[3] KF7-320A.9[9] KF7-320A.10[14] KF7-320A.12[N] KF7-320A.15[4] KF7-320A.18[4] KF7-320A.20[2] KF7-330.3[6] KF7-330.5[53] KF7-340.1M[8] KF7-340.1P[7] KF7-340.9M[3] KF7-340.11[4] KF7-340.15[3] KF7-340.16[4] KF7-351.1[16] KF7-351.3[11] KF7-360.4[14] KF7-360.7M[9] KF7-360.8M[4] KF7-371.1E[15] KF7-376.2[21] KF7-385.1[32] KF7-390.1A[3] KF7-390.3A[15] KF7-393.1C[8] KF7-395.1[4] KF7-450.50[10] KF7-500.1[54] KF7-500.2A[29] KF7-500.6D[9] KF7-500.7[12] KF7-500.20B[4] KF7-500.24[10] KF7-500.26[17] KF7-500.47B[15] KF7-505.33[8] KF7-505.34[3] KF7-580.1[8] /end FUNCTION_LIST
/end MEASUREMENT
/begin MEASUREMENT wfNEUT "Neutral SW" UBYTE COMP_0283 1 100 0 1 BIT_MASK 0x0008 ECU_ADDRESS 0xFFFF8A84
 /begin FUNCTION_LIST KF7-0.2[145] KF7-302.4MA[13] KF7-302.5M[10] KF7-312.6[34] KF7-320A.1[6] KF7-330.4A[53] KF7-351.1[16] KF7-351.2[17] KF7-360.4[14] KF7-360.9M[43] KF7-376.1[6] KF7-390.3A[15] KF7-395.1[4] KF7-450.9A[5] KF7-450.19[4] KF7-450.50[10] KF7-500.1[54] KF7-500.2A[29] KF7-500.6D[9] KF7-500.26[17] KF7-500.28[4] KF7-500.38A[4] KF7-505.15[4] KF7-505.23[2] KF7-505.26[2] KF7-505.27[4] KF7-505.47[3] KF7-525.2[6] KF7-580.1[8] /end FUNCTION_LIST
/end MEASUREMENT
/begin MEASUREMENT wfNEUTD "A neutral SW with the delay" UBYTE COMP_0283 1 100 0 1 BIT_MASK 0x0004 ECU_ADDRESS 0xFFFF8A84
 /begin FUNCTION_LIST KF7-0.2[145] KF7-301.25[11] KF7-302.5M[10] KF7-304.10[1] KF7-330.3[6] KF7-330.4A[53] KF7-330.5[53] KF7-376.2[21] KF7-385.1[32] KF7-385.3[4] KF7-390.3A[15] KF7-410.12[2] KF7-450.1[N] KF7-450.2[1] KF7-450.3[1] KF7-450.4[1] KF7-500.16[4] /end FUNCTION_LIST
/end MEASUREMENT
/begin MEASUREMENT wfTASW "The air temperature switch" UBYTE COMP_0283 1 100 0 1 BIT_MASK 0x0040 ECU_ADDRESS 0xFFFF8A85 /begin FUNCTION_LIST KF7-0.2[145] /end FUNCTION_LIST /end MEASUREMENT
/begin MEASUREMENT wfTOP "A TOP judgement flag for the fuel cut" UBYTE COMP_0283 1 100 0 1 BIT_MASK 0x0020 ECU_ADDRESS 0xFFFF8A85
 /begin FUNCTION_LIST KF7-301.25[11] KF7-304.5[N] KF7-312.3A[27] KF7-312.6[34] KF7-320A.15[4] /end FUNCTION_LIST
/end MEASUREMENT
/begin MEASUREMENT fENGRUN "During the engine rotation, judgement flag" UBYTE COMP_0283 1 100 0 1 BIT_MASK 0x0004 ECU_ADDRESS 0xFFFF8A86
 /begin FUNCTION_LIST KF7-301.25[11] KF7-302.4MA[13] KF7-330.5[53] KF7-360.4[14] KF7-360.9M[43] KF7-377.1A[19] KF7-410.11M[4] KF7-410.11P[4] KF7-500.1[54] KF7-500.47B[15] KF7-505.10[2] KF7-505.16[1] KF7-505.17[3] KF7-505.27[4] KF7-505.33[8] KF7-505.50[1] KF7-505.51[2] KF7-505.52[1] KF7-505.53[1] KF7-505.54[2] R000.1.RS_Integ_1_10_2 R206.2.ECU_Repro_1_0_3 R301.1.Torque_realization_1_0_3 R301.3.FanAftPwl_1_0_4 R301.5.FuelCut_1_2_2 R301.11.INJDiag_1_1_2 R301.21.SafetyLevel2_1_0_2 Rxxx.2.Integration_Diagnostic_cycle_1_1_1 /end FUNCTION_LIST
/end MEASUREMENT
/begin MEASUREMENT fIDLE "IDLE SW" UBYTE COMP_0283 1 100 0 1 BIT_MASK 0x0001 ECU_ADDRESS 0xFFFF8A86
 /begin FUNCTION_LIST KF7-0.2[145] KF7-301.25[11] KF7-301.25M[5] KF7-302.6A[4] KF7-303.1[14] KF7-304.3[2] KF7-312.2A[16] KF7-312.3A[27] KF7-312.4A[6] KF7-312.4C[4] KF7-312.6[34] KF7-313C.1[36] KF7-313C.11B[1] KF7-314.1F[1] KF7-320A.1[6] KF7-320A.2[3] KF7-320A.9[9] KF7-320A.10[14] KF7-320A.12[N] KF7-320A.15[4] KF7-320A.18[4] KF7-320A.20[2] KF7-330.3[6] KF7-330.5[53] KF7-340.1M[8] KF7-340.1P[7] KF7-340.9M[3] KF7-340.11[4] KF7-340.15[3] KF7-340.16[4] KF7-351.1[16] KF7-351.3[11] KF7-360.4[14] KF7-360.7M[9] KF7-360.8M[4] KF7-376.2[21] KF7-385.1[32] KF7-390.1A[3] KF7-390.3A[15] KF7-393.1C[8] KF7-395.1[4] KF7-410.16M[1] KF7-410.17M[5] KF7-450.50[10] KF7-500.1[54] KF7-500.2A[29] KF7-500.6D[9] KF7-500.7[12] KF7-500.20B[4] KF7-500.24[10] KF7-500.26[17] KF7-500.47B[15] KF7-505.33[8] KF7-505.34[3] KF7-580.1[8] R000.1.RS_Integ_1_10_2 R101.1M.aps_pedin_1_2_2 R301.5.FuelCut_1_2_2 R301.8.Inverse_filter_1_1_3 R301.23.ADV_calculation_1_1_2 R301.26.Dashpot_DandN_1_0_2 /end FUNCTION_LIST
/end MEASUREMENT
/begin MEASUREMENT fNEUT "Neutral SW" UBYTE COMP_0283 1 100 0 1 BIT_MASK 0x0008 ECU_ADDRESS 0xFFFF8A87
 /begin FUNCTION_LIST KF7-0.2[145] KF7-302.4MA[13] KF7-302.5M[10] KF7-312.6[34] KF7-313C.1[36] KF7-320A.1[6] KF7-330.4A[53] KF7-351.1[16] KF7-351.2[17] KF7-360.4[14] KF7-360.9M[43] KF7-376.1[6] KF7-390.3A[15] KF7-395.1[4] KF7-450.9A[5] KF7-450.19[4] KF7-450.50[10] KF7-500.1[54] KF7-500.2A[29] KF7-500.6D[9] KF7-500.26[17] KF7-500.28[4] KF7-500.38A[4] KF7-505.15[4] KF7-505.23[2] KF7-505.26[2] KF7-505.27[4] KF7-505.47[3] KF7-525.2[6] KF7-580.1[8] R204.1.CanComm_1_9_2 R301.6.IscAirflow_1_4_5 R301.23.ADV_calculation_1_1_2 R301.26.Dashpot_DandN_1_0_2 R301.28.StarterSwitch_1_0_2 Rxxx.2.Integration_Diagnostic_cycle_1_1_1 /end FUNCTION_LIST
/end MEASUREMENT
/begin MEASUREMENT fNEUTD "A neutral SW with the delay" UBYTE COMP_0283 1 100 0 1 BIT_MASK 0x0004 ECU_ADDRESS 0xFFFF8A87
 /begin FUNCTION_LIST KF7-0.2[145] KF7-301.25[11] KF7-302.5M[10] KF7-304.10[1] KF7-330.3[6] KF7-330.4A[53] KF7-330.5[53] KF7-376.2[21] KF7-385.1[32] KF7-385.3[4] KF7-390.3A[15] KF7-410.12[2] KF7-450.1[N] KF7-450.2[1] KF7-450.3[1] KF7-450.4[1] KF7-500.16[4] R000.1.RS_Integ_1_10_2 R301.1.Torque_realization_1_0_3 R301.6.IscAirflow_1_4_5 /end FUNCTION_LIST
/end MEASUREMENT
/begin MEASUREMENT fTASW "The air temperature switch" UBYTE COMP_0283 1 100 0 1 BIT_MASK 0x0040 ECU_ADDRESS 0xFFFF8A88 /begin FUNCTION_LIST KF7-0.2[145] /end FUNCTION_LIST /end MEASUREMENT
/begin MEASUREMENT fTOP "A TOP judgement flag for the fuel cut" UBYTE COMP_0283 1 100 0 1 BIT_MASK 0x0020 ECU_ADDRESS 0xFFFF8A88
 /begin FUNCTION_LIST KF7-301.25[11] KF7-304.5[N] KF7-312.3A[27] KF7-312.6[34] KF7-320A.15[4] /end FUNCTION_LIST
/end MEASUREMENT
/begin MEASUREMENT wfCVTFAIL "CVT fail flag" UBYTE COMP_0283 1 100 0 1 BIT_MASK 0x0010 ECU_ADDRESS 0xFFFF8A8F /begin FUNCTION_LIST KF7-0.2[145] KF7-340.7[4] /end FUNCTION_LIST /end MEASUREMENT
/begin MEASUREMENT wfTIPDOF "At the time of A/C relay off, after the Pd pressure balance pressure detection" UBYTE COMP_0283 1 100 0 1 BIT_MASK 0x0010 ECU_ADDRESS 0xFFFF8A91 /begin FUNCTION_LIST KF7-301.13[1] KF7-330.5[53] /end FUNCTION_LIST /end MEASUREMENT
/begin MEASUREMENT fCVTFAIL "CVT fail flag" UBYTE COMP_0283 1 100 0 1 BIT_MASK 0x0010 ECU_ADDRESS 0xFFFF8A92 /begin FUNCTION_LIST KF7-0.2[145] KF7-340.7[4] /end FUNCTION_LIST /end MEASUREMENT
/begin MEASUREMENT fTIPDOF "At the time of A/C relay off, after the Pd pressure balance pressure detection" UBYTE COMP_0283 1 100 0 1 BIT_MASK 0x0010 ECU_ADDRESS 0xFFFF8A94 /begin FUNCTION_LIST KF7-301.13[1] KF7-330.5[53] /end FUNCTION_LIST /end MEASUREMENT
/begin MEASUREMENT fISCFB "ISC OPEN/CLOSED judgement" UBYTE COMP_0283 1 100 0 1 BIT_MASK 0x0080 ECU_ADDRESS 0xFFFF8A96
 /begin FUNCTION_LIST KF7-0.2[145] KF7-330.3[6] KF7-330.4A[53] KF7-330.5[53] KF7-351.3[11] KF7-390.3A[15] KF7-500.7[12] KF7-580.1[8] R301.6.IscAirflow_1_4_5 R301.19.ISC_PID_cont_1_0_2 /end FUNCTION_LIST
/end MEASUREMENT
/begin MEASUREMENT bfREGGAS "High-octane 0/ regular 1 judgement" UBYTE COMP_0283 1 100 0 1 BIT_MASK 0x0040 ECU_ADDRESS 0xFFFF2454
 /begin FUNCTION_LIST KF7-0.2[145] KF7-320A.9[9] KF7-330.4A[53] KF7-360.9M[43] KF7-379.3[3] KF7-379.4[1] KF7-379.5[3] KF7-393.1C[8] /end FUNCTION_LIST
/end MEASUREMENT
/begin MEASUREMENT bfSCV "SCV solenoid" UBYTE COMP_0283 1 100 0 1 BIT_MASK 0x0002 ECU_ADDRESS 0xFFFF2457
 /begin FUNCTION_LIST KF7-0.2[145] KF7-311.1A[21] KF7-312.2A[16] KF7-312.3A[27] KF7-312.4A[6] KF7-312.4C[4] KF7-312.6[34] KF7-313C.6[5] KF7-320A.8[2] KF7-320A.9[9] KF7-320A.10[14] KF7-320A.18[4] KF7-379.5[3] KF7-450.1[N] KF7-450.2[1] KF7-450.3[1] KF7-450.4[1] KF7-450.50[10] KF7-500.2A[29] KF7-580.1[8] /end FUNCTION_LIST
/end MEASUREMENT
/begin MEASUREMENT fDUETTE "DUETTE control permission flag" UBYTE COMP_0283 1 100 0 1 BIT_MASK 0x0001 ECU_ADDRESS 0xFFFF246F
 /begin FUNCTION_LIST KF7-0.2[145] KF7-302.13[1] KF7-312.6[34] KF7-320A.15[4] KF7-330.4A[53] KF7-330.7A[1] KF7-360.9M[43] KF7-385.1[32] KF7-385.2[18] KF7-385.3[4] KF7-386.1[4] KF7-386.2[4] KF7-390.1A[3] KF7-390.3A[15] KF7-395.1[4] KF7-410.10[6] KF7-410.12[2] KF7-500.2A[29] KF7-500.26[17] /end FUNCTION_LIST
/end MEASUREMENT
/begin MEASUREMENT fSUB "Decrease control" UBYTE COMP_0283 1 100 0 1 BIT_MASK 0x0040 ECU_ADDRESS 0xFFFF249D
 /begin FUNCTION_LIST KF7-301.8P[3] KF7-360.7P[8] KF7-505.10[2] KF7-525.1[4] KF7-525.2S[10] KF7-580.1[8] /end FUNCTION_LIST
/end MEASUREMENT
/begin MEASUREMENT fQSIGN "Inhalation air quantity sign flag" UBYTE COMP_0283 1 100 0 1 BIT_MASK 0x0020 ECU_ADDRESS 0xFFFF24B4
 /begin FUNCTION_LIST KF7-301.25[11] KF7-304.2[21] KF7-304.3[2] KF7-312.1C[N] KF7-312.4A[6] KF7-390.3A[15] /end FUNCTION_LIST
/end MEASUREMENT
/begin MEASUREMENT fIDLEA1 "IDLE SW1" UBYTE COMP_0283 1 100 0 1 BIT_MASK 0x0080 ECU_ADDRESS 0xFFFF24BA
 /begin FUNCTION_LIST KF7-301.25[11] KF7-301.25M[5] KF7-301.25P[5] R000.1.RS_Integ_1_10_2 /end FUNCTION_LIST
/end MEASUREMENT
/begin MEASUREMENT fIDLEA2 "IDLE SW2" UBYTE COMP_0283 1 100 0 1 BIT_MASK 0x0040 ECU_ADDRESS 0xFFFF24BA
 /begin FUNCTION_LIST KF7-301.25[11] KF7-301.25M[5] KF7-301.25P[5] R000.1.RS_Integ_1_10_2 /end FUNCTION_LIST
/end MEASUREMENT
/begin MEASUREMENT fLOAD "An electric load SW" UBYTE COMP_0283 1 100 0 1 BIT_MASK 0x0020 ECU_ADDRESS 0xFFFF24BB
 /begin FUNCTION_LIST KF7-0.2[145] KF7-302.2M[3] KF7-330.5[53] KF7-351.1[16] KF7-351.2[17] /end FUNCTION_LIST
/end MEASUREMENT
/begin MEASUREMENT fTAINT "TAINT Initialization completion" UBYTE COMP_0283 1 100 0 1 BIT_MASK 0x0080 ECU_ADDRESS 0xFFFF24BE /begin FUNCTION_LIST KF7-301.16[5] KF7-500.1[54] KF7-580.1[8] /end FUNCTION_LIST /end MEASUREMENT
/begin MEASUREMENT fTWINT "TWINT value renewal condition judgement" UBYTE COMP_0283 1 100 0 1 BIT_MASK 0x0080 ECU_ADDRESS 0xFFFF24BF
 /begin FUNCTION_LIST KF7-301.8M[3] KF7-301.16[5] KF7-311.1A[21] KF7-312.6[34] KF7-313C.7[1] KF7-314.1F[1] KF7-320A.10[14] KF7-320A.12[N] KF7-320A.13[N] KF7-320A.19[7] KF7-330.4A[53] KF7-378.3B[5] KF7-385.1[32] KF7-450.8[2] KF7-500.1[54] KF7-500.20B[4] KF7-500.21[19] KF7-500.24[10] KF7-500.26[17] KF7-500.39[5] KF7-500.60[5] KF7-580.1[8] /end FUNCTION_LIST
/end MEASUREMENT
/begin MEASUREMENT fVBINT "VBINT renewal permission flag" UBYTE COMP_0283 1 100 0 1 BIT_MASK 0x0008 ECU_ADDRESS 0xFFFF24BF /begin FUNCTION_LIST KF7-301.7[1] /end FUNCTION_LIST /end MEASUREMENT
/begin MEASUREMENT fKNOCK "Knock flag" UBYTE COMP_0283 1 100 0 1 BIT_MASK 0x0001 ECU_ADDRESS 0xFFFF24C3
 /begin FUNCTION_LIST KF7-301.15[4] KF7-379.1[9] KF7-379.2[1] KF7-379.4[1] KF7-379.5[3] KF7-379.6[N] /end FUNCTION_LIST
/end MEASUREMENT
/begin MEASUREMENT fONOFCR "vA : mONOFCR, last time, comparative value" UBYTE COMP_0283 1 100 0 1 BIT_MASK 0x0080 ECU_ADDRESS 0xFFFF24C4 /begin FUNCTION_LIST KF7-301.21[1] KF7-500.30[8] /end FUNCTION_LIST /end MEASUREMENT
/begin MEASUREMENT afGOV "GOV At the time of the use, flag (for the QuickREF JOB reference)" UBYTE COMP_0283 1 100 0 1 BIT_MASK 0x0008 ECU_ADDRESS 0xFFFF24D0
 /begin FUNCTION_LIST KF7-0.2[145] KF7-320A.1[6] KF7-320A.10[14] KF7-320A.18[4] KF7-386.2[4] KF7-390.1A[3] KF7-390.3A[15] /end FUNCTION_LIST
/end MEASUREMENT
/begin MEASUREMENT afPDCUT "A/C Pd pressure cut signal" UBYTE COMP_0283 1 100 0 1 BIT_MASK 0x0080 ECU_ADDRESS 0xFFFF24D1 /begin FUNCTION_LIST KF7-0.2[145] KF7-376.4[4] /end FUNCTION_LIST /end MEASUREMENT
/begin MEASUREMENT afTPSSNG "TPS Single trouble judgement flag (MAIN)" UBYTE COMP_0283 1 100 0 1 BIT_MASK 0x0040 ECU_ADDRESS 0xFFFF24D2
 /begin FUNCTION_LIST KF7-301.25[11] KF7-301.25M[5] KF7-301.25P[5] KF7-340.1M[8] KF7-340.13[4] KF7-350.1M[5] KF7-350.1P[4] KF7-350.4M[14] KF7-350.4P[13] KF7-360.1[12] KF7-360.4[14] KF7-450.50[10] KF7-505.15[4] KF7-505.34[3] /end FUNCTION_LIST
/end MEASUREMENT
/begin MEASUREMENT fGOV "GOV At the time of the use, flag" UBYTE COMP_0283 1 100 0 1 BIT_MASK 0x0008 ECU_ADDRESS 0xFFFF24D7
 /begin FUNCTION_LIST KF7-0.2[145] KF7-320A.1[6] KF7-320A.10[14] KF7-320A.18[4] KF7-386.2[4] KF7-390.1A[3] KF7-390.3A[15] /end FUNCTION_LIST
/end MEASUREMENT
/begin MEASUREMENT fPDCUT "A/C Pd pressure cut signal" UBYTE COMP_0283 1 100 0 1 BIT_MASK 0x0080 ECU_ADDRESS 0xFFFF24D8 /begin FUNCTION_LIST KF7-0.2[145] KF7-376.4[4] /end FUNCTION_LIST /end MEASUREMENT
/begin MEASUREMENT fTPSSNG "TPS Single trouble judgement flag (MAIN)" UBYTE COMP_0283 1 100 0 1 BIT_MASK 0x0040 ECU_ADDRESS 0xFFFF24D9
 /begin FUNCTION_LIST KF7-301.25[11] KF7-301.25M[5] KF7-301.25P[5] KF7-340.1M[8] KF7-340.13[4] KF7-350.1M[5] KF7-350.1P[4] KF7-350.4M[14] KF7-350.4P[13] KF7-360.1[12] KF7-360.4[14] KF7-410.16M[1] KF7-450.50[10] KF7-505.15[4] KF7-505.34[3] R000.1.RS_Integ_1_10_2 R101.1M.aps_pedin_1_2_2 R101.1P.aps_pedin_1_1_2 /end FUNCTION_LIST
/end MEASUREMENT
/begin MEASUREMENT fFTVOLNEX "Full-close learning renewal experience flag" UBYTE COMP_0283 1 100 0 1 BIT_MASK 0x0080 ECU_ADDRESS 0xFFFFB7E0
 /begin FUNCTION_LIST KF7-301.25[11] KF7-351.3[11] KF7-580.1[8] R901.1.Diag_on_can_app_1_6_2 /end FUNCTION_LIST
/end MEASUREMENT
/begin MEASUREMENT fIDONCHCK "Soft idle judgement normality flag" UBYTE COMP_0283 1 100 0 1 BIT_MASK 0x0001 ECU_ADDRESS 0xFFFFB7E6 /begin FUNCTION_LIST KF7-301.25[11] /end FUNCTION_LIST /end MEASUREMENT
/begin MEASUREMENT tTMTAN1 "Vehicle speed condition delay timer" UBYTE COMP_0201_S 1 100 0 255 ECU_ADDRESS 0xFFFF4429 /begin FUNCTION_LIST KF7-301.16[5] /end FUNCTION_LIST /end MEASUREMENT
/begin MEASUREMENT tTMTAN2 "Starter condition delay timer" UBYTE COMP_0201_S 1 100 0 255 ECU_ADDRESS 0xFFFF442A /begin FUNCTION_LIST KF7-301.16[5] /end FUNCTION_LIST /end MEASUREMENT
/begin MEASUREMENT tACSIG "ACSIG terminal output periodic timer" UBYTE COMP_0202_S 1 100 0 255 ECU_ADDRESS 0xFFFF4445 /begin FUNCTION_LIST KF7-0.2[145] /end FUNCTION_LIST /end MEASUREMENT
/begin MEASUREMENT tVEREND "ë“Çø, ÇØ logic completion judgement time" UBYTE COMP_0202_S 1 100 0 255 ECU_ADDRESS 0xFFFF4567 /begin FUNCTION_LIST KF7-301.1[7] /end FUNCTION_LIST /end MEASUREMENT
/begin MEASUREMENT tVRO2 "The voltage judgement delay whose Rr.O2/S is unusual" UBYTE COMP_0202_S 1 100 0 255 ECU_ADDRESS 0xFFFF456E
 /begin FUNCTION_LIST KF7-301.4[3] KF7-313C.9[3] KF7-500.1[54] KF7-500.21[19] KF7-500.24[10] KF7-580.1[8] /end FUNCTION_LIST
/end MEASUREMENT
/begin MEASUREMENT tETCON "Progress time since the ETCON set" UBYTE COMP_0203_S 1 100 0 255 ECU_ADDRESS 0xFFFF45E8
 /begin FUNCTION_LIST KF7-301.25[11] KF7-340.7[4] KF7-350.4M[14] KF7-350.4P[13] KF7-351.3[11] KF7-360.1[12] KF7-360.4[14] KF7-385.3[4] KF7-450.50[10] KF7-505.2[9] KF7-505.10[2] KF7-505.15[4] KF7-505.16[1] KF7-505.17[3] KF7-505.30[6] KF7-505.32[6] KF7-505.33[8] KF7-505.50[1] KF7-505.51[2] KF7-505.52[1] KF7-505.53[1] KF7-505.54[2] KF7-525.2[6] /end FUNCTION_LIST
/end MEASUREMENT
/begin MEASUREMENT tKAIVRT "VRO2 compensation release delay timer" UBYTE COMP_0202_S 1 100 0 255 ECU_ADDRESS 0xFFFF2561 /begin FUNCTION_LIST KF7-301.4[3] /end FUNCTION_LIST /end MEASUREMENT
/begin MEASUREMENT tTIPDOF "At the time of A/C relay off, Pd pressure balance pressure detection delay" UBYTE COMP_0202_S 1 100 0 255 ECU_ADDRESS 0xFFFF259E /begin FUNCTION_LIST KF7-301.13[1] KF7-330.5[53] /end FUNCTION_LIST /end MEASUREMENT
/begin MEASUREMENT avFCADV "At the time of the fuel cut, ignition timing compensation value" UWORD COMP_0081 1 100 0 255.99609375 ECU_ADDRESS 0xFFFF22E6 /begin FUNCTION_LIST KF7-0.2[145] KF7-386.2[4] KF7-390.1A[3] KF7-390.3A[15] /end FUNCTION_LIST /end MEASUREMENT
/begin MEASUREMENT avMBTCAL "MBT operation value" SBYTE COMP_0018 1 100 -128 127 ECU_ADDRESS 0xFFFF2339
 /begin FUNCTION_LIST KF7-0.2[145] KF7-320A.8[2] KF7-320A.15[4] KF7-320A.18[4] KF7-385.2[18] KF7-386.1[4] KF7-386.2[4] KF7-390.1A[3] /end FUNCTION_LIST
/end MEASUREMENT
/begin MEASUREMENT avTENG "Engine torque" SWORD COMP_0228 1 100 -3276.8 3276.7 ECU_ADDRESS 0xFFFF235E /begin FUNCTION_LIST KF7-0.2[145] KF7-386.1[4] /end FUNCTION_LIST /end MEASUREMENT
/begin MEASUREMENT avTS "Invalid pulse width" UWORD COMP_0231 1 100 0 655350 ECU_ADDRESS 0xFFFF2394
 /begin FUNCTION_LIST KF7-0.2[145] KF7-312.1C[N] KF7-312.5A[4] KF7-312.5C[1] KF7-313C.9[3] KF7-314.1F[1] KF7-450.50[10] KF7-580.1[8] /end FUNCTION_LIST
/end MEASUREMENT
/begin MEASUREMENT avTTEPTD "PTD target engine torque" SWORD COMP_0228 1 100 -3276.8 3276.7 ECU_ADDRESS 0xFFFF239A
 /begin FUNCTION_LIST KF7-0.2[145] KF7-340.1P[7] KF7-340.7[4] KF7-340.8M[8] KF7-360.9M[43] KF7-360.9P[22] KF7-360.11[1] KF7-360.12[6] KF7-385.3[4] KF7-500.2A[29] KF7-505.51[2] KF7-525.2[6] KF7-525.2S[10] /end FUNCTION_LIST
/end MEASUREMENT
/begin MEASUREMENT avVAPO "Throttle open-degree target value (virtual)" UWORD COMP_0005 1 100 0 7208.85 ECU_ADDRESS 0xFFFF40E6
 /begin FUNCTION_LIST KF7-301.25[11] KF7-304.9[2] KF7-312.2A[16] KF7-312.3A[27] KF7-320A.2[3] KF7-320A.15[4] KF7-330.5[53] KF7-340.1M[8] KF7-340.2M[2] KF7-350.1M[5] KF7-350.4M[14] KF7-351.3[11] KF7-360.12[6] KF7-385.1[32] KF7-385.2[18] KF7-385.3[4] KF7-410.12[2] KF7-410.20[N] KF7-500.2A[29] KF7-505.15[4] KF7-505.26[2] KF7-505.32[6] KF7-525.2[6] KF7-525.2S[10] /end FUNCTION_LIST
/end MEASUREMENT
/begin MEASUREMENT avVTCTRG "VTC target operation angle" UBYTE COMP_0256 1 100 -64 63.5 ECU_ADDRESS 0xFFFF22EA
 /begin FUNCTION_LIST KF7-0.2[145] KF7-320A.22[5] KF7-393.1C[8] KF7-460.1[6] KF7-500.6D[9] KF7-500.47B[15] KF7-580.1[8] /end FUNCTION_LIST
/end MEASUREMENT
/begin MEASUREMENT bvKATHOS "Wall way compensation pulse width" SWORD COMP_0449 1 100 -128 127.99609375 ECU_ADDRESS 0xFFFF22C8
 /begin FUNCTION_LIST KF7-0.2[145] KF7-305.7[6] KF7-312.1C[N] KF7-312.4A[6] KF7-312.4C[4] KF7-313C.1[36] KF7-313C.9[3] KF7-450.50[10] /end FUNCTION_LIST
/end MEASUREMENT
/begin MEASUREMENT bvKBLRC "Mixed ratio learning value" UWORD COMP_0031 1 100 0 255.99609375 ECU_ADDRESS 0xFFFF22CA
 /begin FUNCTION_LIST KF7-0.2[145] KF7-305.7[6] KF7-312.1C[N] KF7-312.3A[27] KF7-313C.9[3] KF7-313C.11B[1] KF7-314.1F[1] KF7-330.5[53] KF7-450.50[10] KF7-460.1[6] KF7-500.1[54] KF7-500.20B[4] KF7-500.21[19] KF7-500.24[10] KF7-525.2[6] KF7-580.1[8] R901.1.Diag_on_can_app_1_6_2 R904.1.Gst_on_can_1_0_1 /end FUNCTION_LIST
/end MEASUREMENT
/begin MEASUREMENT bvKBLRC_R#1 "Mixed ratio learning value" UWORD COMP_0031 1 100 0 255.99609375 ECU_ADDRESS 0xFFFF22CA
 /begin FUNCTION_LIST KF7-0.2[145] KF7-305.7[6] KF7-312.1C[N] KF7-312.3A[27] KF7-313C.9[3] KF7-313C.11B[1] KF7-314.1F[1] KF7-330.5[53] KF7-450.50[10] KF7-460.1[6] KF7-500.1[54] KF7-500.20B[4] KF7-500.21[19] KF7-500.24[10] KF7-525.2[6] KF7-580.1[8] R901.1.Diag_on_can_app_1_6_2 R904.1.Gst_on_can_1_0_1 /end FUNCTION_LIST
/end MEASUREMENT
/begin MEASUREMENT bvKBLRC_R#2 "Mixed ratio learning value" UWORD COMP_0031 1 100 0 255.99609375 ECU_ADDRESS 0xFFFF22CC
 /begin FUNCTION_LIST KF7-0.2[145] KF7-305.7[6] KF7-312.1C[N] KF7-312.3A[27] KF7-313C.9[3] KF7-313C.11B[1] KF7-314.1F[1] KF7-330.5[53] KF7-450.50[10] KF7-460.1[6] KF7-500.1[54] KF7-500.20B[4] KF7-500.21[19] KF7-500.24[10] KF7-525.2[6] KF7-580.1[8] R901.1.Diag_on_can_app_1_6_2 R904.1.Gst_on_can_1_0_1 /end FUNCTION_LIST
/end MEASUREMENT
/begin MEASUREMENT bvNSET0 "Idle speed temporary target value" UBYTE COMP_0006 1 100 0 3187.5 ECU_ADDRESS 0xFFFF22A9
 /begin FUNCTION_LIST KF7-301.25[11] KF7-304.2[21] KF7-304.10[1] KF7-312.2A[16] KF7-330.3[6] KF7-330.4A[53] KF7-330.5[53] KF7-330.7A[1] KF7-330.8[1] KF7-330.9[8] KF7-351.1[16] KF7-351.2[17] KF7-385.1[32] KF7-385.3[4] KF7-390.3A[15] KF7-450.1[N] KF7-450.2[1] KF7-450.3[1] KF7-450.4[1] KF7-500.1[54] KF7-580.1[8] /end FUNCTION_LIST
/end MEASUREMENT
/begin MEASUREMENT bvNSET00 "Idle speed setup value" UBYTE COMP_0006 1 100 0 3187.5 ECU_ADDRESS 0xFFFF22DA
 /begin FUNCTION_LIST KF7-301.25[11] KF7-330.4A[53] KF7-330.5[53] KF7-351.1[16] KF7-351.2[17] KF7-385.1[32] KF7-385.3[4] KF7-450.1[N] KF7-450.2[1] KF7-450.3[1] KF7-450.4[1] /end FUNCTION_LIST
/end MEASUREMENT
/begin MEASUREMENT bvSTFBYA "Target air-fuel ratio cost" UWORD COMP_0328 1 100 0 399.99392106 ECU_ADDRESS 0xFFFF22E0
 /begin FUNCTION_LIST KF7-0.2[145] KF7-311.1A[21] KF7-312.2A[16] KF7-314.1F[1] KF7-320A.10[14] /end FUNCTION_LIST
/end MEASUREMENT
/begin MEASUREMENT bvTFBYA0 "Target air-fuel ratio basic value" UWORD COMP_0217 1 100 0 3.999941832 ECU_ADDRESS 0xFFFF22AC
 /begin FUNCTION_LIST KF7-0.2[145] KF7-311.1A[21] KF7-312.2A[16] KF7-312.3A[27] KF7-313C.6[5] KF7-314.1F[1] KF7-320A.8[2] KF7-320A.9[9] KF7-320A.14[1] KF7-320A.17[N] KF7-386.1[4] KF7-450.50[10] KF7-460.1[6] KF7-500.24[10] KF7-580.1[8] R301.7.KHOT_1_0_2 R301.9.Target_Equivalent_Ratio_1_0_2 R301.10.TITM_1_0_2 /end FUNCTION_LIST
/end MEASUREMENT
/begin MEASUREMENT vA "VEVOUTT- (the last vEVOUT)" UBYTE COMP_0267 1 100 0 65280 ECU_ADDRESS 0xFFFF1F8C
 /begin FUNCTION_LIST KF7-0.2[145] KF7-301.1[7] KF7-301.4[3] KF7-301.7[1] KF7-301.8M[3] KF7-301.13[1] KF7-301.15[4] KF7-301.18[5] KF7-301.19[8] KF7-301.21[1] KF7-301.25[11] KF7-301.28[2] KF7-301.30[2] KF7-301.31[1] KF7-302.2M[3] KF7-302.4MA[13] KF7-302.5M[10] KF7-302.6A[4] KF7-303.5A[9] KF7-304.1B[5] KF7-304.2[21] KF7-304.3[2] KF7-304.7[1] KF7-304.9[2] KF7-304.10[1] KF7-304.13[N] KF7-305.4BM[31] KF7-305.6[1] KF7-305.7[6] KF7-305.14[2] KF7-311.1A[21] KF7-312.1C[N] KF7-312.2A[16] KF7-312.3A[27] KF7-312.4A[6] KF7-312.5A[4] KF7-312.5C[1] KF7-312.6[34] KF7-313C.1[36] KF7-313C.2[4] KF7-313C.3[1] KF7-313C.4[3] KF7-313C.5[3] KF7-313C.6[5] KF7-313C.9[3] KF7-313C.11B[1] KF7-314.1F[1] KF7-320A.1[6] KF7-320A.10[14] KF7-320A.15[4] KF7-330.4A[53] KF7-330.5[53] KF7-340.1M[8] KF7-340.2M[2] KF7-340.2P[1] KF7-340.5P[2] KF7-340.6M[2] KF7-340.6P[2] KF7-340.8M[8] KF7-340.15[3] KF7-340.16[4] KF7-350.1M[5] KF7-350.4M[14] KF7-350.4P[13] KF7-351.1[16] KF7-351.2[17] KF7-351.3[11] KF7-360.1[12] KF7-371.1E[15] KF7-376.1[6] KF7-376.2[21] KF7-378.3B[5] KF7-379.1[9] KF7-379.3[3] KF7-379.4[1] KF7-379.5[3] KF7-385.1[32] KF7-385.3[4] KF7-386.1[4] KF7-386.2[4] KF7-386.3[8] KF7-390.1A[3] KF7-390.3A[15] KF7-393.1C[8] KF7-400.1[1] KF7-400.3[N] KF7-400.5[3] KF7-410.3[N] KF7-410.19[2] KF7-450.1[N] KF7-450.2[1] KF7-450.3[1] KF7-450.4[1] KF7-450.9A[5] KF7-450.50[10] KF7-460.1[6] KF7-500.1[54] KF7-500.2A[29] KF7-500.3[2] KF7-500.6D[9] KF7-500.8[5] KF7-500.20B[4] KF7-500.21[19] KF7-500.24[10] KF7-500.25A[7] KF7-500.26[17] KF7-500.30[8] KF7-500.38A[4] KF7-500.39[5] KF7-500.47B[15] KF7-500.56[2] KF7-500.59[6] KF7-500.60[5] KF7-500.74[11] KF7-500.74B[5] KF7-500.75[4] KF7-500.76[8] KF7-505.9[3] KF7-505.23[2] KF7-505.26[2] KF7-505.28[1] KF7-505.31[5] KF7-505.32[6] KF7-505.33[8] KF7-505.34[3] KF7-505.35[2] KF7-505.38[4] KF7-505.41[2] KF7-580.1[8] /end FUNCTION_LIST
/end MEASUREMENT
/begin MEASUREMENT vAACTVO "ISC, very, throttle open-degree" UWORD COMP_0005 1 100 0 7208.85 ECU_ADDRESS 0xFFFF26FC /begin FUNCTION_LIST KF7-301.25[11] KF7-350.4M[14] R000.1.RS_Integ_1_10_2 /end FUNCTION_LIST /end MEASUREMENT
/begin MEASUREMENT vAAPO "Accelerator opening area" UWORD COMP_0042 1 100 0 52.428 ECU_ADDRESS 0xFFFF10C2
 /begin FUNCTION_LIST KF7-0.2[145] KF7-340.1M[8] KF7-340.2M[2] KF7-340.7[4] KF7-410.17M[5] R301.20.AmbientComp_1_0_2 /end FUNCTION_LIST
/end MEASUREMENT
/begin MEASUREMENT vADCVO2 "Single O2 sensor A/D data buffer" UWORD COMP_0023 1 100 0 327675 ECU_ADDRESS 0xFFFF1E00 /begin FUNCTION_LIST KF7-301.4[3] /end FUNCTION_LIST /end MEASUREMENT
/begin MEASUREMENT vADCVO2_R#1 "Single O2 sensor A/D data buffer" UWORD COMP_0023 1 100 0 327675 ECU_ADDRESS 0xFFFF1E00 /begin FUNCTION_LIST KF7-301.4[3] /end FUNCTION_LIST /end MEASUREMENT
/begin MEASUREMENT vADCVO2_R#2 "Single O2 sensor A/D data buffer" UWORD COMP_0023 1 100 0 327675 ECU_ADDRESS 0xFFFF1E02 /begin FUNCTION_LIST KF7-301.4[3] /end FUNCTION_LIST /end MEASUREMENT
/begin MEASUREMENT vADCVRO2 "Rear O2 sensor A/D data buffer" UWORD COMP_0023 1 100 0 327675 ECU_ADDRESS 0xFFFF1E0C /begin FUNCTION_LIST KF7-301.4[3] /end FUNCTION_LIST /end MEASUREMENT
/begin MEASUREMENT vADCVRO2_R#1 "Rear O2 sensor A/D data buffer" UWORD COMP_0023 1 100 0 327675 ECU_ADDRESS 0xFFFF1E0C /begin FUNCTION_LIST KF7-301.4[3] /end FUNCTION_LIST /end MEASUREMENT
/begin MEASUREMENT vADCVRO2_R#2 "Rear O2 sensor A/D data buffer" UWORD COMP_0023 1 100 0 327675 ECU_ADDRESS 0xFFFF1E0E /begin FUNCTION_LIST KF7-301.4[3] /end FUNCTION_LIST /end MEASUREMENT
/begin MEASUREMENT vADO2R "A rear O2 voltage for the A/F sensor system" UWORD COMP_0023 1 100 0 327675 ECU_ADDRESS 0xFFFF8966 /begin FUNCTION_LIST KF7-301.4[3] /end FUNCTION_LIST /end MEASUREMENT
/begin MEASUREMENT vADO2R_R#1 "A rear O2 voltage for the A/F sensor system" UWORD COMP_0023 1 100 0 327675 ECU_ADDRESS 0xFFFF8966 /begin FUNCTION_LIST KF7-301.4[3] /end FUNCTION_LIST /end MEASUREMENT
/begin MEASUREMENT vADO2R_R#2 "A rear O2 voltage for the A/F sensor system" UWORD COMP_0023 1 100 0 327675 ECU_ADDRESS 0xFFFF8968 /begin FUNCTION_LIST KF7-301.4[3] /end FUNCTION_LIST /end MEASUREMENT
/begin MEASUREMENT vADV "Ignition timing" SBYTE COMP_0018 1 100 -128 127 ECU_ADDRESS 0xFFFF1F8E
 /begin FUNCTION_LIST KF7-0.2[145] KF7-303.5A[9] KF7-304.5[N] KF7-305.4AM[10] KF7-305.4BM[31] KF7-320A.1[6] KF7-320A.3[N] KF7-320A.4[6] KF7-320A.5[N] KF7-320A.10[14] KF7-320A.15[4] KF7-320A.18[4] KF7-320A.19[7] KF7-330.3[6] KF7-351.1[16] KF7-385.1[32] KF7-386.1[4] KF7-386.2[4] KF7-390.3A[15] KF7-450.9A[5] KF7-450.50[10] KF7-460.1[6] KF7-580.1[8] R301.13.FFDforDiagOnCAN_1_1_3 R301.23.ADV_calculation_1_1_2 R901.1.Diag_on_can_app_1_6_2 /end FUNCTION_LIST
/end MEASUREMENT
/begin MEASUREMENT vAFC "#NAME?" UWORD COMP_0023 1 100 0 327675 ECU_ADDRESS 0xFFFF389A /begin FUNCTION_LIST KF7-301.18[5] /end FUNCTION_LIST /end MEASUREMENT
/begin MEASUREMENT vAFC_R#1 "#NAME?" UWORD COMP_0023 1 100 0 327675 ECU_ADDRESS 0xFFFF389A /begin FUNCTION_LIST KF7-301.18[5] /end FUNCTION_LIST /end MEASUREMENT
/begin MEASUREMENT vAFC_R#2 "#NAME?" UWORD COMP_0023 1 100 0 327675 ECU_ADDRESS 0xFFFF389C /begin FUNCTION_LIST KF7-301.18[5] /end FUNCTION_LIST /end MEASUREMENT
/begin MEASUREMENT vAFCLT2 "After the condition A start, timer" UBYTE COMP_0014 1 100 0 2550 ECU_ADDRESS 0xFFFF38C8 /begin FUNCTION_LIST KF7-301.1[7] /end FUNCTION_LIST /end MEASUREMENT
/begin MEASUREMENT vAFIOUT "ÉCÉìÉsÅ[É_ÉìÉX electric current signal Iout" UWORD COMP_0023 1 100 0 327675 ECU_ADDRESS 0xFFFF3566 /begin FUNCTION_LIST KF7-301.18[5] /end FUNCTION_LIST /end MEASUREMENT
/begin MEASUREMENT vAFIOUT_R#1 "ÉCÉìÉsÅ[É_ÉìÉX electric current signal Iout" UWORD COMP_0023 1 100 0 327675 ECU_ADDRESS 0xFFFF3566 /begin FUNCTION_LIST KF7-301.18[5] /end FUNCTION_LIST /end MEASUREMENT
/begin MEASUREMENT vAFIOUT_R#2 "ÉCÉìÉsÅ[É_ÉìÉX electric current signal Iout" UWORD COMP_0023 1 100 0 327675 ECU_ADDRESS 0xFFFF3568 /begin FUNCTION_LIST KF7-301.18[5] /end FUNCTION_LIST /end MEASUREMENT
/begin MEASUREMENT vAFM "A/F sensor-" UWORD COMP_0370 1 100 0 163837.5 ECU_ADDRESS 0xFFFF403C
 /begin FUNCTION_LIST KF7-301.1[7] KF7-301.16[5] KF7-304.1B[5] KF7-312.1C[N] KF7-312.3A[27] KF7-312.4A[6] KF7-312.4C[4] KF7-313C.4[3] KF7-313C.5[3] KF7-314.1F[1] KF7-351.3[11] KF7-371.1E[15] KF7-400.1[1] KF7-400.5[3] KF7-450.2[1] KF7-450.3[1] KF7-450.4[1] KF7-450.5[1] KF7-450.50[10] KF7-500.7[12] KF7-500.38A[4] KF7-500.74[11] KF7-500.75[4] KF7-500.76[8] KF7-505.26[2] KF7-580.1[8] /end FUNCTION_LIST
/end MEASUREMENT
/begin MEASUREMENT vAFO "A/F output voltage" UWORD COMP_0023 1 100 0 327675 ECU_ADDRESS 0xFFFF38CE /begin FUNCTION_LIST KF7-301.18[5] /end FUNCTION_LIST /end MEASUREMENT
/begin MEASUREMENT vAFO_R#1 "A/F output voltage" UWORD COMP_0023 1 100 0 327675 ECU_ADDRESS 0xFFFF38CE /begin FUNCTION_LIST KF7-301.18[5] /end FUNCTION_LIST /end MEASUREMENT
/begin MEASUREMENT vAFO_R#2 "A/F output voltage" UWORD COMP_0023 1 100 0 327675 ECU_ADDRESS 0xFFFF38D0 /begin FUNCTION_LIST KF7-301.18[5] /end FUNCTION_LIST /end MEASUREMENT
/begin MEASUREMENT vAFP "After lambda point compensation, A/F sensor output voltage" UWORD COMP_0370 1 100 0 163837.5 ECU_ADDRESS 0xFFFF49B4 /begin FUNCTION_LIST KF7-301.18[5] KF7-313C.3[1] /end FUNCTION_LIST /end MEASUREMENT
/begin MEASUREMENT vAFP_R#1 "After lambda point compensation, A/F sensor output voltage" UWORD COMP_0370 1 100 0 163837.5 ECU_ADDRESS 0xFFFF49B4 /begin FUNCTION_LIST KF7-301.18[5] KF7-313C.3[1] /end FUNCTION_LIST /end MEASUREMENT
/begin MEASUREMENT vAFP_R#2 "After lambda point compensation, A/F sensor output voltage" UWORD COMP_0370 1 100 0 163837.5 ECU_ADDRESS 0xFFFF49B6 /begin FUNCTION_LIST KF7-301.18[5] KF7-313C.3[1] /end FUNCTION_LIST /end MEASUREMENT
/begin MEASUREMENT vAFS "After lambda point compensation, A/F sensor output voltage" UWORD COMP_0023 1 100 0 327675 ECU_ADDRESS 0xFFFF48AC
 /begin FUNCTION_LIST KF7-301.18[5] KF7-313C.2[4] KF7-313C.3[1] KF7-500.74[11] KF7-500.76[8] KF7-580.1[8] /end FUNCTION_LIST
/end MEASUREMENT
/begin MEASUREMENT vAFS_R#1 "After lambda point compensation, A/F sensor output voltage" UWORD COMP_0023 1 100 0 327675 ECU_ADDRESS 0xFFFF48AC
 /begin FUNCTION_LIST KF7-301.18[5] KF7-313C.2[4] KF7-313C.3[1] KF7-500.74[11] KF7-500.76[8] KF7-580.1[8] /end FUNCTION_LIST
/end MEASUREMENT
/begin MEASUREMENT vAFS_R#2 "After lambda point compensation, A/F sensor output voltage" UWORD COMP_0023 1 100 0 327675 ECU_ADDRESS 0xFFFF48AE
 /begin FUNCTION_LIST KF7-301.18[5] KF7-313C.2[4] KF7-313C.3[1] KF7-500.74[11] KF7-500.76[8] KF7-580.1[8] /end FUNCTION_LIST
/end MEASUREMENT
/begin MEASUREMENT vAPO1 "After the lower limit value limiter treatment, accelerator 1 open-degree" UWORD COMP_0005 1 100 0 7208.85 ECU_ADDRESS 0xFFFF48C6
 /begin FUNCTION_LIST KF7-301.25[11] KF7-301.25M[5] KF7-505.2[9] KF7-525.2[6] R000.1.RS_Integ_1_10_2 /end FUNCTION_LIST
/end MEASUREMENT
/begin MEASUREMENT vAPO2 "After the lower limit value limiter treatment, accelerator 2 open-degree" UWORD COMP_0005 1 100 0 7208.85 ECU_ADDRESS 0xFFFF48C8
 /begin FUNCTION_LIST KF7-301.25[11] KF7-301.25P[5] KF7-385.1[32] KF7-505.2[9] KF7-525.2[6] R000.1.RS_Integ_1_10_2 /end FUNCTION_LIST
/end MEASUREMENT
/begin MEASUREMENT vAPOFS "Accelerator open-degree for the target open-degree operation" UWORD COMP_0005 1 100 0 7208.85 ECU_ADDRESS 0xFFFF48CA
 /begin FUNCTION_LIST KF7-0.2[145] KF7-301.25M[5] KF7-350.4M[14] KF7-350.4P[13] KF7-360.7M[9] KF7-360.7P[8] KF7-450.19[4] KF7-505.9[3] R000.1.RS_Integ_1_10_2 /end FUNCTION_LIST
/end MEASUREMENT
/begin MEASUREMENT vAPOFSR "Accelerator pedal ratio" UWORD COMP_0362_S 1 100 0 8191.875 ECU_ADDRESS 0xFFFF4780
 /begin FUNCTION_LIST KF7-0.2[145] KF7-410.3[N] KF7-410.10[6] KF7-410.16M[1] KF7-505.9[3] R000.1.RS_Integ_1_10_2 R301.21.SafetyLevel2_1_0_2 /end FUNCTION_LIST
/end MEASUREMENT
/begin MEASUREMENT vAPOK "Accelerator open-degree table" UBYTE COMP_0002 1 100 0 89.25 ECU_ADDRESS 0xFFFF48CC
 /begin FUNCTION_LIST KF7-301.25[11] KF7-360.7M[9] KF7-360.7P[8] KF7-500.26[17] KF7-505.2[9] /end FUNCTION_LIST
/end MEASUREMENT
/begin MEASUREMENT vAPS1AV "Accelerator pedal sensor 1 voltage movement mean" UWORD COMP_0023 1 100 0 327675 ECU_ADDRESS 0xFFFF38FC /begin FUNCTION_LIST KF7-301.25[11] /end FUNCTION_LIST /end MEASUREMENT
/begin MEASUREMENT vAPS1CL "Accelerator pedal 1 full-close position learning value" UWORD COMP_0023 1 100 0 327675 ECU_ADDRESS 0xFFFFB55E
 /begin FUNCTION_LIST KF7-301.25[11] KF7-305.1[7] KF7-305.4AM[10] KF7-505.26[2] R000.4.EepAlloc_1_2_2 /end FUNCTION_LIST
/end MEASUREMENT
/begin MEASUREMENT vAPS1OF "Accelerator 1 open-degree" SWORD COMP_0377 1 100 -3604.48 3604.37 ECU_ADDRESS 0xFFFF48CE
 /begin FUNCTION_LIST KF7-301.25[11] KF7-301.25M[5] KF7-301.25P[5] KF7-500.1[54] KF7-505.2[9] R904.1.Gst_on_can_1_0_1 /end FUNCTION_LIST
/end MEASUREMENT
/begin MEASUREMENT vAPS1V "Accelerator pedal sensor 1 voltage" UWORD COMP_0023 1 100 0 327675 ECU_ADDRESS 0xFFFF48D0
 /begin FUNCTION_LIST KF7-301.25[11] KF7-312.1C[N] KF7-505.2[9] KF7-525.1[4] KF7-580.1[8] R000.1.RS_Integ_1_10_2 R301.13.FFDforDiagOnCAN_1_1_3 R901.1.Diag_on_can_app_1_6_2 /end FUNCTION_LIST
/end MEASUREMENT
/begin MEASUREMENT vAPS2AV "Accelerator pedal sensor 2 voltage movement mean" UWORD COMP_0023 1 100 0 327675 ECU_ADDRESS 0xFFFF390C /begin FUNCTION_LIST KF7-301.25[11] /end FUNCTION_LIST /end MEASUREMENT
/begin MEASUREMENT vAPS2CL "Accelerator pedal 2 full-close position learning value" UWORD COMP_0023 1 100 0 327675 ECU_ADDRESS 0xFFFFB560
 /begin FUNCTION_LIST KF7-301.25[11] KF7-305.1[7] KF7-305.4AM[10] KF7-505.26[2] R000.4.EepAlloc_1_2_2 /end FUNCTION_LIST
/end MEASUREMENT
/begin MEASUREMENT vAPS2OF "Accelerator 2 open-degree" SWORD COMP_0377 1 100 -3604.48 3604.37 ECU_ADDRESS 0xFFFF48D2
 /begin FUNCTION_LIST KF7-301.25[11] KF7-301.25M[5] KF7-301.25P[5] KF7-500.1[54] KF7-505.2[9] R904.1.Gst_on_can_1_0_1 /end FUNCTION_LIST
/end MEASUREMENT
/begin MEASUREMENT vAPS2V "Accelerator pedal sensor 2 voltage" UWORD COMP_0023 1 100 0 327675 ECU_ADDRESS 0xFFFF48D4
 /begin FUNCTION_LIST KF7-301.25[11] KF7-505.2[9] KF7-525.1[4] KF7-580.1[8] R000.1.RS_Integ_1_10_2 R301.13.FFDforDiagOnCAN_1_1_3 R901.1.Diag_on_can_app_1_6_2 /end FUNCTION_LIST
/end MEASUREMENT
/begin MEASUREMENT vAQSISC "ISC opening area" UWORD COMP_0042 1 100 0 52.428 ECU_ADDRESS 0xFFFF117E
 /begin FUNCTION_LIST KF7-301.25[11] KF7-330.1M[3] KF7-340.1M[8] KF7-350.1M[5] KF7-350.4M[14] /end FUNCTION_LIST
/end MEASUREMENT
/begin MEASUREMENT vAVAFC "#NAME?" UWORD COMP_0023 1 100 0 327675 ECU_ADDRESS 0xFFFF3928 /begin FUNCTION_LIST KF7-301.18[5] /end FUNCTION_LIST /end MEASUREMENT
/begin MEASUREMENT vAVAFC_R#1 "#NAME?" UWORD COMP_0023 1 100 0 327675 ECU_ADDRESS 0xFFFF3928 /begin FUNCTION_LIST KF7-301.18[5] /end FUNCTION_LIST /end MEASUREMENT
/begin MEASUREMENT vAVAFC_R#2 "#NAME?" UWORD COMP_0023 1 100 0 327675 ECU_ADDRESS 0xFFFF392A /begin FUNCTION_LIST KF7-301.18[5] /end FUNCTION_LIST /end MEASUREMENT
/begin MEASUREMENT vAVPDACON "Pd pressure weighted average value" UWORD COMP_0010 1 100 0 196.605 ECU_ADDRESS 0xFFFF8976 /begin FUNCTION_LIST KF7-301.13[1] KF7-351.2[17] /end FUNCTION_LIST /end MEASUREMENT
/begin MEASUREMENT vCHOS "Wall way compensation output pulse width by the cylinder" SWORD COMP_0386 1 100 -327680 327670 ECU_ADDRESS 0xFFFF11DC
 /begin FUNCTION_LIST KF7-0.2[145] KF7-312.1C[N] KF7-312.4A[6] KF7-312.4C[4] KF7-312.5A[4] KF7-312.5C[1] /end FUNCTION_LIST
/end MEASUREMENT
/begin MEASUREMENT vCNTLRNNG "Full-close learning treatment ERR number of times" UBYTE COMP_0030 1 100 0 255 ECU_ADDRESS 0xFFFFA2BC /begin FUNCTION_LIST KF7-301.25[11] KF7-505.26[2] KF7-505.30[6] /end FUNCTION_LIST /end MEASUREMENT
/begin MEASUREMENT vCNTTAN "At least, intake air temperature renewal counter" UBYTE COMP_0016 1 100 0 255 ECU_ADDRESS 0xFFFF3AB8 /begin FUNCTION_LIST KF7-301.16[5] /end FUNCTION_LIST /end MEASUREMENT
/begin MEASUREMENT vCURGP "An actual gear position (CurGP) signal" UBYTE COMP_0068 1 100 0 255 ECU_ADDRESS 0xFFFF88C2
 /begin FUNCTION_LIST KF7-0.2[145] KF7-312.6[34] KF7-330.5[53] KF7-330.9[8] KF7-340.7[4] KF7-340.9M[3] KF7-340.9P[3] KF7-360.8M[4] KF7-360.9M[43] KF7-360.12[6] KF7-385.1[32] KF7-385.2[18] R000.1.RS_Integ_1_10_2 R204.1.CanComm_1_9_2 R301.23.ADV_calculation_1_1_2 /end FUNCTION_LIST
/end MEASUREMENT
/begin MEASUREMENT vDAPS1V "The amount of a change in accelerator pedal sensor 1 open-degree" UWORD COMP_0393 1 100 -163840 163835 ECU_ADDRESS 0xFFFF3AEC /begin FUNCTION_LIST KF7-301.25[11] /end FUNCTION_LIST /end MEASUREMENT
/begin MEASUREMENT vDAPS2V "The amount of a change in accelerator pedal sensor 2 open-degree" UWORD COMP_0393 1 100 -163840 163835 ECU_ADDRESS 0xFFFF3AEE /begin FUNCTION_LIST KF7-301.25[11] /end FUNCTION_LIST /end MEASUREMENT
/begin MEASUREMENT vDELTAN "É¢TAN" UBYTE COMP_0003 1 100 0 255 ECU_ADDRESS 0xFFFF3AF0 /begin FUNCTION_LIST KF7-301.16[5] /end FUNCTION_LIST /end MEASUREMENT
/begin MEASUREMENT vDOFST "The amount of offset learning renewal" SWORD COMP_0353 1 100 -163840 163835 ECU_ADDRESS 0xFFFF1E7A /begin FUNCTION_LIST KF7-301.25[11] /end FUNCTION_LIST /end MEASUREMENT
/begin MEASUREMENT vDPAMB "Atomospheric pressure output value" UWORD COMP_0050 1 100 0 5119.921875 ECU_ADDRESS 0xFFFF4920 /begin FUNCTION_LIST KF7-301.19[8] /end FUNCTION_LIST /end MEASUREMENT
/begin MEASUREMENT vDTWF "Temperature non-balance condition coefficient" UBYTE COMP_0044 1 100 0 1.9921875 ECU_ADDRESS 0xFFFF898A
 /begin FUNCTION_LIST KF7-301.8M[3] KF7-312.3A[27] KF7-312.4A[6] KF7-312.4C[4] KF7-312.5C[1] /end FUNCTION_LIST
/end MEASUREMENT
/begin MEASUREMENT vE "At the time of the idle, relative value requirement engine torque control value" UBYTE COMP_0009 1 100 0 199.21875 ECU_ADDRESS 0xFFFF1FBC
 /begin FUNCTION_LIST KF7-0.2[145] KF7-304.2[21] KF7-305.1[7] KF7-305.4BM[31] KF7-305.14[2] KF7-312.2A[16] KF7-312.3A[27] KF7-320A.9[9] KF7-320A.10[14] KF7-320A.18[4] KF7-320A.22[5] KF7-386.2[4] KF7-390.1A[3] KF7-450.9A[5] KF7-500.1[54] KF7-500.2A[29] KF7-500.6D[9] KF7-500.26[17] KF7-500.30[8] KF7-505.22[3] KF7-580.1[8] /end FUNCTION_LIST
/end MEASUREMENT
/begin MEASUREMENT vEGRQ "Target EGR rate map value" UBYTE COMP_0141 1 100 0 49.8046875 ECU_ADDRESS 0xFFFF12CC /begin FUNCTION_LIST KF7-0.2[145] /end FUNCTION_LIST /end MEASUREMENT
/begin MEASUREMENT vERQH0 "vDOFST value choice condition value" SLONG COMP_0415 1 100 -8388608 8388607.99609375 ECU_ADDRESS 0xFFFF1EAC /begin FUNCTION_LIST KF7-301.25[11] /end FUNCTION_LIST /end MEASUREMENT
/begin MEASUREMENT vEVOUTT "Purge valve operation drive period" UWORD COMP_0417 1 100 0 524280 ECU_ADDRESS 0xFFFF1FC6 /begin FUNCTION_LIST KF7-301.21[1] KF7-371.1E[15] /end FUNCTION_LIST /end MEASUREMENT
/begin MEASUREMENT vEVPION "Coil electric current value" UWORD COMP_0418 1 100 0 163837.5 ECU_ADDRESS 0xFFFF1FC8 /begin FUNCTION_LIST KF7-301.21[1] /end FUNCTION_LIST /end MEASUREMENT
/begin MEASUREMENT vEVPOUT "Purge output pulse width" UWORD COMP_0417 1 100 0 524280 ECU_ADDRESS 0xFFFF1FCA
 /begin FUNCTION_LIST KF7-0.2[145] KF7-301.21[1] KF7-371.1E[15] KF7-450.50[10] KF7-500.76[8] /end FUNCTION_LIST
/end MEASUREMENT
/begin MEASUREMENT vEVPR "Coil electric current weighted average value" UWORD COMP_0418 1 100 0 163837.5 ECU_ADDRESS 0xFFFF1FCC /begin FUNCTION_LIST KF7-301.21[1] KF7-371.1E[15] /end FUNCTION_LIST /end MEASUREMENT
/begin MEASUREMENT vFCADV "At the time of the fuel cut, ignition timing compensation value" UWORD COMP_0081 1 100 0 255.99609375 ECU_ADDRESS 0xFFFF22EC
 /begin FUNCTION_LIST KF7-0.2[145] KF7-386.2[4] KF7-390.1A[3] KF7-390.3A[15] R301.5.FuelCut_1_2_2 R301.23.ADV_calculation_1_1_2 /end FUNCTION_LIST
/end MEASUREMENT
/begin MEASUREMENT vGKTVO "Throttle sensor offset learning value" UWORD COMP_0431 1 100 0 89.998625685 ECU_ADDRESS 0xFFFF1EB4 /begin FUNCTION_LIST KF7-301.25[11] KF7-304.13[N] KF7-450.7[2] /end FUNCTION_LIST /end MEASUREMENT
/begin MEASUREMENT vGKTVOF "Throttle sensor offset learning value" UBYTE COMP_0023 1 100 0 1275 ECU_ADDRESS 0xFFFFA012 /begin FUNCTION_LIST KF7-301.25[11] /end FUNCTION_LIST /end MEASUREMENT
/begin MEASUREMENT vGOV "At the time of the idle, GOV" SBYTE COMP_0018 1 100 -128 127 ECU_ADDRESS 0xFFFF13D7
 /begin FUNCTION_LIST KF7-0.2[145] KF7-320A.1[6] KF7-320A.10[14] KF7-320A.18[4] KF7-386.2[4] KF7-390.1A[3] KF7-390.3A[15] R301.25.GOV_idle_1_0_2 /end FUNCTION_LIST
/end MEASUREMENT
/begin MEASUREMENT vHOSCMAX "The amount of maximum O2 storage" SLONG COMP_0094_S 1 100 -21474836.48 21474836.47 ECU_ADDRESS 0xFFFFA490 /begin FUNCTION_LIST KF7-0.2[145] KF7-313C.1[36] KF7-313C.5[3] KF7-500.21[19] /end FUNCTION_LIST /end MEASUREMENT
/begin MEASUREMENT vHOSCMAX_R#1 "The amount of maximum O2 storage" SLONG COMP_0094_S 1 100 -21474836.48 21474836.47 ECU_ADDRESS 0xFFFFA490 /begin FUNCTION_LIST KF7-0.2[145] KF7-313C.1[36] KF7-313C.5[3] KF7-500.21[19] /end FUNCTION_LIST /end MEASUREMENT
/begin MEASUREMENT vHOSCMAX_R#2 "The amount of maximum O2 storage" SLONG COMP_0094_S 1 100 -21474836.48 21474836.47 ECU_ADDRESS 0xFFFFA494 /begin FUNCTION_LIST KF7-0.2[145] KF7-313C.1[36] KF7-313C.5[3] KF7-500.21[19] /end FUNCTION_LIST /end MEASUREMENT
/begin MEASUREMENT vHWENAVE "The mean of the square of VB-VHW# of around the unit time" UBYTE COMP_0096_S 1 100 0 326400000 ECU_ADDRESS 0xFFFF37F3 /begin FUNCTION_LIST KF7-301.1[7] /end FUNCTION_LIST /end MEASUREMENT
/begin MEASUREMENT vHWENRG "The integration value of the square of VB-VHW#" ULONG COMP_0097_S 1 100 0 5497558137600 ECU_ADDRESS 0xFFFF37F4 /begin FUNCTION_LIST KF7-301.1[7] /end FUNCTION_LIST /end MEASUREMENT
/begin MEASUREMENT vIA1CL "Accelerator pedal 1 full-close position learning value" UWORD COMP_0023 1 100 0 327675 ECU_ADDRESS 0xFFFFB600
 /begin FUNCTION_LIST KF7-301.25[11] KF7-305.1[7] KF7-305.4AM[10] R000.4.EepAlloc_1_2_2 /end FUNCTION_LIST
/end MEASUREMENT
/begin MEASUREMENT vIA2CL "APS2CL backup reversal data value" UWORD COMP_0023 1 100 0 327675 ECU_ADDRESS 0xFFFFB602
 /begin FUNCTION_LIST KF7-301.25[11] KF7-305.1[7] KF7-305.4AM[10] R000.4.EepAlloc_1_2_2 /end FUNCTION_LIST
/end MEASUREMENT
/begin MEASUREMENT vINWFT "TWF operation initial value" UBYTE COMP_0323 1 100 -200 118.75 ECU_ADDRESS 0xFFFF1EB6 /begin FUNCTION_LIST KF7-301.8M[3] /end FUNCTION_LIST /end MEASUREMENT
/begin MEASUREMENT vIROB "The absolute value of the electric current order value (before the limiter)" ULONG COMP_0600_S 1 100 0 32766.305493555 ECU_ADDRESS 0xFFFF36AC /begin FUNCTION_LIST KF7-301.25[11] KF7-360.1[12] KF7-525.2[6] /end FUNCTION_LIST /end MEASUREMENT
/begin MEASUREMENT vIROBS "The sign of IROB" UBYTE COMP_0068 1 100 0 255 ECU_ADDRESS 0xFFFF35ED /begin FUNCTION_LIST KF7-301.25[11] KF7-360.1[12] /end FUNCTION_LIST /end MEASUREMENT
/begin MEASUREMENT vISCV "Idle speed adjustment volume voltage" UBYTE COMP_0054 1 100 0 5100 ECU_ADDRESS 0xFFFF89AE
 /begin FUNCTION_LIST KF7-0.2[145] KF7-320A.3[N] KF7-330.4A[53] KF7-360.8M[4] KF7-460.1[6] KF7-500.21[19] KF7-500.26[17] KF7-580.1[8] R301.8.Inverse_filter_1_1_3 /end FUNCTION_LIST
/end MEASUREMENT
/begin MEASUREMENT vIT1CL "(MainCPU) bit reversal data for the TPS1CL diagnosis" SWORD COMP_0408 1 100 -163840 163835 ECU_ADDRESS 0xFFFFB606
 /begin FUNCTION_LIST KF7-301.25[11] KF7-305.1[7] KF7-305.4AM[10] KF7-580.1[8] R000.4.EepAlloc_1_2_2 /end FUNCTION_LIST
/end MEASUREMENT
/begin MEASUREMENT vIT2CL "(MainCPU) bit reversal data for the TPS2CL diagnosis" SWORD COMP_0408 1 100 -163840 163835 ECU_ADDRESS 0xFFFFB608
 /begin FUNCTION_LIST KF7-301.25[11] KF7-305.1[7] KF7-305.4AM[10] KF7-580.1[8] R000.4.EepAlloc_1_2_2 /end FUNCTION_LIST
/end MEASUREMENT
/begin MEASUREMENT vIT4BCL "The throttle sensor 1, input voltage of four times - (After it deals with an average.)" UWORD COMP_0061 1 100 0 327675 ECU_ADDRESS 0xFFFFB532
 /begin FUNCTION_LIST KF7-301.25[11] KF7-305.1[7] KF7-580.1[8] R000.4.EepAlloc_1_2_2 /end FUNCTION_LIST
/end MEASUREMENT
/begin MEASUREMENT vKNFIL1 "Knock-fail voltage 1" UBYTE COMP_0054 1 100 0 5100 ECU_ADDRESS 0xFFFF49B9 /begin FUNCTION_LIST KF7-301.15[4] KF7-500.12[3] /end FUNCTION_LIST /end MEASUREMENT
/begin MEASUREMENT vKNFIL2 "Knock-fail voltage 2" UBYTE COMP_0054 1 100 0 5100 ECU_ADDRESS 0xFFFF49BA /begin FUNCTION_LIST KF7-301.15[4] KF7-500.12[3] /end FUNCTION_LIST /end MEASUREMENT
/begin MEASUREMENT vKTRM "A/F flat compensation coefficient" UBYTE COMP_0044 1 100 0 1.9921875 ECU_ADDRESS 0xFFFF1EBE
 /begin FUNCTION_LIST KF7-0.2[145] KF7-301.25[11] KF7-304.2[21] KF7-304.13[N] KF7-313C.1[36] KF7-314.1F[1] KF7-460.1[6] /end FUNCTION_LIST
/end MEASUREMENT
/begin MEASUREMENT vKVCC1 "AD conversion compensation value 1" UWORD COMP_0069 1 100 0 1.999970916 ECU_ADDRESS 0xFFFFA4C2 /begin FUNCTION_LIST KF7-301.4[3] KF7-400.1[1] KF7-400.2[N] KF7-400.3[N] /end FUNCTION_LIST /end MEASUREMENT
/begin MEASUREMENT vLNRPM "Engine speed" UBYTE COMP_0006 1 100 0 3187.5 ECU_ADDRESS 0xFFFF8A42
 /begin FUNCTION_LIST KF7-301.25[11] KF7-302.4MA[13] KF7-303.5A[9] KF7-303.6M[5] KF7-304.2[21] KF7-304.10[1] KF7-311.1A[21] KF7-312.1C[N] KF7-312.2A[16] KF7-312.3A[27] KF7-320A.10[14] KF7-320A.19[7] KF7-330.5[53] KF7-330.7A[1] KF7-330.8[1] KF7-330.9[8] KF7-340.7[4] KF7-360.9M[43] KF7-376.2[21] KF7-393.1C[8] KF7-410.12[2] KF7-450.5[1] KF7-450.9A[5] KF7-500.1[54] KF7-500.6D[9] KF7-500.7[12] KF7-500.21[19] KF7-500.47B[15] KF7-580.1[8] R301.1.Torque_realization_1_0_3 R301.6.IscAirflow_1_4_5 R301.10.TITM_1_0_2 R301.25.GOV_idle_1_0_2 /end FUNCTION_LIST
/end MEASUREMENT
/begin MEASUREMENT vMBTCAL "MBT operation value" SBYTE COMP_0018 1 100 -128 127 ECU_ADDRESS 0xFFFF23E7
 /begin FUNCTION_LIST KF7-0.2[145] KF7-320A.8[2] KF7-320A.15[4] KF7-320A.18[4] KF7-385.2[18] KF7-386.1[4] KF7-386.2[4] KF7-390.1A[3] R301.1.Torque_realization_1_0_3 R301.22.TRHOSI_1_0_2 R301.23.ADV_calculation_1_1_2 /end FUNCTION_LIST
/end MEASUREMENT
/begin MEASUREMENT vMCRNTAVE "Motor drive electric current value (average treatment)" UBYTE COMP_0100_S 1 100 0 25.5 ECU_ADDRESS 0xFFFF3DEE
 /begin FUNCTION_LIST KF7-301.25[11] KF7-301.30[2] KF7-505.26[2] KF7-505.32[6] KF7-525.2[6] /end FUNCTION_LIST
/end MEASUREMENT
/begin MEASUREMENT vMF "The amount of adhesion" ULONG COMP_0144 1 100 0 2097150.9257699 ECU_ADDRESS 0xFFFF157C /begin FUNCTION_LIST KF7-0.2[145] KF7-312.4A[6] KF7-312.4C[4] KF7-330.5[53] /end FUNCTION_LIST /end MEASUREMENT
/begin MEASUREMENT vMISA "Misfire parameter" UBYTE COMP_0605_S 1 100 -128 127 ECU_ADDRESS 0xFFFF36FA /begin FUNCTION_LIST KF7-0.2[145] KF7-500.26[17] /end FUNCTION_LIST /end MEASUREMENT
/begin MEASUREMENT vMISC "Misfire parameter" UBYTE COMP_0605_S 1 100 -128 127 ECU_ADDRESS 0xFFFF3704 /begin FUNCTION_LIST KF7-0.2[145] KF7-500.26[17] /end FUNCTION_LIST /end MEASUREMENT
/begin MEASUREMENT vNEXTGP "Next gear position" UBYTE COMP_0068 1 100 0 255 ECU_ADDRESS 0xFFFF88C4
 /begin FUNCTION_LIST KF7-0.2[145] KF7-302.6A[4] KF7-312.6[34] KF7-340.9M[3] KF7-340.9P[3] KF7-360.9M[43] KF7-360.12[6] KF7-385.1[32] KF7-385.2[18] R204.1.CanComm_1_9_2 /end FUNCTION_LIST
/end MEASUREMENT
/begin MEASUREMENT vNRPM "Engine speed" UWORD COMP_0006 1 100 0 819187.5 ECU_ADDRESS 0xFFFF8A4C
 /begin FUNCTION_LIST KF7-301.25[11] KF7-302.5M[10] KF7-303.6M[5] KF7-304.2[21] KF7-304.5[N] KF7-304.9[2] KF7-311.1A[21] KF7-312.1C[N] KF7-312.2A[16] KF7-312.6[34] KF7-313C.1[36] KF7-313C.6[5] KF7-313C.11B[1] KF7-314.1F[1] KF7-320A.4[6] KF7-320A.8[2] KF7-320A.9[9] KF7-320A.14[1] KF7-320A.15[4] KF7-320A.19[7] KF7-320A.21[N] KF7-360.9M[43] KF7-379.1[9] KF7-379.2[1] KF7-385.2[18] KF7-450.9A[5] KF7-450.50[10] KF7-500.1[54] KF7-500.7[12] KF7-500.10[3] KF7-500.20B[4] KF7-500.21[19] KF7-500.26[17] KF7-500.38A[4] KF7-580.1[8] R301.1.Torque_realization_1_0_3 R301.2.MapBreakpoint_1_1_2 R301.5.FuelCut_1_2_2 R301.9.Target_Equivalent_Ratio_1_0_2 R301.23.ADV_calculation_1_1_2 R904.1.Gst_on_can_1_0_1 /end FUNCTION_LIST
/end MEASUREMENT
/begin MEASUREMENT vPAMB "Atomospheric pressure output value" UWORD COMP_0486 1 100 0 5119.921875 ECU_ADDRESS 0xFFFFA080
 /begin FUNCTION_LIST KF7-0.2[145] KF7-301.19[8] KF7-312.1C[N] KF7-330.5[53] KF7-351.3[11] KF7-360.9M[43] KF7-410.11M[4] KF7-500.1[54] KF7-500.30[8] KF7-500.38A[4] KF7-500.74[11] KF7-580.1[8] R000.1.RS_Integ_1_10_2 R301.13.FFDforDiagOnCAN_1_1_3 R901.1.Diag_on_can_app_1_6_2 /end FUNCTION_LIST
/end MEASUREMENT
/begin MEASUREMENT vPAMBA "After the weighted average, sensor voltage" UWORD COMP_0486 1 100 0 5119.921875 ECU_ADDRESS 0xFFFFB640 /begin FUNCTION_LIST KF7-301.19[8] /end FUNCTION_LIST /end MEASUREMENT
/begin MEASUREMENT vPAMBO "In front of 1s, atomospheric pressure absolute value" UWORD COMP_0050 1 100 0 5119.921875 ECU_ADDRESS 0xFFFF3E24 /begin FUNCTION_LIST KF7-301.19[8] /end FUNCTION_LIST /end MEASUREMENT
/begin MEASUREMENT vPDACOF "At the time of A/C relay off, latest value Pd pressure" UBYTE COMP_0011 1 100 0 5.1 ECU_ADDRESS 0xFFFF89BA /begin FUNCTION_LIST KF7-301.13[1] KF7-330.5[53] /end FUNCTION_LIST /end MEASUREMENT
/begin MEASUREMENT vPDACON "At the time of A/C relay on, latest value Pd pressure" UBYTE COMP_0011 1 100 0 5.1 ECU_ADDRESS 0xFFFF89BB /begin FUNCTION_LIST KF7-301.13[1] KF7-330.5[53] /end FUNCTION_LIST /end MEASUREMENT
/begin MEASUREMENT vPDPREN "Pd pressure" UBYTE COMP_0011 1 100 0 5.1 ECU_ADDRESS 0xFFFF89BC
 /begin FUNCTION_LIST KF7-301.13[1] KF7-330.4A[53] KF7-376.1[6] KF7-376.4[4] KF7-377.1A[19] KF7-385.1[32] /end FUNCTION_LIST
/end MEASUREMENT
/begin MEASUREMENT vPDPREN1 "Pd pressure 1" UWORD COMP_0010 1 100 0 196.605 ECU_ADDRESS 0xFFFF1EF4 /begin FUNCTION_LIST KF7-301.13[1] /end FUNCTION_LIST /end MEASUREMENT
/begin MEASUREMENT vPDPRES "Pd pressure sensor voltage" UWORD COMP_0023 1 100 0 327675 ECU_ADDRESS 0xFFFF89BE
 /begin FUNCTION_LIST KF7-301.13[1] KF7-460.1[6] KF7-580.1[8] R000.1.RS_Integ_1_10_2 R301.13.FFDforDiagOnCAN_1_1_3 R901.1.Diag_on_can_app_1_6_2 /end FUNCTION_LIST
/end MEASUREMENT
/begin MEASUREMENT vPFDUTY "Output duty" UBYTE COMP_0047 1 100 0 127.5 ECU_ADDRESS 0xFFFF1650 /begin FUNCTION_LIST KF7-0.2[145] KF7-580.1[8] /end FUNCTION_LIST /end MEASUREMENT
/begin MEASUREMENT vPRESS "At the time of the start, an atomospheric pressure for pulse width compensation" UWORD COMP_0050 1 100 0 5119.921875 ECU_ADDRESS 0xFFFF89C0
 /begin FUNCTION_LIST KF7-301.19[8] KF7-311.1A[21] KF7-312.1C[N] R000.1.RS_Integ_1_10_2 /end FUNCTION_LIST
/end MEASUREMENT
/begin MEASUREMENT vQA4 "Inhalation air quantity index number" UWORD COMP_0004 1 100 0 65535 ECU_ADDRESS 0xFFFF888A
 /begin FUNCTION_LIST KF7-301.1[7] KF7-304.1B[5] KF7-500.8[5] KF7-500.60[5] R901.1.Diag_on_can_app_1_6_2 /end FUNCTION_LIST
/end MEASUREMENT
/begin MEASUREMENT vQH0 "TVO-N flow-quantity" UBYTE COMP_0032 1 100 0 0.99609375 ECU_ADDRESS 0xFFFF89C2
 /begin FUNCTION_LIST KF7-0.2[145] KF7-301.8M[3] KF7-301.25[11] KF7-304.1B[5] KF7-304.2[21] KF7-304.9[2] KF7-304.13[N] KF7-312.4A[6] KF7-312.4C[4] KF7-312.5A[4] KF7-312.5C[1] KF7-330.5[53] KF7-340.1M[8] KF7-340.1P[7] KF7-340.2M[2] KF7-340.2P[1] KF7-340.8M[8] KF7-340.8P[8] KF7-350.4M[14] KF7-351.3[11] KF7-360.8M[4] KF7-360.9M[43] KF7-360.12[6] KF7-371.1E[15] KF7-385.3[4] KF7-410.11M[4] KF7-410.11P[4] KF7-410.17M[5] KF7-410.17P[1] KF7-500.7[12] KF7-505.50[1] R301.2.MapBreakpoint_1_1_2 /end FUNCTION_LIST
/end MEASUREMENT
/begin MEASUREMENT vQH0QL "Air learning QH0 basic value" UWORD COMP_0146 1 100 0 99.998480265 ECU_ADDRESS 0xFFFF30DE /begin FUNCTION_LIST KF7-0.2[145] KF7-304.9[2] KF7-304.13[N] KF7-351.3[11] /end FUNCTION_LIST /end MEASUREMENT
/begin MEASUREMENT vRAC "Inside element ÉCÉìÉsÅ[É_ÉìÉX value" UWORD COMP_0415_S 1 100 0 4095.9375 ECU_ADDRESS 0xFFFF1CB0 /begin FUNCTION_LIST KF7-301.18[5] KF7-313C.2[4] KF7-378.3B[5] /end FUNCTION_LIST /end MEASUREMENT
/begin MEASUREMENT vRAC_R#1 "Inside element ÉCÉìÉsÅ[É_ÉìÉX value" UWORD COMP_0415_S 1 100 0 4095.9375 ECU_ADDRESS 0xFFFF1CB0 /begin FUNCTION_LIST KF7-301.18[5] KF7-313C.2[4] KF7-378.3B[5] /end FUNCTION_LIST /end MEASUREMENT
/begin MEASUREMENT vRAC_R#2 "Inside element ÉCÉìÉsÅ[É_ÉìÉX value" UWORD COMP_0415_S 1 100 0 4095.9375 ECU_ADDRESS 0xFFFF1CB2 /begin FUNCTION_LIST KF7-301.18[5] KF7-313C.2[4] KF7-378.3B[5] /end FUNCTION_LIST /end MEASUREMENT
/begin MEASUREMENT vROHCR "The rest O2/H voltage value" UBYTE COMP_0054 1 100 0 5100 ECU_ADDRESS 0xFFFF4966 /begin FUNCTION_LIST KF7-301.6[1] KF7-500.25A[7] KF7-580.1[8] /end FUNCTION_LIST /end MEASUREMENT
/begin MEASUREMENT vSCVSTPD "SCV target open-degree" UWORD COMP_0140 1 100 0 32767.5 ECU_ADDRESS 0xFFFF31C2 /begin FUNCTION_LIST KF7-0.2[145] KF7-450.50[10] KF7-580.1[8] /end FUNCTION_LIST /end MEASUREMENT
/begin MEASUREMENT vSSOFT1 "Condition formation time" UBYTE COMP_0250 1 100 0 1020 ECU_ADDRESS 0xFFFF37FB /begin FUNCTION_LIST KF7-301.1[7] /end FUNCTION_LIST /end MEASUREMENT
/begin MEASUREMENT vSSOFTM "Element, lead initial temperature index number" UWORD COMP_0176 1 100 0 1023.984375 ECU_ADDRESS 0xFFFF37FE /begin FUNCTION_LIST KF7-301.1[7] /end FUNCTION_LIST /end MEASUREMENT
/begin MEASUREMENT vTA "Inhalation air voltage" UWORD COMP_0023 1 100 0 327675 ECU_ADDRESS 0xFFFF4972 /begin FUNCTION_LIST KF7-301.16[5] KF7-500.44[3] R901.1.Diag_on_can_app_1_6_2 /end FUNCTION_LIST /end MEASUREMENT
/begin MEASUREMENT vTAB "Intake air temperature sensor voltage" UBYTE COMP_0054 1 100 0 5100 ECU_ADDRESS 0xFFFF4974 /begin FUNCTION_LIST KF7-301.16[5] KF7-460.1[6] /end FUNCTION_LIST /end MEASUREMENT
/begin MEASUREMENT vTAG "An intake air temperature for GST" UBYTE COMP_0428 1 100 -40 215 ECU_ADDRESS 0xFFFF4975 /begin FUNCTION_LIST KF7-301.16[5] KF7-500.1[54] R904.1.Gst_on_can_1_0_1 /end FUNCTION_LIST /end MEASUREMENT
/begin MEASUREMENT vTAINT "At the time of the start, intake air temperature" UBYTE COMP_0035 1 100 -50 205 ECU_ADDRESS 0xFFFFA088 /begin FUNCTION_LIST KF7-301.16[5] KF7-500.1[54] KF7-580.1[8] /end FUNCTION_LIST /end MEASUREMENT
/begin MEASUREMENT vTAK "An intake air temperature for the table reference" UBYTE COMP_0356 1 100 -40 119.375 ECU_ADDRESS 0xFFFF89C7
 /begin FUNCTION_LIST KF7-301.16[5] KF7-330.4A[53] KF7-330.5[53] KF7-351.3[11] KF7-360.9M[43] KF7-500.7[12] R000.1.RS_Integ_1_10_2 /end FUNCTION_LIST
/end MEASUREMENT
/begin MEASUREMENT vTAMNBU "TANBMN backup value" UBYTE COMP_0035 1 100 -50 205 ECU_ADDRESS 0xFFFFB64C /begin FUNCTION_LIST KF7-301.16[5] /end FUNCTION_LIST /end MEASUREMENT
/begin MEASUREMENT vTAN "Intake air temperature" UBYTE COMP_0035 1 100 -50 205 ECU_ADDRESS 0xFFFF4976
 /begin FUNCTION_LIST KF7-301.16[5] KF7-312.1C[N] KF7-320A.9[9] KF7-360.9M[43] KF7-410.11M[4] KF7-460.1[6] KF7-500.1[54] KF7-500.7[12] KF7-500.38A[4] KF7-500.44[3] KF7-580.1[8] R301.7.KHOT_1_0_2 R301.13.FFDforDiagOnCAN_1_1_3 R901.1.Diag_on_can_app_1_6_2 /end FUNCTION_LIST
/end MEASUREMENT
/begin MEASUREMENT vTANBMN "The one for the catalyst diagnosis, at least, intake air temperature" UBYTE COMP_0035 1 100 -50 205 ECU_ADDRESS 0xFFFF4977
 /begin FUNCTION_LIST KF7-301.16[5] KF7-500.1[54] KF7-500.8[5] KF7-500.21[19] KF7-500.26[17] KF7-500.30[8] KF7-500.38A[4] KF7-500.39[5] KF7-500.60[5] KF7-580.1[8] /end FUNCTION_LIST
/end MEASUREMENT
/begin MEASUREMENT vTANMIN "At least, intake air temperature" UBYTE COMP_0035 1 100 -50 205 ECU_ADDRESS 0xFFFF4978 /begin FUNCTION_LIST KF7-301.16[5] KF7-500.21[19] /end FUNCTION_LIST /end MEASUREMENT
/begin MEASUREMENT vTANST "At the time of the start, intake air temperature" UBYTE COMP_0035 1 100 -50 205 ECU_ADDRESS 0xFFFF4979 /begin FUNCTION_LIST KF7-301.16[5] KF7-330.4A[53] KF7-500.21[19] /end FUNCTION_LIST /end MEASUREMENT
/begin MEASUREMENT vTATE "PTD torque area conversion value" UWORD COMP_0042 1 100 0 52.428 ECU_ADDRESS 0xFFFF1808
 /begin FUNCTION_LIST KF7-0.2[145] KF7-340.1M[8] KF7-340.1P[7] KF7-340.7[4] KF7-350.1M[5] KF7-350.1P[4] KF7-410.17M[5] KF7-410.17P[1] KF7-500.1[54] KF7-500.2A[29] KF7-505.52[1] KF7-525.2[6] KF7-525.2S[10] R301.20.AmbientComp_1_0_2 R301.21.SafetyLevel2_1_0_2 /end FUNCTION_LIST
/end MEASUREMENT
/begin MEASUREMENT vTENG "Engine torque" SWORD COMP_0228 1 100 -3276.8 3276.7 ECU_ADDRESS 0xFFFF240C
 /begin FUNCTION_LIST KF7-0.2[145] KF7-386.1[4] KF7-410.10[6] R000.1.RS_Integ_1_10_2 R301.1.Torque_realization_1_0_3 /end FUNCTION_LIST
/end MEASUREMENT
/begin MEASUREMENT vTFBYA00 "Target air-fuel ratio basic value" UWORD COMP_0057 1 100 0 3.999941832 ECU_ADDRESS 0xFFFF18B0
 /begin FUNCTION_LIST KF7-0.2[145] KF7-330.5[53] KF7-350.4M[14] KF7-350.4P[13] KF7-351.3[11] KF7-580.1[8] /end FUNCTION_LIST
/end MEASUREMENT
/begin MEASUREMENT vTFDD "The D range target drive power" SWORD COMP_0030_S 1 100 -32768 32767 ECU_ADDRESS 0xFFFF18DC /begin FUNCTION_LIST KF7-0.2[145] KF7-340.3M[1] KF7-340.7[4] KF7-340.8M[8] /end FUNCTION_LIST /end MEASUREMENT
/begin MEASUREMENT vTFDPTD "The final target drive power" SWORD COMP_0030_S 1 100 -32768 32767 ECU_ADDRESS 0xFFFF18E2 /begin FUNCTION_LIST KF7-0.2[145] KF7-340.8M[8] /end FUNCTION_LIST /end MEASUREMENT
/begin MEASUREMENT vTGTVOGK "Target throttle open-degree for learning" UWORD COMP_0164_S 1 100 -14.08205 98.55623125 ECU_ADDRESS 0xFFFF3742 /begin FUNCTION_LIST KF7-301.25[11] KF7-360.1[12] /end FUNCTION_LIST /end MEASUREMENT
/begin MEASUREMENT vTGTVOLM "After the full-open limiter, target throttle open-degree" UWORD COMP_0164_S 1 100 -14.08205 98.55623125 ECU_ADDRESS 0xFFFF3744 /begin FUNCTION_LIST KF7-301.25[11] KF7-360.1[12] KF7-505.33[8] /end FUNCTION_LIST /end MEASUREMENT
/begin MEASUREMENT vTINT "An interval for the misfire judgement" ULONG COMP_0376 1 100 0 429496729.5 ECU_ADDRESS 0xFFFF1D30 /begin FUNCTION_LIST KF7-0.2[145] KF7-303.5A[9] KF7-500.26[17] /end FUNCTION_LIST /end MEASUREMENT
/begin MEASUREMENT vTINT_R#1 "An interval for the misfire judgement" ULONG COMP_0376 1 100 0 429496729.5 ECU_ADDRESS 0xFFFF1D30 /begin FUNCTION_LIST KF7-0.2[145] KF7-303.5A[9] KF7-500.26[17] /end FUNCTION_LIST /end MEASUREMENT
/begin MEASUREMENT vTINT_R#2 "An interval for the misfire judgement" ULONG COMP_0376 1 100 0 429496729.5 ECU_ADDRESS 0xFFFF1D34 /begin FUNCTION_LIST KF7-0.2[145] KF7-303.5A[9] KF7-500.26[17] /end FUNCTION_LIST /end MEASUREMENT
/begin MEASUREMENT vTITM "A basic injection timing" UWORD COMP_0190 1 100 0 131070 ECU_ADDRESS 0xFFFF193A
 /begin FUNCTION_LIST KF7-0.2[145] KF7-311.1A[21] KF7-450.9A[5] KF7-460.1[6] KF7-525.2[6] R301.10.TITM_1_0_2 R901.1.Diag_on_can_app_1_6_2 /end FUNCTION_LIST
/end MEASUREMENT
/begin MEASUREMENT vTMHOS "Element, lead initial temperature compensation value" UBYTE COMP_0021 1 100 0 99.609375 ECU_ADDRESS 0xFFFF3801 /begin FUNCTION_LIST KF7-301.1[7] /end FUNCTION_LIST /end MEASUREMENT
/begin MEASUREMENT vTMPCAT "Catalyst estimated temperature" UBYTE COMP_0062 1 100 0 1020 ECU_ADDRESS 0xFFFF3349 /begin FUNCTION_LIST KF7-0.2[145] KF7-378.2B[6] KF7-500.1[54] KF7-500.21[19] /end FUNCTION_LIST /end MEASUREMENT
/begin MEASUREMENT vTP "Cylinder intake quantity equivalent pulse width" UWORD COMP_0144 1 100 0 31.999495335 ECU_ADDRESS 0xFFFF886E
 /begin FUNCTION_LIST KF7-0.2[145] KF7-301.25[11] KF7-304.1B[5] KF7-304.2[21] KF7-304.3[2] KF7-305.7[6] KF7-311.1A[21] KF7-312.1C[N] KF7-312.3A[27] KF7-312.4A[6] KF7-312.4C[4] KF7-312.5A[4] KF7-312.5C[1] KF7-312.6[34] KF7-313C.1[36] KF7-313C.4[3] KF7-313C.5[3] KF7-313C.9[3] KF7-313C.11B[1] KF7-314.1F[1] KF7-320A.4[6] KF7-320A.9[9] KF7-320A.13[N] KF7-320A.14[1] KF7-320A.17[N] KF7-320A.22[5] KF7-350.4M[14] KF7-350.4P[13] KF7-351.3[11] KF7-371.1E[15] KF7-376.2[21] KF7-378.2B[6] KF7-379.2[1] KF7-379.5[3] KF7-386.1[4] KF7-393.1C[8] KF7-395.1[4] KF7-450.5[1] KF7-450.7[2] KF7-450.50[10] KF7-500.1[54] KF7-500.16[4] KF7-500.20B[4] KF7-500.21[19] KF7-500.24[10] KF7-500.25A[7] KF7-500.26[17] KF7-500.28[4] KF7-500.30[8] KF7-500.39[5] KF7-500.51[3] KF7-500.59[6] KF7-500.74[11] KF7-500.76[8] KF7-505.23[2] KF7-580.1[8] R301.2.MapBreakpoint_1_1_2 /end FUNCTION_LIST
/end MEASUREMENT
/begin MEASUREMENT vTPINT "TP initial value" UWORD COMP_0635_S 1 100 0 31.9994298 ECU_ADDRESS 0xFFFF1DD4 /begin FUNCTION_LIST KF7-301.25[11] KF7-304.2[21] /end FUNCTION_LIST /end MEASUREMENT
/begin MEASUREMENT vTPO "Throttle open-degree" UWORD COMP_0005 1 100 0 7208.85 ECU_ADDRESS 0xFFFF3F6E /begin FUNCTION_LIST KF7-301.25[11] KF7-500.7[12] KF7-505.2[9] /end FUNCTION_LIST /end MEASUREMENT
/begin MEASUREMENT vTPO1 "Throttle 1 open-degree" UWORD COMP_0005 1 100 0 7208.85 ECU_ADDRESS 0xFFFF497E
 /begin FUNCTION_LIST KF7-301.25[11] KF7-301.25M[5] KF7-304.9[2] KF7-304.13[N] KF7-351.3[11] KF7-450.50[10] KF7-500.7[12] KF7-505.2[9] KF7-505.15[4] KF7-505.28[1] KF7-505.31[5] KF7-505.32[6] KF7-505.33[8] KF7-505.34[3] KF7-525.2[6] R000.1.RS_Integ_1_10_2 R901.1.Diag_on_can_app_1_6_2 /end FUNCTION_LIST
/end MEASUREMENT
/begin MEASUREMENT vTPO1OV "Throttle open-degree 1" UWORD COMP_0164_S 1 100 -14.08205 98.55623125 ECU_ADDRESS 0xFFFF475C /begin FUNCTION_LIST KF7-301.25[11] KF7-360.1[12] KF7-505.28[1] KF7-505.33[8] /end FUNCTION_LIST /end MEASUREMENT
/begin MEASUREMENT vTPO2 "Throttle 2 open-degree" UWORD COMP_0005 1 100 0 7208.85 ECU_ADDRESS 0xFFFF4980
 /begin FUNCTION_LIST KF7-301.25[11] KF7-301.25P[5] KF7-360.1[12] KF7-505.2[9] KF7-525.2[6] R000.1.RS_Integ_1_10_2 R901.1.Diag_on_can_app_1_6_2 /end FUNCTION_LIST
/end MEASUREMENT
/begin MEASUREMENT vTPO4OV "Throttle open-degree 1 (four times)" UWORD COMP_0164_S 1 100 -14.08205 98.55623125 ECU_ADDRESS 0xFFFF475E /begin FUNCTION_LIST KF7-301.25[11] KF7-360.1[12] KF7-505.28[1] /end FUNCTION_LIST /end MEASUREMENT
/begin MEASUREMENT vTPOK "For the throttle open-degree table reference" UBYTE COMP_0002 1 100 0 89.25 ECU_ADDRESS 0xFFFF4982 /begin FUNCTION_LIST KF7-301.25[11] KF7-505.2[9] /end FUNCTION_LIST /end MEASUREMENT
/begin MEASUREMENT vTPS1AV "Throttle sensor 1 input voltage (After it deals with an average.)" UWORD COMP_0061 1 100 0 327675 ECU_ADDRESS 0xFFFF3750 /begin FUNCTION_LIST KF7-301.25[11] /end FUNCTION_LIST /end MEASUREMENT
/begin MEASUREMENT vTPS1CL "(MainCPU) Throttle sensor 1 full-close learning value" UWORD COMP_0061 1 100 0 327675 ECU_ADDRESS 0xFFFFA08A
 /begin FUNCTION_LIST KF7-301.25[11] KF7-305.1[7] KF7-305.4AM[10] KF7-505.26[2] KF7-505.29[4] KF7-580.1[8] R000.4.EepAlloc_1_2_2 R901.1.Diag_on_can_app_1_6_2 /end FUNCTION_LIST
/end MEASUREMENT
/begin MEASUREMENT vTPS1CLJD "Throttle sensor 1 full-close position judgement input value" UWORD COMP_0061 1 100 0 327675 ECU_ADDRESS 0xFFFF375A /begin FUNCTION_LIST KF7-301.25[11] /end FUNCTION_LIST /end MEASUREMENT
/begin MEASUREMENT vTPS1OF "Throttle 1 open-degree" SWORD COMP_0377 1 100 -3604.48 3604.37 ECU_ADDRESS 0xFFFF4984
 /begin FUNCTION_LIST KF7-301.25[11] KF7-301.25M[5] KF7-301.25P[5] KF7-500.1[54] KF7-505.2[9] R000.1.RS_Integ_1_10_2 R904.1.Gst_on_can_1_0_1 /end FUNCTION_LIST
/end MEASUREMENT
/begin MEASUREMENT vTPS1OV "After the overcoat sampling, throttle sensor 1 voltage" UWORD COMP_0050 1 100 0 5119.921875 ECU_ADDRESS 0xFFFF3760 /begin FUNCTION_LIST KF7-301.25[11] /end FUNCTION_LIST /end MEASUREMENT
/begin MEASUREMENT vTPS1V "Throttle sensor 1 voltage" UWORD COMP_0023 1 100 0 327675 ECU_ADDRESS 0xFFFF4784
 /begin FUNCTION_LIST KF7-301.25[11] KF7-351.3[11] KF7-505.2[9] KF7-505.28[1] KF7-505.38[4] KF7-525.1[4] KF7-580.1[8] R901.1.Diag_on_can_app_1_6_2 /end FUNCTION_LIST
/end MEASUREMENT
/begin MEASUREMENT vTPS2AV "Throttle sensor 2 input voltage (After it deals with an average.)" UWORD COMP_0061 1 100 0 327675 ECU_ADDRESS 0xFFFF3768 /begin FUNCTION_LIST KF7-301.25[11] /end FUNCTION_LIST /end MEASUREMENT
/begin MEASUREMENT vTPS2CL "(MainCPU) Throttle sensor 2 full-close learning value" UWORD COMP_0061 1 100 0 327675 ECU_ADDRESS 0xFFFFA08C
 /begin FUNCTION_LIST KF7-301.25[11] KF7-305.1[7] KF7-305.4AM[10] KF7-505.26[2] KF7-505.29[4] KF7-580.1[8] R000.4.EepAlloc_1_2_2 R901.1.Diag_on_can_app_1_6_2 /end FUNCTION_LIST
/end MEASUREMENT
/begin MEASUREMENT vTPS2CLJD "Throttle sensor 2 full-close position judgement input value" UWORD COMP_0061 1 100 0 327675 ECU_ADDRESS 0xFFFF3772 /begin FUNCTION_LIST KF7-301.25[11] /end FUNCTION_LIST /end MEASUREMENT
/begin MEASUREMENT vTPS2OF "Throttle 2 open-degree" SWORD COMP_0377 1 100 -3604.48 3604.37 ECU_ADDRESS 0xFFFF4986
 /begin FUNCTION_LIST KF7-301.25[11] KF7-301.25M[5] KF7-301.25P[5] KF7-500.1[54] KF7-505.2[9] R000.1.RS_Integ_1_10_2 /end FUNCTION_LIST
/end MEASUREMENT
/begin MEASUREMENT vTPS2V "Throttle sensor 2 voltage" UWORD COMP_0023 1 100 0 327675 ECU_ADDRESS 0xFFFF4786
 /begin FUNCTION_LIST KF7-301.25[11] KF7-505.2[9] KF7-525.1[4] KF7-580.1[8] R901.1.Diag_on_can_app_1_6_2 /end FUNCTION_LIST
/end MEASUREMENT
/begin MEASUREMENT vTPS4BAV "The throttle sensor 1, input voltage (After it deals with an average.) of four times" UWORD COMP_0061 1 100 0 327675 ECU_ADDRESS 0xFFFF3774 /begin FUNCTION_LIST KF7-301.25[11] /end FUNCTION_LIST /end MEASUREMENT
/begin MEASUREMENT vTPS4BCJD "The throttle sensor 1, full-close position judgement input value of four times" UWORD COMP_0061 1 100 0 327675 ECU_ADDRESS 0xFFFF377E /begin FUNCTION_LIST KF7-301.25[11] /end FUNCTION_LIST /end MEASUREMENT
/begin MEASUREMENT vTPS4BCL "Throttle sensor 1 (four times input) full-close position learning value" UWORD COMP_0023 1 100 0 327675 ECU_ADDRESS 0xFFFFB546
 /begin FUNCTION_LIST KF7-301.25[11] KF7-305.1[7] KF7-580.1[8] R000.4.EepAlloc_1_2_2 /end FUNCTION_LIST
/end MEASUREMENT
/begin MEASUREMENT vTPS4BOV "After the overcoat sampling, throttle sensor 1 (four times input) voltage" UWORD COMP_0050 1 100 0 5119.921875 ECU_ADDRESS 0xFFFF3780 /begin FUNCTION_LIST KF7-301.25[11] /end FUNCTION_LIST /end MEASUREMENT
/begin MEASUREMENT vTPS4BV "Throttle sensor 1 (four times input) voltage" UWORD COMP_0023 1 100 0 327675 ECU_ADDRESS 0xFFFF35EE /begin FUNCTION_LIST KF7-301.25[11] /end FUNCTION_LIST /end MEASUREMENT
/begin MEASUREMENT vTPSDEFCH "Default passage TPS voltage" UWORD COMP_0023 1 100 0 327675 ECU_ADDRESS 0xFFFF378E /begin FUNCTION_LIST KF7-301.25[11] /end FUNCTION_LIST /end MEASUREMENT
/begin MEASUREMENT vTPTRM "A/F flat compensation pulse width" UWORD COMP_0512 1 100 0 127.998046875 ECU_ADDRESS 0xFFFF8892
 /begin FUNCTION_LIST KF7-301.25[11] KF7-304.2[21] KF7-304.3[2] KF7-305.7[6] KF7-312.1C[N] KF7-312.3A[27] KF7-312.4A[6] KF7-312.4C[4] KF7-312.6[34] KF7-313C.4[3] KF7-313C.5[3] KF7-351.3[11] KF7-371.1E[15] KF7-378.2B[6] KF7-379.2[1] KF7-379.5[3] KF7-393.1C[8] KF7-500.1[54] KF7-500.16[4] KF7-500.21[19] KF7-500.24[10] KF7-500.25A[7] KF7-500.26[17] KF7-500.28[4] KF7-500.30[8] KF7-500.39[5] KF7-500.51[3] KF7-500.59[6] KF7-500.74[11] KF7-500.76[8] /end FUNCTION_LIST
/end MEASUREMENT
/begin MEASUREMENT vTRADV "The amount of initial retard" UBYTE COMP_0017 1 100 0 255 ECU_ADDRESS 0xFFFF19AF
 /begin FUNCTION_LIST KF7-0.2[145] KF7-320A.15[4] KF7-385.1[32] R301.23.ADV_calculation_1_1_2 /end FUNCTION_LIST
/end MEASUREMENT
/begin MEASUREMENT vTS "Invalid pulse width" UWORD COMP_0231 1 100 0 655350 ECU_ADDRESS 0xFFFF2442
 /begin FUNCTION_LIST KF7-0.2[145] KF7-312.1C[N] KF7-312.5A[4] KF7-312.5C[1] KF7-313C.9[3] KF7-314.1F[1] KF7-450.50[10] KF7-580.1[8] /end FUNCTION_LIST
/end MEASUREMENT
/begin MEASUREMENT vTTAAPO "A total basic opening area" UWORD COMP_0042 1 100 0 52.428 ECU_ADDRESS 0xFFFF19D8
 /begin FUNCTION_LIST KF7-301.25[11] KF7-304.9[2] KF7-340.1M[8] KF7-340.1P[7] KF7-340.2M[2] KF7-340.2P[1] KF7-350.1M[5] KF7-350.4M[14] KF7-350.4P[13] KF7-351.3[11] KF7-385.3[4] R000.1.RS_Integ_1_10_2 /end FUNCTION_LIST
/end MEASUREMENT
/begin MEASUREMENT vTTEAPO "APO engine torque order value" SWORD COMP_0228 1 100 -3276.8 3276.7 ECU_ADDRESS 0xFFFF19DE
 /begin FUNCTION_LIST KF7-0.2[145] KF7-340.1P[7] KF7-340.2M[2] KF7-340.6M[2] KF7-340.7[4] KF7-340.8M[8] /end FUNCTION_LIST
/end MEASUREMENT
/begin MEASUREMENT vTTEP "After the TCS/VDC control, PTD requested torque" SWORD COMP_0228 1 100 -3276.8 3276.7 ECU_ADDRESS 0xFFFF19EA
 /begin FUNCTION_LIST KF7-0.2[145] KF7-340.1M[8] KF7-340.1P[7] KF7-360.12[6] KF7-385.2[18] KF7-385.3[4] KF7-410.17M[5] KF7-410.17P[1] KF7-500.2A[29] KF7-505.47[3] KF7-505.53[1] KF7-525.2[6] KF7-525.2S[10] R000.1.RS_Integ_1_10_2 R301.1.Torque_realization_1_0_3 R301.5.FuelCut_1_2_2 R301.20.AmbientComp_1_0_2 R301.21.SafetyLevel2_1_0_2 /end FUNCTION_LIST
/end MEASUREMENT
/begin MEASUREMENT vTTEPTD "PTD target engine torque" SWORD COMP_0228 1 100 -3276.8 3276.7 ECU_ADDRESS 0xFFFF2448
 /begin FUNCTION_LIST KF7-0.2[145] KF7-340.1P[7] KF7-340.7[4] KF7-340.8M[8] KF7-360.9M[43] KF7-360.9P[22] KF7-360.11[1] KF7-360.12[6] KF7-385.3[4] KF7-500.2A[29] KF7-505.51[2] KF7-525.2[6] KF7-525.2S[10] /end FUNCTION_LIST
/end MEASUREMENT
/begin MEASUREMENT vTTWN "Oil temperature rise time constant" UBYTE COMP_0068 1 100 0 255 ECU_ADDRESS 0xFFFF341A /begin FUNCTION_LIST KF7-301.8M[3] KF7-301.16[5] KF7-500.1[54] /end FUNCTION_LIST /end MEASUREMENT
/begin MEASUREMENT vTVO "Throttle open-degree" UBYTE COMP_0002 1 100 0 89.25 ECU_ADDRESS 0xFFFF88A9
 /begin FUNCTION_LIST KF7-301.1[7] KF7-301.8M[3] KF7-301.25[11] KF7-304.1B[5] KF7-304.2[21] KF7-304.9[2] KF7-304.10[1] KF7-304.13[N] KF7-312.1C[N] KF7-312.2A[16] KF7-312.3A[27] KF7-312.4A[6] KF7-312.4C[4] KF7-312.5A[4] KF7-312.5C[1] KF7-312.6[34] KF7-313C.1[36] KF7-313C.4[3] KF7-313C.5[3] KF7-320A.12[N] KF7-320A.13[N] KF7-320A.15[4] KF7-330.5[53] KF7-340.1M[8] KF7-340.1P[7] KF7-340.2M[2] KF7-340.8M[8] KF7-351.3[11] KF7-360.9M[43] KF7-360.12[6] KF7-376.2[21] KF7-385.3[4] KF7-450.5[1] KF7-450.7[2] KF7-500.1[54] KF7-500.7[12] KF7-500.21[19] KF7-500.24[10] KF7-500.26[17] KF7-505.26[2] KF7-580.1[8] R301.13.FFDforDiagOnCAN_1_1_3 R301.23.ADV_calculation_1_1_2 R901.1.Diag_on_can_app_1_6_2 R904.1.Gst_on_can_1_0_1 /end FUNCTION_LIST
/end MEASUREMENT
/begin MEASUREMENT vTVOCOM0 "Throttle open-degree order value" UWORD COMP_0164_S 1 100 -14.08205 98.55623125 ECU_ADDRESS 0xFFFF379A /begin FUNCTION_LIST KF7-301.25[11] KF7-360.1[12] KF7-505.33[8] /end FUNCTION_LIST /end MEASUREMENT
/begin MEASUREMENT vTVOINT "Throttle full-close position learning value" UWORD COMP_0023 1 100 0 327675 ECU_ADDRESS 0xFFFFA08E /begin FUNCTION_LIST KF7-301.25[11] KF7-304.10[1] KF7-500.38A[4] /end FUNCTION_LIST /end MEASUREMENT
/begin MEASUREMENT vTVOMIN "Throttle full-close position" UWORD COMP_0061 1 100 0 327675 ECU_ADDRESS 0xFFFF1F48 /begin FUNCTION_LIST KF7-301.25[11] KF7-304.10[1] /end FUNCTION_LIST /end MEASUREMENT
/begin MEASUREMENT vTVOV "Throttle sensor voltage" UWORD COMP_0061 1 100 0 327675 ECU_ADDRESS 0xFFFF89D2 /begin FUNCTION_LIST KF7-301.25[11] KF7-312.1C[N] KF7-500.7[12] KF7-500.38A[4] /end FUNCTION_LIST /end MEASUREMENT
/begin MEASUREMENT vTW "Coolant temperature sensor voltage" UBYTE COMP_0054 1 100 0 5100 ECU_ADDRESS 0xFFFF89D7
 /begin FUNCTION_LIST KF7-301.8M[3] KF7-312.6[34] KF7-377.1A[19] KF7-450.8[2] KF7-460.1[6] KF7-500.1[54] KF7-500.8[5] KF7-500.44[3] KF7-505.10[2] KF7-580.1[8] R301.5.FuelCut_1_2_2 R901.1.Diag_on_can_app_1_6_2 /end FUNCTION_LIST
/end MEASUREMENT
/begin MEASUREMENT vTWF "Adhesion temperature for wall way compensation" UWORD COMP_0520 1 100 -200 119.995149955 ECU_ADDRESS 0xFFFF1DEA /begin FUNCTION_LIST KF7-0.2[145] KF7-301.8M[3] KF7-312.4C[4] /end FUNCTION_LIST /end MEASUREMENT
/begin MEASUREMENT vTWINT "At the time of the start, coolant temperature" UBYTE COMP_0035 1 100 -50 205 ECU_ADDRESS 0xFFFF88AA
 /begin FUNCTION_LIST KF7-301.8M[3] KF7-301.16[5] KF7-311.1A[21] KF7-312.6[34] KF7-313C.7[1] KF7-314.1F[1] KF7-320A.10[14] KF7-320A.12[N] KF7-320A.13[N] KF7-320A.19[7] KF7-330.4A[53] KF7-378.3B[5] KF7-385.1[32] KF7-450.8[2] KF7-500.1[54] KF7-500.20B[4] KF7-500.21[19] KF7-500.24[10] KF7-500.26[17] KF7-500.39[5] KF7-500.60[5] KF7-580.1[8] R000.1.RS_Integ_1_10_2 R301.6.IscAirflow_1_4_5 /end FUNCTION_LIST
/end MEASUREMENT
/begin MEASUREMENT vTWINTR "At the time of the power supply injection, coolant temperature" UBYTE COMP_0035 1 100 -50 205 ECU_ADDRESS 0xFFFF3835 /begin FUNCTION_LIST KF7-301.8M[3] /end FUNCTION_LIST /end MEASUREMENT
/begin MEASUREMENT vTWK "A coolant temperature for the table reference" UBYTE COMP_0356 1 100 -40 119.375 ECU_ADDRESS 0xFFFF88AB DISPLAY_IDENTIFIER Vxx_tco
 /begin FUNCTION_LIST KF7-0.2[145] KF7-301.8M[3] KF7-301.25[11] KF7-302.4MA[13] KF7-302.5M[10] KF7-304.2[21] KF7-304.3[2] KF7-304.13[N] KF7-311.1A[21] KF7-312.1C[N] KF7-312.3A[27] KF7-312.4A[6] KF7-312.4C[4] KF7-312.5A[4] KF7-312.5C[1] KF7-312.6[34] KF7-320A.8[2] KF7-320A.10[14] KF7-320A.13[N] KF7-320A.19[7] KF7-320A.23[N] KF7-330.1M[3] KF7-330.1P[3] KF7-330.4A[53] KF7-330.5[53] KF7-351.1[16] KF7-351.2[17] KF7-379.2[1] KF7-385.1[32] KF7-385.3[4] KF7-390.3A[15] KF7-393.1C[8] KF7-410.12[2] KF7-450.8[2] KF7-450.9A[5] KF7-500.8[5] KF7-500.26[17] KF7-500.38A[4] KF7-580.1[8] R000.1.RS_Integ_1_10_2 R106.2.epw_mxalt_1_1_0 R106.5.epw_ptcxx_1_1_0 R107.1.iss_ariss_1_0_4 R107.2.iss_atiss_1_0_2 R203.1.crk_mngtx_1_2_1 R203.2.crk_restx_1_0_8 R204.1.CanComm_1_9_2 R301.1.Torque_realization_1_0_3 R301.5.FuelCut_1_2_2 R301.6.IscAirflow_1_4_5 R301.7.KHOT_1_0_2 R301.13.FFDforDiagOnCAN_1_1_3 R301.19.ISC_PID_cont_1_0_2 R301.22.TRHOSI_1_0_2 R301.25.GOV_idle_1_0_2 R901.1.Diag_on_can_app_1_6_2 /end FUNCTION_LIST
/end MEASUREMENT
/begin MEASUREMENT vTWKINT "At the time of the start for the table reference, coolant temperature" UBYTE COMP_0356 1 100 -40 119.375 ECU_ADDRESS 0xFFFF88AC
 /begin FUNCTION_LIST KF7-301.8M[3] KF7-304.2[21] KF7-312.3A[27] KF7-313C.1[36] KF7-330.4A[53] KF7-330.8[1] KF7-390.3A[15] KF7-450.8[2] KF7-500.39[5] /end FUNCTION_LIST
/end MEASUREMENT
/begin MEASUREMENT vTWN "Coolant temperature" UBYTE COMP_0035 1 100 -50 205 ECU_ADDRESS 0xFFFF88AE
 /begin FUNCTION_LIST KF7-301.8M[3] KF7-301.16[5] KF7-301.25[11] KF7-304.3[2] KF7-304.10[1] KF7-311.1A[21] KF7-312.2A[16] KF7-312.3A[27] KF7-312.4A[6] KF7-312.6[34] KF7-313C.4[3] KF7-313C.5[3] KF7-313C.6[5] KF7-314.1F[1] KF7-320A.1[6] KF7-320A.2[3] KF7-320A.9[9] KF7-320A.10[14] KF7-320A.12[N] KF7-320A.13[N] KF7-320A.15[4] KF7-320A.22[5] KF7-330.4A[53] KF7-330.5[53] KF7-330.7A[1] KF7-330.9[8] KF7-351.1[16] KF7-351.2[17] KF7-351.3[11] KF7-360.9M[43] KF7-360.12[6] KF7-376.2[21] KF7-377.1A[19] KF7-378.2B[6] KF7-378.3B[5] KF7-385.1[32] KF7-385.2[18] KF7-390.3A[15] KF7-393.1C[8] KF7-395.1[4] KF7-450.8[2] KF7-450.9A[5] KF7-460.1[6] KF7-500.1[54] KF7-500.6D[9] KF7-500.7[12] KF7-500.8[5] KF7-500.16[4] KF7-500.20B[4] KF7-500.21[19] KF7-500.24[10] KF7-500.26[17] KF7-500.28[4] KF7-500.30[8] KF7-500.38A[4] KF7-500.39[5] KF7-500.44[3] KF7-500.47B[15] KF7-500.60[5] KF7-500.74[11] KF7-500.76[8] KF7-505.23[2] KF7-525.2[6] KF7-580.1[8] R000.1.RS_Integ_1_10_2 R301.2.MapBreakpoint_1_1_2 R301.3.FanAftPwl_1_0_4 R301.5.FuelCut_1_2_2 R301.7.KHOT_1_0_2 R301.9.Target_Equivalent_Ratio_1_0_2 R301.10.TITM_1_0_2 R301.23.ADV_calculation_1_1_2 R301.25.GOV_idle_1_0_2 R301.26.Dashpot_DandN_1_0_2 R901.1.Diag_on_can_app_1_6_2 Rxxx.2.Integration_Diagnostic_cycle_1_1_1 /end FUNCTION_LIST
/end MEASUREMENT
/begin MEASUREMENT vTWNKO "IGN SW At the time of off, coolant temperature" UBYTE COMP_0035 1 100 -50 205 ECU_ADDRESS 0xFFFFB2BC
 /begin FUNCTION_LIST KF7-301.8M[3] KF7-313C.7[1] KF7-320A.19[7] KF7-500.21[19] R000.4.EepAlloc_1_2_2 /end FUNCTION_LIST
/end MEASUREMENT
/begin MEASUREMENT vTWNNEW "Coolant temperature, this time, value" UBYTE COMP_0035 1 100 -50 205 ECU_ADDRESS 0xFFFF89D9 /begin FUNCTION_LIST KF7-301.8M[3] KF7-312.3A[27] R301.7.KHOT_1_0_2 /end FUNCTION_LIST /end MEASUREMENT
/begin MEASUREMENT vTW_S "SUB side coolant temperature sensor voltage" UBYTE COMP_0054 1 100 0 5100 ECU_ADDRESS 0xFFFF89EA /begin FUNCTION_LIST KF7-301.8P[3] KF7-505.10[2] /end FUNCTION_LIST /end MEASUREMENT
/begin MEASUREMENT vUS "AFM output signal reading value" UWORD COMP_0023 1 100 0 327675 ECU_ADDRESS 0xFFFF8860
 /begin FUNCTION_LIST KF7-301.1[7] KF7-330.5[53] KF7-350.1M[5] KF7-400.1[1] KF7-400.5[3] KF7-500.7[12] KF7-505.26[2] KF7-580.1[8] R901.1.Diag_on_can_app_1_6_2 /end FUNCTION_LIST
/end MEASUREMENT
/begin MEASUREMENT vUSB "AFM output signal reading value (After it is compensated.)" UWORD COMP_0023 1 100 0 327675 ECU_ADDRESS 0xFFFF1DD8 /begin FUNCTION_LIST KF7-301.1[7] /end FUNCTION_LIST /end MEASUREMENT
/begin MEASUREMENT vVAPO "Throttle open-degree target value (virtual)" UWORD COMP_0005 1 100 0 7208.85 ECU_ADDRESS 0xFFFF40EC
 /begin FUNCTION_LIST KF7-301.25[11] KF7-304.9[2] KF7-312.2A[16] KF7-312.3A[27] KF7-320A.2[3] KF7-320A.15[4] KF7-330.5[53] KF7-340.1M[8] KF7-340.2M[2] KF7-350.1M[5] KF7-350.4M[14] KF7-351.3[11] KF7-360.12[6] KF7-385.1[32] KF7-385.2[18] KF7-385.3[4] KF7-410.12[2] KF7-410.17M[5] KF7-410.20[N] KF7-500.2A[29] KF7-505.15[4] KF7-505.26[2] KF7-505.32[6] KF7-525.2[6] KF7-525.2S[10] R000.1.RS_Integ_1_10_2 R301.1.Torque_realization_1_0_3 R301.9.Target_Equivalent_Ratio_1_0_2 R301.20.AmbientComp_1_0_2 R301.23.ADV_calculation_1_1_2 R301.26.Dashpot_DandN_1_0_2 /end FUNCTION_LIST
/end MEASUREMENT
/begin MEASUREMENT vVATT "Battery voltage" UWORD COMP_0054 1 100 0 1310700 ECU_ADDRESS 0xFFFF89DA /begin FUNCTION_LIST KF7-301.7[1] R000.1.RS_Integ_1_10_2 /end FUNCTION_LIST /end MEASUREMENT
/begin MEASUREMENT vVB "Battery voltage" UBYTE COMP_0033 1 100 0 20400 ECU_ADDRESS 0xFFFF89DC
 /begin FUNCTION_LIST KF7-0.2[145] KF7-301.1[7] KF7-301.7[1] KF7-301.8M[3] KF7-301.16[5] KF7-301.19[8] KF7-301.21[1] KF7-301.25[11] KF7-301.31[1] KF7-302.4MA[13] KF7-302.5M[10] KF7-304.1B[5] KF7-304.7[1] KF7-312.1C[N] KF7-313C.3[1] KF7-313C.4[3] KF7-313C.5[3] KF7-314.1F[1] KF7-320A.6[3] KF7-320A.21[N] KF7-330.4A[53] KF7-340.11[4] KF7-351.1[16] KF7-351.2[17] KF7-378.2B[6] KF7-378.3B[5] KF7-393.1C[8] KF7-400.3[N] KF7-400.5[3] KF7-450.50[10] KF7-500.1[54] KF7-500.2A[29] KF7-500.6D[9] KF7-500.8[5] KF7-500.12[3] KF7-500.20B[4] KF7-500.24[10] KF7-500.25A[7] KF7-500.26[17] KF7-500.28[4] KF7-500.30[8] KF7-500.38A[4] KF7-500.39[5] KF7-500.47B[15] KF7-500.56[2] KF7-500.59[6] KF7-500.69[25] KF7-500.73[1] KF7-500.74[11] KF7-500.75[4] KF7-500.76[8] KF7-505.2[9] KF7-505.9[3] KF7-505.15[4] KF7-505.22[3] KF7-505.23[2] KF7-505.31[5] KF7-505.32[6] KF7-505.33[8] KF7-505.34[3] KF7-505.36[2] KF7-505.37[1] KF7-505.47[3] KF7-505.49[3] KF7-525.2[6] KF7-525.2S[10] KF7-580.1[8] R000.1.RS_Integ_1_10_2 R206.2.ECU_Repro_1_0_3 R301.11.INJDiag_1_1_2 R301.13.FFDforDiagOnCAN_1_1_3 R301.15.PurgeValveVB_shortDiag_1_0_2 R301.16.FrontO2H_VB_shortDiag_1_0_2 R301.17.RearO2H_VB_shortDiag_1_0_2 R301.18.VB_short_Protection_1_0_2 R301.21.SafetyLevel2_1_0_2 R901.1.Diag_on_can_app_1_6_2 R904.1.Gst_on_can_1_0_1 /end FUNCTION_LIST
/end MEASUREMENT
/begin MEASUREMENT vVBAVE2 "Battery voltage value (average treatment 2)" UBYTE COMP_0033 1 100 0 20400 ECU_ADDRESS 0xFFFF476E /begin FUNCTION_LIST KF7-301.25[11] KF7-301.30[2] KF7-360.4[14] KF7-505.32[6] /end FUNCTION_LIST /end MEASUREMENT
/begin MEASUREMENT vVBHOS "The VB compensation value of the progress time" UBYTE COMP_0021 1 100 0 99.609375 ECU_ADDRESS 0xFFFF3802 /begin FUNCTION_LIST KF7-301.1[7] /end FUNCTION_LIST /end MEASUREMENT
/begin MEASUREMENT vVBINT "At the time of the start, battery voltage" UBYTE COMP_0033 1 100 0 20400 ECU_ADDRESS 0xFFFF1DEC /begin FUNCTION_LIST KF7-301.7[1] /end FUNCTION_LIST /end MEASUREMENT
/begin MEASUREMENT vVERR "AFM power supply injection character" ULONG COMP_0643_S 1 100 0 327679.805308001 ECU_ADDRESS 0xFFFF3804 /begin FUNCTION_LIST KF7-301.1[7] /end FUNCTION_LIST /end MEASUREMENT
/begin MEASUREMENT vVEVPR "The EVAP voltage VCC adjustment-less-ization front" UWORD COMP_0023 1 100 0 327675 ECU_ADDRESS 0xFFFF408A /begin FUNCTION_LIST KF7-301.21[1] KF7-400.5[3] /end FUNCTION_LIST /end MEASUREMENT
/begin MEASUREMENT vVIP "Fuel-air ratio detection output" UWORD COMP_0370 1 100 0 163837.5 ECU_ADDRESS 0xFFFF40A4
 /begin FUNCTION_LIST KF7-301.1[7] KF7-303.1[14] KF7-303.6M[5] KF7-304.2[21] KF7-312.1C[N] KF7-312.2A[16] KF7-312.4A[6] KF7-312.5A[4] KF7-312.5C[1] KF7-340.4[1] KF7-340.6M[2] KF7-400.5[3] KF7-500.7[12] KF7-500.8[5] KF7-500.60[5] /end FUNCTION_LIST
/end MEASUREMENT
/begin MEASUREMENT vVO2R "A former O2 voltage raw-value (8bit)" UBYTE COMP_0104 1 100 0 2550 ECU_ADDRESS 0xFFFF2284 /begin FUNCTION_LIST KF7-301.18[5] KF7-400.5[3] /end FUNCTION_LIST /end MEASUREMENT
/begin MEASUREMENT vVO2R_R#1 "A former O2 voltage raw-value (8bit)" UBYTE COMP_0104 1 100 0 2550 ECU_ADDRESS 0xFFFF2284 /begin FUNCTION_LIST KF7-301.18[5] KF7-400.5[3] /end FUNCTION_LIST /end MEASUREMENT
/begin MEASUREMENT vVO2R_R#2 "A former O2 voltage raw-value (8bit)" UBYTE COMP_0104 1 100 0 2550 ECU_ADDRESS 0xFFFF2285 /begin FUNCTION_LIST KF7-301.18[5] KF7-400.5[3] /end FUNCTION_LIST /end MEASUREMENT
/begin MEASUREMENT vVPRES "Absolute pressure sensor voltage" UWORD COMP_0050 1 100 0 5119.921875 ECU_ADDRESS 0xFFFF89DE
 /begin FUNCTION_LIST KF7-0.2[145] KF7-301.19[8] KF7-500.51[3] R000.1.RS_Integ_1_10_2 /end FUNCTION_LIST
/end MEASUREMENT
/begin MEASUREMENT vVRO2 "Rear O2 voltage" UBYTE COMP_0104 1 100 0 2550 ECU_ADDRESS 0xFFFF89E0
 /begin FUNCTION_LIST KF7-301.4[3] KF7-313C.9[3] KF7-500.1[54] KF7-500.21[19] KF7-500.24[10] KF7-580.1[8] R901.1.Diag_on_can_app_1_6_2 R904.1.Gst_on_can_1_0_1 /end FUNCTION_LIST
/end MEASUREMENT
/begin MEASUREMENT vVRO2_R#1 "Rear O2 voltage" UBYTE COMP_0104 1 100 0 2550 ECU_ADDRESS 0xFFFF89E0
 /begin FUNCTION_LIST KF7-301.4[3] KF7-313C.9[3] KF7-500.1[54] KF7-500.21[19] KF7-500.24[10] KF7-580.1[8] R901.1.Diag_on_can_app_1_6_2 R904.1.Gst_on_can_1_0_1 /end FUNCTION_LIST
/end MEASUREMENT
/begin MEASUREMENT vVRO2_R#2 "Rear O2 voltage" UBYTE COMP_0104 1 100 0 2550 ECU_ADDRESS 0xFFFF89E1
 /begin FUNCTION_LIST KF7-301.4[3] KF7-313C.9[3] KF7-500.1[54] KF7-500.21[19] KF7-500.24[10] KF7-580.1[8] R901.1.Diag_on_can_app_1_6_2 R904.1.Gst_on_can_1_0_1 /end FUNCTION_LIST
/end MEASUREMENT
/begin MEASUREMENT vVRO2AD "Rear O2 voltage raw-value" UBYTE COMP_0104 1 100 0 2550 ECU_ADDRESS 0xFFFF1F60 /begin FUNCTION_LIST KF7-301.4[3] /end FUNCTION_LIST /end MEASUREMENT
/begin MEASUREMENT vVRO2AD_R#1 "Rear O2 voltage raw-value" UBYTE COMP_0104 1 100 0 2550 ECU_ADDRESS 0xFFFF1F60 /begin FUNCTION_LIST KF7-301.4[3] /end FUNCTION_LIST /end MEASUREMENT
/begin MEASUREMENT vVRO2AD_R#2 "Rear O2 voltage raw-value" UBYTE COMP_0104 1 100 0 2550 ECU_ADDRESS 0xFFFF1F61 /begin FUNCTION_LIST KF7-301.4[3] /end FUNCTION_LIST /end MEASUREMENT
/begin MEASUREMENT vVSP "Vehicle speed" UBYTE COMP_0007 1 100 0 510 ECU_ADDRESS 0xFFFF89E2
 /begin FUNCTION_LIST KF7-0.2[145] KF7-301.16[5] KF7-303.1[14] KF7-304.5[N] KF7-312.2A[16] KF7-312.3A[27] KF7-312.6[34] KF7-313C.6[5] KF7-314.1F[1] KF7-320A.2[3] KF7-320A.12[N] KF7-320A.15[4] KF7-330.7A[1] KF7-330.9[8] KF7-351.1[16] KF7-351.2[17] KF7-360.4[14] KF7-360.9M[43] KF7-376.2[21] KF7-377.1A[19] KF7-385.1[32] KF7-395.1[4] KF7-450.50[10] KF7-500.1[54] KF7-500.6D[9] KF7-500.7[12] KF7-500.16[4] KF7-500.20B[4] KF7-500.21[19] KF7-500.24[10] KF7-500.25A[7] KF7-500.26[17] KF7-500.28[4] KF7-500.30[8] KF7-500.38A[4] KF7-500.39[5] KF7-500.44[3] KF7-500.47B[15] KF7-500.59[6] KF7-500.74[11] KF7-500.76[8] KF7-505.23[2] KF7-525.2[6] KF7-580.1[8] R301.4.AfFeedback_1_0_1 R301.5.FuelCut_1_2_2 R301.6.IscAirflow_1_4_5 R301.9.Target_Equivalent_Ratio_1_0_2 R301.23.ADV_calculation_1_1_2 R904.1.Gst_on_can_1_0_1 Rxxx.2.Integration_Diagnostic_cycle_1_1_1 /end FUNCTION_LIST
/end MEASUREMENT
/begin MEASUREMENT vVTCTRG "VTC target operation angle" UBYTE COMP_0256 1 100 -64 63.5 ECU_ADDRESS 0xFFFF22F0
 /begin FUNCTION_LIST KF7-0.2[145] KF7-320A.22[5] KF7-393.1C[8] KF7-460.1[6] KF7-500.6D[9] KF7-500.47B[15] KF7-580.1[8] R301.13.FFDforDiagOnCAN_1_1_3 R901.1.Diag_on_can_app_1_6_2 /end FUNCTION_LIST
/end MEASUREMENT
/begin MEASUREMENT vW "The amount of estimated desorption quantity equivalent" UBYTE COMP_0560_S 1 100 0 0.06222 ECU_ADDRESS 0xFFFF34C0
 /begin FUNCTION_LIST KF7-0.2[145] KF7-304.2[21] KF7-371.1E[15] KF7-378.3B[5] KF7-390.3A[15] KF7-500.2A[29] /end FUNCTION_LIST
/end MEASUREMENT
/begin MEASUREMENT wvADO2R "A rear O2 voltage for the A/F sensor system" UWORD COMP_0023 1 100 0 327675 ECU_ADDRESS 0xFFFF88DA /begin FUNCTION_LIST KF7-301.4[3] /end FUNCTION_LIST /end MEASUREMENT
/begin MEASUREMENT wvADO2R_R#1 "A rear O2 voltage for the A/F sensor system" UWORD COMP_0023 1 100 0 327675 ECU_ADDRESS 0xFFFF88DA /begin FUNCTION_LIST KF7-301.4[3] /end FUNCTION_LIST /end MEASUREMENT
/begin MEASUREMENT wvADO2R_R#2 "A rear O2 voltage for the A/F sensor system" UWORD COMP_0023 1 100 0 327675 ECU_ADDRESS 0xFFFF88DC /begin FUNCTION_LIST KF7-301.4[3] /end FUNCTION_LIST /end MEASUREMENT
/begin MEASUREMENT wvAFP "After lambda point compensation, A/F sensor output voltage" UWORD COMP_0370 1 100 0 163837.5 ECU_ADDRESS 0xFFFF49A8 /begin FUNCTION_LIST KF7-301.18[5] KF7-313C.3[1] /end FUNCTION_LIST /end MEASUREMENT
/begin MEASUREMENT wvAFP_R#1 "After lambda point compensation, A/F sensor output voltage" UWORD COMP_0370 1 100 0 163837.5 ECU_ADDRESS 0xFFFF49A8 /begin FUNCTION_LIST KF7-301.18[5] KF7-313C.3[1] /end FUNCTION_LIST /end MEASUREMENT
/begin MEASUREMENT wvAFP_R#2 "After lambda point compensation, A/F sensor output voltage" UWORD COMP_0370 1 100 0 163837.5 ECU_ADDRESS 0xFFFF49AA /begin FUNCTION_LIST KF7-301.18[5] KF7-313C.3[1] /end FUNCTION_LIST /end MEASUREMENT
/begin MEASUREMENT wvAFS "After lambda point compensation, A/F sensor output voltage" UWORD COMP_0023 1 100 0 327675 ECU_ADDRESS 0xFFFF47AA
 /begin FUNCTION_LIST KF7-301.18[5] KF7-313C.2[4] KF7-313C.3[1] KF7-500.74[11] KF7-500.76[8] KF7-580.1[8] /end FUNCTION_LIST
/end MEASUREMENT
/begin MEASUREMENT wvAFS_R#1 "After lambda point compensation, A/F sensor output voltage" UWORD COMP_0023 1 100 0 327675 ECU_ADDRESS 0xFFFF47AA
 /begin FUNCTION_LIST KF7-301.18[5] KF7-313C.2[4] KF7-313C.3[1] KF7-500.74[11] KF7-500.76[8] KF7-580.1[8] /end FUNCTION_LIST
/end MEASUREMENT
/begin MEASUREMENT wvAFS_R#2 "After lambda point compensation, A/F sensor output voltage" UWORD COMP_0023 1 100 0 327675 ECU_ADDRESS 0xFFFF47AC
 /begin FUNCTION_LIST KF7-301.18[5] KF7-313C.2[4] KF7-313C.3[1] KF7-500.74[11] KF7-500.76[8] KF7-580.1[8] /end FUNCTION_LIST
/end MEASUREMENT
/begin MEASUREMENT wvAPO1 "After the lower limit value limiter treatment, accelerator 1 open-degree" UWORD COMP_0005 1 100 0 7208.85 ECU_ADDRESS 0xFFFF47C4 /begin FUNCTION_LIST KF7-301.25[11] KF7-301.25M[5] KF7-505.2[9] KF7-525.2[6] /end FUNCTION_LIST /end MEASUREMENT
/begin MEASUREMENT wvAPO2 "After the lower limit value limiter treatment, accelerator 2 open-degree" UWORD COMP_0005 1 100 0 7208.85 ECU_ADDRESS 0xFFFF47C6
 /begin FUNCTION_LIST KF7-301.25[11] KF7-301.25P[5] KF7-385.1[32] KF7-505.2[9] KF7-525.2[6] /end FUNCTION_LIST
/end MEASUREMENT
/begin MEASUREMENT wvAPOFS "Accelerator open-degree for the target open-degree operation" UWORD COMP_0005 1 100 0 7208.85 ECU_ADDRESS 0xFFFF47C8
 /begin FUNCTION_LIST KF7-0.2[145] KF7-301.25M[5] KF7-350.4M[14] KF7-350.4P[13] KF7-360.7M[9] KF7-360.7P[8] KF7-450.19[4] KF7-505.9[3] /end FUNCTION_LIST
/end MEASUREMENT
/begin MEASUREMENT wvAPOFSR "Accelerator pedal ratio" UWORD COMP_0362_S 1 100 0 8191.875 ECU_ADDRESS 0xFFFF4774 /begin FUNCTION_LIST KF7-0.2[145] KF7-505.9[3] /end FUNCTION_LIST /end MEASUREMENT
/begin MEASUREMENT wvAPOK "(MainCPU) APO for the table reference" UBYTE COMP_0002 1 100 0 89.25 ECU_ADDRESS 0xFFFF47CA
 /begin FUNCTION_LIST KF7-301.25[11] KF7-360.7M[9] KF7-360.7P[8] KF7-500.26[17] KF7-505.2[9] /end FUNCTION_LIST
/end MEASUREMENT
/begin MEASUREMENT wvAPS1OF "(MainCPU) Accelerator open-degree 1" SWORD COMP_0377 1 100 -3604.48 3604.37 ECU_ADDRESS 0xFFFF47CC
 /begin FUNCTION_LIST KF7-301.25[11] KF7-301.25M[5] KF7-301.25P[5] KF7-500.1[54] KF7-505.2[9] /end FUNCTION_LIST
/end MEASUREMENT
/begin MEASUREMENT wvAPS1V "(MainCPU) Accelerator sensor 1 input voltage" UWORD COMP_0061 1 100 0 327675 ECU_ADDRESS 0xFFFF47CE
 /begin FUNCTION_LIST KF7-301.25[11] KF7-312.1C[N] KF7-505.2[9] KF7-525.1[4] KF7-580.1[8] /end FUNCTION_LIST
/end MEASUREMENT
/begin MEASUREMENT wvAPS2OF "(MainCPU) Accelerator open-degree 2" SWORD COMP_0377 1 100 -3604.48 3604.37 ECU_ADDRESS 0xFFFF47D0
 /begin FUNCTION_LIST KF7-301.25[11] KF7-301.25M[5] KF7-301.25P[5] KF7-500.1[54] KF7-505.2[9] /end FUNCTION_LIST
/end MEASUREMENT
/begin MEASUREMENT wvAPS2V "(MainCPU) Accelerator sensor 2 input voltage" UWORD COMP_0061 1 100 0 327675 ECU_ADDRESS 0xFFFF47D2 /begin FUNCTION_LIST KF7-301.25[11] KF7-505.2[9] KF7-525.1[4] KF7-580.1[8] /end FUNCTION_LIST /end MEASUREMENT
/begin MEASUREMENT wvAVPDACON "Pd pressure weighted average value" UWORD COMP_0010 1 100 0 196.605 ECU_ADDRESS 0xFFFF88EA /begin FUNCTION_LIST KF7-301.13[1] KF7-351.2[17] /end FUNCTION_LIST /end MEASUREMENT
/begin MEASUREMENT wvCURGP "An actual gear position (CurGP) signal" UBYTE COMP_0068 1 100 0 255 ECU_ADDRESS 0xFFFF88BC
 /begin FUNCTION_LIST KF7-0.2[145] KF7-312.6[34] KF7-330.5[53] KF7-330.9[8] KF7-340.7[4] KF7-340.9M[3] KF7-340.9P[3] KF7-360.8M[4] KF7-360.9M[43] KF7-360.12[6] KF7-385.1[32] KF7-385.2[18] /end FUNCTION_LIST
/end MEASUREMENT
/begin MEASUREMENT wvDPAMB "In front of 1s, atomospheric pressure absolute value" UWORD COMP_0050 1 100 0 5119.921875 ECU_ADDRESS 0xFFFF481E /begin FUNCTION_LIST KF7-301.19[8] /end FUNCTION_LIST /end MEASUREMENT
/begin MEASUREMENT wvDTWF "Temperature non-balance condition coefficient" UBYTE COMP_0044 1 100 0 1.9921875 ECU_ADDRESS 0xFFFF88FE
 /begin FUNCTION_LIST KF7-301.8M[3] KF7-312.3A[27] KF7-312.4A[6] KF7-312.4C[4] KF7-312.5C[1] /end FUNCTION_LIST
/end MEASUREMENT
/begin MEASUREMENT wvGKTVOF "Throttle sensor offset learning value" UBYTE COMP_0023 1 100 0 1275 ECU_ADDRESS 0xFFFF9F6E /begin FUNCTION_LIST KF7-301.25[11] /end FUNCTION_LIST /end MEASUREMENT
/begin MEASUREMENT wvISCV "Idle speed adjustment volume voltage" UBYTE COMP_0054 1 100 0 5100 ECU_ADDRESS 0xFFFF8922
 /begin FUNCTION_LIST KF7-0.2[145] KF7-320A.3[N] KF7-330.4A[53] KF7-360.8M[4] KF7-460.1[6] KF7-500.21[19] KF7-500.26[17] KF7-580.1[8] /end FUNCTION_LIST
/end MEASUREMENT
/begin MEASUREMENT wvKNFIL1 "Knock-fail voltage 1" UBYTE COMP_0054 1 100 0 5100 ECU_ADDRESS 0xFFFF49AD /begin FUNCTION_LIST KF7-301.15[4] KF7-500.12[3] /end FUNCTION_LIST /end MEASUREMENT
/begin MEASUREMENT wvKNFIL2 "Knock-fail voltage 2" UBYTE COMP_0054 1 100 0 5100 ECU_ADDRESS 0xFFFF49AE /begin FUNCTION_LIST KF7-301.15[4] KF7-500.12[3] /end FUNCTION_LIST /end MEASUREMENT
/begin MEASUREMENT wvLNRPM "Engine speed" UBYTE COMP_0006 1 100 0 3187.5 ECU_ADDRESS 0xFFFF8A0A
 /begin FUNCTION_LIST KF7-301.25[11] KF7-302.4MA[13] KF7-303.5A[9] KF7-303.6M[5] KF7-304.2[21] KF7-304.10[1] KF7-311.1A[21] KF7-312.1C[N] KF7-312.2A[16] KF7-312.3A[27] KF7-320A.10[14] KF7-320A.19[7] KF7-330.5[53] KF7-330.7A[1] KF7-330.8[1] KF7-330.9[8] KF7-340.7[4] KF7-360.9M[43] KF7-376.2[21] KF7-393.1C[8] KF7-410.12[2] KF7-450.5[1] KF7-450.9A[5] KF7-500.1[54] KF7-500.6D[9] KF7-500.7[12] KF7-500.21[19] KF7-500.47B[15] KF7-580.1[8] /end FUNCTION_LIST
/end MEASUREMENT
/begin MEASUREMENT wvNEXTGP "Next gear position" UBYTE COMP_0068 1 100 0 255 ECU_ADDRESS 0xFFFF88BE
 /begin FUNCTION_LIST KF7-0.2[145] KF7-302.6A[4] KF7-312.6[34] KF7-340.9M[3] KF7-340.9P[3] KF7-360.9M[43] KF7-360.12[6] KF7-385.1[32] KF7-385.2[18] /end FUNCTION_LIST
/end MEASUREMENT
/begin MEASUREMENT wvNRPM "Engine speed" UWORD COMP_0006 1 100 0 819187.5 ECU_ADDRESS 0xFFFF8A14
 /begin FUNCTION_LIST KF7-301.25[11] KF7-302.5M[10] KF7-303.6M[5] KF7-304.2[21] KF7-304.5[N] KF7-304.9[2] KF7-311.1A[21] KF7-312.1C[N] KF7-312.2A[16] KF7-312.6[34] KF7-313C.1[36] KF7-313C.6[5] KF7-314.1F[1] KF7-320A.4[6] KF7-320A.8[2] KF7-320A.9[9] KF7-320A.14[1] KF7-320A.15[4] KF7-320A.19[7] KF7-320A.21[N] KF7-360.9M[43] KF7-379.1[9] KF7-379.2[1] KF7-385.2[18] KF7-450.9A[5] KF7-450.50[10] KF7-500.1[54] KF7-500.7[12] KF7-500.10[3] KF7-500.20B[4] KF7-500.21[19] KF7-500.26[17] KF7-500.38A[4] KF7-580.1[8] /end FUNCTION_LIST
/end MEASUREMENT
/begin MEASUREMENT wvPAMB "Atomospheric pressure output value" UWORD COMP_0050 1 100 0 5119.921875 ECU_ADDRESS 0xFFFF9FDC
 /begin FUNCTION_LIST KF7-0.2[145] KF7-301.19[8] KF7-312.1C[N] KF7-330.5[53] KF7-351.3[11] KF7-360.9M[43] KF7-500.1[54] KF7-500.30[8] KF7-500.38A[4] KF7-500.74[11] KF7-580.1[8] /end FUNCTION_LIST
/end MEASUREMENT
/begin MEASUREMENT wvPDACOF "At the time of A/C relay off, latest value Pd pressure" UBYTE COMP_0011 1 100 0 5.1 ECU_ADDRESS 0xFFFF892E /begin FUNCTION_LIST KF7-301.13[1] KF7-330.5[53] /end FUNCTION_LIST /end MEASUREMENT
/begin MEASUREMENT wvPDACON "At the time of A/C relay on, latest value Pd pressure" UBYTE COMP_0011 1 100 0 5.1 ECU_ADDRESS 0xFFFF892F /begin FUNCTION_LIST KF7-301.13[1] KF7-330.5[53] /end FUNCTION_LIST /end MEASUREMENT
/begin MEASUREMENT wvPDPREN "Pd pressure" UBYTE COMP_0011 1 100 0 5.1 ECU_ADDRESS 0xFFFF8930
 /begin FUNCTION_LIST KF7-301.13[1] KF7-330.4A[53] KF7-376.1[6] KF7-376.4[4] KF7-377.1A[19] KF7-385.1[32] /end FUNCTION_LIST
/end MEASUREMENT
/begin MEASUREMENT wvPDPRES "Pd pressure sensor voltage" UWORD COMP_0023 1 100 0 327675 ECU_ADDRESS 0xFFFF8932 /begin FUNCTION_LIST KF7-301.13[1] KF7-460.1[6] KF7-580.1[8] /end FUNCTION_LIST /end MEASUREMENT
/begin MEASUREMENT wvPRESS "At the time of the start, an atomospheric pressure for pulse width compensation" UWORD COMP_0050 1 100 0 5119.921875 ECU_ADDRESS 0xFFFF8934 /begin FUNCTION_LIST KF7-301.19[8] KF7-311.1A[21] KF7-312.1C[N] /end FUNCTION_LIST /end MEASUREMENT
/begin MEASUREMENT wvQA4 "Inhalation air quantity index number" UWORD COMP_0004 1 100 0 65535 ECU_ADDRESS 0xFFFF887A /begin FUNCTION_LIST KF7-301.1[7] KF7-304.1B[5] KF7-500.8[5] KF7-500.60[5] /end FUNCTION_LIST /end MEASUREMENT
/begin MEASUREMENT wvQH0 "TVO-N flow-quantity" UBYTE COMP_0032 1 100 0 0.99609375 ECU_ADDRESS 0xFFFF8936
 /begin FUNCTION_LIST KF7-0.2[145] KF7-301.8M[3] KF7-301.25[11] KF7-304.1B[5] KF7-304.2[21] KF7-304.9[2] KF7-304.13[N] KF7-312.4A[6] KF7-312.4C[4] KF7-312.5A[4] KF7-312.5C[1] KF7-330.5[53] KF7-340.1M[8] KF7-340.1P[7] KF7-340.2M[2] KF7-340.2P[1] KF7-340.8M[8] KF7-340.8P[8] KF7-350.4M[14] KF7-351.3[11] KF7-360.8M[4] KF7-360.9M[43] KF7-360.12[6] KF7-371.1E[15] KF7-385.3[4] KF7-410.11M[4] KF7-410.11P[4] KF7-410.17M[5] KF7-410.17P[1] KF7-500.7[12] KF7-505.50[1] /end FUNCTION_LIST
/end MEASUREMENT
/begin MEASUREMENT wvROHCR "The rest O2/H voltage value" UBYTE COMP_0054 1 100 0 5100 ECU_ADDRESS 0xFFFF4864 /begin FUNCTION_LIST KF7-301.6[1] KF7-500.25A[7] KF7-580.1[8] /end FUNCTION_LIST /end MEASUREMENT
/begin MEASUREMENT wvTA "Inhalation air voltage" UWORD COMP_0023 1 100 0 327675 ECU_ADDRESS 0xFFFF4870 /begin FUNCTION_LIST KF7-301.16[5] KF7-500.44[3] /end FUNCTION_LIST /end MEASUREMENT
/begin MEASUREMENT wvTAB "Intake air temperature sensor voltage" UBYTE COMP_0054 1 100 0 5100 ECU_ADDRESS 0xFFFF4872 /begin FUNCTION_LIST KF7-301.16[5] KF7-460.1[6] /end FUNCTION_LIST /end MEASUREMENT
/begin MEASUREMENT wvTAG "An intake air temperature for GST" UBYTE COMP_0428 1 100 -40 215 ECU_ADDRESS 0xFFFF4873 /begin FUNCTION_LIST KF7-301.16[5] KF7-500.1[54] /end FUNCTION_LIST /end MEASUREMENT
/begin MEASUREMENT wvTAINT "At the time of the start, intake air temperature" UBYTE COMP_0035 1 100 -50 205 ECU_ADDRESS 0xFFFF9FE4 /begin FUNCTION_LIST KF7-301.16[5] KF7-500.1[54] KF7-580.1[8] /end FUNCTION_LIST /end MEASUREMENT
/begin MEASUREMENT wvTAK "An intake air temperature for the table reference" UBYTE COMP_0356 1 100 -40 119.375 ECU_ADDRESS 0xFFFF893B
 /begin FUNCTION_LIST KF7-301.16[5] KF7-330.4A[53] KF7-330.5[53] KF7-351.3[11] KF7-360.9M[43] KF7-500.7[12] /end FUNCTION_LIST
/end MEASUREMENT
/begin MEASUREMENT wvTAN "Intake air temperature" UBYTE COMP_0035 1 100 -50 205 ECU_ADDRESS 0xFFFF4874
 /begin FUNCTION_LIST KF7-301.16[5] KF7-312.1C[N] KF7-320A.9[9] KF7-360.9M[43] KF7-460.1[6] KF7-500.1[54] KF7-500.7[12] KF7-500.38A[4] KF7-500.44[3] KF7-580.1[8] /end FUNCTION_LIST
/end MEASUREMENT
/begin MEASUREMENT wvTANBMN "The one for the catalyst diagnosis, at least, intake air temperature" UBYTE COMP_0035 1 100 -50 205 ECU_ADDRESS 0xFFFF4875
 /begin FUNCTION_LIST KF7-301.16[5] KF7-500.1[54] KF7-500.8[5] KF7-500.21[19] KF7-500.26[17] KF7-500.30[8] KF7-500.38A[4] KF7-500.39[5] KF7-500.60[5] KF7-580.1[8] /end FUNCTION_LIST
/end MEASUREMENT
/begin MEASUREMENT wvTANMIN "At least, intake air temperature" UBYTE COMP_0035 1 100 -50 205 ECU_ADDRESS 0xFFFF4876 /begin FUNCTION_LIST KF7-301.16[5] KF7-500.21[19] /end FUNCTION_LIST /end MEASUREMENT
/begin MEASUREMENT wvTANST "At the time of the start, intake air temperature" UBYTE COMP_0035 1 100 -50 205 ECU_ADDRESS 0xFFFF4877 /begin FUNCTION_LIST KF7-301.16[5] KF7-330.4A[53] KF7-500.21[19] /end FUNCTION_LIST /end MEASUREMENT
/begin MEASUREMENT wvTP "Cylinder intake quantity equivalent pulse width" UWORD COMP_0144 1 100 0 31.999495335 ECU_ADDRESS 0xFFFF886C
 /begin FUNCTION_LIST KF7-0.2[145] KF7-301.25[11] KF7-304.1B[5] KF7-304.2[21] KF7-304.3[2] KF7-305.7[6] KF7-311.1A[21] KF7-312.1C[N] KF7-312.3A[27] KF7-312.4A[6] KF7-312.4C[4] KF7-312.5A[4] KF7-312.5C[1] KF7-312.6[34] KF7-313C.1[36] KF7-313C.4[3] KF7-313C.5[3] KF7-313C.9[3] KF7-314.1F[1] KF7-320A.4[6] KF7-320A.9[9] KF7-320A.13[N] KF7-320A.14[1] KF7-320A.17[N] KF7-320A.22[5] KF7-350.4M[14] KF7-350.4P[13] KF7-351.3[11] KF7-371.1E[15] KF7-376.2[21] KF7-378.2B[6] KF7-379.2[1] KF7-379.5[3] KF7-386.1[4] KF7-393.1C[8] KF7-395.1[4] KF7-450.5[1] KF7-450.7[2] KF7-450.50[10] KF7-500.1[54] KF7-500.16[4] KF7-500.20B[4] KF7-500.21[19] KF7-500.24[10] KF7-500.25A[7] KF7-500.26[17] KF7-500.28[4] KF7-500.30[8] KF7-500.39[5] KF7-500.51[3] KF7-500.59[6] KF7-500.74[11] KF7-500.76[8] KF7-505.23[2] KF7-580.1[8] /end FUNCTION_LIST
/end MEASUREMENT
/begin MEASUREMENT wvTPO1 "Throttle 1 open-degree" UWORD COMP_0005 1 100 0 7208.85 ECU_ADDRESS 0xFFFF487C
 /begin FUNCTION_LIST KF7-301.25[11] KF7-301.25M[5] KF7-304.9[2] KF7-304.13[N] KF7-351.3[11] KF7-450.50[10] KF7-500.7[12] KF7-505.2[9] KF7-505.15[4] KF7-505.28[1] KF7-505.31[5] KF7-505.32[6] KF7-505.33[8] KF7-505.34[3] KF7-525.2[6] /end FUNCTION_LIST
/end MEASUREMENT
/begin MEASUREMENT wvTPO1OV "Throttle open-degree 1" UWORD COMP_0164_S 1 100 -14.08205 98.55623125 ECU_ADDRESS 0xFFFF4756 /begin FUNCTION_LIST KF7-301.25[11] KF7-360.1[12] KF7-505.28[1] KF7-505.33[8] /end FUNCTION_LIST /end MEASUREMENT
/begin MEASUREMENT wvTPO2 "Throttle 2 open-degree" UWORD COMP_0005 1 100 0 7208.85 ECU_ADDRESS 0xFFFF487E
 /begin FUNCTION_LIST KF7-301.25[11] KF7-301.25P[5] KF7-360.1[12] KF7-505.2[9] KF7-525.2[6] /end FUNCTION_LIST
/end MEASUREMENT
/begin MEASUREMENT wvTPO4OV "Throttle open-degree 1 (four times)" UWORD COMP_0164_S 1 100 -14.08205 98.55623125 ECU_ADDRESS 0xFFFF4758 /begin FUNCTION_LIST KF7-301.25[11] KF7-360.1[12] KF7-505.28[1] /end FUNCTION_LIST /end MEASUREMENT
/begin MEASUREMENT wvTPOK "For the throttle open-degree table reference" UBYTE COMP_0002 1 100 0 89.25 ECU_ADDRESS 0xFFFF4880 /begin FUNCTION_LIST KF7-301.25[11] KF7-505.2[9] /end FUNCTION_LIST /end MEASUREMENT
/begin MEASUREMENT wvTPS1CL "(MainCPU) Throttle sensor 1 full-close learning value" UWORD COMP_0061 1 100 0 327675 ECU_ADDRESS 0xFFFF9FE6
 /begin FUNCTION_LIST KF7-301.25[11] KF7-305.1[7] KF7-305.4AM[10] KF7-505.29[4] KF7-580.1[8] /end FUNCTION_LIST
/end MEASUREMENT
/begin MEASUREMENT wvTPS1OF "(MainCPU) Throttle open-degree 1" SWORD COMP_0377 1 100 -3604.48 3604.37 ECU_ADDRESS 0xFFFF4882
 /begin FUNCTION_LIST KF7-301.25[11] KF7-301.25M[5] KF7-301.25P[5] KF7-500.1[54] KF7-505.2[9] /end FUNCTION_LIST
/end MEASUREMENT
/begin MEASUREMENT wvTPS1V "(MainCPU) Throttle sensor 1 voltage" UWORD COMP_0061 1 100 0 327675 ECU_ADDRESS 0xFFFF4778
 /begin FUNCTION_LIST KF7-301.25[11] KF7-351.3[11] KF7-505.2[9] KF7-505.28[1] KF7-505.38[4] KF7-525.1[4] KF7-580.1[8] /end FUNCTION_LIST
/end MEASUREMENT
/begin MEASUREMENT wvTPS2CL "(MainCPU) Throttle sensor 2 full-close learning value" UWORD COMP_0061 1 100 0 327675 ECU_ADDRESS 0xFFFF9FE8
 /begin FUNCTION_LIST KF7-301.25[11] KF7-305.1[7] KF7-305.4AM[10] KF7-505.29[4] KF7-580.1[8] /end FUNCTION_LIST
/end MEASUREMENT
/begin MEASUREMENT wvTPS2OF "(MainCPU) Throttle open-degree 2" SWORD COMP_0377 1 100 -3604.48 3604.37 ECU_ADDRESS 0xFFFF4884
 /begin FUNCTION_LIST KF7-301.25[11] KF7-301.25M[5] KF7-301.25P[5] KF7-500.1[54] KF7-505.2[9] /end FUNCTION_LIST
/end MEASUREMENT
/begin MEASUREMENT wvTPS2V "(MainCPU) Throttle sensor 2 voltage" UWORD COMP_0061 1 100 0 327675 ECU_ADDRESS 0xFFFF477A /begin FUNCTION_LIST KF7-301.25[11] KF7-505.2[9] KF7-525.1[4] KF7-580.1[8] /end FUNCTION_LIST /end MEASUREMENT
/begin MEASUREMENT wvTPTRM "A/F Flat compensation pulse width" UWORD COMP_0512 1 100 0 127.998046875 ECU_ADDRESS 0xFFFF8882
 /begin FUNCTION_LIST KF7-301.25[11] KF7-304.2[21] KF7-304.3[2] KF7-312.1C[N] KF7-312.4A[6] /end FUNCTION_LIST
/end MEASUREMENT
/begin MEASUREMENT wvTVO "Throttle open-degree" UBYTE COMP_0002 1 100 0 89.25 ECU_ADDRESS 0xFFFF889D
 /begin FUNCTION_LIST KF7-301.1[7] KF7-301.8M[3] KF7-301.25[11] KF7-304.1B[5] KF7-304.2[21] KF7-304.9[2] KF7-304.10[1] KF7-304.13[N] KF7-312.1C[N] KF7-312.2A[16] KF7-312.3A[27] KF7-312.4A[6] KF7-312.4C[4] KF7-312.5A[4] KF7-312.5C[1] KF7-312.6[34] KF7-313C.1[36] KF7-313C.4[3] KF7-313C.5[3] KF7-320A.12[N] KF7-320A.13[N] KF7-320A.15[4] KF7-330.5[53] KF7-340.1M[8] KF7-340.1P[7] KF7-340.2M[2] KF7-340.8M[8] KF7-351.3[11] KF7-360.9M[43] KF7-360.12[6] KF7-376.2[21] KF7-385.3[4] KF7-450.5[1] KF7-450.7[2] KF7-500.1[54] KF7-500.7[12] KF7-500.21[19] KF7-500.24[10] KF7-500.26[17] KF7-505.26[2] KF7-580.1[8] /end FUNCTION_LIST
/end MEASUREMENT
/begin MEASUREMENT wvTVOINT "Throttle full-close position learning value" UWORD COMP_0023 1 100 0 327675 ECU_ADDRESS 0xFFFF9FEA /begin FUNCTION_LIST KF7-301.25[11] KF7-304.10[1] KF7-500.38A[4] /end FUNCTION_LIST /end MEASUREMENT
/begin MEASUREMENT wvTVOV "Throttle sensor voltage" UWORD COMP_0061 1 100 0 327675 ECU_ADDRESS 0xFFFF8946 /begin FUNCTION_LIST KF7-301.25[11] KF7-312.1C[N] KF7-500.7[12] KF7-500.38A[4] /end FUNCTION_LIST /end MEASUREMENT
/begin MEASUREMENT wvTW "Coolant temperature sensor output voltage" UBYTE COMP_0054 1 100 0 5100 ECU_ADDRESS 0xFFFF894B
 /begin FUNCTION_LIST KF7-301.8M[3] KF7-312.6[34] KF7-377.1A[19] KF7-450.8[2] KF7-460.1[6] KF7-500.1[54] KF7-500.8[5] KF7-500.44[3] KF7-505.10[2] KF7-580.1[8] /end FUNCTION_LIST
/end MEASUREMENT
/begin MEASUREMENT wvTWINT "At the time of the start, coolant temperature" UBYTE COMP_0035 1 100 -50 205 ECU_ADDRESS 0xFFFF889E
 /begin FUNCTION_LIST KF7-301.8M[3] KF7-301.16[5] KF7-311.1A[21] KF7-312.6[34] KF7-313C.7[1] KF7-314.1F[1] KF7-320A.10[14] KF7-320A.12[N] KF7-320A.13[N] KF7-320A.19[7] KF7-330.4A[53] KF7-378.3B[5] KF7-385.1[32] KF7-450.8[2] KF7-500.1[54] KF7-500.20B[4] KF7-500.21[19] KF7-500.24[10] KF7-500.26[17] KF7-500.39[5] KF7-500.60[5] KF7-580.1[8] /end FUNCTION_LIST
/end MEASUREMENT
/begin MEASUREMENT wvTWK "A coolant temperature for the table reference" UBYTE COMP_0356 1 100 -40 119.375 ECU_ADDRESS 0xFFFF889F
 /begin FUNCTION_LIST KF7-0.2[145] KF7-301.8M[3] KF7-301.25[11] KF7-302.4MA[13] KF7-302.5M[10] KF7-304.2[21] KF7-304.3[2] KF7-304.13[N] KF7-311.1A[21] KF7-312.1C[N] KF7-312.3A[27] KF7-312.4A[6] KF7-312.4C[4] KF7-312.5A[4] KF7-312.5C[1] KF7-312.6[34] KF7-320A.8[2] KF7-320A.10[14] KF7-320A.13[N] KF7-320A.19[7] KF7-320A.23[N] KF7-330.1M[3] KF7-330.1P[3] KF7-330.4A[53] KF7-330.5[53] KF7-351.1[16] KF7-351.2[17] KF7-379.2[1] KF7-385.1[32] KF7-385.3[4] KF7-390.3A[15] KF7-393.1C[8] KF7-410.12[2] KF7-450.8[2] KF7-450.9A[5] KF7-500.8[5] KF7-500.26[17] KF7-500.38A[4] KF7-580.1[8] /end FUNCTION_LIST
/end MEASUREMENT
/begin MEASUREMENT wvTWKINT "At the time of the start for the table reference, coolant temperature" UBYTE COMP_0356 1 100 -40 119.375 ECU_ADDRESS 0xFFFF88A0
 /begin FUNCTION_LIST KF7-301.8M[3] KF7-304.2[21] KF7-312.3A[27] KF7-313C.1[36] KF7-330.4A[53] KF7-330.8[1] KF7-390.3A[15] KF7-450.8[2] KF7-500.39[5] /end FUNCTION_LIST
/end MEASUREMENT
/begin MEASUREMENT wvTWN "Coolant temperature" UBYTE COMP_0035 1 100 -50 205 ECU_ADDRESS 0xFFFF88A2
 /begin FUNCTION_LIST KF7-301.8M[3] KF7-301.16[5] KF7-301.25[11] KF7-304.3[2] KF7-304.10[1] KF7-311.1A[21] KF7-312.2A[16] KF7-312.3A[27] KF7-312.4A[6] KF7-312.6[34] KF7-313C.4[3] KF7-313C.5[3] KF7-313C.6[5] KF7-314.1F[1] KF7-320A.1[6] KF7-320A.2[3] KF7-320A.9[9] KF7-320A.10[14] KF7-320A.12[N] KF7-320A.13[N] KF7-320A.15[4] KF7-320A.22[5] KF7-330.4A[53] KF7-330.5[53] KF7-330.7A[1] KF7-330.9[8] KF7-351.1[16] KF7-351.2[17] KF7-351.3[11] KF7-360.9M[43] KF7-360.12[6] KF7-376.2[21] KF7-377.1A[19] KF7-378.2B[6] KF7-378.3B[5] KF7-385.1[32] KF7-385.2[18] KF7-390.3A[15] KF7-393.1C[8] KF7-395.1[4] KF7-450.8[2] KF7-450.9A[5] KF7-460.1[6] KF7-500.1[54] KF7-500.6D[9] KF7-500.7[12] KF7-500.8[5] KF7-500.16[4] KF7-500.20B[4] KF7-500.21[19] KF7-500.24[10] KF7-500.26[17] KF7-500.28[4] KF7-500.30[8] KF7-500.38A[4] KF7-500.39[5] KF7-500.44[3] KF7-500.47B[15] KF7-500.60[5] KF7-500.74[11] KF7-500.76[8] KF7-505.23[2] KF7-525.2[6] KF7-580.1[8] /end FUNCTION_LIST
/end MEASUREMENT
/begin MEASUREMENT wvTWNNEW "Coolant temperature, this time, value" UBYTE COMP_0035 1 100 -50 205 ECU_ADDRESS 0xFFFF894D /begin FUNCTION_LIST KF7-301.8M[3] KF7-312.3A[27] /end FUNCTION_LIST /end MEASUREMENT
/begin MEASUREMENT wvTW_S "SUB side coolant temperature sensor voltage" UBYTE COMP_0054 1 100 0 5100 ECU_ADDRESS 0xFFFF895E /begin FUNCTION_LIST KF7-301.8P[3] KF7-505.10[2] /end FUNCTION_LIST /end MEASUREMENT
/begin MEASUREMENT wvUS "AFM output signal reading value" UWORD COMP_0023 1 100 0 327675 ECU_ADDRESS 0xFFFF884E
 /begin FUNCTION_LIST KF7-301.1[7] KF7-330.5[53] KF7-350.1M[5] KF7-400.1[1] KF7-400.5[3] KF7-500.7[12] KF7-505.26[2] KF7-580.1[8] /end FUNCTION_LIST
/end MEASUREMENT
/begin MEASUREMENT wvVATT "Battery voltage" UWORD COMP_0054 1 100 0 1310700 ECU_ADDRESS 0xFFFF894E /begin FUNCTION_LIST KF7-301.7[1] /end FUNCTION_LIST /end MEASUREMENT
/begin MEASUREMENT wvVB "Battery voltage" UBYTE COMP_0033 1 100 0 20400 ECU_ADDRESS 0xFFFF8950
 /begin FUNCTION_LIST KF7-0.2[145] KF7-301.1[7] KF7-301.7[1] KF7-301.8M[3] KF7-301.16[5] KF7-301.19[8] KF7-301.21[1] KF7-301.25[11] KF7-301.31[1] KF7-302.4MA[13] KF7-302.5M[10] KF7-304.1B[5] KF7-304.7[1] KF7-312.1C[N] KF7-313C.3[1] KF7-313C.4[3] KF7-313C.5[3] KF7-314.1F[1] KF7-320A.6[3] KF7-320A.21[N] KF7-330.4A[53] KF7-340.11[4] KF7-351.1[16] KF7-351.2[17] KF7-378.2B[6] KF7-378.3B[5] KF7-393.1C[8] KF7-400.3[N] KF7-400.5[3] KF7-450.50[10] KF7-500.1[54] KF7-500.2A[29] KF7-500.6D[9] KF7-500.8[5] KF7-500.12[3] KF7-500.20B[4] KF7-500.24[10] KF7-500.25A[7] KF7-500.26[17] KF7-500.28[4] KF7-500.30[8] KF7-500.38A[4] KF7-500.39[5] KF7-500.47B[15] KF7-500.56[2] KF7-500.59[6] KF7-500.69[25] KF7-500.73[1] KF7-500.74[11] KF7-500.75[4] KF7-500.76[8] KF7-505.2[9] KF7-505.9[3] KF7-505.15[4] KF7-505.22[3] KF7-505.23[2] KF7-505.31[5] KF7-505.32[6] KF7-505.33[8] KF7-505.34[3] KF7-505.36[2] KF7-505.37[1] KF7-505.47[3] KF7-505.49[3] KF7-525.2[6] KF7-525.2S[10] KF7-580.1[8] /end FUNCTION_LIST
/end MEASUREMENT
/begin MEASUREMENT wvVBAVE2 "Battery voltage value (average treatment 2)" UBYTE COMP_0033 1 100 0 20400 ECU_ADDRESS 0xFFFF476A /begin FUNCTION_LIST KF7-301.25[11] KF7-301.30[2] KF7-360.4[14] KF7-505.32[6] /end FUNCTION_LIST /end MEASUREMENT
/begin MEASUREMENT wvVPRES "Absolute pressure sensor voltage" UWORD COMP_0050 1 100 0 5119.921875 ECU_ADDRESS 0xFFFF8952 /begin FUNCTION_LIST KF7-0.2[145] KF7-301.19[8] KF7-500.51[3] /end FUNCTION_LIST /end MEASUREMENT
/begin MEASUREMENT wvVRO2 "Rear O2 voltage" UBYTE COMP_0104 1 100 0 2550 ECU_ADDRESS 0xFFFF8954
 /begin FUNCTION_LIST KF7-301.4[3] KF7-313C.9[3] KF7-500.1[54] KF7-500.21[19] KF7-500.24[10] KF7-580.1[8] /end FUNCTION_LIST
/end MEASUREMENT
/begin MEASUREMENT wvVRO2_R#1 "Rear O2 voltage" UBYTE COMP_0104 1 100 0 2550 ECU_ADDRESS 0xFFFF8954
 /begin FUNCTION_LIST KF7-301.4[3] KF7-313C.9[3] KF7-500.1[54] KF7-500.21[19] KF7-500.24[10] KF7-580.1[8] /end FUNCTION_LIST
/end MEASUREMENT
/begin MEASUREMENT wvVRO2_R#2 "Rear O2 voltage" UBYTE COMP_0104 1 100 0 2550 ECU_ADDRESS 0xFFFF8955
 /begin FUNCTION_LIST KF7-301.4[3] KF7-313C.9[3] KF7-500.1[54] KF7-500.21[19] KF7-500.24[10] KF7-580.1[8] /end FUNCTION_LIST
/end MEASUREMENT
/begin MEASUREMENT wvVSP "Vehicle speed" UBYTE COMP_0007 1 100 0 510 ECU_ADDRESS 0xFFFF8956
 /begin FUNCTION_LIST KF7-0.2[145] KF7-301.16[5] KF7-303.1[14] KF7-304.5[N] KF7-312.2A[16] KF7-312.3A[27] KF7-312.6[34] KF7-313C.6[5] KF7-314.1F[1] KF7-320A.2[3] KF7-320A.12[N] KF7-320A.15[4] KF7-330.7A[1] KF7-330.9[8] KF7-351.1[16] KF7-351.2[17] KF7-360.4[14] KF7-360.9M[43] KF7-376.2[21] KF7-377.1A[19] KF7-385.1[32] KF7-395.1[4] KF7-450.50[10] KF7-500.1[54] KF7-500.6D[9] KF7-500.7[12] KF7-500.16[4] KF7-500.20B[4] KF7-500.21[19] KF7-500.24[10] KF7-500.25A[7] KF7-500.26[17] KF7-500.28[4] KF7-500.30[8] KF7-500.38A[4] KF7-500.39[5] KF7-500.44[3] KF7-500.47B[15] KF7-500.59[6] KF7-500.74[11] KF7-500.76[8] KF7-505.23[2] KF7-525.2[6] KF7-580.1[8] /end FUNCTION_LIST
/end MEASUREMENT
/* COMPU_METHOD --------------------------------------------------------- */
/begin COMPU_METHOD COMP_0017 "1deg" RAT_FUNC "%8.2" "deg" COEFFS 0 1 0 0 0 1 /end COMPU_METHOD
/begin COMPU_METHOD COMP_0068 "1-" RAT_FUNC "%8.2" "-" COEFFS 0 1 0 0 0 1 /end COMPU_METHOD
/begin COMPU_METHOD COMP_0004 "1Å|" RAT_FUNC "%8.2" "Å|" COEFFS 0 1 0 0 0 1 /end COMPU_METHOD
/begin COMPU_METHOD COMP_0061 "5mv" RAT_FUNC "%8.2" "mv" COEFFS 0 1 0 0 0 5 /end COMPU_METHOD
/begin COMPU_METHOD COMP_0023 "5mV" RAT_FUNC "%8.2" "mV" COEFFS 0 1 0 0 0 5 /end COMPU_METHOD
/begin COMPU_METHOD COMP_0002 "0.35deg" RAT_FUNC "%8.2" "deg" COEFFS 0 1 0 0 0 0.35 /end COMPU_METHOD
/begin COMPU_METHOD COMP_0003 "1Åé" RAT_FUNC "%8.2" "Åé" COEFFS 0 1 0 0 0 1 /end COMPU_METHOD
/begin COMPU_METHOD COMP_0014 "10ms" RAT_FUNC "%8.2" "ms" COEFFS 0 1 0 0 0 10 /end COMPU_METHOD
/begin COMPU_METHOD COMP_0006 "12.5rpm" RAT_FUNC "%8.2" "rpm" COEFFS 0 1 0 0 0 12.5 /end COMPU_METHOD
/begin COMPU_METHOD COMP_0008 "100ms" RAT_FUNC "%8.2" "ms" COEFFS 0 1 0 0 0 100 /end COMPU_METHOD
/begin COMPU_METHOD COMP_0009 "100/128%" RAT_FUNC "%8.2" "%" COEFFS 0 1 0 0 0 0.78125 /end COMPU_METHOD
/begin COMPU_METHOD COMP_0010 "0.003MPa" RAT_FUNC "%8.4" "MPa" COEFFS 0 1 0 0 0 0.003 /end COMPU_METHOD
/begin COMPU_METHOD COMP_0013 "1s" RAT_FUNC "%8.2" "s" COEFFS 0 1 0 0 0 1 /end COMPU_METHOD
/begin COMPU_METHOD COMP_0047 "0.5%" RAT_FUNC "%8.2" "%" COEFFS 0 1 0 0 0 0.5 /end COMPU_METHOD
/begin COMPU_METHOD COMP_0486 "20/256mv" RAT_FUNC "%8.3" "mv" COEFFS 0 1 0 0 0 0.078125 /end COMPU_METHOD
/begin COMPU_METHOD COMP_0353 "5mV" RAT_FUNC "%8.2" "mV" COEFFS 0 1 0 0 0 5 /end COMPU_METHOD
/begin COMPU_METHOD COMP_0018 "1deg" RAT_FUNC "%8.2" "deg" COEFFS 0 1 0 0 0 1 /end COMPU_METHOD
/begin COMPU_METHOD COMP_0081 "1/256deg" RAT_FUNC "%8.4" "deg" COEFFS 0 1 0 0 0 0.00390625 /end COMPU_METHOD
/begin COMPU_METHOD COMP_0007 "2km/h" RAT_FUNC "%8.2" "km/h" COEFFS 0 1 0 0 0 2 /end COMPU_METHOD
/begin COMPU_METHOD COMP_0021 "100/256%" RAT_FUNC "%8.2" "%" COEFFS 0 1 0 0 0 0.390625 /end COMPU_METHOD
/begin COMPU_METHOD COMP_0217 "1/16384-" RAT_FUNC "%8.6" "-" COEFFS 0 1 0 0 0 0.0000610352 /end COMPU_METHOD
/begin COMPU_METHOD COMP_0250 "4ms" RAT_FUNC "%8.2" "ms" COEFFS 0 1 0 0 0 4 /end COMPU_METHOD
/begin COMPU_METHOD COMP_0033 "80mV" RAT_FUNC "%8.2" "mV" COEFFS 0 1 0 0 0 80 /end COMPU_METHOD
/begin COMPU_METHOD COMP_0032 "1/256Å|" RAT_FUNC "%8.4" "Å|" COEFFS 0 1 0 0 0 0.00390625 /end COMPU_METHOD
/begin COMPU_METHOD COMP_0130 "0.0275deg" RAT_FUNC "%8.3" "deg" COEFFS 0 1 0 0 0 0.0275 /end COMPU_METHOD
/begin COMPU_METHOD COMP_0370 "2.5mv" RAT_FUNC "%8.2" "mv" COEFFS 0 1 0 0 0 2.5 /end COMPU_METHOD
/begin COMPU_METHOD COMP_0030 "1âÒ" RAT_FUNC "%8.2" "âÒ" COEFFS 0 1 0 0 0 1 /end COMPU_METHOD
/begin COMPU_METHOD COMP_0031 "1/256%" RAT_FUNC "%8.4" "%" COEFFS 0 1 0 0 0 0.00390625 /end COMPU_METHOD
/begin COMPU_METHOD COMP_0005 "0.11deg" RAT_FUNC "%8.2" "deg" COEFFS 0 1 0 0 0 0.11 /end COMPU_METHOD
/begin COMPU_METHOD COMP_0362_S "0.125%" RAT_FUNC "%8.2" "%" COEFFS 0 1 0 0 0 0.125 /end COMPU_METHOD
/begin COMPU_METHOD COMP_0044 "1/128Å|" RAT_FUNC "%8.4" "Å|" COEFFS 0 1 0 0 0 0.0078125 /end COMPU_METHOD
/begin COMPU_METHOD COMP_0016 "1count" RAT_FUNC "%8.2" "count" COEFFS 0 1 0 0 0 1 /end COMPU_METHOD
/begin COMPU_METHOD COMP_0054 "20mV" RAT_FUNC "%8.2" "mV" COEFFS 0 1 0 0 0 20 /end COMPU_METHOD
/begin COMPU_METHOD COMP_0050 "5/64mV" RAT_FUNC "%8.3" "mV" COEFFS 0 1 0 0 0 0.078125 /end COMPU_METHOD
/begin COMPU_METHOD COMP_0035 "X-50Åé" RAT_FUNC "%8.2" "Åé" COEFFS 0 1 50 0 0 1 /end COMPU_METHOD
/begin COMPU_METHOD COMP_0228 "0.1Nm" RAT_FUNC "%8.2" "Nm" COEFFS 0 1 0 0 0 0.1 /end COMPU_METHOD
/begin COMPU_METHOD COMP_0377 "0.11deg" RAT_FUNC "%8.2" "deg" COEFFS 0 1 0 0 0 0.11 /end COMPU_METHOD
/begin COMPU_METHOD COMP_0069 "1/(128*256)Å|" RAT_FUNC "%8.6" "Å|" COEFFS 0 1 0 0 0 0.0000305176 /end COMPU_METHOD
/begin COMPU_METHOD COMP_0104 "10mV" RAT_FUNC "%8.2" "mV" COEFFS 0 1 0 0 0 10 /end COMPU_METHOD
/begin COMPU_METHOD COMP_0190 "2deg" RAT_FUNC "%8.2" "deg" COEFFS 0 1 0 0 0 2 /end COMPU_METHOD
/begin COMPU_METHOD COMP_0256 "64/128degCA" RAT_FUNC "%8.2" "degCA" COEFFS 0 1 64 0 0 0.5 /end COMPU_METHOD
/begin COMPU_METHOD COMP_0149 "1/2048Å|" RAT_FUNC "%8.5" "Å|" COEFFS 0 1 0 0 0 0.000488282 /end COMPU_METHOD
/begin COMPU_METHOD COMP_0415_S "38368É∂" RAT_FUNC "%8.3" "É∂" COEFFS 0 1 0 0 0 0.0625 /end COMPU_METHOD
/begin COMPU_METHOD COMP_0094_S "mgmg" RAT_FUNC "%8.3" "mg" COEFFS 0 1 0 0 0 0.01 /end COMPU_METHOD
/begin COMPU_METHOD COMP_0062 "4Åé" RAT_FUNC "%8.2" "Åé" COEFFS 0 1 0 0 0 4 /end COMPU_METHOD
/begin COMPU_METHOD COMP_0146 "100/256/256%" RAT_FUNC "%8.4" "%" COEFFS 0 1 0 0 0 0.001525879 /end COMPU_METHOD
/begin COMPU_METHOD COMP_0267 "256us" RAT_FUNC "%8.2" "us" COEFFS 0 1 0 0 0 256 /end COMPU_METHOD
/begin COMPU_METHOD COMP_0011 "0.02MPa" RAT_FUNC "%8.3" "MPa" COEFFS 0 1 0 0 0 0.02 /end COMPU_METHOD
/begin COMPU_METHOD COMP_0447_S "38368É∂/100ms" RAT_FUNC "%8.3" "É∂/100ms" COEFFS 0 1 0 0 0 0.0625 /end COMPU_METHOD
/begin COMPU_METHOD COMP_0356 "0.625X-40Åé" RAT_FUNC "%8.2" "Åé" COEFFS 0 1 40 0 0 0.625 /end COMPU_METHOD
/begin COMPU_METHOD COMP_0285 "0.00001Å|" RAT_FUNC "%8.6" "Å|" COEFFS 0 1 0 0 0 0.00001 /end COMPU_METHOD
/begin COMPU_METHOD COMP_0030_S "NN" RAT_FUNC "%8.2" "N" COEFFS 0 1 0 0 0 1 /end COMPU_METHOD
/begin COMPU_METHOD COMP_0057 "1/16384Å|" RAT_FUNC "%8.6" "Å|" COEFFS 0 1 0 0 0 0.0000610352 /end COMPU_METHOD
/begin COMPU_METHOD COMP_0315 "0.09765%/ms" RAT_FUNC "%8.3" "%/ms" COEFFS 0 1 0 0 0 0.09765 /end COMPU_METHOD
/begin COMPU_METHOD COMP_0144 "1/2048ms" RAT_FUNC "%8.5" "ms" COEFFS 0 1 0 0 0 0.000488281 /end COMPU_METHOD
/begin COMPU_METHOD COMP_0231 "10É S" RAT_FUNC "%8.2" "É S" COEFFS 0 1 0 0 0 10 /end COMPU_METHOD
/begin COMPU_METHOD COMP_0362 "25cc" RAT_FUNC "%8.2" "cc" COEFFS 0 1 0 0 0 25 /end COMPU_METHOD
/begin COMPU_METHOD COMP_0278_S "fixed axis Åé" RAT_FUNC "%8.2" "Åé" COEFFS 0 1 40 0 0 20 /end COMPU_METHOD
/begin COMPU_METHOD COMP_0280_S "fixed axis Åé" RAT_FUNC "%8.2" "Åé" COEFFS 0 1 40 0 0 10 /end COMPU_METHOD
/begin COMPU_METHOD COMP_0042 "0.0008cm**2" RAT_FUNC "%8.5" "cm**2" COEFFS 0 1 0 0 0 0.0008 /end COMPU_METHOD
/begin COMPU_METHOD COMP_0041 "0.0008cm^2" RAT_FUNC "%8.5" "cm^2" COEFFS 0 1 0 0 0 0.0008 /end COMPU_METHOD
/begin COMPU_METHOD COMP_0302_S "fixed axis mV" RAT_FUNC "%8.2" "mV" COEFFS 0 1 0 0 0 160 /end COMPU_METHOD
/begin COMPU_METHOD COMP_0311_S "fixed axis V" RAT_FUNC "%8.3" "V" COEFFS 0 1 0 0 0 0.08 /end COMPU_METHOD
/begin COMPU_METHOD COMP_0324_S "fixed axis 1" RAT_FUNC "%8.2" "1" COEFFS 0 1 0 0 0 0.125 /end COMPU_METHOD
/begin COMPU_METHOD COMP_0323 "1.25X-200Åé" RAT_FUNC "%8.2" "Åé" COEFFS 0 1 200 0 0 1.25 /end COMPU_METHOD
/begin COMPU_METHOD COMP_0096_S "mV^2mV^2" RAT_FUNC "%8.2" "mV^2" COEFFS 0 1 0 0 0 1280000 /end COMPU_METHOD
/begin COMPU_METHOD COMP_0283 "1flag" RAT_FUNC "%8.2" "flag" COEFFS 0 1 0 0 0 1 /end COMPU_METHOD
/begin COMPU_METHOD COMP_0201_S "1s1s" RAT_FUNC "%8.2" "1s" COEFFS 0 1 0 0 0 1 /end COMPU_METHOD
/begin COMPU_METHOD COMP_0202_S "100ms100ms" RAT_FUNC "%8.2" "100ms" COEFFS 0 1 0 0 0 1 /end COMPU_METHOD
/begin COMPU_METHOD COMP_0203_S "10ms10ms" RAT_FUNC "%8.2" "10ms" COEFFS 0 1 0 0 0 1 /end COMPU_METHOD
/begin COMPU_METHOD COMP_0428 "X-40Åé" RAT_FUNC "%8.2" "Åé" COEFFS 0 1 40 0 0 1 /end COMPU_METHOD
/begin COMPU_METHOD COMP_0140 "0.5STEP" RAT_FUNC "%8.2" "STEP" COEFFS 0 1 0 0 0 0.5 /end COMPU_METHOD
/begin COMPU_METHOD COMP_0449 "1/256ms" RAT_FUNC "%8.4" "ms" COEFFS 0 1 0 0 0 0.00390625 /end COMPU_METHOD
/begin COMPU_METHOD COMP_0141 "50/256%" RAT_FUNC "%8.2" "%" COEFFS 0 1 0 0 0 0.1953125 /end COMPU_METHOD
/begin COMPU_METHOD COMP_0328 "100/(64*256)%" RAT_FUNC "%8.4" "%" COEFFS 0 1 0 0 0 0.006103516 /end COMPU_METHOD
/begin COMPU_METHOD COMP_0376 "0.1É S" RAT_FUNC "%8.2" "É S" COEFFS 0 1 0 0 0 0.1 /end COMPU_METHOD
/begin COMPU_METHOD COMP_0560_S "--" RAT_FUNC "%8.5" "-" COEFFS 0 1 0 0 0 0.000244 /end COMPU_METHOD
/begin COMPU_METHOD COMP_0386 "10É S" RAT_FUNC "%8.2" "É S" COEFFS 0 1 0 0 0 10 /end COMPU_METHOD
/begin COMPU_METHOD COMP_0393 "5mV" RAT_FUNC "%8.2" "mV" COEFFS 0 1 163840 0 0 5 /end COMPU_METHOD
/begin COMPU_METHOD COMP_0415 "1/256Å|" RAT_FUNC "%8.4" "Å|" COEFFS 0 1 0 0 0 0.00390625 /end COMPU_METHOD
/begin COMPU_METHOD COMP_0417 "8us" RAT_FUNC "%8.2" "us" COEFFS 0 1 0 0 0 8 /end COMPU_METHOD
/begin COMPU_METHOD COMP_0418 "2.5mA" RAT_FUNC "%8.2" "mA" COEFFS 0 1 0 0 0 2.5 /end COMPU_METHOD
/begin COMPU_METHOD COMP_0176 "1/64ms" RAT_FUNC "%8.3" "ms" COEFFS 0 1 0 0 0 0.015625 /end COMPU_METHOD
/begin COMPU_METHOD COMP_0431 "90/(256*256)deg" RAT_FUNC "%8.4" "deg" COEFFS 0 1 0 0 0 0.001373291 /end COMPU_METHOD
/begin COMPU_METHOD COMP_0097_S "mV^2*4msmV^2*4ms" RAT_FUNC "%8.2" "mV^2*4ms" COEFFS 0 1 0 0 0 1280 /end COMPU_METHOD
/begin COMPU_METHOD COMP_0600_S "AA" RAT_FUNC "%8.6" "A" COEFFS 0 1 0 0 0 0.000007629 /end COMPU_METHOD
/begin COMPU_METHOD COMP_0408 "5mv" RAT_FUNC "%8.2" "mv" COEFFS 0 1 0 0 0 5 /end COMPU_METHOD
/begin COMPU_METHOD COMP_0605_S "(É S)^-2(ms)^-1(É S)^-2" RAT_FUNC "%8.2" "(É S)^-2" COEFFS 0 1 128 0 0 1 /end COMPU_METHOD
/begin COMPU_METHOD COMP_0100_S "AA" RAT_FUNC "%8.2" "A" COEFFS 0 1 0 0 0 0.1 /end COMPU_METHOD
/begin COMPU_METHOD COMP_0164_S "degdeg" RAT_FUNC "%8.4" "deg" COEFFS 0 1 14.08205 0 0 0.00171875 /end COMPU_METHOD
/begin COMPU_METHOD COMP_0512 "1/512ms" RAT_FUNC "%8.4" "ms" COEFFS 0 1 0 0 0 0.001953125 /end COMPU_METHOD
/begin COMPU_METHOD COMP_0635_S "msms" RAT_FUNC "%8.5" "ms" COEFFS 0 1 0 0 0 0.00048828 /end COMPU_METHOD
/begin COMPU_METHOD COMP_0520 "1.25/256X-200Åé" RAT_FUNC "%8.4" "Åé" COEFFS 0 1 200 0 0 0.004882813 /end COMPU_METHOD
/begin COMPU_METHOD COMP_0643_S "mVmV" RAT_FUNC "%8.6" "mV" COEFFS 0 1 0 0 0 0.0000762939 /end COMPU_METHOD
/* RECORD_LAYOUT ------------------------------------------------------ */
/begin RECORD_LAYOUT REC_UBYTE_C FNC_VALUES 1 UBYTE COLUMN_DIR DIRECT /end RECORD_LAYOUT
/begin RECORD_LAYOUT REC_UWORD_C FNC_VALUES 1 UWORD COLUMN_DIR DIRECT /end RECORD_LAYOUT
/begin RECORD_LAYOUT REC_AXIS_UBYTE AXIS_PTS_X 1 UBYTE INDEX_INCR DIRECT /end RECORD_LAYOUT
/begin RECORD_LAYOUT REC_AXIS_UWORD AXIS_PTS_X 1 UWORD INDEX_INCR DIRECT /end RECORD_LAYOUT
/end MODULE
/end PROJECT
