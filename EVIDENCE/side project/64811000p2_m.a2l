ASAP2_VERSION 1 3_BETA
/begin PROJECT TK_X91_EUR_VC ""
/begin HEADER "" /* key HEADER ++ "comment" Ç… Par.scomment */ PROJECT_NO TK_X91_EUR_VC /* key PROJECT_NO ++ project number Ç… car_eng_desti_lot */ VERSION "7V4YHZEB2" /* key VERSION ++ version number Ç… mProgver */ /end HEADER
/begin MODULE DIM ""
/begin MOD_COMMON "" DEPOSIT ABSOLUTE BYTE_ORDER MSB_FIRST /* ﬁ≤ƒµ∞¿ﬁ∞Ç™ÿÃﬂ⁄∞ΩÇ≥ÇÍÇÈ */ /end MOD_COMMON
/begin FUNCTION KF7-500.21[19] "FTP catalyst diagnosis " /end FUNCTION
/begin FUNCTION KF7-500.24[10] "Rear O2 sensor diagnosis" /end FUNCTION
/begin FUNCTION KF7-500.25A[7] "Rear O2 heater diagnosis" /end FUNCTION
/begin FUNCTION KF7-500.26[17] "All range misfiring diagnosis" /end FUNCTION
/begin FUNCTION KF7-500.28[4] "NEUT switch diagnosis" /end FUNCTION
/begin FUNCTION KF7-500.30[8] "Purge control valve diagnosis" /end FUNCTION
/begin FUNCTION KF7-500.38A[4] "ISC diagnosis (step motor type)" /end FUNCTION
/begin CHARACTERISTIC mCRCAT "Misfire judgement catalyst criteria" CURVE 0x0000C921 REC_UBYTE_C 0 COMP_0074 0 0.99609375
 /begin AXIS_DESCR FIX_AXIS NO_INPUT_QUANTITY COMP_0205_S 5 0 4 FIX_AXIS_PAR_DIST 0 1 5 /end AXIS_DESCR
 /begin FUNCTION_LIST KF7-500.26[17] /end FUNCTION_LIST
/end CHARACTERISTIC
/begin CHARACTERISTIC mALPCTH "Diagnosis permission MALPHA upper limit value" VALUE 0x00008268 REC_UBYTE_C 0 COMP_0027 0 255 /begin FUNCTION_LIST KF7-500.21[19] /end FUNCTION_LIST /end CHARACTERISTIC
/begin CHARACTERISTIC mALPCTL "Diagnosis permission MALPHA lower limit value" VALUE 0x00008269 REC_UBYTE_C 0 COMP_0027 0 255 /begin FUNCTION_LIST KF7-500.21[19] /end FUNCTION_LIST /end CHARACTERISTIC
/begin CHARACTERISTIC mCATBAI "Catalyst criteria judgement number of times multiple value" VALUE 0x000082E1 REC_UBYTE_C 0 COMP_0016 0 255 /begin FUNCTION_LIST KF7-500.26[17] /end FUNCTION_LIST /end CHARACTERISTIC
/begin CHARACTERISTIC mCATDY1 "Diagnosis permission delay" VALUE 0x000082E2 REC_UBYTE_C 0 COMP_0008 0 25500 /begin FUNCTION_LIST KF7-500.21[19] /end FUNCTION_LIST /end CHARACTERISTIC
/begin CHARACTERISTIC mCATEVP "Stage 2 diagnosis canister purge cut delay" VALUE 0x000082E3 REC_UBYTE_C 0 COMP_0013 0 255 /begin FUNCTION_LIST KF7-500.21[19] /end FUNCTION_LIST /end CHARACTERISTIC
/begin CHARACTERISTIC mCATJDLY "Region judgement condition delay" VALUE 0x000082E7 REC_UBYTE_C 0 COMP_0008 0 25500 /begin FUNCTION_LIST KF7-500.21[19] /end FUNCTION_LIST /end CHARACTERISTIC
/begin CHARACTERISTIC mCATMAH "Stage 1 MALPHA upper limit" VALUE 0x000082E8 REC_UBYTE_C 0 COMP_0027 0 255 /begin FUNCTION_LIST KF7-500.21[19] /end FUNCTION_LIST /end CHARACTERISTIC
/begin CHARACTERISTIC mCATMAL "Stage 1 MALPHA lower limit" VALUE 0x000082E9 REC_UBYTE_C 0 COMP_0027 0 255 /begin FUNCTION_LIST KF7-500.21[19] /end FUNCTION_LIST /end CHARACTERISTIC
/begin CHARACTERISTIC mCATNAH "Region A speed upper limit" VALUE 0x000082EA REC_UBYTE_C 0 COMP_0056 0 6375 /begin FUNCTION_LIST KF7-500.21[19] /end FUNCTION_LIST /end CHARACTERISTIC
/begin CHARACTERISTIC mCATNAL "Region A speed lower limit" VALUE 0x000082EB REC_UBYTE_C 0 COMP_0000 0 6375 /begin FUNCTION_LIST KF7-500.21[19] /end FUNCTION_LIST /end CHARACTERISTIC
/begin CHARACTERISTIC mCATNBH "Region B speed upper limit" VALUE 0x000082EC REC_UBYTE_C 0 COMP_0056 0 6375 /begin FUNCTION_LIST KF7-500.21[19] /end FUNCTION_LIST /end CHARACTERISTIC
/begin CHARACTERISTIC mCATNBL "Region B speed lower limit" VALUE 0x000082ED REC_UBYTE_C 0 COMP_0000 0 6375 /begin FUNCTION_LIST KF7-500.21[19] /end FUNCTION_LIST /end CHARACTERISTIC
/begin CHARACTERISTIC mCATNNH "Region B N/L speed upper limit" VALUE 0x000082EE REC_UBYTE_C 0 COMP_0000 0 6375 /begin FUNCTION_LIST KF7-500.21[19] /end FUNCTION_LIST /end CHARACTERISTIC
/begin CHARACTERISTIC mCATNNL "Region B N/L speed lower limit" VALUE 0x000082EF REC_UBYTE_C 0 COMP_0000 0 6375 /begin FUNCTION_LIST KF7-500.21[19] /end FUNCTION_LIST /end CHARACTERISTIC
/begin CHARACTERISTIC mCATPAH "Region A TP upper limit" VALUE 0x000082F0 REC_UBYTE_C 0 COMP_0001 0 31.875 /begin FUNCTION_LIST KF7-500.21[19] /end FUNCTION_LIST /end CHARACTERISTIC
/begin CHARACTERISTIC mCATPAL "Region A TP lower limit" VALUE 0x000082F1 REC_UBYTE_C 0 COMP_0001 0 31.875 /begin FUNCTION_LIST KF7-500.21[19] /end FUNCTION_LIST /end CHARACTERISTIC
/begin CHARACTERISTIC mCATPBH "Region B TP upper limit" VALUE 0x000082F2 REC_UBYTE_C 0 COMP_0001 0 31.875 /begin FUNCTION_LIST KF7-500.21[19] /end FUNCTION_LIST /end CHARACTERISTIC
/begin CHARACTERISTIC mCATPBL "Region B TP lower limit" VALUE 0x000082F3 REC_UBYTE_C 0 COMP_0001 0 31.875 /begin FUNCTION_LIST KF7-500.21[19] /end FUNCTION_LIST /end CHARACTERISTIC
/begin CHARACTERISTIC mCATQMA "Catalyst diagnosis region A inhalation air quantity upper limit" VALUE 0x0000909C REC_UWORD_C 0 COMP_0004 0 65535 /begin FUNCTION_LIST KF7-500.21[19] /end FUNCTION_LIST /end CHARACTERISTIC
/begin CHARACTERISTIC mCATQMB "Catalyst diagnosis region B inhalation air quantity upper limit" VALUE 0x0000909E REC_UWORD_C 0 COMP_0004 0 65535 /begin FUNCTION_LIST KF7-500.21[19] /end FUNCTION_LIST /end CHARACTERISTIC
/begin CHARACTERISTIC mCJVSP1 "A region vehicle speed condition lower limit" VALUE 0x00008318 REC_UBYTE_C 0 COMP_0007 0 510 /begin FUNCTION_LIST KF7-500.21[19] /end FUNCTION_LIST /end CHARACTERISTIC
/begin CHARACTERISTIC mCJVSP3 "B region vehicle speed condition lower limit" VALUE 0x0000831A REC_UBYTE_C 0 COMP_0007 0 510 /begin FUNCTION_LIST KF7-500.21[19] /end FUNCTION_LIST /end CHARACTERISTIC
/begin CHARACTERISTIC mCLORPM "ISC diagnosis rotation change condition judgement value" VALUE 0x0000832A REC_UBYTE_C 0 COMP_0070 0 3187.5 /begin FUNCTION_LIST KF7-500.38A[4] /end FUNCTION_LIST /end CHARACTERISTIC
/begin CHARACTERISTIC mCNGMOK "MSTRG OK criteria" VALUE 0x00008341 REC_UBYTE_C 0 COMP_0085_S 0 255 /begin FUNCTION_LIST KF7-500.21[19] /end FUNCTION_LIST /end CHARACTERISTIC
/begin CHARACTERISTIC mCNVDLY "Region judgement NG delay" VALUE 0x0000834F REC_UBYTE_C 0 COMP_0008 0 25500 /begin FUNCTION_LIST KF7-500.21[19] /end FUNCTION_LIST /end CHARACTERISTIC
/begin CHARACTERISTIC mCRING1 "TINT measuring start offset" VALUE 0x0000818C REC_SBYTE_C 0 COMP_0075 -128 127 /begin FUNCTION_LIST KF7-500.26[17] /end FUNCTION_LIST /end CHARACTERISTIC
/begin CHARACTERISTIC mCRTEM2 "Misfire OK judgement emission criteria" VALUE 0x000090BC REC_UWORD_C 0 COMP_0016 0 65535 /begin FUNCTION_LIST KF7-500.26[17] /end FUNCTION_LIST /end CHARACTERISTIC
/begin CHARACTERISTIC mDLMFDT "After the start for the misfire cancellation delta-TVO setup, delay" VALUE 0x00008466 REC_UBYTE_C 0 COMP_0049 0 255 /begin FUNCTION_LIST KF7-500.26[17] /end FUNCTION_LIST /end CHARACTERISTIC
/begin CHARACTERISTIC mDLYCD3 "Stage 2 diagnosis condition disconnection delay" VALUE 0x0000847B REC_UBYTE_C 0 COMP_0013 0 255 /begin FUNCTION_LIST KF7-500.21[19] /end FUNCTION_LIST /end CHARACTERISTIC
/begin CHARACTERISTIC mDMFISC "After the ISCV big time start, delay" VALUE 0x00008485 REC_UBYTE_C 0 COMP_0049 0 255 /begin FUNCTION_LIST KF7-500.26[17] /end FUNCTION_LIST /end CHARACTERISTIC
/begin CHARACTERISTIC mDMNRGG "TINT compensation operation condition engine rotation slowdown condition upper limit" VALUE 0x0000848A REC_UBYTE_C 0 COMP_0000 0 6375 /begin FUNCTION_LIST KF7-500.26[17] /end FUNCTION_LIST /end CHARACTERISTIC
/begin CHARACTERISTIC mDNCAT "É¢N condition upper limit" VALUE 0x0000848D REC_UBYTE_C 0 COMP_0070 0 3187.5 /begin FUNCTION_LIST KF7-500.21[19] /end FUNCTION_LIST /end CHARACTERISTIC
/begin CHARACTERISTIC mDRKTCN "TINT compensation difference value for the RKTilx cancellation" VALUE 0x00009136 REC_UWORD_C 0 COMP_0069 0 1.999970916 /begin FUNCTION_LIST KF7-500.26[17] /end FUNCTION_LIST /end CHARACTERISTIC
/begin CHARACTERISTIC mDTPCAT "Delta-TP condition upper limit" VALUE 0x000084E4 REC_UBYTE_C 0 COMP_0124 0 31.875 /begin FUNCTION_LIST KF7-500.21[19] /end FUNCTION_LIST /end CHARACTERISTIC
/begin CHARACTERISTIC mDTVCTH "Diagnosis permission ATVO upper limit value" VALUE 0x000084EC REC_UBYTE_C 0 COMP_0002 0 89.25 /begin FUNCTION_LIST KF7-500.21[19] /end FUNCTION_LIST /end CHARACTERISTIC
/begin CHARACTERISTIC mDTVNGC "Purge control valve breakage judgement sample number of times" VALUE 0x000084EF REC_UBYTE_C 0 COMP_0016 0 255 /begin FUNCTION_LIST KF7-500.30[8] /end FUNCTION_LIST /end CHARACTERISTIC
/begin CHARACTERISTIC mDTVOGH "TVO ETC:APOK monitor bad road judgement delta proper side reference" VALUE 0x000084F1 REC_UBYTE_C 0 COMP_0129 -44.8 44.45 /begin FUNCTION_LIST KF7-500.26[17] /end FUNCTION_LIST /end CHARACTERISTIC
/begin CHARACTERISTIC mDTVOGL "TVO ETC:APOK monitor bad road judgement delta-TVO ETC:É¢APOK negative side reference" VALUE 0x000084F2 REC_UBYTE_C 0 COMP_0129 -44.8 44.45 /begin FUNCTION_LIST KF7-500.26[17] /end FUNCTION_LIST /end CHARACTERISTIC
/begin CHARACTERISTIC mDTVOGN "TVO ETC:APOK monitor bad road judgement delta-TVO ETC:É¢APOK judgement number of times reference" VALUE 0x000084F3 REC_UBYTE_C 0 COMP_0016 0 255 /begin FUNCTION_LIST KF7-500.26[17] /end FUNCTION_LIST /end CHARACTERISTIC
/begin CHARACTERISTIC mDTVOGT "TVO ETC:APOK monitor bad road judgement delta-TVO ETC:É¢APOK judgement time reference" VALUE 0x000084F4 REC_UBYTE_C 0 COMP_0014 0 2550 /begin FUNCTION_LIST KF7-500.26[17] /end FUNCTION_LIST /end CHARACTERISTIC
/begin CHARACTERISTIC mDTVRVH "Purge control valve breakage judgement voltage upper limit" VALUE 0x000084FB REC_UBYTE_C 0 COMP_0054 0 5100 /begin FUNCTION_LIST KF7-500.30[8] /end FUNCTION_LIST /end CHARACTERISTIC
/begin CHARACTERISTIC mDTVRVL "Purge control valve breakage judgement voltage lower limit" VALUE 0x000084FC REC_UBYTE_C 0 COMP_0054 0 5100 /begin FUNCTION_LIST KF7-500.30[8] /end FUNCTION_LIST /end CHARACTERISTIC
/begin CHARACTERISTIC mDVRONG "Response time NG judgement reference" VALUE 0x00008516 REC_UBYTE_C 0 COMP_0104 0 2550 /begin FUNCTION_LIST KF7-500.24[10] R901.1.Diag_on_can_app_1_6_2 /end FUNCTION_LIST /end CHARACTERISTIC
/begin CHARACTERISTIC mEVPNML "Speed condition lower limit value" VALUE 0x00008597 REC_UBYTE_C 0 COMP_0000 0 6375 /begin FUNCTION_LIST KF7-500.30[8] /end FUNCTION_LIST /end CHARACTERISTIC
/begin CHARACTERISTIC mEVPTAL "At least, intake air temperature lower limit value" VALUE 0x0000859C REC_UBYTE_C 0 COMP_0035 -50 205 /begin FUNCTION_LIST KF7-500.30[8] /end FUNCTION_LIST /end CHARACTERISTIC
/begin CHARACTERISTIC mEVPTFL "Fuel temperature condition lower limit value" VALUE 0x0000859D REC_UBYTE_C 0 COMP_0035 -50 205 /begin FUNCTION_LIST KF7-500.30[8] /end FUNCTION_LIST /end CHARACTERISTIC
/begin CHARACTERISTIC mEVPTPH "TP condition upper limit" VALUE 0x0000859E REC_UBYTE_C 0 COMP_0001 0 31.875 /begin FUNCTION_LIST KF7-500.30[8] /end FUNCTION_LIST /end CHARACTERISTIC
/begin CHARACTERISTIC mEVPTPL "TP condition lower limit" VALUE 0x0000859F REC_UBYTE_C 0 COMP_0001 0 31.875 /begin FUNCTION_LIST KF7-500.30[8] /end FUNCTION_LIST /end CHARACTERISTIC
/begin CHARACTERISTIC mEVPTWH "Coolant temperature condition upper limit" VALUE 0x000085A0 REC_UBYTE_C 0 COMP_0035 -50 205 /begin FUNCTION_LIST KF7-500.30[8] /end FUNCTION_LIST /end CHARACTERISTIC
/begin CHARACTERISTIC mEVPTWL "Coolant temperature condition lower limit" VALUE 0x000085A1 REC_UBYTE_C 0 COMP_0035 -50 205 /begin FUNCTION_LIST KF7-500.30[8] /end FUNCTION_LIST /end CHARACTERISTIC
/begin CHARACTERISTIC mEVPVSH "Vehicle speed condition upper limit" VALUE 0x000085A2 REC_UBYTE_C 0 COMP_0007 0 510 /begin FUNCTION_LIST KF7-500.30[8] /end FUNCTION_LIST /end CHARACTERISTIC
/begin CHARACTERISTIC mFUKBAI "Catalyst damage criteria judgement number of times multiple value" VALUE 0x00008650 REC_UBYTE_C 0 COMP_0016 0 255 /begin FUNCTION_LIST KF7-500.26[17] /end FUNCTION_LIST /end CHARACTERISTIC
/begin CHARACTERISTIC mISCPA2 "ISC diagnosis permission atomospheric pressure (A/C on)" VALUE 0x00009304 REC_UWORD_C 0 COMP_0050 0 5119.921875 /begin FUNCTION_LIST KF7-500.38A[4] /end FUNCTION_LIST /end CHARACTERISTIC
/begin CHARACTERISTIC mISCPAT "Atomospheric pressure value" VALUE 0x00009306 REC_UWORD_C 0 COMP_0050 0 5119.921875 /begin FUNCTION_LIST KF7-500.38A[4] /end FUNCTION_LIST /end CHARACTERISTIC
/begin CHARACTERISTIC mISCTAL "ISC diagnosis permission air temperature condition lower limit" VALUE 0x00008764 REC_UBYTE_C 0 COMP_0035 -50 205 /begin FUNCTION_LIST KF7-500.38A[4] /end FUNCTION_LIST /end CHARACTERISTIC
/begin CHARACTERISTIC mISCTAN "ISC diagnosis permission air temperature condition upper limit" VALUE 0x00008765 REC_UBYTE_C 0 COMP_0035 -50 205 /begin FUNCTION_LIST KF7-500.38A[4] /end FUNCTION_LIST /end CHARACTERISTIC
/begin CHARACTERISTIC mISCTMN "ISC tolerance diagnosis lower limit value" VALUE 0x00008766 REC_UBYTE_C 0 COMP_0006 0 3187.5 /begin FUNCTION_LIST KF7-500.38A[4] /end FUNCTION_LIST /end CHARACTERISTIC
/begin CHARACTERISTIC mKAPPA "Weight coefficient" VALUE 0x00008781 REC_UBYTE_C 0 COMP_0021 0 99.609375 /begin FUNCTION_LIST KF7-500.21[19] /end FUNCTION_LIST /end CHARACTERISTIC
/begin CHARACTERISTIC mKBLCTH "Diagnosis permission KBLRC upper limit value" VALUE 0x00008786 REC_UBYTE_C 0 COMP_0027 0 255 /begin FUNCTION_LIST KF7-500.21[19] /end FUNCTION_LIST /end CHARACTERISTIC
/begin CHARACTERISTIC mKBLCTL "Diagnosis permission KBLRC lower limit value" VALUE 0x00008787 REC_UBYTE_C 0 COMP_0027 0 255 /begin FUNCTION_LIST KF7-500.21[19] /end FUNCTION_LIST /end CHARACTERISTIC
/begin CHARACTERISTIC mKCATTH "Intake air temperature compensation basic intake air temperature" VALUE 0x0000878C REC_UBYTE_C 0 COMP_0035 -50 205 /begin FUNCTION_LIST KF7-500.21[19] /end FUNCTION_LIST /end CHARACTERISTIC
/begin CHARACTERISTIC mKCATTM "Intake air temperature compensation coefficient" VALUE 0x0000878D REC_UBYTE_C 0 COMP_0205 0 796.875 /begin FUNCTION_LIST KF7-500.21[19] /end FUNCTION_LIST /end CHARACTERISTIC
/begin CHARACTERISTIC mKCTRT "Catalyst activated compensation temperature" VALUE 0x0000878F REC_UBYTE_C 0 COMP_0062 0 1020 /begin FUNCTION_LIST KF7-500.21[19] /end FUNCTION_LIST /end CHARACTERISTIC
/begin CHARACTERISTIC mKCWPMX "CCATWP maximum value" VALUE 0x00008790 REC_UBYTE_C 0 COMP_0096 0 2550 /begin FUNCTION_LIST KF7-500.21[19] /end FUNCTION_LIST /end CHARACTERISTIC
/begin CHARACTERISTIC mKCWPSL "CCATWP threshold" VALUE 0x00008791 REC_UBYTE_C 0 COMP_0096 0 2550 /begin FUNCTION_LIST KF7-500.21[19] /end FUNCTION_LIST /end CHARACTERISTIC
/begin CHARACTERISTIC mKKWCT "Filter time constant compensation coefficient" VALUE 0x000087AE REC_UBYTE_C 0 COMP_0205 0 796.875 /begin FUNCTION_LIST KF7-500.21[19] /end FUNCTION_LIST /end CHARACTERISTIC
/begin CHARACTERISTIC mKMISA1 "MATH1 compensation coefficient" VALUE 0x000087B4 REC_UBYTE_C 0 COMP_0009 0 199.21875 /begin FUNCTION_LIST KF7-500.26[17] /end FUNCTION_LIST /end CHARACTERISTIC
/begin CHARACTERISTIC mKMISA2 "MATH2 compensation coefficient" VALUE 0x000087B5 REC_UBYTE_C 0 COMP_0009 0 199.21875 /begin FUNCTION_LIST KF7-500.26[17] /end FUNCTION_LIST /end CHARACTERISTIC
/begin CHARACTERISTIC mKMISA3 "MATH3 compensation coefficient" VALUE 0x000087B6 REC_UBYTE_C 0 COMP_0009 0 199.21875 /begin FUNCTION_LIST KF7-500.26[17] /end FUNCTION_LIST /end CHARACTERISTIC
/begin CHARACTERISTIC mKMISA5 "MATH5 compensation coefficient" VALUE 0x000087B7 REC_UBYTE_C 0 COMP_0009 0 199.21875 /begin FUNCTION_LIST KF7-500.26[17] /end FUNCTION_LIST /end CHARACTERISTIC
/begin CHARACTERISTIC mKMISA6 "MATH6 compensation coefficient" VALUE 0x000087B8 REC_UBYTE_C 0 COMP_0009 0 199.21875 /begin FUNCTION_LIST KF7-500.26[17] /end FUNCTION_LIST /end CHARACTERISTIC
/begin CHARACTERISTIC mKMISAK "MATGK compensation coefficient" VALUE 0x000087B9 REC_UBYTE_C 0 COMP_0009 0 199.21875 /begin FUNCTION_LIST KF7-500.26[17] /end FUNCTION_LIST /end CHARACTERISTIC
/begin CHARACTERISTIC mKMISC1 "MCTH1 compensation coefficient" VALUE 0x000087BA REC_UBYTE_C 0 COMP_0009 0 199.21875 /begin FUNCTION_LIST KF7-500.26[17] /end FUNCTION_LIST /end CHARACTERISTIC
/begin CHARACTERISTIC mKMISC2 "MCTH2 compensation coefficient" VALUE 0x000087BB REC_UBYTE_C 0 COMP_0009 0 199.21875 /begin FUNCTION_LIST KF7-500.26[17] /end FUNCTION_LIST /end CHARACTERISTIC
/begin CHARACTERISTIC mKMISC3 "MCTH3 compensation coefficient" VALUE 0x000087BC REC_UBYTE_C 0 COMP_0009 0 199.21875 /begin FUNCTION_LIST KF7-500.26[17] /end FUNCTION_LIST /end CHARACTERISTIC
/begin CHARACTERISTIC mKMISC5 "MCTH5 compensation coefficient" VALUE 0x000087BD REC_UBYTE_C 0 COMP_0009 0 199.21875 /begin FUNCTION_LIST KF7-500.26[17] /end FUNCTION_LIST /end CHARACTERISTIC
/begin CHARACTERISTIC mKMISC6 "MCTH6 compensation coefficient" VALUE 0x000087BE REC_UBYTE_C 0 COMP_0009 0 199.21875 /begin FUNCTION_LIST KF7-500.26[17] /end FUNCTION_LIST /end CHARACTERISTIC
/begin CHARACTERISTIC mKMISC7 "MCTH7 compensation coefficient" VALUE 0x000087BF REC_UBYTE_C 0 COMP_0009 0 199.21875 /begin FUNCTION_LIST KF7-500.26[17] /end FUNCTION_LIST /end CHARACTERISTIC
/begin CHARACTERISTIC mKMISC8 "MCTH8 compensation coefficient" VALUE 0x000087C0 REC_UBYTE_C 0 COMP_0009 0 199.21875 /begin FUNCTION_LIST KF7-500.26[17] /end FUNCTION_LIST /end CHARACTERISTIC
/begin CHARACTERISTIC mKMISG3 "MGTH3 compensation coefficient" VALUE 0x000087C1 REC_UBYTE_C 0 COMP_0009 0 199.21875 /begin FUNCTION_LIST KF7-500.26[17] /end FUNCTION_LIST /end CHARACTERISTIC
/begin CHARACTERISTIC mKMISGK "MGTGK compensation coefficient" VALUE 0x000087C2 REC_UBYTE_C 0 COMP_0009 0 199.21875 /begin FUNCTION_LIST KF7-500.26[17] /end FUNCTION_LIST /end CHARACTERISTIC
/begin CHARACTERISTIC mKMSEI1 "METH1 compensation coefficient (at the time of IDLE)" VALUE 0x000087D2 REC_UBYTE_C 0 COMP_0009 0 199.21875 /begin FUNCTION_LIST KF7-500.26[17] /end FUNCTION_LIST /end CHARACTERISTIC
/begin CHARACTERISTIC mKMSEO1 "METH1 compensation coefficient (non-IDLE éû)" VALUE 0x000087D3 REC_UBYTE_C 0 COMP_0009 0 199.21875 /begin FUNCTION_LIST KF7-500.26[17] /end FUNCTION_LIST /end CHARACTERISTIC
/begin CHARACTERISTIC mKSMSA1 "SMATH1 compensation coefficient" VALUE 0x000087E0 REC_UBYTE_C 0 COMP_0009 0 199.21875 /begin FUNCTION_LIST KF7-500.26[17] /end FUNCTION_LIST /end CHARACTERISTIC
/begin CHARACTERISTIC mKTCNOK "Cancellation calculation permission TINT compensation coefficient learning weighted average number of times" VALUE 0x000087E3 REC_UBYTE_C 0 COMP_0016 0 255 /begin FUNCTION_LIST KF7-500.26[17] /end FUNCTION_LIST /end CHARACTERISTIC
/begin CHARACTERISTIC mKTEMPL "Catalyst temperature lower limit" VALUE 0x000087E5 REC_UBYTE_C 0 COMP_0062 0 1020 /begin FUNCTION_LIST KF7-500.21[19] /end FUNCTION_LIST /end CHARACTERISTIC
/begin CHARACTERISTIC mKTMPSL "TMPCAT threshold" VALUE 0x000087E8 REC_UBYTE_C 0 COMP_0062 0 1020 /begin FUNCTION_LIST KF7-500.21[19] /end FUNCTION_LIST /end CHARACTERISTIC
/begin CHARACTERISTIC mKTMPWT "For a long time, at the time of the low temperature, delay" VALUE 0x000087E9 REC_UBYTE_C 0 COMP_0096 0 2550 /begin FUNCTION_LIST KF7-500.21[19] /end FUNCTION_LIST /end CHARACTERISTIC
/begin CHARACTERISTIC mKTNOK1 "MKTNTi operation permission KTNTi integration number of times" VALUE 0x000087EA REC_UBYTE_C 0 COMP_0016 0 255 /begin FUNCTION_LIST KF7-500.26[17] /end FUNCTION_LIST /end CHARACTERISTIC
/begin CHARACTERISTIC mKTOK21 "HOSTNT operation permission TINT compensation coefficient weighted average number of times" VALUE 0x000087EB REC_UBYTE_C 0 COMP_0016 0 255 /begin FUNCTION_LIST KF7-500.26[17] /end FUNCTION_LIST /end CHARACTERISTIC
/begin CHARACTERISTIC mMFDRPM "Slowdown delta-NRPM big time misfire cancellation condition" VALUE 0x00008841 REC_UBYTE_C 0 COMP_0006 0 3187.5 /begin FUNCTION_LIST KF7-500.26[17] /end FUNCTION_LIST /end CHARACTERISTIC
/begin CHARACTERISTIC mMFDTV2 "Misfire cancellation delta-TVO, usually, reference" VALUE 0x00008842 REC_UBYTE_C 0 COMP_0129 -44.8 44.45 /begin FUNCTION_LIST KF7-500.26[17] /end FUNCTION_LIST /end CHARACTERISTIC
/begin CHARACTERISTIC mMFDTV3 "Misfire cancellation delta-TVO initial, a low coolant temperature reference" VALUE 0x00008843 REC_UBYTE_C 0 COMP_0129 -44.8 44.45 /begin FUNCTION_LIST KF7-500.26[17] /end FUNCTION_LIST /end CHARACTERISTIC
/begin CHARACTERISTIC mMFHAOK "Tooth position deviation judgement clear RGPHS1 monitor number of times" VALUE 0x000093A4 REC_UWORD_C 0 COMP_0030 0 65535 /begin FUNCTION_LIST KF7-500.26[17] /end FUNCTION_LIST /end CHARACTERISTIC
/begin CHARACTERISTIC mMFKTL "Learning region bottom side boundary number of times" VALUE 0x00008846 REC_UBYTE_C 0 COMP_0020 0 12750 /begin FUNCTION_LIST KF7-500.26[17] /end FUNCTION_LIST /end CHARACTERISTIC
/begin CHARACTERISTIC mMFNACD "Misfire warning number of times judgement value multiple cylinder misfire catalyst criteria" VALUE 0x00008848 REC_UBYTE_C 0 COMP_0016 0 255 /begin FUNCTION_LIST KF7-500.26[17] /end FUNCTION_LIST /end CHARACTERISTIC
/begin CHARACTERISTIC mMFNAED "Misfire warning number of times judgement value multiple cylinder misfire emission criteria" VALUE 0x00008849 REC_UBYTE_C 0 COMP_0016 0 255 /begin FUNCTION_LIST KF7-500.26[17] /end FUNCTION_LIST /end CHARACTERISTIC
/begin CHARACTERISTIC mMFNCTD "Misfire warning number of times judgement value catalyst criteria" VALUE 0x0000884A REC_UBYTE_C 0 COMP_0016 0 255 /begin FUNCTION_LIST KF7-500.26[17] /end FUNCTION_LIST /end CHARACTERISTIC
/begin CHARACTERISTIC mMFNEMD "Misfire warning number of times judgement value emission criteria" VALUE 0x0000884B REC_UBYTE_C 0 COMP_0016 0 255 /begin FUNCTION_LIST KF7-500.26[17] /end FUNCTION_LIST /end CHARACTERISTIC
/begin CHARACTERISTIC mMFNFTP "Misfire diagnosis FTP region upper limit rotation" VALUE 0x0000884C REC_UBYTE_C 0 COMP_0000 0 6375 /begin FUNCTION_LIST KF7-500.26[17] /end FUNCTION_LIST /end CHARACTERISTIC
/begin CHARACTERISTIC mMFNID "IDLE region TP lower limit" VALUE 0x0000884D REC_UBYTE_C 0 COMP_0020 0 12750 /begin FUNCTION_LIST KF7-500.26[17] /end FUNCTION_LIST /end CHARACTERISTIC
/begin CHARACTERISTIC mMFPID "IDLE region TP upper limit" VALUE 0x0000884E REC_UBYTE_C 0 COMP_0001 0 31.875 /begin FUNCTION_LIST KF7-500.26[17] /end FUNCTION_LIST /end CHARACTERISTIC
/begin CHARACTERISTIC mMFSPC "A reference by the catalyst criteria cylinder" VALUE 0x00008850 REC_UBYTE_C 0 COMP_0016 0 255 /begin FUNCTION_LIST KF7-500.26[17] /end FUNCTION_LIST /end CHARACTERISTIC
/begin CHARACTERISTIC mMFSPE "A reference by the emission criteria cylinder" VALUE 0x00008851 REC_UBYTE_C 0 COMP_0016 0 255 /begin FUNCTION_LIST KF7-500.26[17] /end FUNCTION_LIST /end CHARACTERISTIC
/begin CHARACTERISTIC mMFTFTP "Misfire diagnosis FTP region upper limit TP" VALUE 0x00008852 REC_UBYTE_C 0 COMP_0001 0 31.875 /begin FUNCTION_LIST KF7-500.26[17] /end FUNCTION_LIST /end CHARACTERISTIC
/begin CHARACTERISTIC mMFZURE "TINT measuring section limit movement number of times" VALUE 0x00008853 REC_UBYTE_C 0 COMP_0030 0 255 /begin FUNCTION_LIST KF7-500.26[17] /end FUNCTION_LIST /end CHARACTERISTIC
/begin CHARACTERISTIC mMSU "Misfire parameter unit coefficient" VALUE 0x00008872 REC_UBYTE_C 0 COMP_0004 0 255 /begin FUNCTION_LIST KF7-500.26[17] /end FUNCTION_LIST /end CHARACTERISTIC
/begin CHARACTERISTIC mNEUTVB "NEUT SW condition memory permission battery voltage" VALUE 0x000088AF REC_UBYTE_C 0 COMP_0033 0 20400 /begin FUNCTION_LIST KF7-500.28[4] KF7-505.23[2] /end FUNCTION_LIST /end CHARACTERISTIC
/begin CHARACTERISTIC mNLKCTN "N/L high rotation judgement engine speed" VALUE 0x000088C0 REC_UBYTE_C 0 COMP_0000 0 6375 /begin FUNCTION_LIST KF7-500.21[19] /end FUNCTION_LIST /end CHARACTERISTIC
/begin CHARACTERISTIC mNMFR1 "Misfire diagnosis permission condition Nprm lower limit" VALUE 0x000088C5 REC_UBYTE_C 0 COMP_0020 0 12750 /begin FUNCTION_LIST KF7-500.26[17] /end FUNCTION_LIST /end CHARACTERISTIC
/begin CHARACTERISTIC mNMFR2 "Misfire diagnosis permission condition Nprm upper limit" VALUE 0x000088C6 REC_UBYTE_C 0 COMP_0020 0 12750 /begin FUNCTION_LIST KF7-500.26[17] /end FUNCTION_LIST /end CHARACTERISTIC
/begin CHARACTERISTIC mNMHTNT "TINT compensation operation condition engine rotation condition upper limit" VALUE 0x000088C7 REC_UBYTE_C 0 COMP_0020 0 12750 /begin FUNCTION_LIST KF7-500.26[17] /end FUNCTION_LIST /end CHARACTERISTIC
/begin CHARACTERISTIC mNNSH "Speed condition upper limit" VALUE 0x000088C9 REC_UBYTE_C 0 COMP_0000 0 6375 /begin FUNCTION_LIST KF7-500.28[4] KF7-505.23[2] /end FUNCTION_LIST /end CHARACTERISTIC
/begin CHARACTERISTIC mNNSL "Speed condition lower limit" VALUE 0x000088CA REC_UBYTE_C 0 COMP_0000 0 6375 /begin FUNCTION_LIST KF7-500.28[4] KF7-505.23[2] /end FUNCTION_LIST /end CHARACTERISTIC
/begin CHARACTERISTIC mNRCTH "Diagnosis permission speed upper limit value" VALUE 0x000088DE REC_UBYTE_C 0 COMP_0000 0 6375 /begin FUNCTION_LIST KF7-500.21[19] /end FUNCTION_LIST /end CHARACTERISTIC
/begin CHARACTERISTIC mNRCTL "Diagnosis permission speed lower limit value" VALUE 0x000088DF REC_UBYTE_C 0 COMP_0000 0 6375 /begin FUNCTION_LIST KF7-500.21[19] /end FUNCTION_LIST /end CHARACTERISTIC
/begin CHARACTERISTIC mO2HROD "After unusual voltage judgement permission heater on, delay" VALUE 0x00008914 REC_UBYTE_C 0 COMP_0049 0 255 /begin FUNCTION_LIST KF7-500.24[10] /end FUNCTION_LIST /end CHARACTERISTIC
/begin CHARACTERISTIC mOSCLIM "O2 storage ability lower limit value" VALUE 0x00008957 REC_UBYTE_C 0 COMP_0068 0 255 /begin FUNCTION_LIST KF7-500.21[19] /end FUNCTION_LIST /end CHARACTERISTIC
/begin CHARACTERISTIC mOSCNOM1 "AVOSQ1 normalize coefficient (bank 1)" VALUE 0x0000895D REC_UBYTE_C 0 COMP_0045 0 1.9921875 /begin FUNCTION_LIST KF7-500.21[19] /end FUNCTION_LIST /end CHARACTERISTIC
/begin CHARACTERISTIC mOSCNOM2 "AVOSQ1 normalize coefficient (bank 2)" VALUE 0x0000895E REC_UBYTE_C 0 COMP_0045 0 1.9921875 /begin FUNCTION_LIST KF7-500.21[19] /end FUNCTION_LIST /end CHARACTERISTIC
/begin CHARACTERISTIC mOSCTIM "Catalyst diagnosis operation period" VALUE 0x00008960 REC_UBYTE_C 0 COMP_0014 0 2550 /begin FUNCTION_LIST KF7-500.21[19] /end FUNCTION_LIST /end CHARACTERISTIC
/begin CHARACTERISTIC mPCRSTC "Line pressure sensor characteristic coefficient" VALUE 0x00008982 REC_UBYTE_C 0 COMP_0435_S 0 7.96875 /begin FUNCTION_LIST KF7-500.30[8] /end FUNCTION_LIST /end CHARACTERISTIC
/begin CHARACTERISTIC mPRCLCT "The number of MVRO2 anti-turns for the catalyst diagnosis parameter operation" VALUE 0x000089B8 REC_UBYTE_C 0 COMP_0016 0 255 /begin FUNCTION_LIST KF7-500.21[19] /end FUNCTION_LIST /end CHARACTERISTIC
/begin CHARACTERISTIC mQACTH "Catalyst diagnosis permission inhalation air quantity upper limit value" VALUE 0x00009454 REC_UWORD_C 0 COMP_0004 0 65535 /begin FUNCTION_LIST KF7-500.21[19] /end FUNCTION_LIST /end CHARACTERISTIC
/begin CHARACTERISTIC mQIU "SUMQI computed coefficient" VALUE 0x00008A07 REC_UBYTE_C 0 COMP_0004 0 255 /begin FUNCTION_LIST KF7-500.21[19] /end FUNCTION_LIST /end CHARACTERISTIC
/begin CHARACTERISTIC mRDUTYMN "The rest O2 sensor heater duty lower limit value" VALUE 0x00008A2F REC_UBYTE_C 0 COMP_0132_S 0 2550 /begin FUNCTION_LIST KF7-500.25A[7] /end FUNCTION_LIST /end CHARACTERISTIC
/begin CHARACTERISTIC mRFBALH "Region condition permission maximum MALPHA" VALUE 0x00008A50 REC_UBYTE_C 0 COMP_0027 0 255 /begin FUNCTION_LIST KF7-500.24[10] /end FUNCTION_LIST /end CHARACTERISTIC
/begin CHARACTERISTIC mRFBALL "Region condition permission, at least, MALPHA" VALUE 0x00008A51 REC_UBYTE_C 0 COMP_0027 0 255 /begin FUNCTION_LIST KF7-500.24[10] /end FUNCTION_LIST /end CHARACTERISTIC
/begin CHARACTERISTIC mRFBALT "Region condition permission lambda control continuation time" VALUE 0x00008A52 REC_UBYTE_C 0 COMP_0049 0 255 /begin FUNCTION_LIST KF7-500.24[10] /end FUNCTION_LIST /end CHARACTERISTIC
/begin CHARACTERISTIC mRFBDMN "Region condition permission É¢MNRPM" VALUE 0x00008A54 REC_UBYTE_C 0 COMP_0000 0 6375 /begin FUNCTION_LIST KF7-500.24[10] /end FUNCTION_LIST /end CHARACTERISTIC
/begin CHARACTERISTIC mRFBDTP "Region condition permission delta-TP" VALUE 0x00008A55 REC_UBYTE_C 0 COMP_0001 0 31.875 /begin FUNCTION_LIST KF7-500.24[10] /end FUNCTION_LIST /end CHARACTERISTIC
/begin CHARACTERISTIC mRFBDTV "Region condition permission delta-TVO" VALUE 0x00008A56 REC_UBYTE_C 0 COMP_0002 0 89.25 /begin FUNCTION_LIST KF7-500.24[10] /end FUNCTION_LIST /end CHARACTERISTIC
/begin CHARACTERISTIC mRFBFCT "During the region condition permission fuel cut, continuation time" VALUE 0x00008A57 REC_UBYTE_C 0 COMP_0049 0 255 /begin FUNCTION_LIST KF7-500.24[10] /end FUNCTION_LIST /end CHARACTERISTIC
/begin CHARACTERISTIC mRFBIDT "Region condition permission idle sw off continuation time" VALUE 0x00008A59 REC_UBYTE_C 0 COMP_0049 0 255 /begin FUNCTION_LIST KF7-500.24[10] /end FUNCTION_LIST /end CHARACTERISTIC
/begin CHARACTERISTIC mRFBKBH "Region condition permission maximum KBLRC" VALUE 0x00008A5B REC_UBYTE_C 0 COMP_0027 0 255 /begin FUNCTION_LIST KF7-500.24[10] /end FUNCTION_LIST /end CHARACTERISTIC
/begin CHARACTERISTIC mRFBKBL "Region condition permission, at least, KBLRC" VALUE 0x00008A5C REC_UBYTE_C 0 COMP_0027 0 255 /begin FUNCTION_LIST KF7-500.24[10] /end FUNCTION_LIST /end CHARACTERISTIC
/begin CHARACTERISTIC mRFBKMT "Region condition permission TFBYA0==1.0 continuation time" VALUE 0x00008A5D REC_UBYTE_C 0 COMP_0049 0 255 /begin FUNCTION_LIST KF7-500.24[10] /end FUNCTION_LIST /end CHARACTERISTIC
/begin CHARACTERISTIC mRFBMNH "Region condition permission maximum MNRPM" VALUE 0x00008A60 REC_UBYTE_C 0 COMP_0000 0 6375 /begin FUNCTION_LIST KF7-500.24[10] /end FUNCTION_LIST /end CHARACTERISTIC
/begin CHARACTERISTIC mRFBMNL "Region condition permission, at least, MNRPM" VALUE 0x00008A61 REC_UBYTE_C 0 COMP_0000 0 6375 /begin FUNCTION_LIST KF7-500.24[10] /end FUNCTION_LIST /end CHARACTERISTIC
/begin CHARACTERISTIC mRFBTPH "Region condition permission maximum TP" VALUE 0x00008A64 REC_UBYTE_C 0 COMP_0001 0 31.875 /begin FUNCTION_LIST KF7-500.24[10] KF7-580.1[8] /end FUNCTION_LIST /end CHARACTERISTIC
/begin CHARACTERISTIC mRFBTPL "Region condition permission, at least, TP" VALUE 0x00008A65 REC_UBYTE_C 0 COMP_0001 0 31.875 /begin FUNCTION_LIST KF7-500.24[10] KF7-580.1[8] /end FUNCTION_LIST /end CHARACTERISTIC
/begin CHARACTERISTIC mRFBVSL "Region condition permission, at least, VSP" VALUE 0x00008A66 REC_UBYTE_C 0 COMP_0007 0 510 /begin FUNCTION_LIST KF7-500.24[10] KF7-580.1[8] /end FUNCTION_LIST /end CHARACTERISTIC
/begin CHARACTERISTIC mRFOEVP "Canister purge cut delay" VALUE 0x00008A70 REC_UBYTE_C 0 COMP_0013 0 255 /begin FUNCTION_LIST KF7-500.24[10] /end FUNCTION_LIST /end CHARACTERISTIC
/begin CHARACTERISTIC mRO2REV1 "Imaginary stage 2RrO2 reversal equivalent WKSTRGV" VALUE 0x00008AB3 REC_UBYTE_C 0 COMP_0085_S 0 255 /begin FUNCTION_LIST KF7-500.21[19] /end FUNCTION_LIST /end CHARACTERISTIC
/begin CHARACTERISTIC mRO2REV2 "Imaginary stage 2RrO2 reversal equivalent WKSTRGV" VALUE 0x00008AB4 REC_UBYTE_C 0 COMP_0085_S 0 255 /begin FUNCTION_LIST KF7-500.21[19] /end FUNCTION_LIST /end CHARACTERISTIC
/begin CHARACTERISTIC mRO2V5S "Rear unusual voltage 2 judgement voltage" VALUE 0x00008AB8 REC_UBYTE_C 0 COMP_0104 0 2550 /begin FUNCTION_LIST KF7-500.24[10] /end FUNCTION_LIST /end CHARACTERISTIC
/begin CHARACTERISTIC mROHCMN "The rest O2/H breakage judgement voltage" VALUE 0x00008AB9 REC_UBYTE_C 0 COMP_0054 0 5100 /begin FUNCTION_LIST KF7-500.25A[7] /end FUNCTION_LIST /end CHARACTERISTIC
/begin CHARACTERISTIC mROHCMX "The rest O2/H short judgement voltage" VALUE 0x00008ABA REC_UBYTE_C 0 COMP_0054 0 5100 /begin FUNCTION_LIST KF7-500.25A[7] /end FUNCTION_LIST /end CHARACTERISTIC
/begin CHARACTERISTIC mROHONT "The rest O2/H on time delay" VALUE 0x00008ABB REC_UBYTE_C 0 COMP_0049 0 255 /begin FUNCTION_LIST KF7-500.21[19] /end FUNCTION_LIST /end CHARACTERISTIC
/begin CHARACTERISTIC mROHTM "The rest O2/H diagnosis judgement delay time" VALUE 0x00008ABC REC_UBYTE_C 0 COMP_0049 0 255 /begin FUNCTION_LIST KF7-500.25A[7] /end FUNCTION_LIST /end CHARACTERISTIC
/begin CHARACTERISTIC mROHVBL "The rest O2/H diagnosis condition battery voltage lower limit value" VALUE 0x00008ABE REC_UBYTE_C 0 COMP_0033 0 20400 /begin FUNCTION_LIST KF7-500.25A[7] /end FUNCTION_LIST /end CHARACTERISTIC
/begin CHARACTERISTIC mROIZS2 "Stage 2 judgement storage" VALUE 0x00009774 REC_ULONG_C 0 COMP_0092 0 4294967295 /begin FUNCTION_LIST KF7-500.24[10] /end FUNCTION_LIST /end CHARACTERISTIC
/begin CHARACTERISTIC mROJDLY "After diagnosis permission judgement heater on, delay time" VALUE 0x00008ABF REC_UBYTE_C 0 COMP_0049 0 255 /begin FUNCTION_LIST KF7-500.24[10] KF7-580.1[8] /end FUNCTION_LIST /end CHARACTERISTIC
/begin CHARACTERISTIC mROJFCC "Diagnosis permission judgement fuel cut experience number of times" VALUE 0x00008AC0 REC_UBYTE_C 0 COMP_0030 0 255 /begin FUNCTION_LIST KF7-500.24[10] KF7-580.1[8] /end FUNCTION_LIST /end CHARACTERISTIC
/begin CHARACTERISTIC mROJFCD "After the diagnosis permission judgement fuel cut, progress time" VALUE 0x00008AC1 REC_UBYTE_C 0 COMP_0049 0 255 /begin FUNCTION_LIST KF7-500.24[10] /end FUNCTION_LIST /end CHARACTERISTIC
/begin CHARACTERISTIC mROJFCT "Diagnosis permission judgement fuel cut continuation time" VALUE 0x00008AC3 REC_UBYTE_C 0 COMP_0008 0 25500 /begin FUNCTION_LIST KF7-500.24[10] KF7-580.1[8] /end FUNCTION_LIST /end CHARACTERISTIC
/begin CHARACTERISTIC mROOUS2 "The number of stage 2 judgement RrO2/S anti-turns" VALUE 0x00008AC4 REC_UBYTE_C 0 COMP_0016 0 255 /begin FUNCTION_LIST KF7-500.24[10] /end FUNCTION_LIST /end CHARACTERISTIC
/begin CHARACTERISTIC mROXJSD "After a diagnosis monitor start starts, delay" VALUE 0x00008AC5 REC_UBYTE_C 0 COMP_0049 0 255 /begin FUNCTION_LIST KF7-500.24[10] /end FUNCTION_LIST /end CHARACTERISTIC
/begin CHARACTERISTIC mROXJT1 "Diagnosis judgement timing" VALUE 0x000094E0 REC_UWORD_C 0 COMP_0049 0 65535 /begin FUNCTION_LIST KF7-500.24[10] /end FUNCTION_LIST /end CHARACTERISTIC
/begin CHARACTERISTIC mROXLNG "The judgement voltage that LEAN output is unusual" VALUE 0x00008AC7 REC_UBYTE_C 0 COMP_0104 0 2550 /begin FUNCTION_LIST KF7-500.24[10] R901.1.Diag_on_can_app_1_6_2 /end FUNCTION_LIST /end CHARACTERISTIC
/begin CHARACTERISTIC mROXRNG "The judgement voltage that RICH output is unusual" VALUE 0x00008AC8 REC_UBYTE_C 0 COMP_0104 0 2550 /begin FUNCTION_LIST KF7-500.24[10] R901.1.Diag_on_can_app_1_6_2 /end FUNCTION_LIST /end CHARACTERISTIC
/begin CHARACTERISTIC mRTMLNG "A judgement cylinder concentration rate with the misfire" VALUE 0x00008ADA REC_UBYTE_C 0 COMP_0021 0 99.609375 /begin FUNCTION_LIST KF7-500.26[17] /end FUNCTION_LIST /end CHARACTERISTIC
/begin CHARACTERISTIC mRTMLOK "A judgement cylinder concentration rate without a misfire" VALUE 0x00008ADB REC_UBYTE_C 0 COMP_0021 0 99.609375 /begin FUNCTION_LIST KF7-500.26[17] /end FUNCTION_LIST /end CHARACTERISTIC
/begin CHARACTERISTIC mRTNTMN "A TINT compensation coefficient learning value lower limit by the cylinder" VALUE 0x000094E8 REC_UWORD_C 0 COMP_0069 0 1.999970916 /begin FUNCTION_LIST KF7-500.26[17] /end FUNCTION_LIST /end CHARACTERISTIC
/begin CHARACTERISTIC mRTNTMX "A TINT compensation coefficient learning value upper limit by the cylinder" VALUE 0x000094EA REC_UWORD_C 0 COMP_0069 0 1.999970916 /begin FUNCTION_LIST KF7-500.26[17] /end FUNCTION_LIST /end CHARACTERISTIC
/begin CHARACTERISTIC mSQASL0 "SQASL initial value" VALUE 0x00008B22 REC_UBYTE_C 0 COMP_0291 0 2611.2 /begin FUNCTION_LIST KF7-500.21[19] /end FUNCTION_LIST /end CHARACTERISTIC
/begin CHARACTERISTIC mSRNOM1 "STRAG normalize coefficient" VALUE 0x00008B24 REC_UBYTE_C 0 COMP_0044 0 1.9921875 /begin FUNCTION_LIST KF7-500.21[19] /end FUNCTION_LIST /end CHARACTERISTIC
/begin CHARACTERISTIC mSRNOM2 "STRAG normalize coefficient" VALUE 0x00008B25 REC_UBYTE_C 0 COMP_0044 0 1.9921875 /begin FUNCTION_LIST KF7-500.21[19] /end FUNCTION_LIST /end CHARACTERISTIC
/begin CHARACTERISTIC mST2JDG "Judgement suspension number of times upper limit" VALUE 0x00008B29 REC_UBYTE_C 0 COMP_0016 0 255 /begin FUNCTION_LIST KF7-500.21[19] /end FUNCTION_LIST /end CHARACTERISTIC
/begin CHARACTERISTIC mST2JDGOK "Judgement suspension number of times lower limit" VALUE 0x00008B2A REC_UBYTE_C 0 COMP_0016 0 255 /begin FUNCTION_LIST KF7-500.21[19] /end FUNCTION_LIST /end CHARACTERISTIC
/begin CHARACTERISTIC mSTUG2 "SUMOXY normalize coefficient" VALUE 0x00008B4B REC_UBYTE_C 0 COMP_0092 0 255 /begin FUNCTION_LIST KF7-500.21[19] /end FUNCTION_LIST /end CHARACTERISTIC
/begin CHARACTERISTIC mSUMOSCDL "O2 storage ability integration delay" VALUE 0x00008B4C REC_UBYTE_C 0 COMP_0008 0 25500 /begin FUNCTION_LIST KF7-500.21[19] /end FUNCTION_LIST /end CHARACTERISTIC
/begin CHARACTERISTIC mSUOSLIM "O2 storage ability integration counter lower limit value" VALUE 0x0000956C REC_UWORD_C 0 COMP_0068 0 65535 /begin FUNCTION_LIST KF7-500.21[19] /end FUNCTION_LIST /end CHARACTERISTIC
/begin CHARACTERISTIC mTAIKNG "An advantage judgement cylinder concentration rate with the confrontation misfire" VALUE 0x00008B6C REC_UBYTE_C 0 COMP_0021 0 99.609375 /begin FUNCTION_LIST KF7-500.26[17] /end FUNCTION_LIST /end CHARACTERISTIC
/begin CHARACTERISTIC mTAIKOK "Confrontation misfire judgement-less cylinder concentration rate" VALUE 0x00008B6D REC_UBYTE_C 0 COMP_0021 0 99.609375 /begin FUNCTION_LIST KF7-500.26[17] /end FUNCTION_LIST /end CHARACTERISTIC
/begin CHARACTERISTIC mTAMFMN "Misfire count rise permission, at least, a degree of an intake air temperature" VALUE 0x00008B72 REC_UBYTE_C 0 COMP_0035 -50 205 /begin FUNCTION_LIST KF7-500.26[17] /end FUNCTION_LIST /end CHARACTERISTIC
/begin CHARACTERISTIC mTCATK1 "IGN SW At the time of off, catalyst estimated temperature lower limit" VALUE 0x00008B91 REC_UBYTE_C 0 COMP_0062 0 1020 /begin FUNCTION_LIST KF7-500.21[19] /end FUNCTION_LIST /end CHARACTERISTIC
/begin CHARACTERISTIC mTHRO2 "Unusual voltage judgement time" VALUE 0x00008BE9 REC_UBYTE_C 0 COMP_0049 0 255 /begin FUNCTION_LIST KF7-500.24[10] /end FUNCTION_LIST /end CHARACTERISTIC
/begin CHARACTERISTIC mTIMISC "ISC diagnosis permission delay" VALUE 0x00008BEE REC_UBYTE_C 0 COMP_0013 0 255 /begin FUNCTION_LIST KF7-500.38A[4] /end FUNCTION_LIST /end CHARACTERISTIC
/begin CHARACTERISTIC mTMDOS "Diagnosis permission DOS formation time condition" VALUE 0x00008C31 REC_UBYTE_C 0 COMP_0049 0 255 /begin FUNCTION_LIST KF7-500.24[10] KF7-580.1[8] /end FUNCTION_LIST /end CHARACTERISTIC
/begin CHARACTERISTIC mTMFD2 "Misfire judgement cancellation delay" VALUE 0x00008C46 REC_UBYTE_C 0 COMP_0014 0 2550 /begin FUNCTION_LIST KF7-500.26[17] /end FUNCTION_LIST /end CHARACTERISTIC
/begin CHARACTERISTIC mTMFD3 "Misfire judgement cancellation delay (3/8)" VALUE 0x00008C47 REC_UBYTE_C 0 COMP_0014 0 2550 /begin FUNCTION_LIST KF7-500.26[17] /end FUNCTION_LIST /end CHARACTERISTIC
/begin CHARACTERISTIC mTMGNSK "KTINT compensation operation condition" VALUE 0x00008C4F REC_UBYTE_C 0 COMP_0014 0 2550 /begin FUNCTION_LIST KF7-500.26[17] /end FUNCTION_LIST /end CHARACTERISTIC
/begin CHARACTERISTIC mTMMFD "Misfire diagnosis permission delay" VALUE 0x00008C5D REC_UBYTE_C 0 COMP_0008 0 25500 /begin FUNCTION_LIST KF7-500.26[17] /end FUNCTION_LIST /end CHARACTERISTIC
/begin CHARACTERISTIC mTMNSD "Diagnosis delay" VALUE 0x00008C63 REC_UBYTE_C 0 COMP_0049 0 255 /begin FUNCTION_LIST KF7-500.28[4] KF7-505.23[2] /end FUNCTION_LIST /end CHARACTERISTIC
/begin CHARACTERISTIC mTMRO2H "After rest O2/H diagnosis ON/ off, delay time" VALUE 0x00008C81 REC_UBYTE_C 0 COMP_0049 0 255 /begin FUNCTION_LIST KF7-500.25A[7] /end FUNCTION_LIST /end CHARACTERISTIC
/begin CHARACTERISTIC mTPCST "Misfire cancellation coast going down judgement TP" VALUE 0x00008CC8 REC_UBYTE_C 0 COMP_0001 0 31.875 /begin FUNCTION_LIST KF7-500.26[17] /end FUNCTION_LIST /end CHARACTERISTIC
/begin CHARACTERISTIC mTPCTH "Diagnosis permission TP upper limit value" VALUE 0x00008CC9 REC_UBYTE_C 0 COMP_0001 0 31.875 /begin FUNCTION_LIST KF7-500.21[19] /end FUNCTION_LIST /end CHARACTERISTIC
/begin CHARACTERISTIC mTPCTL "Diagnosis permission TP lower limit value" VALUE 0x00008CCA REC_UBYTE_C 0 COMP_0001 0 31.875 /begin FUNCTION_LIST KF7-500.21[19] /end FUNCTION_LIST /end CHARACTERISTIC
/begin CHARACTERISTIC mTPMFR2 "Misfire judgement cancellation TP condition 2" VALUE 0x00008CD5 REC_UBYTE_C 0 COMP_0001 0 31.875 /begin FUNCTION_LIST KF7-500.26[17] /end FUNCTION_LIST /end CHARACTERISTIC
/begin CHARACTERISTIC mTPNSH "TP condition upper limit" VALUE 0x00008CD6 REC_UBYTE_C 0 COMP_0001 0 31.875 /begin FUNCTION_LIST KF7-500.28[4] KF7-505.23[2] /end FUNCTION_LIST /end CHARACTERISTIC
/begin CHARACTERISTIC mTPNSL "TP condition lower limit" VALUE 0x00008CD7 REC_UBYTE_C 0 COMP_0001 0 31.875 /begin FUNCTION_LIST KF7-500.28[4] KF7-505.23[2] /end FUNCTION_LIST /end CHARACTERISTIC
/begin CHARACTERISTIC mTVOFT "An accelerator foot is put, judgement value" VALUE 0x00008D07 REC_UBYTE_C 0 COMP_0023 0 1275 /begin FUNCTION_LIST KF7-500.38A[4] /end FUNCTION_LIST /end CHARACTERISTIC
/begin CHARACTERISTIC mTVPRZ "Evaporation heat constant lower limit" VALUE 0x00008D09 REC_UBYTE_C 0 COMP_0062 0 1020 /begin FUNCTION_LIST KF7-500.21[19] /end FUNCTION_LIST /end CHARACTERISTIC
/begin CHARACTERISTIC mTWCJ2 "Permission condition coolant temperature condition upper limit value" VALUE 0x00008D1D REC_UBYTE_C 0 COMP_0035 -50 205 /begin FUNCTION_LIST KF7-500.21[19] Rxxx.2.Integration_Diagnostic_cycle_1_1_1 /end FUNCTION_LIST /end CHARACTERISTIC
/begin CHARACTERISTIC mTWCJ4 "Permission condition coolant temperature condition lower limit value" VALUE 0x00008D1E REC_UBYTE_C 0 COMP_0035 -50 205 /begin FUNCTION_LIST KF7-500.21[19] Rxxx.2.Integration_Diagnostic_cycle_1_1_1 /end FUNCTION_LIST /end CHARACTERISTIC
/begin CHARACTERISTIC mTWIROX "At the time of the diagnosis permission judgement start, coolant temperature condition lower limit" VALUE 0x00008D39 REC_UBYTE_C 0 COMP_0035 -50 205 /begin FUNCTION_LIST KF7-500.24[10] /end FUNCTION_LIST /end CHARACTERISTIC
/begin CHARACTERISTIC mTWMF2 "Misfire count rise permission coolant temperature upper limit" VALUE 0x00008D48 REC_UBYTE_C 0 COMP_0035 -50 205 /begin FUNCTION_LIST KF7-500.26[17] /end FUNCTION_LIST /end CHARACTERISTIC
/begin CHARACTERISTIC mTWMFDT "A coolant temperature condition for the misfire cancellation delta-TVO setup" VALUE 0x00008D49 REC_UBYTE_C 0 COMP_0035 -50 205 /begin FUNCTION_LIST KF7-500.26[17] /end FUNCTION_LIST /end CHARACTERISTIC
/begin CHARACTERISTIC mTWMFMN "Misfire count rise permission, at least, at the time of the start, coolant temperature" VALUE 0x00008D4A REC_UBYTE_C 0 COMP_0035 -50 205 /begin FUNCTION_LIST KF7-500.26[17] /end FUNCTION_LIST /end CHARACTERISTIC
/begin CHARACTERISTIC mTWNDKO "IGN SW ON-off coolant temperature difference upper limit" VALUE 0x00008D4C REC_UBYTE_C 0 COMP_0003 0 255 /begin FUNCTION_LIST KF7-500.21[19] /end FUNCTION_LIST /end CHARACTERISTIC
/begin CHARACTERISTIC mTWNK1 "IGN SW At the time of off, coolant temperature lower limit" VALUE 0x00008D52 REC_UBYTE_C 0 COMP_0035 -50 205 /begin FUNCTION_LIST KF7-500.21[19] /end FUNCTION_LIST /end CHARACTERISTIC
/begin CHARACTERISTIC mTWNSL "Coolant temperature condition lower limit" VALUE 0x00008D58 REC_UBYTE_C 0 COMP_0035 -50 205 /begin FUNCTION_LIST KF7-500.28[4] KF7-505.23[2] /end FUNCTION_LIST /end CHARACTERISTIC
/begin CHARACTERISTIC mTWRO2H "Diagnosis permission judgement coolant temperature upper limit" VALUE 0x00008D65 REC_UBYTE_C 0 COMP_0035 -50 205 /begin FUNCTION_LIST KF7-500.24[10] /end FUNCTION_LIST /end CHARACTERISTIC
/begin CHARACTERISTIC mTWRO2L "Diagnosis permission judgement coolant temperature lower limit" VALUE 0x00008D66 REC_UBYTE_C 0 COMP_0035 -50 205 /begin FUNCTION_LIST KF7-500.24[10] /end FUNCTION_LIST /end CHARACTERISTIC
/begin CHARACTERISTIC mVSCTL "Diagnosis permission vehicle speed condition lower limit value" VALUE 0x00008DF9 REC_UBYTE_C 0 COMP_0007 0 510 /begin FUNCTION_LIST KF7-500.21[19] /end FUNCTION_LIST /end CHARACTERISTIC
/begin CHARACTERISTIC mVSNSL "Vehicle speed condition lower limit" VALUE 0x00008E04 REC_UBYTE_C 0 COMP_0007 0 510 /begin FUNCTION_LIST KF7-500.28[4] KF7-505.23[2] /end FUNCTION_LIST /end CHARACTERISTIC
/begin CHARACTERISTIC mVSPCST "Misfire cancellation coast going down judgement VSP" VALUE 0x00008E09 REC_UBYTE_C 0 COMP_0007 0 510 /begin FUNCTION_LIST KF7-500.26[17] /end FUNCTION_LIST /end CHARACTERISTIC
/begin CHARACTERISTIC mTMSATA "MSATHA map" MAP 0x0000AD7E REC_UBYTE_C 0 COMP_0482_S 0 255
 /begin AXIS_DESCR COM_AXIS NO_INPUT_QUANTITY COMP_0020 16 0 12750 AXIS_PTS_REF mLNMIS /end AXIS_DESCR
 /begin AXIS_DESCR COM_AXIS NO_INPUT_QUANTITY COMP_0001 16 0 31.875 AXIS_PTS_REF mLPMIS /end AXIS_DESCR
 /begin FUNCTION_LIST KF7-500.26[17] /end FUNCTION_LIST
/end CHARACTERISTIC
/begin CHARACTERISTIC mTMSATB "MSATHA map" MAP 0x0000AE7E REC_UBYTE_C 0 COMP_0482_S 0 255
 /begin AXIS_DESCR COM_AXIS NO_INPUT_QUANTITY COMP_0020 16 0 12750 AXIS_PTS_REF mLNMIS /end AXIS_DESCR
 /begin AXIS_DESCR COM_AXIS NO_INPUT_QUANTITY COMP_0001 16 0 31.875 AXIS_PTS_REF mLPMIS /end AXIS_DESCR
 /begin FUNCTION_LIST KF7-500.26[17] /end FUNCTION_LIST
/end CHARACTERISTIC
/begin CHARACTERISTIC mTMSATH "MSATH map" MAP 0x0000AF7E REC_UBYTE_C 0 COMP_0482_S 0 255
 /begin AXIS_DESCR COM_AXIS NO_INPUT_QUANTITY COMP_0020 16 0 12750 AXIS_PTS_REF mLNMIS /end AXIS_DESCR
 /begin AXIS_DESCR COM_AXIS NO_INPUT_QUANTITY COMP_0001 16 0 31.875 AXIS_PTS_REF mLPMIS /end AXIS_DESCR
 /begin FUNCTION_LIST KF7-500.26[17] /end FUNCTION_LIST
/end CHARACTERISTIC
/begin CHARACTERISTIC mMTEX1 "In front of the activated judgement, catalyst temperature map" MAP 0x0000A65E REC_UBYTE_C 0 COMP_0062 0 1020
 /begin AXIS_DESCR COM_AXIS NO_INPUT_QUANTITY COMP_0020 8 0 12750 AXIS_PTS_REF mTTEXN /end AXIS_DESCR
 /begin AXIS_DESCR COM_AXIS NO_INPUT_QUANTITY COMP_0001 8 0 31.875 AXIS_PTS_REF mTTEXTP /end AXIS_DESCR
 /begin FUNCTION_LIST KF7-500.21[19] /end FUNCTION_LIST
/end CHARACTERISTIC
/begin CHARACTERISTIC mMTEX2 "After the activated judgement, catalyst temperature map" MAP 0x0000A69E REC_UBYTE_C 0 COMP_0062 0 1020
 /begin AXIS_DESCR COM_AXIS NO_INPUT_QUANTITY COMP_0020 8 0 12750 AXIS_PTS_REF mTTEXN /end AXIS_DESCR
 /begin AXIS_DESCR COM_AXIS NO_INPUT_QUANTITY COMP_0001 8 0 31.875 AXIS_PTS_REF mTTEXTP /end AXIS_DESCR
 /begin FUNCTION_LIST KF7-500.21[19] /end FUNCTION_LIST
/end CHARACTERISTIC
/begin CHARACTERISTIC mTMFPA1 "MFTPA1 reference table" CURVE 0x0000D50A REC_UBYTE_C 0 COMP_0001 0 31.875
 /begin AXIS_DESCR FIX_AXIS NO_INPUT_QUANTITY COMP_0273_S 16 400 6400 FIX_AXIS_PAR_DIST 0 1 16 /end AXIS_DESCR
 /begin FUNCTION_LIST KF7-500.26[17] /end FUNCTION_LIST
/end CHARACTERISTIC
/begin CHARACTERISTIC mTMFPA3 "MFTPA3 reference table" CURVE 0x0000D51A REC_UBYTE_C 0 COMP_0001 0 31.875
 /begin AXIS_DESCR FIX_AXIS NO_INPUT_QUANTITY COMP_0273_S 16 400 6400 FIX_AXIS_PAR_DIST 0 1 16 /end AXIS_DESCR
 /begin FUNCTION_LIST KF7-500.26[17] /end FUNCTION_LIST
/end CHARACTERISTIC
/begin CHARACTERISTIC mTMFPC1 "A table for the MFPCA1 reference" CURVE 0x0000D52A REC_UBYTE_C 0 COMP_0001 0 31.875
 /begin AXIS_DESCR FIX_AXIS NO_INPUT_QUANTITY COMP_0273_S 16 400 6400 FIX_AXIS_PAR_DIST 0 1 16 /end AXIS_DESCR
 /begin FUNCTION_LIST KF7-500.26[17] /end FUNCTION_LIST
/end CHARACTERISTIC
/begin CHARACTERISTIC mTMFPC2 "A table for the MFPCA2 reference" CURVE 0x0000D53A REC_UBYTE_C 0 COMP_0001 0 31.875
 /begin AXIS_DESCR FIX_AXIS NO_INPUT_QUANTITY COMP_0273_S 16 400 6400 FIX_AXIS_PAR_DIST 0 1 16 /end AXIS_DESCR
 /begin FUNCTION_LIST KF7-500.26[17] /end FUNCTION_LIST
/end CHARACTERISTIC
/begin CHARACTERISTIC mTMFPC3 "A table for the MFPCA3 reference" CURVE 0x0000D54A REC_UBYTE_C 0 COMP_0001 0 31.875
 /begin AXIS_DESCR FIX_AXIS NO_INPUT_QUANTITY COMP_0273_S 16 400 6400 FIX_AXIS_PAR_DIST 0 1 16 /end AXIS_DESCR
 /begin FUNCTION_LIST KF7-500.26[17] /end FUNCTION_LIST
/end CHARACTERISTIC
/begin CHARACTERISTIC mTMFPC4 "A table for the MFPCA4 reference" CURVE 0x0000D55A REC_UBYTE_C 0 COMP_0001 0 31.875
 /begin AXIS_DESCR FIX_AXIS NO_INPUT_QUANTITY COMP_0273_S 16 400 6400 FIX_AXIS_PAR_DIST 0 1 16 /end AXIS_DESCR
 /begin FUNCTION_LIST KF7-500.26[17] /end FUNCTION_LIST
/end CHARACTERISTIC
/begin CHARACTERISTIC mTTPMF1 "A table for the TPMFR reference" CURVE 0x0000DB16 REC_UBYTE_C 0 COMP_0001 0 31.875
 /begin AXIS_DESCR FIX_AXIS NO_INPUT_QUANTITY COMP_0273_S 16 400 6400 FIX_AXIS_PAR_DIST 0 1 16 /end AXIS_DESCR
 /begin FUNCTION_LIST KF7-500.26[17] /end FUNCTION_LIST
/end CHARACTERISTIC
/begin CHARACTERISTIC mTCREM "A table for the CRTEM reference" CURVE 0x0000E80A REC_UWORD_C 0 COMP_0016 0 65535
 /begin AXIS_DESCR FIX_AXIS NO_INPUT_QUANTITY COMP_0505_S 4 -20 40 FIX_AXIS_PAR_DIST 0 1 4 /end AXIS_DESCR
 /begin FUNCTION_LIST KF7-500.26[17] /end FUNCTION_LIST
/end CHARACTERISTIC
/begin CHARACTERISTIC mTCRTIA "A table for the CRTIA reference" CURVE 0x0000E812 REC_UWORD_C 0 COMP_0016 0 65535
 /begin AXIS_DESCR FIX_AXIS NO_INPUT_QUANTITY COMP_0505_S 4 -20 40 FIX_AXIS_PAR_DIST 0 1 4 /end AXIS_DESCR
 /begin FUNCTION_LIST KF7-500.26[17] /end FUNCTION_LIST
/end CHARACTERISTIC
/begin CHARACTERISTIC mTCNGM "A table for the CNGMS reference" CURVE 0x0000CEFE REC_UBYTE_C 0 COMP_0514_S 0 255
 /begin AXIS_DESCR FIX_AXIS NO_INPUT_QUANTITY COMP_0271_S 8 0 2800 FIX_AXIS_PAR_DIST 0 1 8 /end AXIS_DESCR
 /begin FUNCTION_LIST KF7-500.21[19] /end FUNCTION_LIST
/end CHARACTERISTIC
/begin CHARACTERISTIC mTDLMFD "DLYMFD reference table" CURVE 0x0000CF96 REC_UBYTE_C 0 COMP_0049 0 255
 /begin AXIS_DESCR FIX_AXIS NO_INPUT_QUANTITY COMP_0278_S 8 -40 100 FIX_AXIS_PAR_DIST 0 1 8 /end AXIS_DESCR
 /begin FUNCTION_LIST KF7-500.26[17] /end FUNCTION_LIST
/end CHARACTERISTIC
/begin CHARACTERISTIC mTKCVSP "Vehicle speed compensation coefficient table" CURVE 0x0000D372 REC_UBYTE_C 0 COMP_0009 0 199.21875
 /begin AXIS_DESCR FIX_AXIS NO_INPUT_QUANTITY COMP_0329_S 8 0 112 FIX_AXIS_PAR_DIST 0 1 8 /end AXIS_DESCR
 /begin FUNCTION_LIST KF7-500.21[19] /end FUNCTION_LIST
/end CHARACTERISTIC
/begin CHARACTERISTIC mTKWCT1 "Filter time constant table" CURVE 0x0000EB02 REC_UWORD_C 0 COMP_0521_S 0 100.18925265
 /begin AXIS_DESCR COM_AXIS NO_INPUT_QUANTITY COMP_0004 8 0 65535 AXIS_PTS_REF mTTKWCT /end AXIS_DESCR
 /begin FUNCTION_LIST KF7-500.21[19] /end FUNCTION_LIST
/end CHARACTERISTIC
/begin CHARACTERISTIC mTSQASL "SQASL table" CURVE 0x0000D8D2 REC_UBYTE_C 0 COMP_0291 0 2611.2
 /begin AXIS_DESCR FIX_AXIS NO_INPUT_QUANTITY COMP_0278_S 8 -40 100 FIX_AXIS_PAR_DIST 0 1 8 /end AXIS_DESCR
 /begin FUNCTION_LIST KF7-500.21[19] /end FUNCTION_LIST
/end CHARACTERISTIC
/begin CHARACTERISTIC mTTWMF1 "TWFM1 reference table" CURVE 0x0000DC72 REC_UBYTE_C 0 COMP_0035 -50 205
 /begin AXIS_DESCR FIX_AXIS NO_INPUT_QUANTITY COMP_0280_S 8 -40 30 FIX_AXIS_PAR_DIST 0 1 8 /end AXIS_DESCR
 /begin FUNCTION_LIST KF7-500.26[17] /end FUNCTION_LIST
/end CHARACTERISTIC
/begin AXIS_PTS mLNMIS "50rpm" 0x0000CACF NO_INPUT_QUANTITY REC_AXIS_UBYTE 0 COMP_0020 16 0 12750 /end AXIS_PTS
/begin AXIS_PTS mLPMIS "38360ms" 0x0000CAEF NO_INPUT_QUANTITY REC_AXIS_UBYTE 0 COMP_0001 16 0 31.875 /end AXIS_PTS
/begin AXIS_PTS mTTEXN "50rpm" 0x0000DA4A NO_INPUT_QUANTITY REC_AXIS_UBYTE 0 COMP_0020 8 0 12750 /end AXIS_PTS
/begin AXIS_PTS mTTEXTP "38360ms" 0x0000DA52 NO_INPUT_QUANTITY REC_AXIS_UBYTE 0 COMP_0001 8 0 31.875 /end AXIS_PTS
/begin AXIS_PTS mTTKWCT "1Å|" 0x0000F39E NO_INPUT_QUANTITY REC_AXIS_UWORD 0 COMP_0004 8 0 65535 /end AXIS_PTS
/begin MEASUREMENT fCATEVP "0:ïsê¨óß  1:ê¨óß" UBYTE COMP_0283 1 100 0 1 BIT_MASK 0x0002 ECU_ADDRESS 0xFFFF294F /begin FUNCTION_LIST KF7-500.21[19] /end FUNCTION_LIST /end MEASUREMENT
/begin MEASUREMENT fFAFAVNG2 "0:ëOA./Fæ›ªíÜä‘ìdà åÃè·NG2âÒñ⁄îªíË  1:ëOA./Fæ›ªíÜä‘ìdà åÃè·NG2âÒñ⁄îªíË" UBYTE COMP_0283 1 100 0 1 BIT_MASK 0x0002 ECU_ADDRESS 0xFFFFA3A7 /begin FUNCTION_LIST KF7-500.24[10] KF7-500.74[11] /end FUNCTION_LIST /end MEASUREMENT
/begin MEASUREMENT fFAFHNG2 "0:À∞¿êfíf2ndƒÿØÃﬂNGñ¢åüèo  1:À∞¿êfíf2ndƒÿØÃﬂNGåüèo" UBYTE COMP_0283 1 100 0 1 BIT_MASK 0x0002 ECU_ADDRESS 0xFFFFA3AA /begin FUNCTION_LIST KF7-500.25A[7] KF7-500.59[6] /end FUNCTION_LIST /end MEASUREMENT
/begin MEASUREMENT fFAFHOK2 "0:À∞¿êfífOKñ¢åüèo  1:À∞¿êfífOKåüèo" UBYTE COMP_0283 1 100 0 1 BIT_MASK 0x0002 ECU_ADDRESS 0xFFFFA3AB /begin FUNCTION_LIST KF7-500.25A[7] KF7-500.59[6] /end FUNCTION_LIST /end MEASUREMENT
/begin MEASUREMENT fFAFHZNG2 "0:ëOA./Fæ›ªâûìöóÚâªêfífNG2âÒñ⁄îªíË  1:ëOA./Fæ›ªâûìöóÚâªêfífNG2âÒñ⁄îªíË" UBYTE COMP_0283 1 100 0 1 BIT_MASK 0x0002 ECU_ADDRESS 0xFFFFA3AD /begin FUNCTION_LIST KF7-500.24[10] KF7-500.74[11] KF7-500.74B[5] /end FUNCTION_LIST /end MEASUREMENT
/begin MEASUREMENT fFAFLNG2 "0:A./Fæ›ªºÃƒêfífÿ∞›ºÃƒNG2âÒñ⁄îªíË  1:A./Fæ›ªºÃƒêfífÿ∞›ºÃƒNG2âÒñ⁄îªíË" UBYTE COMP_0283 1 100 0 1 BIT_MASK 0x0002 ECU_ADDRESS 0xFFFFA3B0 /begin FUNCTION_LIST KF7-500.24[10] KF7-500.75[4] /end FUNCTION_LIST /end MEASUREMENT
/begin MEASUREMENT fFAFOK2 "0:A/Fæ›ªêfífñ¢èIóπ  1:A/Fæ›ªêfífèIóπ" UBYTE COMP_0283 1 100 0 1 BIT_MASK 0x0002 ECU_ADDRESS 0xFFFFA3B3 /begin FUNCTION_LIST KF7-500.24[10] KF7-500.76[8] /end FUNCTION_LIST /end MEASUREMENT
/begin MEASUREMENT fFAFONG2 "0:A/Fæ›ªífê¸êfífÇQÇìÇîƒÿØÃﬂNGåüèo  1:E/Fæ›ªífê¸êfífÇQÇìÇîƒÿØÃﬂNGåüèo" UBYTE COMP_0283 1 100 0 1 BIT_MASK 0x0002 ECU_ADDRESS 0xFFFFA3B5 /begin FUNCTION_LIST KF7-500.24[10] KF7-500.76[8] /end FUNCTION_LIST /end MEASUREMENT
/begin MEASUREMENT fFAFRNG2 "0:A./Fæ›ªºÃƒêfífÿØ¡ºÃƒNG2âÒñ⁄îªíË  1:A./Fæ›ªºÃƒêfífÿØ¡ºÃƒNG2âÒñ⁄îªíË" UBYTE COMP_0283 1 100 0 1 BIT_MASK 0x0002 ECU_ADDRESS 0xFFFFA3B8 /begin FUNCTION_LIST KF7-500.24[10] KF7-500.75[4] /end FUNCTION_LIST /end MEASUREMENT
/begin MEASUREMENT fFAFRVNG2 "0:ÿ∞›Å®ÿØ¡âûìöóÚâªêfíf 2nd TRIP NG  1:ÿ∞›Å®ÿØ¡âûìöóÚâªêfíf 2nd TRIP NG" UBYTE COMP_0283 1 100 0 1 BIT_MASK 0x0002 ECU_ADDRESS 0xFFFFA3BB /begin FUNCTION_LIST KF7-500.24[10] KF7-500.74[11] KF7-500.74B[5] /end FUNCTION_LIST /end MEASUREMENT
/begin MEASUREMENT fFCATD "0:ÉXÉeÅ[ÉW2êfífNG  1:ÉXÉeÅ[ÉW2êfífÇ÷à⁄çs" UBYTE COMP_0283 1 100 0 1 BIT_MASK 0x0002 ECU_ADDRESS 0xFFFF2D0E /begin FUNCTION_LIST KF7-500.21[19] /end FUNCTION_LIST /end MEASUREMENT
/begin MEASUREMENT fFO2HNG2 "0:O2À∞¿êfífNG2âÒñ⁄ñ¢îªíË  1:O2À∞¿êfífNG2âÒñ⁄îªíË" UBYTE COMP_0283 1 100 0 1 BIT_MASK 0x0002 ECU_ADDRESS 0xFFFFA427 /begin FUNCTION_LIST KF7-500.25A[7] /end FUNCTION_LIST /end MEASUREMENT
/begin MEASUREMENT fFO2HOK2 "0:O2À∞¿êfífOKñ¢îªíË  1:O2À∞¿êfífOKîªíË" UBYTE COMP_0283 1 100 0 1 BIT_MASK 0x0002 ECU_ADDRESS 0xFFFFA428 /begin FUNCTION_LIST KF7-500.25A[7] /end FUNCTION_LIST /end MEASUREMENT
/begin MEASUREMENT fFO2OK2 "0:O2æ›ªêfífOKñ¢îªíË  1:O2æ›ªêfífOKîªíË" UBYTE COMP_0283 1 100 0 1 BIT_MASK 0x0002 ECU_ADDRESS 0xFFFF2D86 /begin FUNCTION_LIST KF7-500.24[10] /end FUNCTION_LIST /end MEASUREMENT
/begin MEASUREMENT fFOLNNG2 "0:O2æ›ªàŸèÌìdà≥êfífÿ∞›ºÃƒNG2âÒñ⁄ñ¢  1:O2æ›ªàŸèÌìdà≥êfífÿ∞›ºÃƒNG2âÒñ⁄îª" UBYTE COMP_0283 1 100 0 1 BIT_MASK 0x0002 ECU_ADDRESS 0xFFFFA42A /begin FUNCTION_LIST KF7-500.24[10] /end FUNCTION_LIST /end MEASUREMENT
/begin MEASUREMENT fFOOPNG2 "0:O2æ›ªífê¸êfífNG2âÒñ⁄ñ¢îªíË  1:O2æ›ªífê¸êfífNG2âÒñ⁄îªíË" UBYTE COMP_0283 1 100 0 1 BIT_MASK 0x0002 ECU_ADDRESS 0xFFFFA42C /begin FUNCTION_LIST KF7-500.24[10] /end FUNCTION_LIST /end MEASUREMENT
/begin MEASUREMENT fFORC2NG2 "0:O2æ›ªàŸèÌìdà≥2êfífNG2âÒñ⁄ñ¢îªíË  1:O2æ›ªàŸèÌìdà≥2êfífNG2âÒñ⁄îªíË" UBYTE COMP_0283 1 100 0 1 BIT_MASK 0x0002 ECU_ADDRESS 0xFFFFA42E /begin FUNCTION_LIST KF7-500.24[10] /end FUNCTION_LIST /end MEASUREMENT
/begin MEASUREMENT fFORCNG2 "0:O2æ›ªàŸèÌìdà≥êfífÿØ¡ºÃƒNG2âÒñ⁄ñ¢  1:O2æ›ªàŸèÌìdà≥êfífÿØ¡ºÃƒNG2âÒñ⁄îª" UBYTE COMP_0283 1 100 0 1 BIT_MASK 0x0002 ECU_ADDRESS 0xFFFFA430 /begin FUNCTION_LIST KF7-500.24[10] /end FUNCTION_LIST /end MEASUREMENT
/begin MEASUREMENT fFORPSNG2 "0:O2æ›ªâûìöéûä‘êfíf(é¸îgêî”∆¿ï˚éÆ)  1:O2æ›ªâûìöéûä‘êfíf(é¸îgêî”∆¿ï˚éÆ)" UBYTE COMP_0283 1 100 0 1 BIT_MASK 0x0002 ECU_ADDRESS 0xFFFFB54E /begin FUNCTION_LIST KF7-500.24[10] /end FUNCTION_LIST /end MEASUREMENT
/begin MEASUREMENT fPHNG2 "0:FrO2/SÉ…ì_ºÃƒêfífNG2âÒñ⁄ñ¢îªíË  1:FrO2/SÉ…ì_ºÃƒêfífNG2âÒñ⁄îªíË" UBYTE COMP_0283 1 100 0 1 BIT_MASK 0x0002 ECU_ADDRESS 0xFFFFAEAD /begin FUNCTION_LIST KF7-500.24[10] /end FUNCTION_LIST /end MEASUREMENT
/begin MEASUREMENT fPRCLCT "0:âEãLà»äO  1:ê¨óß" UBYTE COMP_0283 1 100 0 1 BIT_MASK 0x0002 ECU_ADDRESS 0xFFFF3098 /begin FUNCTION_LIST KF7-500.21[19] /end FUNCTION_LIST /end MEASUREMENT
/begin MEASUREMENT fRFOEVP "0:å„O2æ›ªêfífÇ…ÇÊÇÈÉLÉÉÉjÉXÉ^ÉpÅ[  1:å„O2æ›ªêfífÇ…ÇÊÇÈÉLÉÉÉjÉXÉ^ÉpÅ[" UBYTE COMP_0283 1 100 0 1 BIT_MASK 0x0002 ECU_ADDRESS 0xFFFF3133 /begin FUNCTION_LIST KF7-500.24[10] /end FUNCTION_LIST /end MEASUREMENT
/begin MEASUREMENT fRO2OK2 "0:å„O2/SêfífOKñ¢èIóπ  1:å„O2/SêfífOKèIóπ" UBYTE COMP_0283 1 100 0 1 BIT_MASK 0x0002 ECU_ADDRESS 0xFFFFAFFC /begin FUNCTION_LIST KF7-500.24[10] /end FUNCTION_LIST /end MEASUREMENT
/begin MEASUREMENT fROAVNG1 "0:àŸèÌìdà≥2êfífNG 1TRIPñ¢èIóπ  1:àŸèÌìdà≥2êfífNG 1TRIPèIóπ" UBYTE COMP_0283 1 100 0 1 BIT_MASK 0x0002 ECU_ADDRESS 0xFFFFAFFD /begin FUNCTION_LIST KF7-500.24[10] /end FUNCTION_LIST /end MEASUREMENT
/begin MEASUREMENT fROAVNG2 "0:àŸèÌìdà≥2êfífNG 2TRIPñ¢èIóπ  1:àŸèÌìdà≥2êfífNG 2TRIPèIóπ" UBYTE COMP_0283 1 100 0 1 BIT_MASK 0x0002 ECU_ADDRESS 0xFFFFAFFE /begin FUNCTION_LIST KF7-500.24[10] /end FUNCTION_LIST /end MEASUREMENT
/begin MEASUREMENT fROHNG1 "0:å„O2/HêfífàŸèÌèIóπ1TRIPñ¢èIóπ  1:å„O2/HêfífàŸèÌèIóπ1TRIPèIóπ" UBYTE COMP_0283 1 100 0 1 BIT_MASK 0x0002 ECU_ADDRESS 0xFFFFB008 /begin FUNCTION_LIST KF7-500.25A[7] /end FUNCTION_LIST /end MEASUREMENT
/begin MEASUREMENT fROHNG2 "0:å„O2/HêfífàŸèÌèIóπ2TRIPñ¢èIóπ  1:å„O2/HêfífàŸèÌèIóπ2TRIPèIóπ" UBYTE COMP_0283 1 100 0 1 BIT_MASK 0x0002 ECU_ADDRESS 0xFFFFB009 /begin FUNCTION_LIST KF7-500.25A[7] /end FUNCTION_LIST /end MEASUREMENT
/begin MEASUREMENT fROHOK2 "0:å„O2/Hêfífê≥èÌèIóπñ¢èIóπ  1:å„O2/Hêfífê≥èÌèIóπèIóπ" UBYTE COMP_0283 1 100 0 1 BIT_MASK 0x0002 ECU_ADDRESS 0xFFFFB00A /begin FUNCTION_LIST KF7-500.25A[7] /end FUNCTION_LIST /end MEASUREMENT
/begin MEASUREMENT fROHONT "0:ïsê¨óß  1:ê¨óß" UBYTE COMP_0283 1 100 0 1 BIT_MASK 0x0002 ECU_ADDRESS 0xFFFF3178 /begin FUNCTION_LIST KF7-500.21[19] /end FUNCTION_LIST /end MEASUREMENT
/begin MEASUREMENT fROMNNG1 "0:àŸèÌìdà≥(ç≈è¨íl)êfífNG 1TRIPñ¢èI  1:àŸèÌìdà≥(ç≈è¨íl)êfífNG 1TRIPèIóπ" UBYTE COMP_0283 1 100 0 1 BIT_MASK 0x0002 ECU_ADDRESS 0xFFFFB00B /begin FUNCTION_LIST KF7-500.24[10] /end FUNCTION_LIST /end MEASUREMENT
/begin MEASUREMENT fROMNNG2 "0:àŸèÌìdà≥(ç≈è¨íl)êfífNG 2TRIPñ¢èI  1:àŸèÌìdà≥(ç≈è¨íl)êfífNG 2TRIPèIóπ" UBYTE COMP_0283 1 100 0 1 BIT_MASK 0x0002 ECU_ADDRESS 0xFFFFB00C /begin FUNCTION_LIST KF7-500.24[10] /end FUNCTION_LIST /end MEASUREMENT
/begin MEASUREMENT fROMXNG1 "0:àŸèÌìdà≥(ç≈ëÂíl)êfífNG 1TRIPñ¢èI  1:àŸèÌìdà≥(ç≈ëÂíl)êfífNG 1TRIPèIóπ" UBYTE COMP_0283 1 100 0 1 BIT_MASK 0x0002 ECU_ADDRESS 0xFFFFB00D /begin FUNCTION_LIST KF7-500.24[10] /end FUNCTION_LIST /end MEASUREMENT
/begin MEASUREMENT fROMXNG2 "0:àŸèÌìdà≥(ç≈ëÂíl)êfífNG 2TRIPñ¢èI  1:àŸèÌìdà≥(ç≈ëÂíl)êfífNG 2TRIPèIóπ" UBYTE COMP_0283 1 100 0 1 BIT_MASK 0x0002 ECU_ADDRESS 0xFFFFB00E /begin FUNCTION_LIST KF7-500.24[10] /end FUNCTION_LIST /end MEASUREMENT
/begin MEASUREMENT fRORSNG1 "0:âûìöéûä‘êfífNG 1TRIPñ¢èIóπ  1:âûìöéûä‘êfífNG 1TRIPèIóπ" UBYTE COMP_0283 1 100 0 1 BIT_MASK 0x0002 ECU_ADDRESS 0xFFFFB00F /begin FUNCTION_LIST KF7-500.24[10] /end FUNCTION_LIST /end MEASUREMENT
/begin MEASUREMENT fRORSNG2 "0:âûìöéûä‘êfífNG 2TRIPñ¢èIóπ  1:âûìöéûä‘êfífNG 2TRIPèIóπ" UBYTE COMP_0283 1 100 0 1 BIT_MASK 0x0002 ECU_ADDRESS 0xFFFFB010 /begin FUNCTION_LIST KF7-500.24[10] /end FUNCTION_LIST /end MEASUREMENT
/begin MEASUREMENT fST2JDG "0:ïsê¨óß  1:ê¨óß" UBYTE COMP_0283 1 100 0 1 BIT_MASK 0x0002 ECU_ADDRESS 0xFFFF31FD /begin FUNCTION_LIST KF7-500.21[19] /end FUNCTION_LIST /end MEASUREMENT
/begin MEASUREMENT fST2JDGOK "0:ïsê¨óß  1:ê¨óß" UBYTE COMP_0283 1 100 0 1 BIT_MASK 0x0002 ECU_ADDRESS 0xFFFF31FE /begin FUNCTION_LIST KF7-500.21[19] /end FUNCTION_LIST /end MEASUREMENT
/begin MEASUREMENT fSUMOSL "0:âEãLà»äO  1:ÉäÅ[Éìë§O2ÉXÉgÉåÅ[ÉWî\óÕââéZ" UBYTE COMP_0283 1 100 0 1 BIT_MASK 0x0002 ECU_ADDRESS 0xFFFF323C /begin FUNCTION_LIST KF7-500.21[19] /end FUNCTION_LIST /end MEASUREMENT
/begin MEASUREMENT fSUMOSR "0:âEãLà»äO  1:ÉäÉbÉ`ë§O2ÉXÉgÉåÅ[ÉWî\óÕââéZ" UBYTE COMP_0283 1 100 0 1 BIT_MASK 0x0002 ECU_ADDRESS 0xFFFF323D /begin FUNCTION_LIST KF7-500.21[19] /end FUNCTION_LIST /end MEASUREMENT
/begin MEASUREMENT fTCLR "0:ïsê¨óß  1:ê¨óß" UBYTE COMP_0283 1 100 0 1 BIT_MASK 0x0002 ECU_ADDRESS 0xFFFF32CA /begin FUNCTION_LIST KF7-500.21[19] /end FUNCTION_LIST /end MEASUREMENT
/begin MEASUREMENT fGRO2H "0:GST ﬂ◊“∞¿çXêVóñ≥Çµ  1:GST ﬂ◊“∞¿çXêVóÇ†ÇË" UBYTE COMP_0283 1 100 0 1 BIT_MASK 0x0002 ECU_ADDRESS 0xFFFF2E10 /begin FUNCTION_LIST KF7-500.25A[7] /end FUNCTION_LIST /end MEASUREMENT
/begin MEASUREMENT fROJFCT "0:îRóøÉJÉbÉgéûä‘åoâﬂñ¢  1:îRóøÉJÉbÉgéûä‘åoâﬂçœ" UBYTE COMP_0283 1 100 0 1 BIT_MASK 0x0002 ECU_ADDRESS 0xFFFF317B /begin FUNCTION_LIST KF7-500.24[10] KF7-580.1[8] /end FUNCTION_LIST /end MEASUREMENT
/begin MEASUREMENT fMFNWAREA "Misfire diagnosis region distinction flag" UBYTE COMP_0283 1 100 0 1 BIT_MASK 0x0008 ECU_ADDRESS 0xFFFF4278 /begin FUNCTION_LIST KF7-500.26[17] /end FUNCTION_LIST /end MEASUREMENT
/begin MEASUREMENT fFAREAA "Misfire judgement A region" UBYTE COMP_0283 1 100 0 1 BIT_MASK 0x0001 ECU_ADDRESS 0xFFFF42A8 /begin FUNCTION_LIST KF7-500.26[17] /end FUNCTION_LIST /end MEASUREMENT
/begin MEASUREMENT fFAREAC "Misfire judgement C region" UBYTE COMP_0283 1 100 0 1 BIT_MASK 0x0080 ECU_ADDRESS 0xFFFF42A9 /begin FUNCTION_LIST KF7-500.26[17] /end FUNCTION_LIST /end MEASUREMENT
/begin MEASUREMENT fFDRPMD "During delta rpm slowdown" UBYTE COMP_0283 1 100 0 1 BIT_MASK 0x0001 ECU_ADDRESS 0xFFFF42AE /begin FUNCTION_LIST KF7-500.26[17] /end FUNCTION_LIST /end MEASUREMENT
/begin MEASUREMENT fFEM1ST "Emission criteria diagnosis number of times" UBYTE COMP_0283 1 100 0 1 BIT_MASK 0x0001 ECU_ADDRESS 0xFFFF42B0 /begin FUNCTION_LIST KF7-500.26[17] /end FUNCTION_LIST /end MEASUREMENT
/begin MEASUREMENT fFEM2ND "Emission criteria TABLE choice" UBYTE COMP_0283 1 100 0 1 BIT_MASK 0x0080 ECU_ADDRESS 0xFFFF42B1 /begin FUNCTION_LIST KF7-500.26[17] /end FUNCTION_LIST /end MEASUREMENT
/begin MEASUREMENT fFMFAST "After the start, misfire count rise condition" UBYTE COMP_0283 1 100 0 1 BIT_MASK 0x0008 ECU_ADDRESS 0xFFFF42B9 /begin FUNCTION_LIST KF7-500.26[17] /end FUNCTION_LIST /end MEASUREMENT
/begin MEASUREMENT fFMFCLD "A low coolant temperature misfire count rise condition" UBYTE COMP_0283 1 100 0 1 BIT_MASK 0x0004 ECU_ADDRESS 0xFFFF42B9 /begin FUNCTION_LIST KF7-500.26[17] /end FUNCTION_LIST /end MEASUREMENT
/begin MEASUREMENT fFMILCT "Single cylinder misfire MIL flashing requirement" UBYTE COMP_0283 1 100 0 1 BIT_MASK 0x0040 ECU_ADDRESS 0xFFFF42BA /begin FUNCTION_LIST KF7-500.26[17] /end FUNCTION_LIST /end MEASUREMENT
/begin MEASUREMENT fFMILID "More than one misfire MIL flashing requirement" UBYTE COMP_0283 1 100 0 1 BIT_MASK 0x0020 ECU_ADDRESS 0xFFFF42BA /begin FUNCTION_LIST KF7-500.26[17] /end FUNCTION_LIST /end MEASUREMENT
/begin MEASUREMENT fFNBCNA "A TRIP NG memory A concerned" UBYTE COMP_0283 1 100 0 1 BIT_MASK 0x0040 ECU_ADDRESS 0xFFFF42BB /begin FUNCTION_LIST KF7-500.26[17] /end FUNCTION_LIST /end MEASUREMENT
/begin MEASUREMENT fFNBCNB "A TRIP NG memory B concerned" UBYTE COMP_0283 1 100 0 1 BIT_MASK 0x0020 ECU_ADDRESS 0xFFFF42BB /begin FUNCTION_LIST KF7-500.26[17] /end FUNCTION_LIST /end MEASUREMENT
/begin MEASUREMENT fFNBCNC "A TRIP NG memory C concerned" UBYTE COMP_0283 1 100 0 1 BIT_MASK 0x0010 ECU_ADDRESS 0xFFFF42BB /begin FUNCTION_LIST KF7-500.26[17] /end FUNCTION_LIST /end MEASUREMENT
/begin MEASUREMENT fNTDGCNT "NEUT SW diagnosis counter" UBYTE COMP_0283 1 100 0 1 BIT_MASK 0x0080 ECU_ADDRESS 0xFFFF42DA /begin FUNCTION_LIST KF7-500.28[4] KF7-580.1[8] /end FUNCTION_LIST /end MEASUREMENT
/begin MEASUREMENT fRT1CNG "1cyl misfire realtime NG" UBYTE COMP_0283 1 100 0 1 BIT_MASK 0x0080 ECU_ADDRESS 0xFFFF42EB /begin FUNCTION_LIST KF7-500.26[17] /end FUNCTION_LIST /end MEASUREMENT
/begin MEASUREMENT fRT2CNG "2cyl misfire realtime NG" UBYTE COMP_0283 1 100 0 1 BIT_MASK 0x0040 ECU_ADDRESS 0xFFFF42EB /begin FUNCTION_LIST KF7-500.26[17] /end FUNCTION_LIST /end MEASUREMENT
/begin MEASUREMENT fRT3CNG "3cyl misfire realtime NG" UBYTE COMP_0283 1 100 0 1 BIT_MASK 0x0020 ECU_ADDRESS 0xFFFF42EB /begin FUNCTION_LIST KF7-500.26[17] /end FUNCTION_LIST /end MEASUREMENT
/begin MEASUREMENT fRT4CNG "4cyl misfire realtime NG" UBYTE COMP_0283 1 100 0 1 BIT_MASK 0x0010 ECU_ADDRESS 0xFFFF42EB /begin FUNCTION_LIST KF7-500.26[17] /end FUNCTION_LIST /end MEASUREMENT
/begin MEASUREMENT fRT5CNG "5cyl misfire realtime NG" UBYTE COMP_0283 1 100 0 1 BIT_MASK 0x0008 ECU_ADDRESS 0xFFFF42EB /begin FUNCTION_LIST KF7-500.26[17] /end FUNCTION_LIST /end MEASUREMENT
/begin MEASUREMENT fRT6CNG "6cyl misfire realtime NG" UBYTE COMP_0283 1 100 0 1 BIT_MASK 0x0004 ECU_ADDRESS 0xFFFF42EB /begin FUNCTION_LIST KF7-500.26[17] /end FUNCTION_LIST /end MEASUREMENT
/begin MEASUREMENT fRTMCNG "Multi cyl misfire realtime NG" UBYTE COMP_0283 1 100 0 1 BIT_MASK 0x0002 ECU_ADDRESS 0xFFFF42EB /begin FUNCTION_LIST KF7-500.26[17] /end FUNCTION_LIST /end MEASUREMENT
/begin MEASUREMENT fFHSTOK "TINT compensation permission" UBYTE COMP_0283 1 100 0 1 BIT_MASK 0x0001 ECU_ADDRESS 0xFFFF4304 /begin FUNCTION_LIST KF7-500.26[17] /end FUNCTION_LIST /end MEASUREMENT
/begin MEASUREMENT fFMCTH3 "C>=MCTH3, more than 3 ignition" UBYTE COMP_0283 1 100 0 1 BIT_MASK 0x0080 ECU_ADDRESS 0xFFFF4305 /begin FUNCTION_LIST KF7-500.26[17] /end FUNCTION_LIST /end MEASUREMENT
/begin MEASUREMENT fFMGTH3 "|MISG|>=MGTH3" UBYTE COMP_0283 1 100 0 1 BIT_MASK 0x0040 ECU_ADDRESS 0xFFFF4305 /begin FUNCTION_LIST KF7-500.26[17] /end FUNCTION_LIST /end MEASUREMENT
/begin MEASUREMENT fFMKTCL "MKTNT computed experience" UBYTE COMP_0283 1 100 0 1 BIT_MASK 0x0020 ECU_ADDRESS 0xFFFF4305 /begin FUNCTION_LIST KF7-500.26[17] /end FUNCTION_LIST /end MEASUREMENT
/begin MEASUREMENT fFSMATH1 "|SMISA|>=SMATH1" UBYTE COMP_0283 1 100 0 1 BIT_MASK 0x0010 ECU_ADDRESS 0xFFFF4305 /begin FUNCTION_LIST KF7-500.26[17] /end FUNCTION_LIST /end MEASUREMENT
/begin MEASUREMENT fMINUS "Sign MISx molecule" UBYTE COMP_0283 1 100 0 1 BIT_MASK 0x0001 ECU_ADDRESS 0xFFFF4305 /begin FUNCTION_LIST KF7-500.26[17] /end FUNCTION_LIST /end MEASUREMENT
/begin MEASUREMENT fDLTN1 "After the DLTN1 computed the second time" UBYTE COMP_0283 1 100 0 1 BIT_MASK 0x0002 ECU_ADDRESS 0xFFFF431B /begin FUNCTION_LIST KF7-500.21[19] KF7-500.38A[4] /end FUNCTION_LIST /end MEASUREMENT
/begin MEASUREMENT fDLTTP "The first flag" UBYTE COMP_0283 1 100 0 1 BIT_MASK 0x0001 ECU_ADDRESS 0xFFFF431B /begin FUNCTION_LIST KF7-500.21[19] /end FUNCTION_LIST /end MEASUREMENT
/begin MEASUREMENT fFTNSFT "TINT measuring section movement" UBYTE COMP_0283 1 100 0 1 BIT_MASK 0x0001 ECU_ADDRESS 0xFFFF4344 /begin FUNCTION_LIST KF7-500.26[17] /end FUNCTION_LIST /end MEASUREMENT
/begin MEASUREMENT fMFAYNG "The inside of the tooth position deviation judgement" UBYTE COMP_0283 1 100 0 1 BIT_MASK 0x0080 ECU_ADDRESS 0xFFFF4345 /begin FUNCTION_LIST KF7-500.26[17] /end FUNCTION_LIST /end MEASUREMENT
/begin MEASUREMENT fFEMAR "Emission criteria diagnosis timing" UBYTE COMP_0283 1 100 0 1 BIT_MASK 0x0080 ECU_ADDRESS 0xFFFF4346 /begin FUNCTION_LIST KF7-500.26[17] /end FUNCTION_LIST /end MEASUREMENT
/begin MEASUREMENT fFIDMSA "More than one criteria diagnosis timing" UBYTE COMP_0283 1 100 0 1 BIT_MASK 0x0040 ECU_ADDRESS 0xFFFF4346 /begin FUNCTION_LIST KF7-500.26[17] /end FUNCTION_LIST /end MEASUREMENT
/begin MEASUREMENT fFRGJDG "Catalyst criteria diagnosis timing" UBYTE COMP_0283 1 100 0 1 BIT_MASK 0x0020 ECU_ADDRESS 0xFFFF4346 /begin FUNCTION_LIST KF7-500.26[17] /end FUNCTION_LIST /end MEASUREMENT
/begin MEASUREMENT afFMFJAR "Misfire diagnosis permission" UBYTE COMP_0283 1 100 0 1 BIT_MASK 0x0040 ECU_ADDRESS 0xFFFF4354 /begin FUNCTION_LIST KF7-500.26[17] /end FUNCTION_LIST /end MEASUREMENT
/begin MEASUREMENT afFMILBR "Misfire catalyst criteria region MIL flashing requirement distinction" UBYTE COMP_0283 1 100 0 1 BIT_MASK 0x0010 ECU_ADDRESS 0xFFFF4354 /begin FUNCTION_LIST KF7-500.26[17] /end FUNCTION_LIST /end MEASUREMENT
/begin MEASUREMENT fFMFJAR "Misfire diagnosis permission" UBYTE COMP_0283 1 100 0 1 BIT_MASK 0x0040 ECU_ADDRESS 0xFFFF4365 /begin FUNCTION_LIST KF7-500.26[17] /end FUNCTION_LIST /end MEASUREMENT
/begin MEASUREMENT fFMILBR "Misfire catalyst criteria region MIL flashing requirement distinction" UBYTE COMP_0283 1 100 0 1 BIT_MASK 0x0010 ECU_ADDRESS 0xFFFF4365 /begin FUNCTION_LIST KF7-500.26[17] R902.2.DiagMiscell_1_3_5 /end FUNCTION_LIST /end MEASUREMENT
/begin MEASUREMENT wfMFCSTSW "vMFCSTSW operation flag" UBYTE COMP_0283 1 100 0 1 BIT_MASK 0x0020 ECU_ADDRESS 0xFFFF8A7C /begin FUNCTION_LIST KF7-500.26[17] /end FUNCTION_LIST /end MEASUREMENT
/begin MEASUREMENT fMFCSTSW "vMFCSTSW operation flag" UBYTE COMP_0283 1 100 0 1 BIT_MASK 0x0020 ECU_ADDRESS 0xFFFF8A7D /begin FUNCTION_LIST KF7-500.26[17] /end FUNCTION_LIST /end MEASUREMENT
/begin MEASUREMENT fDUTRTD "Torque going down requirement signal retard" UBYTE COMP_0283 1 100 0 1 BIT_MASK 0x0080 ECU_ADDRESS 0xFFFF2470 /begin FUNCTION_LIST KF7-500.26[17] /end FUNCTION_LIST /end MEASUREMENT
/begin MEASUREMENT fISCPA2 "Hysteresis flag" UBYTE COMP_0283 1 100 0 1 BIT_MASK 0x0040 ECU_ADDRESS 0xFFFF2489 /begin FUNCTION_LIST KF7-500.38A[4] /end FUNCTION_LIST /end MEASUREMENT
/begin MEASUREMENT fISCPAT "Hysteresis flag" UBYTE COMP_0283 1 100 0 1 BIT_MASK 0x0020 ECU_ADDRESS 0xFFFF2489 /begin FUNCTION_LIST KF7-500.38A[4] /end FUNCTION_LIST /end MEASUREMENT
/begin MEASUREMENT fMFTLINT "vMFTLINT operation flag" UBYTE COMP_0283 1 100 0 1 BIT_MASK 0x0004 ECU_ADDRESS 0xFFFF24AF /begin FUNCTION_LIST KF7-500.26[17] /end FUNCTION_LIST /end MEASUREMENT
/begin MEASUREMENT fFCNROL "TINT measuring condition flag" UBYTE COMP_0283 1 100 0 1 BIT_MASK 0x0080 ECU_ADDRESS 0xFFFF24C5 /begin FUNCTION_LIST KF7-500.26[17] /end FUNCTION_LIST /end MEASUREMENT
/begin MEASUREMENT fFNGBUA "1st TRIP NG memory A" UBYTE COMP_0283 1 100 0 1 BIT_MASK 0x0004 ECU_ADDRESS 0xFFFFB7DE /begin FUNCTION_LIST KF7-500.26[17] R000.4.EepAlloc_1_2_2 /end FUNCTION_LIST /end MEASUREMENT
/begin MEASUREMENT fFNGBUB "1st TRIP NG memory B" UBYTE COMP_0283 1 100 0 1 BIT_MASK 0x0002 ECU_ADDRESS 0xFFFFB7DE /begin FUNCTION_LIST KF7-500.26[17] R000.4.EepAlloc_1_2_2 /end FUNCTION_LIST /end MEASUREMENT
/begin MEASUREMENT fFNGBUC "1st TRIP NG memory C" UBYTE COMP_0283 1 100 0 1 BIT_MASK 0x0001 ECU_ADDRESS 0xFFFFB7DE /begin FUNCTION_LIST KF7-500.26[17] R000.4.EepAlloc_1_2_2 /end FUNCTION_LIST /end MEASUREMENT
/begin MEASUREMENT fMAENG "Relaxation time-less, last time, NG judgement flag" UBYTE COMP_0283 1 100 0 1 BIT_MASK 0x0020 ECU_ADDRESS 0xFFFFB7E1 /begin FUNCTION_LIST KF7-500.26[17] /end FUNCTION_LIST /end MEASUREMENT
/begin MEASUREMENT fO2SEND "The rest O2/S diagnosis completion distinction" UBYTE COMP_0283 1 100 0 1 BIT_MASK 0x0040 ECU_ADDRESS 0xFFFFB7E2 /begin FUNCTION_LIST KF7-500.24[10] /end FUNCTION_LIST /end MEASUREMENT
/begin MEASUREMENT fO2HEND "The rest O2/S diagnosis completion distinction" UBYTE COMP_0283 1 100 0 1 BIT_MASK 0x0020 ECU_ADDRESS 0xFFFFB7E7 /begin FUNCTION_LIST KF7-500.25A[7] /end FUNCTION_LIST /end MEASUREMENT
/begin MEASUREMENT tDLMFDT "Start SWOff rest delay timer" UBYTE COMP_0201_S 1 100 0 255 ECU_ADDRESS 0xFFFF4380 /begin FUNCTION_LIST KF7-500.26[17] /end FUNCTION_LIST /end MEASUREMENT
/begin MEASUREMENT tDLYCD3 "Stage 2 diagnosis condition disconnection delay" UBYTE COMP_0201_S 1 100 0 255 ECU_ADDRESS 0xFFFF4381 /begin FUNCTION_LIST KF7-500.21[19] /end FUNCTION_LIST /end MEASUREMENT
/begin MEASUREMENT tGRO2H "The rest O2/H diagnosis NG judgement delay timer" UBYTE COMP_0201_S 1 100 0 255 ECU_ADDRESS 0xFFFF4396 /begin FUNCTION_LIST KF7-500.25A[7] /end FUNCTION_LIST /end MEASUREMENT
/begin MEASUREMENT tO2HROD "After unusual voltage judgement permission heater on, delay" UBYTE COMP_0201_S 1 100 0 255 ECU_ADDRESS 0xFFFF43A0 /begin FUNCTION_LIST KF7-500.24[10] /end FUNCTION_LIST /end MEASUREMENT
/begin MEASUREMENT tRFBALT "The rest O2/S diagnosis stage 2 region condition permission lambda control continuation time timer" UBYTE COMP_0201_S 1 100 0 255 ECU_ADDRESS 0xFFFF43B1 /begin FUNCTION_LIST KF7-500.24[10] /end FUNCTION_LIST /end MEASUREMENT
/begin MEASUREMENT tRFBFCT "The rest O2/S diagnosis stage 2 region condition permission F/C inside continuation time timer" UBYTE COMP_0201_S 1 100 0 255 ECU_ADDRESS 0xFFFF43B7 /begin FUNCTION_LIST KF7-500.24[10] /end FUNCTION_LIST /end MEASUREMENT
/begin MEASUREMENT tRFBIDT "The rest O2/S diagnosis stage 2 region condition permission idle off continuation time timer" UBYTE COMP_0201_S 1 100 0 255 ECU_ADDRESS 0xFFFF43BD /begin FUNCTION_LIST KF7-500.24[10] /end FUNCTION_LIST /end MEASUREMENT
/begin MEASUREMENT tRFBKMT "The rest O2/S diagnosis stage 2 region condition permission TFBYA0==1.0 continuation time timer" UBYTE COMP_0201_S 1 100 0 255 ECU_ADDRESS 0xFFFF43C3 /begin FUNCTION_LIST KF7-500.24[10] /end FUNCTION_LIST /end MEASUREMENT
/begin MEASUREMENT tRO2HDY "After rest O2 heater on, delay timer" UBYTE COMP_0201_S 1 100 0 255 ECU_ADDRESS 0xFFFF43C9 /begin FUNCTION_LIST KF7-500.24[10] /end FUNCTION_LIST /end MEASUREMENT
/begin MEASUREMENT tROHONT "Rr.O2/H On time delay" UBYTE COMP_0201_S 1 100 0 255 ECU_ADDRESS 0xFFFF43CB /begin FUNCTION_LIST KF7-500.21[19] /end FUNCTION_LIST /end MEASUREMENT
/begin MEASUREMENT tROHTM "The rest O2/H diagnosis NG judgement delay timer" UBYTE COMP_0201_S 1 100 0 255 ECU_ADDRESS 0xFFFF43CD /begin FUNCTION_LIST KF7-500.25A[7] /end FUNCTION_LIST /end MEASUREMENT
/begin MEASUREMENT tROJD "The rest O2 sensor breakage diagnosis region formation delay timer" UBYTE COMP_0201_S 1 100 0 255 ECU_ADDRESS 0xFFFF43D7 /begin FUNCTION_LIST KF7-500.24[10] /end FUNCTION_LIST /end MEASUREMENT
/begin MEASUREMENT tROJDLY "After diagnosis permission judgement heater on, delay time" UBYTE COMP_0201_S 1 100 0 255 ECU_ADDRESS 0xFFFF43D9 /begin FUNCTION_LIST KF7-500.24[10] KF7-580.1[8] /end FUNCTION_LIST /end MEASUREMENT
/begin MEASUREMENT tROJDNG "The rest O2 sensor breakage diagnosis NG judgement delay timer" UBYTE COMP_0201_S 1 100 0 255 ECU_ADDRESS 0xFFFF43DB /begin FUNCTION_LIST KF7-500.24[10] /end FUNCTION_LIST /end MEASUREMENT
/begin MEASUREMENT tROJFCD "After the diagnosis permission judgement fuel cut, progress time" UBYTE COMP_0201_S 1 100 0 255 ECU_ADDRESS 0xFFFF43DD /begin FUNCTION_LIST KF7-500.24[10] /end FUNCTION_LIST /end MEASUREMENT
/begin MEASUREMENT tROXJSD "After a diagnosis monitor start starts, delay timer" UBYTE COMP_0201_S 1 100 0 255 ECU_ADDRESS 0xFFFF43E1 /begin FUNCTION_LIST KF7-500.24[10] /end FUNCTION_LIST /end MEASUREMENT
/begin MEASUREMENT tTCTJD1 "Region judgement condition delay counter" UBYTE COMP_0201_S 1 100 0 255 ECU_ADDRESS 0xFFFF43F6 /begin FUNCTION_LIST KF7-500.21[19] /end FUNCTION_LIST /end MEASUREMENT
/begin MEASUREMENT tTHRO2 "An unusual voltage judgement time measuring timer" UBYTE COMP_0201_S 1 100 0 255 ECU_ADDRESS 0xFFFF4404 /begin FUNCTION_LIST KF7-500.24[10] /end FUNCTION_LIST /end MEASUREMENT
/begin MEASUREMENT tTMDOS "Diagnosis permission DOS formation time timer" UBYTE COMP_0201_S 1 100 0 255 ECU_ADDRESS 0xFFFF4410 /begin FUNCTION_LIST KF7-500.24[10] KF7-580.1[8] /end FUNCTION_LIST /end MEASUREMENT
/begin MEASUREMENT tTMRO2H "After rest O2/H ON/ off, delay timer" UBYTE COMP_0201_S 1 100 0 255 ECU_ADDRESS 0xFFFF4425 /begin FUNCTION_LIST KF7-500.25A[7] /end FUNCTION_LIST /end MEASUREMENT
/begin MEASUREMENT tROJFCT "Diagnosis permission judgement fuel cut continuation time" UBYTE COMP_0202_S 1 100 0 255 ECU_ADDRESS 0xFFFF44B3 /begin FUNCTION_LIST KF7-500.24[10] KF7-580.1[8] /end FUNCTION_LIST /end MEASUREMENT
/begin MEASUREMENT tSUMOSCDL "O2 storage ability integration delay" UBYTE COMP_0202_S 1 100 0 255 ECU_ADDRESS 0xFFFF44C3 /begin FUNCTION_LIST KF7-500.21[19] /end FUNCTION_LIST /end MEASUREMENT
/begin MEASUREMENT tTCTJDLY "Region judgement condition delay counter" UBYTE COMP_0202_S 1 100 0 255 ECU_ADDRESS 0xFFFF44DE /begin FUNCTION_LIST KF7-500.21[19] /end FUNCTION_LIST /end MEASUREMENT
/begin MEASUREMENT tTMMFD "Bad road cancellation delay timer" UBYTE COMP_0202_S 1 100 0 255 ECU_ADDRESS 0xFFFF4527 /begin FUNCTION_LIST KF7-500.26[17] /end FUNCTION_LIST /end MEASUREMENT
/begin MEASUREMENT tDTVOGT "TVO monitor bad road judgement timer" UBYTE COMP_0203_S 1 100 0 255 ECU_ADDRESS 0xFFFF45E5 /begin FUNCTION_LIST KF7-500.26[17] /end FUNCTION_LIST /end MEASUREMENT
/begin MEASUREMENT tTMGNSK "Tooth precision learning delay timer" UBYTE COMP_0203_S 1 100 0 255 ECU_ADDRESS 0xFFFF463F /begin FUNCTION_LIST KF7-500.26[17] /end FUNCTION_LIST /end MEASUREMENT
/begin MEASUREMENT tTMNUVB "More than a battery voltage NEUTVB# time timer" UBYTE COMP_0203_S 1 100 0 255 ECU_ADDRESS 0xFFFF4648 /begin FUNCTION_LIST KF7-500.28[4] KF7-505.23[2] /end FUNCTION_LIST /end MEASUREMENT
/begin MEASUREMENT avGFCAT "A catalyst diagnosis parameter for the GST output" UBYTE COMP_0044 1 100 0 1.9921875 ECU_ADDRESS 0xFFFFB6E3 /begin FUNCTION_LIST KF7-500.21[19] /end FUNCTION_LIST /end MEASUREMENT
/begin MEASUREMENT avGFCAT_R#1 "A catalyst diagnosis parameter for the GST output" UBYTE COMP_0044 1 100 0 1.9921875 ECU_ADDRESS 0xFFFFB6E3 /begin FUNCTION_LIST KF7-500.21[19] /end FUNCTION_LIST /end MEASUREMENT
/begin MEASUREMENT avGFCAT_R#2 "A catalyst diagnosis parameter for the GST output" UBYTE COMP_0044 1 100 0 1.9921875 ECU_ADDRESS 0xFFFFB6E4 /begin FUNCTION_LIST KF7-500.21[19] /end FUNCTION_LIST /end MEASUREMENT
/begin MEASUREMENT avGRO2N "A parameter for the rest O2/S diagnosis GST" UBYTE COMP_0104 1 100 0 2550 ECU_ADDRESS 0xFFFFB6EC /begin FUNCTION_LIST KF7-500.24[10] /end FUNCTION_LIST /end MEASUREMENT
/begin MEASUREMENT avGRO2R "A parameter for the rest O2/S diagnosis GST" UBYTE COMP_0104 1 100 0 2550 ECU_ADDRESS 0xFFFFB6EE /begin FUNCTION_LIST KF7-500.24[10] /end FUNCTION_LIST /end MEASUREMENT
/begin MEASUREMENT avGRO2X "A parameter for the rest O2/S diagnosis GST" UBYTE COMP_0104 1 100 0 2550 ECU_ADDRESS 0xFFFFB6F0 /begin FUNCTION_LIST KF7-500.24[10] /end FUNCTION_LIST /end MEASUREMENT
/begin MEASUREMENT avME1000 "On every 1000 turns, MFCEM maximum value" UBYTE COMP_0016 1 100 0 255 ECU_ADDRESS 0xFFFFB6FA /begin FUNCTION_LIST KF7-500.26[17] /end FUNCTION_LIST /end MEASUREMENT
/begin MEASUREMENT avPHOS "DOS shift P-gain compensation value" UWORD COMP_0265 1 100 -8.000012288 7.999768147 ECU_ADDRESS 0xFFFF2340 /begin FUNCTION_LIST KF7-500.21[19] KF7-500.24[10] KF7-580.1[8] /end FUNCTION_LIST /end MEASUREMENT
/begin MEASUREMENT avPHOS_R#1 "DOS shift P-gain compensation value" UWORD COMP_0265 1 100 -8.000012288 7.999768147 ECU_ADDRESS 0xFFFF2340 /begin FUNCTION_LIST KF7-500.21[19] KF7-500.24[10] KF7-580.1[8] /end FUNCTION_LIST /end MEASUREMENT
/begin MEASUREMENT avPHOS_R#2 "DOS shift P-gain compensation value" UWORD COMP_0265 1 100 -8.000012288 7.999768147 ECU_ADDRESS 0xFFFF2342 /begin FUNCTION_LIST KF7-500.21[19] KF7-500.24[10] KF7-580.1[8] /end FUNCTION_LIST /end MEASUREMENT
/begin MEASUREMENT avSRTEND "Diagnosis completion monitor flag" UBYTE COMP_0004 1 100 0 255 ECU_ADDRESS 0xFFFF416F
 /begin FUNCTION_LIST KF7-500.30[8] KF7-500.74[11] KF7-500.74B[5] KF7-500.76[8] KF7-580.1[8] /end FUNCTION_LIST
/end MEASUREMENT
/begin MEASUREMENT avSRTEND_R#1 "Diagnosis completion monitor flag" UBYTE COMP_0004 1 100 0 255 ECU_ADDRESS 0xFFFF416F
 /begin FUNCTION_LIST KF7-500.30[8] KF7-500.74[11] KF7-500.74B[5] KF7-500.76[8] KF7-580.1[8] /end FUNCTION_LIST
/end MEASUREMENT
/begin MEASUREMENT avSRTEND_R#2 "Diagnosis completion monitor flag" UBYTE COMP_0004 1 100 0 255 ECU_ADDRESS 0xFFFF4170
 /begin FUNCTION_LIST KF7-500.30[8] KF7-500.74[11] KF7-500.74B[5] KF7-500.76[8] KF7-580.1[8] /end FUNCTION_LIST
/end MEASUREMENT
/begin MEASUREMENT avSRTEND_R#3 "Diagnosis completion monitor flag" UBYTE COMP_0004 1 100 0 255 ECU_ADDRESS 0xFFFF4171
 /begin FUNCTION_LIST KF7-500.30[8] KF7-500.74[11] KF7-500.74B[5] KF7-500.76[8] KF7-580.1[8] /end FUNCTION_LIST
/end MEASUREMENT
/begin MEASUREMENT avSRTEND_R#4 "Diagnosis completion monitor flag" UBYTE COMP_0004 1 100 0 255 ECU_ADDRESS 0xFFFF4172
 /begin FUNCTION_LIST KF7-500.30[8] KF7-500.74[11] KF7-500.74B[5] KF7-500.76[8] KF7-580.1[8] /end FUNCTION_LIST
/end MEASUREMENT
/begin MEASUREMENT avSRTEND_R#5 "Diagnosis completion monitor flag" UBYTE COMP_0004 1 100 0 255 ECU_ADDRESS 0xFFFF4173
 /begin FUNCTION_LIST KF7-500.30[8] KF7-500.74[11] KF7-500.74B[5] KF7-500.76[8] KF7-580.1[8] /end FUNCTION_LIST
/end MEASUREMENT
/begin MEASUREMENT avSRTEND_R#6 "Diagnosis completion monitor flag" UBYTE COMP_0004 1 100 0 255 ECU_ADDRESS 0xFFFF4174
 /begin FUNCTION_LIST KF7-500.30[8] KF7-500.74[11] KF7-500.74B[5] KF7-500.76[8] KF7-580.1[8] /end FUNCTION_LIST
/end MEASUREMENT
/begin MEASUREMENT avSRTRSL "Diagnosis result monitor flag" UBYTE COMP_0004 1 100 0 255 ECU_ADDRESS 0xFFFF4175
 /begin FUNCTION_LIST KF7-500.30[8] KF7-500.74[11] KF7-500.74B[5] KF7-500.76[8] KF7-580.1[8] /end FUNCTION_LIST
/end MEASUREMENT
/begin MEASUREMENT avSRTRSL_R#1 "Diagnosis result monitor flag" UBYTE COMP_0004 1 100 0 255 ECU_ADDRESS 0xFFFF4175
 /begin FUNCTION_LIST KF7-500.30[8] KF7-500.74[11] KF7-500.74B[5] KF7-500.76[8] KF7-580.1[8] /end FUNCTION_LIST
/end MEASUREMENT
/begin MEASUREMENT avSRTRSL_R#2 "Diagnosis result monitor flag" UBYTE COMP_0004 1 100 0 255 ECU_ADDRESS 0xFFFF4176
 /begin FUNCTION_LIST KF7-500.30[8] KF7-500.74[11] KF7-500.74B[5] KF7-500.76[8] KF7-580.1[8] /end FUNCTION_LIST
/end MEASUREMENT
/begin MEASUREMENT avSRTRSL_R#3 "Diagnosis result monitor flag" UBYTE COMP_0004 1 100 0 255 ECU_ADDRESS 0xFFFF4177
 /begin FUNCTION_LIST KF7-500.30[8] KF7-500.74[11] KF7-500.74B[5] KF7-500.76[8] KF7-580.1[8] /end FUNCTION_LIST
/end MEASUREMENT
/begin MEASUREMENT avSRTRSL_R#4 "Diagnosis result monitor flag" UBYTE COMP_0004 1 100 0 255 ECU_ADDRESS 0xFFFF4178
 /begin FUNCTION_LIST KF7-500.30[8] KF7-500.74[11] KF7-500.74B[5] KF7-500.76[8] KF7-580.1[8] /end FUNCTION_LIST
/end MEASUREMENT
/begin MEASUREMENT avSRTRSL_R#5 "Diagnosis result monitor flag" UBYTE COMP_0004 1 100 0 255 ECU_ADDRESS 0xFFFF4179
 /begin FUNCTION_LIST KF7-500.30[8] KF7-500.74[11] KF7-500.74B[5] KF7-500.76[8] KF7-580.1[8] /end FUNCTION_LIST
/end MEASUREMENT
/begin MEASUREMENT avSRTRSL_R#6 "Diagnosis result monitor flag" UBYTE COMP_0004 1 100 0 255 ECU_ADDRESS 0xFFFF417A
 /begin FUNCTION_LIST KF7-500.30[8] KF7-500.74[11] KF7-500.74B[5] KF7-500.76[8] KF7-580.1[8] /end FUNCTION_LIST
/end MEASUREMENT
/begin MEASUREMENT avSRTTST "Diagnosis region monitor flag" UBYTE COMP_0004 1 100 0 255 ECU_ADDRESS 0xFFFF417B
 /begin FUNCTION_LIST KF7-500.30[8] KF7-500.74[11] KF7-500.74B[5] KF7-500.76[8] KF7-580.1[8] /end FUNCTION_LIST
/end MEASUREMENT
/begin MEASUREMENT avSRTTST_R#1 "Diagnosis region monitor flag" UBYTE COMP_0004 1 100 0 255 ECU_ADDRESS 0xFFFF417B
 /begin FUNCTION_LIST KF7-500.30[8] KF7-500.74[11] KF7-500.74B[5] KF7-500.76[8] KF7-580.1[8] /end FUNCTION_LIST
/end MEASUREMENT
/begin MEASUREMENT avSRTTST_R#2 "Diagnosis region monitor flag" UBYTE COMP_0004 1 100 0 255 ECU_ADDRESS 0xFFFF417C
 /begin FUNCTION_LIST KF7-500.30[8] KF7-500.74[11] KF7-500.74B[5] KF7-500.76[8] KF7-580.1[8] /end FUNCTION_LIST
/end MEASUREMENT
/begin MEASUREMENT avSRTTST_R#3 "Diagnosis region monitor flag" UBYTE COMP_0004 1 100 0 255 ECU_ADDRESS 0xFFFF417D
 /begin FUNCTION_LIST KF7-500.30[8] KF7-500.74[11] KF7-500.74B[5] KF7-500.76[8] KF7-580.1[8] /end FUNCTION_LIST
/end MEASUREMENT
/begin MEASUREMENT avSRTTST_R#4 "Diagnosis region monitor flag" UBYTE COMP_0004 1 100 0 255 ECU_ADDRESS 0xFFFF417E
 /begin FUNCTION_LIST KF7-500.30[8] KF7-500.74[11] KF7-500.74B[5] KF7-500.76[8] KF7-580.1[8] /end FUNCTION_LIST
/end MEASUREMENT
/begin MEASUREMENT avSRTTST_R#5 "Diagnosis region monitor flag" UBYTE COMP_0004 1 100 0 255 ECU_ADDRESS 0xFFFF417F
 /begin FUNCTION_LIST KF7-500.30[8] KF7-500.74[11] KF7-500.74B[5] KF7-500.76[8] KF7-580.1[8] /end FUNCTION_LIST
/end MEASUREMENT
/begin MEASUREMENT avSRTTST_R#6 "Diagnosis region monitor flag" UBYTE COMP_0004 1 100 0 255 ECU_ADDRESS 0xFFFF4180
 /begin FUNCTION_LIST KF7-500.30[8] KF7-500.74[11] KF7-500.74B[5] KF7-500.76[8] KF7-580.1[8] /end FUNCTION_LIST
/end MEASUREMENT
/begin MEASUREMENT vAPOK30 "For 30mS, the amount of a change in APOK" UBYTE COMP_0127 1 100 -44.8 44.45 ECU_ADDRESS 0xFFFF48CD /begin FUNCTION_LIST KF7-500.26[17] /end FUNCTION_LIST /end MEASUREMENT
/begin MEASUREMENT vAVEOSC "O2 storage ability mean" ULONG COMP_0555_S 1 100 0 42949672.95 ECU_ADDRESS 0xFFFF118C /begin FUNCTION_LIST KF7-500.21[19] /end FUNCTION_LIST /end MEASUREMENT
/begin MEASUREMENT vAVEOSC_R#1 "O2 storage ability mean" ULONG COMP_0555_S 1 100 0 42949672.95 ECU_ADDRESS 0xFFFF118C /begin FUNCTION_LIST KF7-500.21[19] /end FUNCTION_LIST /end MEASUREMENT
/begin MEASUREMENT vAVEOSC_R#2 "O2 storage ability mean" ULONG COMP_0555_S 1 100 0 42949672.95 ECU_ADDRESS 0xFFFF1190 /begin FUNCTION_LIST KF7-500.21[19] /end FUNCTION_LIST /end MEASUREMENT
/begin MEASUREMENT vAVOSQ1 "O2 storage ability index number" UBYTE COMP_0068 1 100 0 255 ECU_ADDRESS 0xFFFF28A9 /begin FUNCTION_LIST KF7-500.21[19] /end FUNCTION_LIST /end MEASUREMENT
/begin MEASUREMENT vAVOSQ1_R#1 "O2 storage ability index number" UBYTE COMP_0068 1 100 0 255 ECU_ADDRESS 0xFFFF28A9 /begin FUNCTION_LIST KF7-500.21[19] /end FUNCTION_LIST /end MEASUREMENT
/begin MEASUREMENT vAVOSQ1_R#2 "O2 storage ability index number" UBYTE COMP_0068 1 100 0 255 ECU_ADDRESS 0xFFFF28AA /begin FUNCTION_LIST KF7-500.21[19] /end FUNCTION_LIST /end MEASUREMENT
/begin MEASUREMENT vBDLR1 "The minimum value (stage 1) of the proper side (LR) change quantity maximum value" UBYTE COMP_0382 1 100 0 2550 ECU_ADDRESS 0xFFFFB563 /begin FUNCTION_LIST KF7-500.24[10] /end FUNCTION_LIST /end MEASUREMENT
/begin MEASUREMENT vBDLR2 "The minimum value (stage 2) of the proper side (LR) change quantity maximum value" UBYTE COMP_0382 1 100 0 2550 ECU_ADDRESS 0xFFFFA28F /begin FUNCTION_LIST KF7-500.24[10] /end FUNCTION_LIST /end MEASUREMENT
/begin MEASUREMENT vBDRL1 "Minimum value (stage 1) on the negative side (RL) change quantity maximum value" UBYTE COMP_0382 1 100 0 2550 ECU_ADDRESS 0xFFFFB565 /begin FUNCTION_LIST KF7-500.24[10] /end FUNCTION_LIST /end MEASUREMENT
/begin MEASUREMENT vBDRL2 "Minimum value (stage 2) on the negative side (RL) change quantity maximum value" UBYTE COMP_0382 1 100 0 2550 ECU_ADDRESS 0xFFFFA291 /begin FUNCTION_LIST KF7-500.24[10] /end FUNCTION_LIST /end MEASUREMENT
/begin MEASUREMENT vBRMN1 "The maximum value (stage 1) of the VRO2MIN value" UBYTE COMP_0104 1 100 0 2550 ECU_ADDRESS 0xFFFFB56A /begin FUNCTION_LIST KF7-500.24[10] /end FUNCTION_LIST /end MEASUREMENT
/begin MEASUREMENT vBRMN2 "The maximum value (stage 2) of the VRO2MIN value" UBYTE COMP_0104 1 100 0 2550 ECU_ADDRESS 0xFFFFA29C /begin FUNCTION_LIST KF7-500.24[10] /end FUNCTION_LIST /end MEASUREMENT
/begin MEASUREMENT vBRMX1 "The minimum value (stage 1) of the VRO2MAX value" UBYTE COMP_0104 1 100 0 2550 ECU_ADDRESS 0xFFFFB56C /begin FUNCTION_LIST KF7-500.24[10] /end FUNCTION_LIST /end MEASUREMENT
/begin MEASUREMENT vBRMX2 "The minimum value (stage 2) of the VRO2MAX value" UBYTE COMP_0104 1 100 0 2550 ECU_ADDRESS 0xFFFFA29E /begin FUNCTION_LIST KF7-500.24[10] /end FUNCTION_LIST /end MEASUREMENT
/begin MEASUREMENT vCATST1B1 "Catalyst diagnosis stage 1 complete number of times counter bank 1" UWORD COMP_0016 1 100 0 65535 ECU_ADDRESS 0xFFFFA2B0 /begin FUNCTION_LIST KF7-500.21[19] /end FUNCTION_LIST /end MEASUREMENT
/begin MEASUREMENT vCATST1B2 "Catalyst diagnosis stage 1 complete number of times counter bank 2" UWORD COMP_0016 1 100 0 65535 ECU_ADDRESS 0xFFFFA2B2 /begin FUNCTION_LIST KF7-500.21[19] /end FUNCTION_LIST /end MEASUREMENT
/begin MEASUREMENT vCCATWP "KTEXDY delay timer" UBYTE COMP_0096 1 100 0 2550 ECU_ADDRESS 0xFFFF295A /begin FUNCTION_LIST KF7-500.21[19] /end FUNCTION_LIST /end MEASUREMENT
/begin MEASUREMENT vCNGMS "MSTRG NG criteria" UBYTE COMP_0085_S 1 100 0 255 ECU_ADDRESS 0xFFFF29A4 /begin FUNCTION_LIST KF7-500.21[19] /end FUNCTION_LIST /end MEASUREMENT
/begin MEASUREMENT vCNGMS_R#1 "MSTRG NG criteria" UBYTE COMP_0085_S 1 100 0 255 ECU_ADDRESS 0xFFFF29A4 /begin FUNCTION_LIST KF7-500.21[19] /end FUNCTION_LIST /end MEASUREMENT
/begin MEASUREMENT vCNGMS_R#2 "MSTRG NG criteria" UBYTE COMP_0085_S 1 100 0 255 ECU_ADDRESS 0xFFFF29A5 /begin FUNCTION_LIST KF7-500.21[19] /end FUNCTION_LIST /end MEASUREMENT
/begin MEASUREMENT vCNGOSC "AVOSQ NG limit value" UBYTE COMP_0068 1 100 0 255 ECU_ADDRESS 0xFFFFA2B7 /begin FUNCTION_LIST KF7-500.21[19] R904.1.Gst_on_can_1_0_1 /end FUNCTION_LIST /end MEASUREMENT
/begin MEASUREMENT vCNGOSC_R#1 "AVOSQ NG limit value" UBYTE COMP_0068 1 100 0 255 ECU_ADDRESS 0xFFFFA2B7 /begin FUNCTION_LIST KF7-500.21[19] R904.1.Gst_on_can_1_0_1 /end FUNCTION_LIST /end MEASUREMENT
/begin MEASUREMENT vCNGOSC_R#2 "AVOSQ NG limit value" UBYTE COMP_0068 1 100 0 255 ECU_ADDRESS 0xFFFFA2B8 /begin FUNCTION_LIST KF7-500.21[19] R904.1.Gst_on_can_1_0_1 /end FUNCTION_LIST /end MEASUREMENT
/begin MEASUREMENT vCNTO2S "O2 sensor diagnosis completion number of times counter" UBYTE COMP_0016 1 100 0 255 ECU_ADDRESS 0xFFFFA2BD /begin FUNCTION_LIST KF7-500.24[10] /end FUNCTION_LIST /end MEASUREMENT
/begin MEASUREMENT vCNTZRE "TINT measuring section movement control execution number of times counter" UBYTE COMP_0030 1 100 0 255 ECU_ADDRESS 0xFFFF4052 /begin FUNCTION_LIST KF7-500.26[17] /end FUNCTION_LIST /end MEASUREMENT
/begin MEASUREMENT vCRTCAT "A criteria for the catalyst diagnosis" ULONG COMP_0074 1 100 0 16777215.9960938 ECU_ADDRESS 0xFFFF3624 /begin FUNCTION_LIST KF7-500.26[17] /end FUNCTION_LIST /end MEASUREMENT
/begin MEASUREMENT vCRTEM "Misfire judgement emission criteria" UWORD COMP_0016 1 100 0 65535 ECU_ADDRESS 0xFFFF29C8 /begin FUNCTION_LIST KF7-500.26[17] /end FUNCTION_LIST /end MEASUREMENT
/begin MEASUREMENT vCRTFUK "A catalyst diagnosis criteria for the multiple cylinder misfire" ULONG COMP_0074 1 100 0 16777215.9960938 ECU_ADDRESS 0xFFFF3628 /begin FUNCTION_LIST KF7-500.26[17] /end FUNCTION_LIST /end MEASUREMENT
/begin MEASUREMENT vCRTIA "Misfire judgement multiple cylinder misfire criteria" UWORD COMP_0016 1 100 0 65535 ECU_ADDRESS 0xFFFF29CA /begin FUNCTION_LIST KF7-500.26[17] /end FUNCTION_LIST /end MEASUREMENT
/begin MEASUREMENT vDLEPX2 "The maximum value of the absolute value of the amount of change between 1 S of EVPRES" UBYTE COMP_0102 1 100 0 5100 ECU_ADDRESS 0xFFFF2A50 /begin FUNCTION_LIST KF7-500.30[8] /end FUNCTION_LIST /end MEASUREMENT
/begin MEASUREMENT vDLTN1 "The amount of a change in NRPM" UBYTE COMP_0070 1 100 0 3187.5 ECU_ADDRESS 0xFFFF491B /begin FUNCTION_LIST KF7-500.21[19] KF7-500.38A[4] /end FUNCTION_LIST /end MEASUREMENT
/begin MEASUREMENT vDLTTP "TP change absolute value" UBYTE COMP_0124 1 100 0 31.875 ECU_ADDRESS 0xFFFF491C /begin FUNCTION_LIST KF7-500.21[19] /end FUNCTION_LIST /end MEASUREMENT
/begin MEASUREMENT vDTVO30 "For 30mS, the amount of a change in TVO" UBYTE COMP_0127 1 100 -44.8 44.45 ECU_ADDRESS 0xFFFF4923 /begin FUNCTION_LIST KF7-500.26[17] /end FUNCTION_LIST /end MEASUREMENT
/begin MEASUREMENT vDTVSL1 "Coil resistance sample number of times 1" UBYTE COMP_0016 1 100 0 255 ECU_ADDRESS 0xFFFF405E /begin FUNCTION_LIST KF7-500.30[8] /end FUNCTION_LIST /end MEASUREMENT
/begin MEASUREMENT vDTVSL2 "Coil resistance sample number of times 2" UBYTE COMP_0016 1 100 0 255 ECU_ADDRESS 0xFFFF405F /begin FUNCTION_LIST KF7-500.30[8] /end FUNCTION_LIST /end MEASUREMENT
/begin MEASUREMENT vDVLRX "The proper side (LR) change quantity maximum value" UBYTE COMP_0586_S 1 100 0 2550 ECU_ADDRESS 0xFFFF4924 /begin FUNCTION_LIST KF7-500.24[10] R901.1.Diag_on_can_app_1_6_2 /end FUNCTION_LIST /end MEASUREMENT
/begin MEASUREMENT vDVRLX "Negative side (RL) change quantity maximum value" UBYTE COMP_0586_S 1 100 0 2550 ECU_ADDRESS 0xFFFF4926 /begin FUNCTION_LIST KF7-500.24[10] R901.1.Diag_on_can_app_1_6_2 /end FUNCTION_LIST /end MEASUREMENT
/begin MEASUREMENT vDZ1000 "A counter for the MAX detection number count in the judgement of an emission 1000 turns" UBYTE COMP_0016 1 100 0 255 ECU_ADDRESS 0xFFFF362C /begin FUNCTION_LIST KF7-500.26[17] /end FUNCTION_LIST /end MEASUREMENT
/begin MEASUREMENT vDZ10MX "A MAX detection number counter in the judgement of an emission 1000 turns" UBYTE COMP_0016 1 100 0 255 ECU_ADDRESS 0xFFFFB52C /begin FUNCTION_LIST KF7-500.26[17] /end FUNCTION_LIST /end MEASUREMENT
/begin MEASUREMENT vDZTOTA "After the condition formation, one-second misfire detection counter" UWORD COMP_0016 1 100 0 65535 ECU_ADDRESS 0xFFFFB52E /begin FUNCTION_LIST KF7-500.26[17] /end FUNCTION_LIST /end MEASUREMENT
/begin MEASUREMENT vEMCOUN "Emission 1000 turns judgement number of times counter" UWORD COMP_0016 1 100 0 65535 ECU_ADDRESS 0xFFFFA306 /begin FUNCTION_LIST KF7-500.26[17] /end FUNCTION_LIST /end MEASUREMENT
/begin MEASUREMENT vENZN21 "The TINT compensation coefficient learning weighted average number of times by the cylinder" UBYTE COMP_0016 1 100 0 255 ECU_ADDRESS 0xFFFFB530 /begin FUNCTION_LIST KF7-500.26[17] /end FUNCTION_LIST /end MEASUREMENT
/begin MEASUREMENT vENZNN1 "KTNTi integration number of times" UBYTE COMP_0016 1 100 0 255 ECU_ADDRESS 0xFFFF362D /begin FUNCTION_LIST KF7-500.26[17] /end FUNCTION_LIST /end MEASUREMENT
/begin MEASUREMENT vEQURT "Lambda control phase agreement condition counter" UBYTE COMP_0044 1 100 0 1.9921875 ECU_ADDRESS 0xFFFF2B5F /begin FUNCTION_LIST KF7-500.21[19] /end FUNCTION_LIST /end MEASUREMENT
/begin MEASUREMENT vEQURT_R#1 "Lambda control phase agreement condition counter" UBYTE COMP_0044 1 100 0 1.9921875 ECU_ADDRESS 0xFFFF2B5F /begin FUNCTION_LIST KF7-500.21[19] /end FUNCTION_LIST /end MEASUREMENT
/begin MEASUREMENT vEQURT_R#2 "Lambda control phase agreement condition counter" UBYTE COMP_0044 1 100 0 1.9921875 ECU_ADDRESS 0xFFFF2B60 /begin FUNCTION_LIST KF7-500.21[19] /end FUNCTION_LIST /end MEASUREMENT
/begin MEASUREMENT vFCATD "A parameter monitor flag for the experiment" UBYTE COMP_0004 1 100 0 255 ECU_ADDRESS 0xFFFF2D0C /begin FUNCTION_LIST KF7-500.21[19] /end FUNCTION_LIST /end MEASUREMENT
/begin MEASUREMENT vFCATD_R#1 "A parameter monitor flag for the experiment" UBYTE COMP_0004 1 100 0 255 ECU_ADDRESS 0xFFFF2D0C /begin FUNCTION_LIST KF7-500.21[19] /end FUNCTION_LIST /end MEASUREMENT
/begin MEASUREMENT vFCATD_R#2 "A parameter monitor flag for the experiment" UBYTE COMP_0004 1 100 0 255 ECU_ADDRESS 0xFFFF2D0D /begin FUNCTION_LIST KF7-500.21[19] /end FUNCTION_LIST /end MEASUREMENT
/begin MEASUREMENT vFFMFCA "The occurrence misfire number (the part of A) by the region" UBYTE COMP_0016 1 100 0 255 ECU_ADDRESS 0xFFFF2D55 /begin FUNCTION_LIST KF7-500.26[17] /end FUNCTION_LIST /end MEASUREMENT
/begin MEASUREMENT vFFMFCB "The occurrence misfire number (the part of B) by the region" UBYTE COMP_0016 1 100 0 255 ECU_ADDRESS 0xFFFF2D56 /begin FUNCTION_LIST KF7-500.26[17] /end FUNCTION_LIST /end MEASUREMENT
/begin MEASUREMENT vFFMFCC "The occurrence misfire number (the part of C) by the region" UBYTE COMP_0016 1 100 0 255 ECU_ADDRESS 0xFFFF2D57 /begin FUNCTION_LIST KF7-500.26[17] /end FUNCTION_LIST /end MEASUREMENT
/begin MEASUREMENT vFFMFCD "The occurrence misfire number (the part of D) by the region" UBYTE COMP_0016 1 100 0 255 ECU_ADDRESS 0xFFFF2D58 /begin FUNCTION_LIST KF7-500.26[17] /end FUNCTION_LIST /end MEASUREMENT
/begin MEASUREMENT vFFMFCE "The occurrence misfire number (the part of E) by the region" UBYTE COMP_0016 1 100 0 255 ECU_ADDRESS 0xFFFF2D59 /begin FUNCTION_LIST KF7-500.26[17] /end FUNCTION_LIST /end MEASUREMENT
/begin MEASUREMENT vFFMFCF "The occurrence misfire number (the part of F) by the region" UBYTE COMP_0016 1 100 0 255 ECU_ADDRESS 0xFFFF2D5A /begin FUNCTION_LIST KF7-500.26[17] /end FUNCTION_LIST /end MEASUREMENT
/begin MEASUREMENT vFHFMEM "C>=MCTH3 memory flag" UWORD COMP_0068 1 100 0 65535 ECU_ADDRESS 0xFFFF362E /begin FUNCTION_LIST KF7-500.26[17] /end FUNCTION_LIST /end MEASUREMENT
/begin MEASUREMENT vFMFMEA "For the misfire conditions memory flag multiple cylinder misfire" UWORD COMP_0068 1 100 0 65535 ECU_ADDRESS 0xFFFF3630 /begin FUNCTION_LIST KF7-500.26[17] /end FUNCTION_LIST /end MEASUREMENT
/begin MEASUREMENT vFMFMEB "A (confrontation) misfire conditions memory flag for the multiple cylinder" UWORD COMP_0068 1 100 0 65535 ECU_ADDRESS 0xFFFF3632 /begin FUNCTION_LIST KF7-500.26[17] /end FUNCTION_LIST /end MEASUREMENT
/begin MEASUREMENT vFMFMEM "For the misfire conditions memory flag single cylinder misfire" UWORD COMP_0068 1 100 0 65535 ECU_ADDRESS 0xFFFF3634 /begin FUNCTION_LIST KF7-500.26[17] /end FUNCTION_LIST /end MEASUREMENT
/begin MEASUREMENT vGFCAT1 "A catalyst diagnosis parameter 1 for the GST output" UBYTE COMP_0068 1 100 0 255 ECU_ADDRESS 0xFFFFA46E /begin FUNCTION_LIST KF7-500.21[19] R904.1.Gst_on_can_1_0_1 /end FUNCTION_LIST /end MEASUREMENT
/begin MEASUREMENT vGFCAT1_R#1 "A catalyst diagnosis parameter 1 for the GST output" UBYTE COMP_0068 1 100 0 255 ECU_ADDRESS 0xFFFFA46E /begin FUNCTION_LIST KF7-500.21[19] R904.1.Gst_on_can_1_0_1 /end FUNCTION_LIST /end MEASUREMENT
/begin MEASUREMENT vGFCAT1_R#2 "A catalyst diagnosis parameter 1 for the GST output" UBYTE COMP_0068 1 100 0 255 ECU_ADDRESS 0xFFFFA46F /begin FUNCTION_LIST KF7-500.21[19] R904.1.Gst_on_can_1_0_1 /end FUNCTION_LIST /end MEASUREMENT
/begin MEASUREMENT vGFCAT2 "A catalyst diagnosis parameter (stage 2) for the GST output" UBYTE COMP_0085_S 1 100 0 255 ECU_ADDRESS 0xFFFFA470 /begin FUNCTION_LIST KF7-500.21[19] R904.1.Gst_on_can_1_0_1 /end FUNCTION_LIST /end MEASUREMENT
/begin MEASUREMENT vGFCAT2_R#1 "A catalyst diagnosis parameter (stage 2) for the GST output" UBYTE COMP_0085_S 1 100 0 255 ECU_ADDRESS 0xFFFFA470 /begin FUNCTION_LIST KF7-500.21[19] R904.1.Gst_on_can_1_0_1 /end FUNCTION_LIST /end MEASUREMENT
/begin MEASUREMENT vGFCAT2_R#2 "A catalyst diagnosis parameter (stage 2) for the GST output" UBYTE COMP_0085_S 1 100 0 255 ECU_ADDRESS 0xFFFFA471 /begin FUNCTION_LIST KF7-500.21[19] R904.1.Gst_on_can_1_0_1 /end FUNCTION_LIST /end MEASUREMENT
/begin MEASUREMENT vGNGMS "A catalyst diagnosis limit (stage 2) for the GST output" UBYTE COMP_0085_S 1 100 0 255 ECU_ADDRESS 0xFFFFA47E /begin FUNCTION_LIST KF7-500.21[19] R904.1.Gst_on_can_1_0_1 /end FUNCTION_LIST /end MEASUREMENT
/begin MEASUREMENT vGNGMS_R#1 "A catalyst diagnosis limit (stage 2) for the GST output" UBYTE COMP_0085_S 1 100 0 255 ECU_ADDRESS 0xFFFFA47E /begin FUNCTION_LIST KF7-500.21[19] R904.1.Gst_on_can_1_0_1 /end FUNCTION_LIST /end MEASUREMENT
/begin MEASUREMENT vGNGMS_R#2 "A catalyst diagnosis limit (stage 2) for the GST output" UBYTE COMP_0085_S 1 100 0 255 ECU_ADDRESS 0xFFFFA47F /begin FUNCTION_LIST KF7-500.21[19] R904.1.Gst_on_can_1_0_1 /end FUNCTION_LIST /end MEASUREMENT
/begin MEASUREMENT vGRDTNT "TNIT inclination coefficient" SLONG COMP_0433 1 100 -214748364.8 214748364.7 ECU_ADDRESS 0xFFFF3640 /begin FUNCTION_LIST KF7-500.26[17] /end FUNCTION_LIST /end MEASUREMENT
/begin MEASUREMENT vGRO2 "A parameter for the rest O2/S diagnosis GST" UBYTE COMP_0104 1 100 0 2550 ECU_ADDRESS 0xFFFFA484 /begin FUNCTION_LIST KF7-500.24[10] /end FUNCTION_LIST /end MEASUREMENT
/begin MEASUREMENT vGRO2H "A parameter for the rest O2/H GST" UBYTE COMP_0054 1 100 0 5100 ECU_ADDRESS 0xFFFFB5FE /begin FUNCTION_LIST KF7-500.25A[7] /end FUNCTION_LIST /end MEASUREMENT
/begin MEASUREMENT vGRO2N "A parameter for the rest O2/S diagnosis GST" UBYTE COMP_0104 1 100 0 2550 ECU_ADDRESS 0xFFFFB794 /begin FUNCTION_LIST KF7-500.24[10] R901.1.Diag_on_can_app_1_6_2 /end FUNCTION_LIST /end MEASUREMENT
/begin MEASUREMENT vGRO2R "A parameter for the rest O2/S diagnosis GST" UBYTE COMP_0104 1 100 0 2550 ECU_ADDRESS 0xFFFFB796 /begin FUNCTION_LIST KF7-500.24[10] R901.1.Diag_on_can_app_1_6_2 /end FUNCTION_LIST /end MEASUREMENT
/begin MEASUREMENT vGRO2X "A parameter for the rest O2/S diagnosis GST" UBYTE COMP_0104 1 100 0 2550 ECU_ADDRESS 0xFFFFB798 /begin FUNCTION_LIST KF7-500.24[10] R901.1.Diag_on_can_app_1_6_2 /end FUNCTION_LIST /end MEASUREMENT
/begin MEASUREMENT vHSTNT3 "Compensation TINT memory 3" ULONG COMP_0376 1 100 0 429496729.5 ECU_ADDRESS 0xFFFF3650 /begin FUNCTION_LIST KF7-500.26[17] /end FUNCTION_LIST /end MEASUREMENT
/begin MEASUREMENT vHSTNT8 "Compensation TINT memory 8" ULONG COMP_0376 1 100 0 429496729.5 ECU_ADDRESS 0xFFFF3654 /begin FUNCTION_LIST KF7-500.26[17] /end FUNCTION_LIST /end MEASUREMENT
/begin MEASUREMENT vHSTNT9 "Compensation TINT memory 9" ULONG COMP_0376 1 100 0 429496729.5 ECU_ADDRESS 0xFFFF3658 /begin FUNCTION_LIST KF7-500.26[17] /end FUNCTION_LIST /end MEASUREMENT
/begin MEASUREMENT vISCCNT "A counter (for the RATE law) for ISC function diagnosis frequency measuring" UWORD COMP_0016 1 100 0 65535 ECU_ADDRESS 0xFFFFA4A8 /begin FUNCTION_LIST KF7-500.38A[4] KF7-580.1[8] /end FUNCTION_LIST /end MEASUREMENT
/begin MEASUREMENT vJGEVP1 "Line pressure sensor voltage load mean" UBYTE COMP_0054 1 100 0 5100 ECU_ADDRESS 0xFFFF2E6B /begin FUNCTION_LIST KF7-500.30[8] /end FUNCTION_LIST /end MEASUREMENT
/begin MEASUREMENT vJGEVP2 "At the time of the bypass close, line pressure" UBYTE COMP_0054 1 100 0 5100 ECU_ADDRESS 0xFFFF2E6C /begin FUNCTION_LIST KF7-500.30[8] /end FUNCTION_LIST /end MEASUREMENT
/begin MEASUREMENT vKCTVSP "Vehicle speed compensation coefficient" UBYTE COMP_0009 1 100 0 199.21875 ECU_ADDRESS 0xFFFF2E7A /begin FUNCTION_LIST KF7-500.21[19] /end FUNCTION_LIST /end MEASUREMENT
/begin MEASUREMENT vKTEXDY "For a long time, at the time of the low temperature, delay timer" UBYTE COMP_0096 1 100 0 2550 ECU_ADDRESS 0xFFFF2E90 /begin FUNCTION_LIST KF7-500.21[19] /end FUNCTION_LIST /end MEASUREMENT
/begin MEASUREMENT vKTNT "A TINT compensation coefficient by the cylinder" UWORD COMP_0456 1 100 0 1.999970916 ECU_ADDRESS 0xFFFF36B0 /begin FUNCTION_LIST KF7-500.26[17] /end FUNCTION_LIST /end MEASUREMENT
/begin MEASUREMENT vKWCT1 "Filter time constant (heat transmission clause)" UWORD COMP_0410 1 100 0 99.9985458 ECU_ADDRESS 0xFFFF2E94 /begin FUNCTION_LIST KF7-500.21[19] /end FUNCTION_LIST /end MEASUREMENT
/begin MEASUREMENT vKWCT2 "Filter time constant (heat ì± clause)" UWORD COMP_0410 1 100 0 99.9985458 ECU_ADDRESS 0xFFFF2E96 /begin FUNCTION_LIST KF7-500.21[19] /end FUNCTION_LIST /end MEASUREMENT
/begin MEASUREMENT vMATGK "KTNIT cancellation MISG judgement value" UBYTE COMP_0605_S 1 100 -128 127 ECU_ADDRESS 0xFFFF2EEE /begin FUNCTION_LIST KF7-500.26[17] /end FUNCTION_LIST /end MEASUREMENT
/begin MEASUREMENT vMATH1 "Judgement cancellation threshold" UBYTE COMP_0605_S 1 100 -128 127 ECU_ADDRESS 0xFFFF2EEF /begin FUNCTION_LIST KF7-500.26[17] /end FUNCTION_LIST /end MEASUREMENT
/begin MEASUREMENT vMATH2 "MISA threshold" UBYTE COMP_0605_S 1 100 -128 127 ECU_ADDRESS 0xFFFF36BB /begin FUNCTION_LIST KF7-500.26[17] /end FUNCTION_LIST /end MEASUREMENT
/begin MEASUREMENT vMATH3 "Judgement cancellation threshold" UBYTE COMP_0605_S 1 100 -128 127 ECU_ADDRESS 0xFFFF2EF0 /begin FUNCTION_LIST KF7-500.26[17] /end FUNCTION_LIST /end MEASUREMENT
/begin MEASUREMENT vMATH5 "MISA threshold" UBYTE COMP_0605_S 1 100 -128 127 ECU_ADDRESS 0xFFFF2EF1 /begin FUNCTION_LIST KF7-500.26[17] /end FUNCTION_LIST /end MEASUREMENT
/begin MEASUREMENT vMATH6 "MISA threshold" UBYTE COMP_0605_S 1 100 -128 127 ECU_ADDRESS 0xFFFF2EF2 /begin FUNCTION_LIST KF7-500.26[17] /end FUNCTION_LIST /end MEASUREMENT
/begin MEASUREMENT vMCTH1 "MISC threshold" UBYTE COMP_0605_S 1 100 -128 127 ECU_ADDRESS 0xFFFF2F74 /begin FUNCTION_LIST KF7-500.26[17] /end FUNCTION_LIST /end MEASUREMENT
/begin MEASUREMENT vMCTH2 "MISC threshold" UBYTE COMP_0605_S 1 100 -128 127 ECU_ADDRESS 0xFFFF2F75 /begin FUNCTION_LIST KF7-500.26[17] /end FUNCTION_LIST /end MEASUREMENT
/begin MEASUREMENT vMCTH3 "Judgement cancellation MISC threshold" UBYTE COMP_0605_S 1 100 -128 127 ECU_ADDRESS 0xFFFF2F76 /begin FUNCTION_LIST KF7-500.26[17] /end FUNCTION_LIST /end MEASUREMENT
/begin MEASUREMENT vMCTH5 "MISC threshold" UBYTE COMP_0605_S 1 100 -128 127 ECU_ADDRESS 0xFFFF2F77 /begin FUNCTION_LIST KF7-500.26[17] /end FUNCTION_LIST /end MEASUREMENT
/begin MEASUREMENT vMCTH6 "MISC threshold" UBYTE COMP_0605_S 1 100 -128 127 ECU_ADDRESS 0xFFFF2F78 /begin FUNCTION_LIST KF7-500.26[17] /end FUNCTION_LIST /end MEASUREMENT
/begin MEASUREMENT vMCTH7 "MISC threshold" UBYTE COMP_0605_S 1 100 -128 127 ECU_ADDRESS 0xFFFF2F79 /begin FUNCTION_LIST KF7-500.26[17] /end FUNCTION_LIST /end MEASUREMENT
/begin MEASUREMENT vME1000 "On every 1000 turns, MFCEM maximum value" UBYTE COMP_0016 1 100 0 255 ECU_ADDRESS 0xFFFFB7A2 /begin FUNCTION_LIST KF7-500.26[17] R901.1.Diag_on_can_app_1_6_2 /end FUNCTION_LIST /end MEASUREMENT
/begin MEASUREMENT vMETH1 "MISE threshold" UBYTE COMP_0605_S 1 100 -128 127 ECU_ADDRESS 0xFFFF36BC /begin FUNCTION_LIST KF7-500.26[17] /end FUNCTION_LIST /end MEASUREMENT
/begin MEASUREMENT vMFA200 "200Å~FUKBAI# rotation every MFAID maximum value" UBYTE COMP_0016 1 100 0 255 ECU_ADDRESS 0xFFFFA55A /begin FUNCTION_LIST KF7-500.26[17] /end FUNCTION_LIST /end MEASUREMENT
/begin MEASUREMENT vMFAIA "Multiple cylinder misfire number counter (total)" UWORD COMP_0016 1 100 0 65535 ECU_ADDRESS 0xFFFF36BE /begin FUNCTION_LIST KF7-500.26[17] /end FUNCTION_LIST /end MEASUREMENT
/begin MEASUREMENT vMFAID "For the misfire occurrence number counter multiple cylinder misfire" UWORD COMP_0016 1 100 0 65535 ECU_ADDRESS 0xFFFF36C0 /begin FUNCTION_LIST KF7-500.26[17] /end FUNCTION_LIST /end MEASUREMENT
/begin MEASUREMENT vMFAIT "A multiple cylinder misfire occurrence number counter (confrontation) by the cylinder" UWORD COMP_0016 1 100 0 65535 ECU_ADDRESS 0xFFFF36CE /begin FUNCTION_LIST KF7-500.26[17] /end FUNCTION_LIST /end MEASUREMENT
/begin MEASUREMENT vMFAYSI "Tooth position deviation judgement RGPHS1 monitor number of times counter" UWORD COMP_0016 1 100 0 65535 ECU_ADDRESS 0xFFFF4074 /begin FUNCTION_LIST KF7-500.26[17] /end FUNCTION_LIST /end MEASUREMENT
/begin MEASUREMENT vMFC200 "200Å~CATBAI# rotation every MFCAT maximum value" UBYTE COMP_0016 1 100 0 255 ECU_ADDRESS 0xFFFFA561 /begin FUNCTION_LIST KF7-500.26[17] /end FUNCTION_LIST /end MEASUREMENT
/begin MEASUREMENT vMFCAT "For the misfire occurrence number counter catalyst region" UWORD COMP_0016 1 100 0 65535 ECU_ADDRESS 0xFFFF36DC /begin FUNCTION_LIST KF7-500.26[17] /end FUNCTION_LIST /end MEASUREMENT
/begin MEASUREMENT vMFCEM "For the misfire occurrence number counter emission catalyst" UWORD COMP_0016 1 100 0 65535 ECU_ADDRESS 0xFFFF36EA /begin FUNCTION_LIST KF7-500.26[17] /end FUNCTION_LIST /end MEASUREMENT
/begin MEASUREMENT vMFCLVA "Misfire judgement CLV (for the catalyst criteria)" UBYTE COMP_0463 1 100 0 99.99999981 ECU_ADDRESS 0xFFFFA568 /begin FUNCTION_LIST KF7-500.26[17] R000.4.EepAlloc_1_2_2 /end FUNCTION_LIST /end MEASUREMENT
/begin MEASUREMENT vMFCLVB "Misfire judgement region CLV (after the start, for the emission criteria)" UBYTE COMP_0463 1 100 0 99.99999981 ECU_ADDRESS 0xFFFFA569 /begin FUNCTION_LIST KF7-500.26[17] R000.4.EepAlloc_1_2_2 /end FUNCTION_LIST /end MEASUREMENT
/begin MEASUREMENT vMFCLVC "Misfire judgement region CLV (usually, for the emission criteria)" UBYTE COMP_0463 1 100 0 99.99999981 ECU_ADDRESS 0xFFFFA56A /begin FUNCTION_LIST KF7-500.26[17] R000.4.EepAlloc_1_2_2 /end FUNCTION_LIST /end MEASUREMENT
/begin MEASUREMENT vMFCSTSW "Starter condition mask misfire number of times maximum value" UWORD COMP_0016 1 100 0 65535 ECU_ADDRESS 0xFFFFB534 /begin FUNCTION_LIST KF7-500.26[17] /end FUNCTION_LIST /end MEASUREMENT
/begin MEASUREMENT vMFCYMX "A specific cylinder concentration rate" UBYTE COMP_0027 1 100 0 255 ECU_ADDRESS 0xFFFFA56B /begin FUNCTION_LIST KF7-500.26[17] /end FUNCTION_LIST /end MEASUREMENT
/begin MEASUREMENT vMFDVCA "After the NG judgement, driving-cycle counter (for the catalyst criteria)" UBYTE COMP_0016 1 100 0 255 ECU_ADDRESS 0xFFFFA56D /begin FUNCTION_LIST KF7-500.26[17] R000.4.EepAlloc_1_2_2 /end FUNCTION_LIST /end MEASUREMENT
/begin MEASUREMENT vMFDVCB "After the NG judgement, driving-cycle counter (after the start, for the emission criteria)" UBYTE COMP_0016 1 100 0 255 ECU_ADDRESS 0xFFFFA56E /begin FUNCTION_LIST KF7-500.26[17] R000.4.EepAlloc_1_2_2 /end FUNCTION_LIST /end MEASUREMENT
/begin MEASUREMENT vMFDVCC "After the NG judgement, driving-cycle counter (usually, for the emission criteria)" UBYTE COMP_0016 1 100 0 255 ECU_ADDRESS 0xFFFFA56F /begin FUNCTION_LIST KF7-500.26[17] R000.4.EepAlloc_1_2_2 /end FUNCTION_LIST /end MEASUREMENT
/begin MEASUREMENT vMFN11 "The new diagnosis region rush number of times" ULONG COMP_0030 1 100 0 4294967295 ECU_ADDRESS 0xFFFFA570 /begin FUNCTION_LIST KF7-500.26[17] /end FUNCTION_LIST /end MEASUREMENT
/begin MEASUREMENT vMFN12 "The new diagnosis region rush number of times" ULONG COMP_0030 1 100 0 4294967295 ECU_ADDRESS 0xFFFFA574 /begin FUNCTION_LIST KF7-500.26[17] /end FUNCTION_LIST /end MEASUREMENT
/begin MEASUREMENT vMFN13 "The new diagnosis region rush number of times" ULONG COMP_0030 1 100 0 4294967295 ECU_ADDRESS 0xFFFFA578 /begin FUNCTION_LIST KF7-500.26[17] /end FUNCTION_LIST /end MEASUREMENT
/begin MEASUREMENT vMFN14 "The new diagnosis region rush number of times" ULONG COMP_0030 1 100 0 4294967295 ECU_ADDRESS 0xFFFFA57C /begin FUNCTION_LIST KF7-500.26[17] /end FUNCTION_LIST /end MEASUREMENT
/begin MEASUREMENT vMFN21 "The new diagnosis region rush number of times" ULONG COMP_0030 1 100 0 4294967295 ECU_ADDRESS 0xFFFFA580 /begin FUNCTION_LIST KF7-500.26[17] /end FUNCTION_LIST /end MEASUREMENT
/begin MEASUREMENT vMFN22 "The new diagnosis region rush number of times" ULONG COMP_0030 1 100 0 4294967295 ECU_ADDRESS 0xFFFFA584 /begin FUNCTION_LIST KF7-500.26[17] /end FUNCTION_LIST /end MEASUREMENT
/begin MEASUREMENT vMFN23 "The new diagnosis region rush number of times" ULONG COMP_0030 1 100 0 4294967295 ECU_ADDRESS 0xFFFFA588 /begin FUNCTION_LIST KF7-500.26[17] /end FUNCTION_LIST /end MEASUREMENT
/begin MEASUREMENT vMFN24 "The new diagnosis region rush number of times" ULONG COMP_0030 1 100 0 4294967295 ECU_ADDRESS 0xFFFFA58C /begin FUNCTION_LIST KF7-500.26[17] /end FUNCTION_LIST /end MEASUREMENT
/begin MEASUREMENT vMFNAC "Misfire warning number of times counter (for the multiple cylinder misfire catalyst criteria)" UBYTE COMP_0016 1 100 0 255 ECU_ADDRESS 0xFFFF2F82 /begin FUNCTION_LIST KF7-500.26[17] /end FUNCTION_LIST /end MEASUREMENT
/begin MEASUREMENT vMFNAE "Misfire warning number of times counter (for the multiple cylinder misfire emission criteria)" UBYTE COMP_0016 1 100 0 255 ECU_ADDRESS 0xFFFF2F83 /begin FUNCTION_LIST KF7-500.26[17] /end FUNCTION_LIST /end MEASUREMENT
/begin MEASUREMENT vMFNCT "Misfire warning number of times counter (for the catalyst criteria)" UBYTE COMP_0016 1 100 0 255 ECU_ADDRESS 0xFFFF2F84 /begin FUNCTION_LIST KF7-500.26[17] /end FUNCTION_LIST /end MEASUREMENT
/begin MEASUREMENT vMFNEM "Misfire warning number of times counter (for the emission criteria)" UBYTE COMP_0016 1 100 0 255 ECU_ADDRESS 0xFFFF2F85 /begin FUNCTION_LIST KF7-500.26[17] /end FUNCTION_LIST /end MEASUREMENT
/begin MEASUREMENT vMFRPMA "Misfire judgement region engine speed (for the catalyst criteria)" UWORD COMP_0006 1 100 0 819187.5 ECU_ADDRESS 0xFFFFA590 /begin FUNCTION_LIST KF7-500.26[17] R000.4.EepAlloc_1_2_2 /end FUNCTION_LIST /end MEASUREMENT
/begin MEASUREMENT vMFRPMB "Misfire judgement region engine speed (after the start, for the emission criteria)" UWORD COMP_0006 1 100 0 819187.5 ECU_ADDRESS 0xFFFFA592 /begin FUNCTION_LIST KF7-500.26[17] R000.4.EepAlloc_1_2_2 /end FUNCTION_LIST /end MEASUREMENT
/begin MEASUREMENT vMFRPMC "Misfire judgement region engine speed (usually, for the emission criteria)" UWORD COMP_0006 1 100 0 819187.5 ECU_ADDRESS 0xFFFFA594 /begin FUNCTION_LIST KF7-500.26[17] R000.4.EepAlloc_1_2_2 /end FUNCTION_LIST /end MEASUREMENT
/begin MEASUREMENT vMFSDMI "Relaxation time-less continuance NG judgement number of times" UWORD COMP_0016 1 100 0 65535 ECU_ADDRESS 0xFFFFA598 /begin FUNCTION_LIST KF7-500.26[17] /end FUNCTION_LIST /end MEASUREMENT
/begin MEASUREMENT vMFSDNG "Relaxation time-less NG judgement number of times" UWORD COMP_0016 1 100 0 65535 ECU_ADDRESS 0xFFFFA59A /begin FUNCTION_LIST KF7-500.26[17] /end FUNCTION_LIST /end MEASUREMENT
/begin MEASUREMENT vMFSDOK "Relaxation time-less OK judgement number of times" UWORD COMP_0016 1 100 0 65535 ECU_ADDRESS 0xFFFFA59C /begin FUNCTION_LIST KF7-500.26[17] /end FUNCTION_LIST /end MEASUREMENT
/begin MEASUREMENT vMFSEM "At the time of NG, the number of misfires" UWORD COMP_0016 1 100 0 65535 ECU_ADDRESS 0xFFFFA59E /begin FUNCTION_LIST KF7-500.26[17] /end FUNCTION_LIST /end MEASUREMENT
/begin MEASUREMENT vMFSEM_R#1 "At the time of NG, the number of misfires" UWORD COMP_0016 1 100 0 65535 ECU_ADDRESS 0xFFFFA59E /begin FUNCTION_LIST KF7-500.26[17] /end FUNCTION_LIST /end MEASUREMENT
/begin MEASUREMENT vMFSEM_R#2 "At the time of NG, the number of misfires" UWORD COMP_0016 1 100 0 65535 ECU_ADDRESS 0xFFFFA5A0 /begin FUNCTION_LIST KF7-500.26[17] /end FUNCTION_LIST /end MEASUREMENT
/begin MEASUREMENT vMFSEM_R#3 "At the time of NG, the number of misfires" UWORD COMP_0016 1 100 0 65535 ECU_ADDRESS 0xFFFFA5A2 /begin FUNCTION_LIST KF7-500.26[17] /end FUNCTION_LIST /end MEASUREMENT
/begin MEASUREMENT vMFSEM_R#4 "At the time of NG, the number of misfires" UWORD COMP_0016 1 100 0 65535 ECU_ADDRESS 0xFFFFA5A4 /begin FUNCTION_LIST KF7-500.26[17] /end FUNCTION_LIST /end MEASUREMENT
/begin MEASUREMENT vMFSEM_R#5 "At the time of NG, the number of misfires" UWORD COMP_0016 1 100 0 65535 ECU_ADDRESS 0xFFFFA5A6 /begin FUNCTION_LIST KF7-500.26[17] /end FUNCTION_LIST /end MEASUREMENT
/begin MEASUREMENT vMFSEM_R#6 "At the time of NG, the number of misfires" UWORD COMP_0016 1 100 0 65535 ECU_ADDRESS 0xFFFFA5A8 /begin FUNCTION_LIST KF7-500.26[17] /end FUNCTION_LIST /end MEASUREMENT
/begin MEASUREMENT vMFSEM_R#7 "At the time of NG, the number of misfires" UWORD COMP_0016 1 100 0 65535 ECU_ADDRESS 0xFFFFA5AA /begin FUNCTION_LIST KF7-500.26[17] /end FUNCTION_LIST /end MEASUREMENT
/begin MEASUREMENT vMFSEM_R#8 "At the time of NG, the number of misfires" UWORD COMP_0016 1 100 0 65535 ECU_ADDRESS 0xFFFFA5AC /begin FUNCTION_LIST KF7-500.26[17] /end FUNCTION_LIST /end MEASUREMENT
/begin MEASUREMENT vMFSKM "At the time of NG, mileage" UWORD COMP_0607_S 1 100 0 1684249.5 ECU_ADDRESS 0xFFFFA5AE /begin FUNCTION_LIST KF7-500.26[17] /end FUNCTION_LIST /end MEASUREMENT
/begin MEASUREMENT vMFSKM_R#1 "At the time of NG, mileage" UWORD COMP_0607_S 1 100 0 1684249.5 ECU_ADDRESS 0xFFFFA5AE /begin FUNCTION_LIST KF7-500.26[17] /end FUNCTION_LIST /end MEASUREMENT
/begin MEASUREMENT vMFSKM_R#2 "At the time of NG, mileage" UWORD COMP_0607_S 1 100 0 1684249.5 ECU_ADDRESS 0xFFFFA5B0 /begin FUNCTION_LIST KF7-500.26[17] /end FUNCTION_LIST /end MEASUREMENT
/begin MEASUREMENT vMFSKM_R#3 "At the time of NG, mileage" UWORD COMP_0607_S 1 100 0 1684249.5 ECU_ADDRESS 0xFFFFA5B2 /begin FUNCTION_LIST KF7-500.26[17] /end FUNCTION_LIST /end MEASUREMENT
/begin MEASUREMENT vMFSKM_R#4 "At the time of NG, mileage" UWORD COMP_0607_S 1 100 0 1684249.5 ECU_ADDRESS 0xFFFFA5B4 /begin FUNCTION_LIST KF7-500.26[17] /end FUNCTION_LIST /end MEASUREMENT
/begin MEASUREMENT vMFSKM_R#5 "At the time of NG, mileage" UWORD COMP_0607_S 1 100 0 1684249.5 ECU_ADDRESS 0xFFFFA5B6 /begin FUNCTION_LIST KF7-500.26[17] /end FUNCTION_LIST /end MEASUREMENT
/begin MEASUREMENT vMFSKM_R#6 "At the time of NG, mileage" UWORD COMP_0607_S 1 100 0 1684249.5 ECU_ADDRESS 0xFFFFA5B8 /begin FUNCTION_LIST KF7-500.26[17] /end FUNCTION_LIST /end MEASUREMENT
/begin MEASUREMENT vMFSKM_R#7 "At the time of NG, mileage" UWORD COMP_0607_S 1 100 0 1684249.5 ECU_ADDRESS 0xFFFFA5BA /begin FUNCTION_LIST KF7-500.26[17] /end FUNCTION_LIST /end MEASUREMENT
/begin MEASUREMENT vMFSKM_R#8 "At the time of NG, mileage" UWORD COMP_0607_S 1 100 0 1684249.5 ECU_ADDRESS 0xFFFFA5BC /begin FUNCTION_LIST KF7-500.26[17] /end FUNCTION_LIST /end MEASUREMENT
/begin MEASUREMENT vMFSMN "At the time of NG, speed" UBYTE COMP_0000 1 100 0 6375 ECU_ADDRESS 0xFFFFA5BE /begin FUNCTION_LIST KF7-500.26[17] /end FUNCTION_LIST /end MEASUREMENT
/begin MEASUREMENT vMFSMN_R#1 "At the time of NG, speed" UBYTE COMP_0000 1 100 0 6375 ECU_ADDRESS 0xFFFFA5BE /begin FUNCTION_LIST KF7-500.26[17] /end FUNCTION_LIST /end MEASUREMENT
/begin MEASUREMENT vMFSMN_R#2 "At the time of NG, speed" UBYTE COMP_0000 1 100 0 6375 ECU_ADDRESS 0xFFFFA5BF /begin FUNCTION_LIST KF7-500.26[17] /end FUNCTION_LIST /end MEASUREMENT
/begin MEASUREMENT vMFSMN_R#3 "At the time of NG, speed" UBYTE COMP_0000 1 100 0 6375 ECU_ADDRESS 0xFFFFA5C0 /begin FUNCTION_LIST KF7-500.26[17] /end FUNCTION_LIST /end MEASUREMENT
/begin MEASUREMENT vMFSMN_R#4 "At the time of NG, speed" UBYTE COMP_0000 1 100 0 6375 ECU_ADDRESS 0xFFFFA5C1 /begin FUNCTION_LIST KF7-500.26[17] /end FUNCTION_LIST /end MEASUREMENT
/begin MEASUREMENT vMFSMN_R#5 "At the time of NG, speed" UBYTE COMP_0000 1 100 0 6375 ECU_ADDRESS 0xFFFFA5C2 /begin FUNCTION_LIST KF7-500.26[17] /end FUNCTION_LIST /end MEASUREMENT
/begin MEASUREMENT vMFSMN_R#6 "At the time of NG, speed" UBYTE COMP_0000 1 100 0 6375 ECU_ADDRESS 0xFFFFA5C3 /begin FUNCTION_LIST KF7-500.26[17] /end FUNCTION_LIST /end MEASUREMENT
/begin MEASUREMENT vMFSMN_R#7 "At the time of NG, speed" UBYTE COMP_0000 1 100 0 6375 ECU_ADDRESS 0xFFFFA5C4 /begin FUNCTION_LIST KF7-500.26[17] /end FUNCTION_LIST /end MEASUREMENT
/begin MEASUREMENT vMFSMN_R#8 "At the time of NG, speed" UBYTE COMP_0000 1 100 0 6375 ECU_ADDRESS 0xFFFFA5C5 /begin FUNCTION_LIST KF7-500.26[17] /end FUNCTION_LIST /end MEASUREMENT
/begin MEASUREMENT vMFSTA "At the time of NG, at least, intake air temperature" UBYTE COMP_0035 1 100 -50 205 ECU_ADDRESS 0xFFFFA5C6 /begin FUNCTION_LIST KF7-500.26[17] /end FUNCTION_LIST /end MEASUREMENT
/begin MEASUREMENT vMFSTA_R#1 "At the time of NG, at least, intake air temperature" UBYTE COMP_0035 1 100 -50 205 ECU_ADDRESS 0xFFFFA5C6 /begin FUNCTION_LIST KF7-500.26[17] /end FUNCTION_LIST /end MEASUREMENT
/begin MEASUREMENT vMFSTA_R#2 "At the time of NG, at least, intake air temperature" UBYTE COMP_0035 1 100 -50 205 ECU_ADDRESS 0xFFFFA5C7 /begin FUNCTION_LIST KF7-500.26[17] /end FUNCTION_LIST /end MEASUREMENT
/begin MEASUREMENT vMFSTA_R#3 "At the time of NG, at least, intake air temperature" UBYTE COMP_0035 1 100 -50 205 ECU_ADDRESS 0xFFFFA5C8 /begin FUNCTION_LIST KF7-500.26[17] /end FUNCTION_LIST /end MEASUREMENT
/begin MEASUREMENT vMFSTA_R#4 "At the time of NG, at least, intake air temperature" UBYTE COMP_0035 1 100 -50 205 ECU_ADDRESS 0xFFFFA5C9 /begin FUNCTION_LIST KF7-500.26[17] /end FUNCTION_LIST /end MEASUREMENT
/begin MEASUREMENT vMFSTA_R#5 "At the time of NG, at least, intake air temperature" UBYTE COMP_0035 1 100 -50 205 ECU_ADDRESS 0xFFFFA5CA /begin FUNCTION_LIST KF7-500.26[17] /end FUNCTION_LIST /end MEASUREMENT
/begin MEASUREMENT vMFSTA_R#6 "At the time of NG, at least, intake air temperature" UBYTE COMP_0035 1 100 -50 205 ECU_ADDRESS 0xFFFFA5CB /begin FUNCTION_LIST KF7-500.26[17] /end FUNCTION_LIST /end MEASUREMENT
/begin MEASUREMENT vMFSTA_R#7 "At the time of NG, at least, intake air temperature" UBYTE COMP_0035 1 100 -50 205 ECU_ADDRESS 0xFFFFA5CC /begin FUNCTION_LIST KF7-500.26[17] /end FUNCTION_LIST /end MEASUREMENT
/begin MEASUREMENT vMFSTA_R#8 "At the time of NG, at least, intake air temperature" UBYTE COMP_0035 1 100 -50 205 ECU_ADDRESS 0xFFFFA5CD /begin FUNCTION_LIST KF7-500.26[17] /end FUNCTION_LIST /end MEASUREMENT
/begin MEASUREMENT vMFSTP "At the time of NG, TP" UBYTE COMP_0001 1 100 0 31.875 ECU_ADDRESS 0xFFFFA5CE /begin FUNCTION_LIST KF7-500.26[17] /end FUNCTION_LIST /end MEASUREMENT
/begin MEASUREMENT vMFSTP_R#1 "At the time of NG, TP" UBYTE COMP_0001 1 100 0 31.875 ECU_ADDRESS 0xFFFFA5CE /begin FUNCTION_LIST KF7-500.26[17] /end FUNCTION_LIST /end MEASUREMENT
/begin MEASUREMENT vMFSTP_R#2 "At the time of NG, TP" UBYTE COMP_0001 1 100 0 31.875 ECU_ADDRESS 0xFFFFA5CF /begin FUNCTION_LIST KF7-500.26[17] /end FUNCTION_LIST /end MEASUREMENT
/begin MEASUREMENT vMFSTP_R#3 "At the time of NG, TP" UBYTE COMP_0001 1 100 0 31.875 ECU_ADDRESS 0xFFFFA5D0 /begin FUNCTION_LIST KF7-500.26[17] /end FUNCTION_LIST /end MEASUREMENT
/begin MEASUREMENT vMFSTP_R#4 "At the time of NG, TP" UBYTE COMP_0001 1 100 0 31.875 ECU_ADDRESS 0xFFFFA5D1 /begin FUNCTION_LIST KF7-500.26[17] /end FUNCTION_LIST /end MEASUREMENT
/begin MEASUREMENT vMFSTP_R#5 "At the time of NG, TP" UBYTE COMP_0001 1 100 0 31.875 ECU_ADDRESS 0xFFFFA5D2 /begin FUNCTION_LIST KF7-500.26[17] /end FUNCTION_LIST /end MEASUREMENT
/begin MEASUREMENT vMFSTP_R#6 "At the time of NG, TP" UBYTE COMP_0001 1 100 0 31.875 ECU_ADDRESS 0xFFFFA5D3 /begin FUNCTION_LIST KF7-500.26[17] /end FUNCTION_LIST /end MEASUREMENT
/begin MEASUREMENT vMFSTP_R#7 "At the time of NG, TP" UBYTE COMP_0001 1 100 0 31.875 ECU_ADDRESS 0xFFFFA5D4 /begin FUNCTION_LIST KF7-500.26[17] /end FUNCTION_LIST /end MEASUREMENT
/begin MEASUREMENT vMFSTP_R#8 "At the time of NG, TP" UBYTE COMP_0001 1 100 0 31.875 ECU_ADDRESS 0xFFFFA5D5 /begin FUNCTION_LIST KF7-500.26[17] /end FUNCTION_LIST /end MEASUREMENT
/begin MEASUREMENT vMFSTW "At the time of NG, coolant temperature" UBYTE COMP_0035 1 100 -50 205 ECU_ADDRESS 0xFFFFA5D6 /begin FUNCTION_LIST KF7-500.26[17] /end FUNCTION_LIST /end MEASUREMENT
/begin MEASUREMENT vMFSTW_R#1 "At the time of NG, coolant temperature" UBYTE COMP_0035 1 100 -50 205 ECU_ADDRESS 0xFFFFA5D6 /begin FUNCTION_LIST KF7-500.26[17] /end FUNCTION_LIST /end MEASUREMENT
/begin MEASUREMENT vMFSTW_R#2 "At the time of NG, coolant temperature" UBYTE COMP_0035 1 100 -50 205 ECU_ADDRESS 0xFFFFA5D7 /begin FUNCTION_LIST KF7-500.26[17] /end FUNCTION_LIST /end MEASUREMENT
/begin MEASUREMENT vMFSTW_R#3 "At the time of NG, coolant temperature" UBYTE COMP_0035 1 100 -50 205 ECU_ADDRESS 0xFFFFA5D8 /begin FUNCTION_LIST KF7-500.26[17] /end FUNCTION_LIST /end MEASUREMENT
/begin MEASUREMENT vMFSTW_R#4 "At the time of NG, coolant temperature" UBYTE COMP_0035 1 100 -50 205 ECU_ADDRESS 0xFFFFA5D9 /begin FUNCTION_LIST KF7-500.26[17] /end FUNCTION_LIST /end MEASUREMENT
/begin MEASUREMENT vMFSTW_R#5 "At the time of NG, coolant temperature" UBYTE COMP_0035 1 100 -50 205 ECU_ADDRESS 0xFFFFA5DA /begin FUNCTION_LIST KF7-500.26[17] /end FUNCTION_LIST /end MEASUREMENT
/begin MEASUREMENT vMFSTW_R#6 "At the time of NG, coolant temperature" UBYTE COMP_0035 1 100 -50 205 ECU_ADDRESS 0xFFFFA5DB /begin FUNCTION_LIST KF7-500.26[17] /end FUNCTION_LIST /end MEASUREMENT
/begin MEASUREMENT vMFSTW_R#7 "At the time of NG, coolant temperature" UBYTE COMP_0035 1 100 -50 205 ECU_ADDRESS 0xFFFFA5DC /begin FUNCTION_LIST KF7-500.26[17] /end FUNCTION_LIST /end MEASUREMENT
/begin MEASUREMENT vMFSTW_R#8 "At the time of NG, coolant temperature" UBYTE COMP_0035 1 100 -50 205 ECU_ADDRESS 0xFFFFA5DD /begin FUNCTION_LIST KF7-500.26[17] /end FUNCTION_LIST /end MEASUREMENT
/begin MEASUREMENT vMFSVS "At the time of NG, vehicle speed" UBYTE COMP_0007 1 100 0 510 ECU_ADDRESS 0xFFFFA5DE /begin FUNCTION_LIST KF7-500.26[17] /end FUNCTION_LIST /end MEASUREMENT
/begin MEASUREMENT vMFSVS_R#1 "At the time of NG, vehicle speed" UBYTE COMP_0007 1 100 0 510 ECU_ADDRESS 0xFFFFA5DE /begin FUNCTION_LIST KF7-500.26[17] /end FUNCTION_LIST /end MEASUREMENT
/begin MEASUREMENT vMFSVS_R#2 "At the time of NG, vehicle speed" UBYTE COMP_0007 1 100 0 510 ECU_ADDRESS 0xFFFFA5DF /begin FUNCTION_LIST KF7-500.26[17] /end FUNCTION_LIST /end MEASUREMENT
/begin MEASUREMENT vMFSVS_R#3 "At the time of NG, vehicle speed" UBYTE COMP_0007 1 100 0 510 ECU_ADDRESS 0xFFFFA5E0 /begin FUNCTION_LIST KF7-500.26[17] /end FUNCTION_LIST /end MEASUREMENT
/begin MEASUREMENT vMFSVS_R#4 "At the time of NG, vehicle speed" UBYTE COMP_0007 1 100 0 510 ECU_ADDRESS 0xFFFFA5E1 /begin FUNCTION_LIST KF7-500.26[17] /end FUNCTION_LIST /end MEASUREMENT
/begin MEASUREMENT vMFSVS_R#5 "At the time of NG, vehicle speed" UBYTE COMP_0007 1 100 0 510 ECU_ADDRESS 0xFFFFA5E2 /begin FUNCTION_LIST KF7-500.26[17] /end FUNCTION_LIST /end MEASUREMENT
/begin MEASUREMENT vMFSVS_R#6 "At the time of NG, vehicle speed" UBYTE COMP_0007 1 100 0 510 ECU_ADDRESS 0xFFFFA5E3 /begin FUNCTION_LIST KF7-500.26[17] /end FUNCTION_LIST /end MEASUREMENT
/begin MEASUREMENT vMFSVS_R#7 "At the time of NG, vehicle speed" UBYTE COMP_0007 1 100 0 510 ECU_ADDRESS 0xFFFFA5E4 /begin FUNCTION_LIST KF7-500.26[17] /end FUNCTION_LIST /end MEASUREMENT
/begin MEASUREMENT vMFSVS_R#8 "At the time of NG, vehicle speed" UBYTE COMP_0007 1 100 0 510 ECU_ADDRESS 0xFFFFA5E5 /begin FUNCTION_LIST KF7-500.26[17] /end FUNCTION_LIST /end MEASUREMENT
/begin MEASUREMENT vMFTL "Misfire occurrence number integration counter" UWORD COMP_0016 1 100 0 65535 ECU_ADDRESS 0xFFFFB536 /begin FUNCTION_LIST KF7-500.26[17] /end FUNCTION_LIST /end MEASUREMENT
/begin MEASUREMENT vMFTLINT "At the time of the start, misfire occurrence number integration counter" UWORD COMP_0016 1 100 0 65535 ECU_ADDRESS 0xFFFF36F8 /begin FUNCTION_LIST KF7-500.26[17] /end FUNCTION_LIST /end MEASUREMENT
/begin MEASUREMENT vMFTWA "Misfire judgement region coolant temperature (for the catalyst criteria)" UBYTE COMP_0468 1 100 -40 215 ECU_ADDRESS 0xFFFFA5E6 /begin FUNCTION_LIST KF7-500.26[17] R000.4.EepAlloc_1_2_2 /end FUNCTION_LIST /end MEASUREMENT
/begin MEASUREMENT vMFTWB "Misfire judgement region coolant temperature (after the start, for the emission criteria)" UBYTE COMP_0468 1 100 -40 215 ECU_ADDRESS 0xFFFFA5E7 /begin FUNCTION_LIST KF7-500.26[17] R000.4.EepAlloc_1_2_2 /end FUNCTION_LIST /end MEASUREMENT
/begin MEASUREMENT vMFTWC "Misfire judgement region coolant temperature (usually, for the emission criteria)" UBYTE COMP_0468 1 100 -40 215 ECU_ADDRESS 0xFFFFA5E8 /begin FUNCTION_LIST KF7-500.26[17] R000.4.EepAlloc_1_2_2 /end FUNCTION_LIST /end MEASUREMENT
/begin MEASUREMENT vMFX "The amount of increase in the number of misfire occurrences" UBYTE COMP_0068 1 100 0 255 ECU_ADDRESS 0xFFFF2F8A /begin FUNCTION_LIST KF7-500.26[17] /end FUNCTION_LIST /end MEASUREMENT
/begin MEASUREMENT vMFXQS11 "Misfire counter increase quantity square integration value" ULONG COMP_0068 1 100 0 4294967295 ECU_ADDRESS 0xFFFFA5EC /begin FUNCTION_LIST KF7-500.26[17] /end FUNCTION_LIST /end MEASUREMENT
/begin MEASUREMENT vMFXQS12 "Misfire counter increase quantity square integration value" ULONG COMP_0068 1 100 0 4294967295 ECU_ADDRESS 0xFFFFA5F0 /begin FUNCTION_LIST KF7-500.26[17] /end FUNCTION_LIST /end MEASUREMENT
/begin MEASUREMENT vMFXQS13 "Misfire counter increase quantity square integration value" ULONG COMP_0068 1 100 0 4294967295 ECU_ADDRESS 0xFFFFA5F4 /begin FUNCTION_LIST KF7-500.26[17] /end FUNCTION_LIST /end MEASUREMENT
/begin MEASUREMENT vMFXQS14 "Misfire counter increase quantity square integration value" ULONG COMP_0068 1 100 0 4294967295 ECU_ADDRESS 0xFFFFA5F8 /begin FUNCTION_LIST KF7-500.26[17] /end FUNCTION_LIST /end MEASUREMENT
/begin MEASUREMENT vMFXQS21 "Misfire counter increase quantity square integration value" ULONG COMP_0068 1 100 0 4294967295 ECU_ADDRESS 0xFFFFA5FC /begin FUNCTION_LIST KF7-500.26[17] /end FUNCTION_LIST /end MEASUREMENT
/begin MEASUREMENT vMFXQS22 "Misfire counter increase quantity square integration value" ULONG COMP_0068 1 100 0 4294967295 ECU_ADDRESS 0xFFFFA600 /begin FUNCTION_LIST KF7-500.26[17] /end FUNCTION_LIST /end MEASUREMENT
/begin MEASUREMENT vMFXQS23 "Misfire counter increase quantity square integration value" ULONG COMP_0068 1 100 0 4294967295 ECU_ADDRESS 0xFFFFA604 /begin FUNCTION_LIST KF7-500.26[17] /end FUNCTION_LIST /end MEASUREMENT
/begin MEASUREMENT vMFXQS24 "Misfire counter increase quantity square integration value" ULONG COMP_0068 1 100 0 4294967295 ECU_ADDRESS 0xFFFFA608 /begin FUNCTION_LIST KF7-500.26[17] /end FUNCTION_LIST /end MEASUREMENT
/begin MEASUREMENT vMFXS11 "Misfire counter increase quantity integration value" ULONG COMP_0016 1 100 0 4294967295 ECU_ADDRESS 0xFFFFA60C /begin FUNCTION_LIST KF7-500.26[17] /end FUNCTION_LIST /end MEASUREMENT
/begin MEASUREMENT vMFXS12 "Misfire counter increase quantity integration value" ULONG COMP_0016 1 100 0 4294967295 ECU_ADDRESS 0xFFFFA610 /begin FUNCTION_LIST KF7-500.26[17] /end FUNCTION_LIST /end MEASUREMENT
/begin MEASUREMENT vMFXS13 "Misfire counter increase quantity integration value" ULONG COMP_0016 1 100 0 4294967295 ECU_ADDRESS 0xFFFFA614 /begin FUNCTION_LIST KF7-500.26[17] /end FUNCTION_LIST /end MEASUREMENT
/begin MEASUREMENT vMFXS14 "Misfire counter increase quantity integration value" ULONG COMP_0016 1 100 0 4294967295 ECU_ADDRESS 0xFFFFA618 /begin FUNCTION_LIST KF7-500.26[17] /end FUNCTION_LIST /end MEASUREMENT
/begin MEASUREMENT vMFXS21 "Misfire counter increase quantity integration value" ULONG COMP_0016 1 100 0 4294967295 ECU_ADDRESS 0xFFFFA61C /begin FUNCTION_LIST KF7-500.26[17] /end FUNCTION_LIST /end MEASUREMENT
/begin MEASUREMENT vMFXS22 "Misfire counter increase quantity integration value" ULONG COMP_0016 1 100 0 4294967295 ECU_ADDRESS 0xFFFFA620 /begin FUNCTION_LIST KF7-500.26[17] /end FUNCTION_LIST /end MEASUREMENT
/begin MEASUREMENT vMFXS23 "Misfire counter increase quantity integration value" ULONG COMP_0016 1 100 0 4294967295 ECU_ADDRESS 0xFFFFA624 /begin FUNCTION_LIST KF7-500.26[17] /end FUNCTION_LIST /end MEASUREMENT
/begin MEASUREMENT vMFXS24 "Misfire counter increase quantity integration value" ULONG COMP_0016 1 100 0 4294967295 ECU_ADDRESS 0xFFFFA628 /begin FUNCTION_LIST KF7-500.26[17] /end FUNCTION_LIST /end MEASUREMENT
/begin MEASUREMENT vMGTGK "KTINT cancellation MISG judgement value" UBYTE COMP_0605_S 1 100 -128 127 ECU_ADDRESS 0xFFFF2F8D /begin FUNCTION_LIST KF7-500.26[17] /end FUNCTION_LIST /end MEASUREMENT
/begin MEASUREMENT vMGTH3 "Judgement cancellation threshold" UBYTE COMP_0605_S 1 100 -128 127 ECU_ADDRESS 0xFFFF2F8E /begin FUNCTION_LIST KF7-500.26[17] /end FUNCTION_LIST /end MEASUREMENT
/begin MEASUREMENT vMISB "Misfire parameter" UBYTE COMP_0605_S 1 100 -128 127 ECU_ADDRESS 0xFFFF3700 /begin FUNCTION_LIST KF7-500.26[17] /end FUNCTION_LIST /end MEASUREMENT
/begin MEASUREMENT vMISB_R#1 "Misfire parameter" UBYTE COMP_0605_S 1 100 -128 127 ECU_ADDRESS 0xFFFF3700 /begin FUNCTION_LIST KF7-500.26[17] /end FUNCTION_LIST /end MEASUREMENT
/begin MEASUREMENT vMISB_R#2 "Misfire parameter" UBYTE COMP_0605_S 1 100 -128 127 ECU_ADDRESS 0xFFFF3701 /begin FUNCTION_LIST KF7-500.26[17] /end FUNCTION_LIST /end MEASUREMENT
/begin MEASUREMENT vMISB_R#3 "Misfire parameter" UBYTE COMP_0605_S 1 100 -128 127 ECU_ADDRESS 0xFFFF3702 /begin FUNCTION_LIST KF7-500.26[17] /end FUNCTION_LIST /end MEASUREMENT
/begin MEASUREMENT vMISB_R#4 "Misfire parameter" UBYTE COMP_0605_S 1 100 -128 127 ECU_ADDRESS 0xFFFF3703 /begin FUNCTION_LIST KF7-500.26[17] /end FUNCTION_LIST /end MEASUREMENT
/begin MEASUREMENT vMISE "Misfire parameter" UBYTE COMP_0605_S 1 100 -128 127 ECU_ADDRESS 0xFFFF3705 /begin FUNCTION_LIST KF7-500.26[17] /end FUNCTION_LIST /end MEASUREMENT
/begin MEASUREMENT vMISF "Misfire parameter" UBYTE COMP_0605_S 1 100 -128 127 ECU_ADDRESS 0xFFFF3706 /begin FUNCTION_LIST KF7-500.26[17] /end FUNCTION_LIST /end MEASUREMENT
/begin MEASUREMENT vMISF_R#1 "Misfire parameter" UBYTE COMP_0605_S 1 100 -128 127 ECU_ADDRESS 0xFFFF3706 /begin FUNCTION_LIST KF7-500.26[17] /end FUNCTION_LIST /end MEASUREMENT
/begin MEASUREMENT vMISF_R#2 "Misfire parameter" UBYTE COMP_0605_S 1 100 -128 127 ECU_ADDRESS 0xFFFF3707 /begin FUNCTION_LIST KF7-500.26[17] /end FUNCTION_LIST /end MEASUREMENT
/begin MEASUREMENT vMISF_R#3 "Misfire parameter" UBYTE COMP_0605_S 1 100 -128 127 ECU_ADDRESS 0xFFFF3708 /begin FUNCTION_LIST KF7-500.26[17] /end FUNCTION_LIST /end MEASUREMENT
/begin MEASUREMENT vMISF_R#4 "Misfire parameter" UBYTE COMP_0605_S 1 100 -128 127 ECU_ADDRESS 0xFFFF3709 /begin FUNCTION_LIST KF7-500.26[17] /end FUNCTION_LIST /end MEASUREMENT
/begin MEASUREMENT vMISG "Misfire parameter" UBYTE COMP_0605_S 1 100 -128 127 ECU_ADDRESS 0xFFFF370A /begin FUNCTION_LIST KF7-500.26[17] /end FUNCTION_LIST /end MEASUREMENT
/begin MEASUREMENT vMKTNT "KTNTi mean" UWORD COMP_0456 1 100 0 1.999970916 ECU_ADDRESS 0xFFFF370C /begin FUNCTION_LIST KF7-500.26[17] /end FUNCTION_LIST /end MEASUREMENT
/begin MEASUREMENT vMSATH "Threshold reference value" UBYTE COMP_0608_S 1 100 0 255 ECU_ADDRESS 0xFFFF2FEC /begin FUNCTION_LIST KF7-500.26[17] /end FUNCTION_LIST /end MEASUREMENT
/begin MEASUREMENT vMSATHA "MISA threshold reference value" UBYTE COMP_0608_S 1 100 0 255 ECU_ADDRESS 0xFFFF2FED /begin FUNCTION_LIST KF7-500.26[17] /end FUNCTION_LIST /end MEASUREMENT
/begin MEASUREMENT vMSTRG "STRAG mean" UBYTE COMP_0085_S 1 100 0 255 ECU_ADDRESS 0xFFFF2FF2 /begin FUNCTION_LIST KF7-500.21[19] /end FUNCTION_LIST /end MEASUREMENT
/begin MEASUREMENT vMSTRG_R#1 "STRAG mean" UBYTE COMP_0085_S 1 100 0 255 ECU_ADDRESS 0xFFFF2FF2 /begin FUNCTION_LIST KF7-500.21[19] /end FUNCTION_LIST /end MEASUREMENT
/begin MEASUREMENT vMSTRG_R#2 "STRAG mean" UBYTE COMP_0085_S 1 100 0 255 ECU_ADDRESS 0xFFFF2FF3 /begin FUNCTION_LIST KF7-500.21[19] /end FUNCTION_LIST /end MEASUREMENT
/begin MEASUREMENT vNTDGCNT "A counter for neutral SW diagnosis frequency measuring" UWORD COMP_0016 1 100 0 65535 ECU_ADDRESS 0xFFFFAE64 /begin FUNCTION_LIST KF7-500.28[4] KF7-580.1[8] /end FUNCTION_LIST /end MEASUREMENT
/begin MEASUREMENT vNUMSTG "STRAG average number" UBYTE COMP_0016 1 100 0 255 ECU_ADDRESS 0xFFFF3039 /begin FUNCTION_LIST KF7-500.21[19] /end FUNCTION_LIST /end MEASUREMENT
/begin MEASUREMENT vNUMSTG_R#1 "STRAG average number" UBYTE COMP_0016 1 100 0 255 ECU_ADDRESS 0xFFFF3039 /begin FUNCTION_LIST KF7-500.21[19] /end FUNCTION_LIST /end MEASUREMENT
/begin MEASUREMENT vNUMSTG_R#2 "STRAG average number" UBYTE COMP_0016 1 100 0 255 ECU_ADDRESS 0xFFFF303A /begin FUNCTION_LIST KF7-500.21[19] /end FUNCTION_LIST /end MEASUREMENT
/begin MEASUREMENT vNUMSTGV "The STRAG average number for imaginary stage 2" UBYTE COMP_0016 1 100 0 255 ECU_ADDRESS 0xFFFF303B /begin FUNCTION_LIST KF7-500.21[19] /end FUNCTION_LIST /end MEASUREMENT
/begin MEASUREMENT vNUMSTGV_R#1 "The STRAG average number for imaginary stage 2" UBYTE COMP_0016 1 100 0 255 ECU_ADDRESS 0xFFFF303B /begin FUNCTION_LIST KF7-500.21[19] /end FUNCTION_LIST /end MEASUREMENT
/begin MEASUREMENT vNUMSTGV_R#2 "The STRAG average number for imaginary stage 2" UBYTE COMP_0016 1 100 0 255 ECU_ADDRESS 0xFFFF303C /begin FUNCTION_LIST KF7-500.21[19] /end FUNCTION_LIST /end MEASUREMENT
/begin MEASUREMENT vO2SMIL "O2 sensor diagnosis completion mileage integration value" UWORD COMP_0385 1 100 0 105380.28 ECU_ADDRESS 0xFFFFAE6A /begin FUNCTION_LIST KF7-500.24[10] /end FUNCTION_LIST /end MEASUREMENT
/begin MEASUREMENT vPCVOLM "After reference pressure measuring, time limit" UBYTE COMP_0008 1 100 0 25500 ECU_ADDRESS 0xFFFF3074 /begin FUNCTION_LIST KF7-500.30[8] /end FUNCTION_LIST /end MEASUREMENT
/begin MEASUREMENT vPHOS "DOS shift P-gain compensation value" UWORD COMP_0265 1 100 -8.000012288 7.999768147 ECU_ADDRESS 0xFFFF23EE
 /begin FUNCTION_LIST KF7-500.21[19] KF7-500.24[10] KF7-580.1[8] R901.1.Diag_on_can_app_1_6_2 /end FUNCTION_LIST
/end MEASUREMENT
/begin MEASUREMENT vPHOS_R#1 "DOS shift P-gain compensation value" UWORD COMP_0265 1 100 -8.000012288 7.999768147 ECU_ADDRESS 0xFFFF23EE
 /begin FUNCTION_LIST KF7-500.21[19] KF7-500.24[10] KF7-580.1[8] R901.1.Diag_on_can_app_1_6_2 /end FUNCTION_LIST
/end MEASUREMENT
/begin MEASUREMENT vPHOS_R#2 "DOS shift P-gain compensation value" UWORD COMP_0265 1 100 -8.000012288 7.999768147 ECU_ADDRESS 0xFFFF23F0
 /begin FUNCTION_LIST KF7-500.21[19] KF7-500.24[10] KF7-580.1[8] R901.1.Diag_on_can_app_1_6_2 /end FUNCTION_LIST
/end MEASUREMENT
/begin MEASUREMENT vPHOS1 "PHOS F/B operation value" UWORD COMP_0265 1 100 -8.000012288 7.999768147 ECU_ADDRESS 0xFFFF1672 /begin FUNCTION_LIST KF7-500.21[19] KF7-500.24[10] KF7-580.1[8] /end FUNCTION_LIST /end MEASUREMENT
/begin MEASUREMENT vPHOS1_R#1 "PHOS F/B operation value" UWORD COMP_0265 1 100 -8.000012288 7.999768147 ECU_ADDRESS 0xFFFF1672 /begin FUNCTION_LIST KF7-500.21[19] KF7-500.24[10] KF7-580.1[8] /end FUNCTION_LIST /end MEASUREMENT
/begin MEASUREMENT vPHOS1_R#2 "PHOS F/B operation value" UWORD COMP_0265 1 100 -8.000012288 7.999768147 ECU_ADDRESS 0xFFFF1674 /begin FUNCTION_LIST KF7-500.21[19] KF7-500.24[10] KF7-580.1[8] /end FUNCTION_LIST /end MEASUREMENT
/begin MEASUREMENT vPHOSA "PHOS1 weighted average value in the PHOS learning region" UWORD COMP_0489 1 100 -7.995392 7.995148 ECU_ADDRESS 0xFFFF3086 /begin FUNCTION_LIST KF7-500.24[10] KF7-580.1[8] /end FUNCTION_LIST /end MEASUREMENT
/begin MEASUREMENT vPHOSA_R#1 "PHOS1 weighted average value in the PHOS learning region" UWORD COMP_0489 1 100 -7.995392 7.995148 ECU_ADDRESS 0xFFFF3086 /begin FUNCTION_LIST KF7-500.24[10] KF7-580.1[8] /end FUNCTION_LIST /end MEASUREMENT
/begin MEASUREMENT vPHOSA_R#2 "PHOS1 weighted average value in the PHOS learning region" UWORD COMP_0489 1 100 -7.995392 7.995148 ECU_ADDRESS 0xFFFF3088 /begin FUNCTION_LIST KF7-500.24[10] KF7-580.1[8] /end FUNCTION_LIST /end MEASUREMENT
/begin MEASUREMENT vPHOSAZ "DOS PHOS learning value" UWORD COMP_0265 1 100 -8.000012288 7.999768147 ECU_ADDRESS 0xFFFFAEAE /begin FUNCTION_LIST KF7-500.21[19] /end FUNCTION_LIST /end MEASUREMENT
/begin MEASUREMENT vPHOSAZ_R#1 "DOS PHOS learning value" UWORD COMP_0265 1 100 -8.000012288 7.999768147 ECU_ADDRESS 0xFFFFAEAE /begin FUNCTION_LIST KF7-500.21[19] /end FUNCTION_LIST /end MEASUREMENT
/begin MEASUREMENT vPHOSAZ_R#2 "DOS PHOS learning value" UWORD COMP_0265 1 100 -8.000012288 7.999768147 ECU_ADDRESS 0xFFFFAEB0 /begin FUNCTION_LIST KF7-500.21[19] /end FUNCTION_LIST /end MEASUREMENT
/begin MEASUREMENT vPMTO2HRL1 "Parameter monitor RAM" UBYTE COMP_0013 1 100 0 255 ECU_ADDRESS 0xFFFFAEC1 /begin FUNCTION_LIST KF7-500.25A[7] /end FUNCTION_LIST /end MEASUREMENT
/begin MEASUREMENT vPMTO2HRR1 "Parameter monitor RAM" UBYTE COMP_0013 1 100 0 255 ECU_ADDRESS 0xFFFFAEC2 /begin FUNCTION_LIST KF7-500.25A[7] /end FUNCTION_LIST /end MEASUREMENT
/begin MEASUREMENT vPMTRO2L1 "Parameter monitor RAM" UBYTE COMP_0013 1 100 0 255 ECU_ADDRESS 0xFFFFAEC5 /begin FUNCTION_LIST KF7-500.24[10] /end FUNCTION_LIST /end MEASUREMENT
/begin MEASUREMENT vPMTRO2R1 "Parameter monitor RAM" UBYTE COMP_0013 1 100 0 255 ECU_ADDRESS 0xFFFFAEC6 /begin FUNCTION_LIST KF7-500.24[10] /end FUNCTION_LIST /end MEASUREMENT
/begin MEASUREMENT vPVEVPR "The EVAP voltage VCC adjustment-less-ization front" UBYTE COMP_0054 1 100 0 5100 ECU_ADDRESS 0xFFFF407C /begin FUNCTION_LIST KF7-500.30[8] /end FUNCTION_LIST /end MEASUREMENT
/begin MEASUREMENT vRFO2TMV "A diagnosis region timer for imaginary stage 2" UBYTE COMP_0013 1 100 0 255 ECU_ADDRESS 0xFFFF3131 /begin FUNCTION_LIST KF7-500.24[10] /end FUNCTION_LIST /end MEASUREMENT
/begin MEASUREMENT vRGPHS1 "Ring gear POS signal phase monitor value" SBYTE COMP_0075 1 100 -128 127 ECU_ADDRESS 0xFFFF407F /begin FUNCTION_LIST KF7-500.26[17] /end FUNCTION_LIST /end MEASUREMENT
/begin MEASUREMENT vRGSTR1 "Ring gear tooth position store RAM. NO.1 for TINT measuring" SBYTE COMP_0495 1 100 -128 127 ECU_ADDRESS 0xFFFFB66E /begin FUNCTION_LIST KF7-500.26[17] /end FUNCTION_LIST /end MEASUREMENT
/begin MEASUREMENT vRGSTR2 "Ring gear tooth position store RAM. NO.2 for TINT measuring" SBYTE COMP_0495 1 100 -128 127 ECU_ADDRESS 0xFFFFB66F /begin FUNCTION_LIST KF7-500.26[17] /end FUNCTION_LIST /end MEASUREMENT
/begin MEASUREMENT vRHBAH1 "The rest O2/H voltage value time series data (bank1)" UBYTE COMP_0054 1 100 0 5100 ECU_ADDRESS 0xFFFFAF18 /begin FUNCTION_LIST KF7-500.25A[7] /end FUNCTION_LIST /end MEASUREMENT
/begin MEASUREMENT vRHBAH1_R#1 "The rest O2/H voltage value time series data (bank1)" UBYTE COMP_0054 1 100 0 5100 ECU_ADDRESS 0xFFFFAF18 /begin FUNCTION_LIST KF7-500.25A[7] /end FUNCTION_LIST /end MEASUREMENT
/begin MEASUREMENT vRHBAH1_R#2 "The rest O2/H voltage value time series data (bank1)" UBYTE COMP_0054 1 100 0 5100 ECU_ADDRESS 0xFFFFAF19 /begin FUNCTION_LIST KF7-500.25A[7] /end FUNCTION_LIST /end MEASUREMENT
/begin MEASUREMENT vRHBAH1_R#3 "The rest O2/H voltage value time series data (bank1)" UBYTE COMP_0054 1 100 0 5100 ECU_ADDRESS 0xFFFFAF1A /begin FUNCTION_LIST KF7-500.25A[7] /end FUNCTION_LIST /end MEASUREMENT
/begin MEASUREMENT vRHBAH1_R#4 "The rest O2/H voltage value time series data (bank1)" UBYTE COMP_0054 1 100 0 5100 ECU_ADDRESS 0xFFFFAF1B /begin FUNCTION_LIST KF7-500.25A[7] /end FUNCTION_LIST /end MEASUREMENT
/begin MEASUREMENT vRHBAH1_R#5 "The rest O2/H voltage value time series data (bank1)" UBYTE COMP_0054 1 100 0 5100 ECU_ADDRESS 0xFFFFAF1C /begin FUNCTION_LIST KF7-500.25A[7] /end FUNCTION_LIST /end MEASUREMENT
/begin MEASUREMENT vRHBAH1_R#6 "The rest O2/H voltage value time series data (bank1)" UBYTE COMP_0054 1 100 0 5100 ECU_ADDRESS 0xFFFFAF1D /begin FUNCTION_LIST KF7-500.25A[7] /end FUNCTION_LIST /end MEASUREMENT
/begin MEASUREMENT vRHBAH1_R#7 "The rest O2/H voltage value time series data (bank1)" UBYTE COMP_0054 1 100 0 5100 ECU_ADDRESS 0xFFFFAF1E /begin FUNCTION_LIST KF7-500.25A[7] /end FUNCTION_LIST /end MEASUREMENT
/begin MEASUREMENT vRHBAH1_R#8 "The rest O2/H voltage value time series data (bank1)" UBYTE COMP_0054 1 100 0 5100 ECU_ADDRESS 0xFFFFAF1F /begin FUNCTION_LIST KF7-500.25A[7] /end FUNCTION_LIST /end MEASUREMENT
/begin MEASUREMENT vRHBAH1_R#9 "The rest O2/H voltage value time series data (bank1)" UBYTE COMP_0054 1 100 0 5100 ECU_ADDRESS 0xFFFFAF20 /begin FUNCTION_LIST KF7-500.25A[7] /end FUNCTION_LIST /end MEASUREMENT
/begin MEASUREMENT vRHBAH1_R#10 "The rest O2/H voltage value time series data (bank1)" UBYTE COMP_0054 1 100 0 5100 ECU_ADDRESS 0xFFFFAF21 /begin FUNCTION_LIST KF7-500.25A[7] /end FUNCTION_LIST /end MEASUREMENT
/begin MEASUREMENT vRHBAH1_R#11 "The rest O2/H voltage value time series data (bank1)" UBYTE COMP_0054 1 100 0 5100 ECU_ADDRESS 0xFFFFAF22 /begin FUNCTION_LIST KF7-500.25A[7] /end FUNCTION_LIST /end MEASUREMENT
/begin MEASUREMENT vRHBAH2 "The rest O2/H voltage value time series data (bank2)" UBYTE COMP_0054 1 100 0 5100 ECU_ADDRESS 0xFFFFAF23 /begin FUNCTION_LIST KF7-500.25A[7] /end FUNCTION_LIST /end MEASUREMENT
/begin MEASUREMENT vRHBAH2_R#1 "The rest O2/H voltage value time series data (bank2)" UBYTE COMP_0054 1 100 0 5100 ECU_ADDRESS 0xFFFFAF23 /begin FUNCTION_LIST KF7-500.25A[7] /end FUNCTION_LIST /end MEASUREMENT
/begin MEASUREMENT vRHBAH2_R#2 "The rest O2/H voltage value time series data (bank2)" UBYTE COMP_0054 1 100 0 5100 ECU_ADDRESS 0xFFFFAF24 /begin FUNCTION_LIST KF7-500.25A[7] /end FUNCTION_LIST /end MEASUREMENT
/begin MEASUREMENT vRHBAH2_R#3 "The rest O2/H voltage value time series data (bank2)" UBYTE COMP_0054 1 100 0 5100 ECU_ADDRESS 0xFFFFAF25 /begin FUNCTION_LIST KF7-500.25A[7] /end FUNCTION_LIST /end MEASUREMENT
/begin MEASUREMENT vRHBAH2_R#4 "The rest O2/H voltage value time series data (bank2)" UBYTE COMP_0054 1 100 0 5100 ECU_ADDRESS 0xFFFFAF26 /begin FUNCTION_LIST KF7-500.25A[7] /end FUNCTION_LIST /end MEASUREMENT
/begin MEASUREMENT vRHBAH2_R#5 "The rest O2/H voltage value time series data (bank2)" UBYTE COMP_0054 1 100 0 5100 ECU_ADDRESS 0xFFFFAF27 /begin FUNCTION_LIST KF7-500.25A[7] /end FUNCTION_LIST /end MEASUREMENT
/begin MEASUREMENT vRHBAH2_R#6 "The rest O2/H voltage value time series data (bank2)" UBYTE COMP_0054 1 100 0 5100 ECU_ADDRESS 0xFFFFAF28 /begin FUNCTION_LIST KF7-500.25A[7] /end FUNCTION_LIST /end MEASUREMENT
/begin MEASUREMENT vRHBAH2_R#7 "The rest O2/H voltage value time series data (bank2)" UBYTE COMP_0054 1 100 0 5100 ECU_ADDRESS 0xFFFFAF29 /begin FUNCTION_LIST KF7-500.25A[7] /end FUNCTION_LIST /end MEASUREMENT
/begin MEASUREMENT vRHBAH2_R#8 "The rest O2/H voltage value time series data (bank2)" UBYTE COMP_0054 1 100 0 5100 ECU_ADDRESS 0xFFFFAF2A /begin FUNCTION_LIST KF7-500.25A[7] /end FUNCTION_LIST /end MEASUREMENT
/begin MEASUREMENT vRHBAH2_R#9 "The rest O2/H voltage value time series data (bank2)" UBYTE COMP_0054 1 100 0 5100 ECU_ADDRESS 0xFFFFAF2B /begin FUNCTION_LIST KF7-500.25A[7] /end FUNCTION_LIST /end MEASUREMENT
/begin MEASUREMENT vRHBAH2_R#10 "The rest O2/H voltage value time series data (bank2)" UBYTE COMP_0054 1 100 0 5100 ECU_ADDRESS 0xFFFFAF2C /begin FUNCTION_LIST KF7-500.25A[7] /end FUNCTION_LIST /end MEASUREMENT
/begin MEASUREMENT vRHBAH2_R#11 "The rest O2/H voltage value time series data (bank2)" UBYTE COMP_0054 1 100 0 5100 ECU_ADDRESS 0xFFFFAF2D /begin FUNCTION_LIST KF7-500.25A[7] /end FUNCTION_LIST /end MEASUREMENT
/begin MEASUREMENT vRHBDY1 "Rear O2 sensor heater duty time series data (bank1)" UWORD COMP_0133_S 1 100 0 2559.9609375 ECU_ADDRESS 0xFFFFAF30 /begin FUNCTION_LIST KF7-500.25A[7] /end FUNCTION_LIST /end MEASUREMENT
/begin MEASUREMENT vRHBDY1_R#1 "Rear O2 sensor heater duty time series data (bank1)" UWORD COMP_0133_S 1 100 0 2559.9609375 ECU_ADDRESS 0xFFFFAF30 /begin FUNCTION_LIST KF7-500.25A[7] /end FUNCTION_LIST /end MEASUREMENT
/begin MEASUREMENT vRHBDY1_R#2 "Rear O2 sensor heater duty time series data (bank1)" UWORD COMP_0133_S 1 100 0 2559.9609375 ECU_ADDRESS 0xFFFFAF32 /begin FUNCTION_LIST KF7-500.25A[7] /end FUNCTION_LIST /end MEASUREMENT
/begin MEASUREMENT vRHBDY1_R#3 "Rear O2 sensor heater duty time series data (bank1)" UWORD COMP_0133_S 1 100 0 2559.9609375 ECU_ADDRESS 0xFFFFAF34 /begin FUNCTION_LIST KF7-500.25A[7] /end FUNCTION_LIST /end MEASUREMENT
/begin MEASUREMENT vRHBDY1_R#4 "Rear O2 sensor heater duty time series data (bank1)" UWORD COMP_0133_S 1 100 0 2559.9609375 ECU_ADDRESS 0xFFFFAF36 /begin FUNCTION_LIST KF7-500.25A[7] /end FUNCTION_LIST /end MEASUREMENT
/begin MEASUREMENT vRHBDY1_R#5 "Rear O2 sensor heater duty time series data (bank1)" UWORD COMP_0133_S 1 100 0 2559.9609375 ECU_ADDRESS 0xFFFFAF38 /begin FUNCTION_LIST KF7-500.25A[7] /end FUNCTION_LIST /end MEASUREMENT
/begin MEASUREMENT vRHBDY1_R#6 "Rear O2 sensor heater duty time series data (bank1)" UWORD COMP_0133_S 1 100 0 2559.9609375 ECU_ADDRESS 0xFFFFAF3A /begin FUNCTION_LIST KF7-500.25A[7] /end FUNCTION_LIST /end MEASUREMENT
/begin MEASUREMENT vRHBDY1_R#7 "Rear O2 sensor heater duty time series data (bank1)" UWORD COMP_0133_S 1 100 0 2559.9609375 ECU_ADDRESS 0xFFFFAF3C /begin FUNCTION_LIST KF7-500.25A[7] /end FUNCTION_LIST /end MEASUREMENT
/begin MEASUREMENT vRHBDY1_R#8 "Rear O2 sensor heater duty time series data (bank1)" UWORD COMP_0133_S 1 100 0 2559.9609375 ECU_ADDRESS 0xFFFFAF3E /begin FUNCTION_LIST KF7-500.25A[7] /end FUNCTION_LIST /end MEASUREMENT
/begin MEASUREMENT vRHBDY1_R#9 "Rear O2 sensor heater duty time series data (bank1)" UWORD COMP_0133_S 1 100 0 2559.9609375 ECU_ADDRESS 0xFFFFAF40 /begin FUNCTION_LIST KF7-500.25A[7] /end FUNCTION_LIST /end MEASUREMENT
/begin MEASUREMENT vRHBDY1_R#10 "Rear O2 sensor heater duty time series data (bank1)" UWORD COMP_0133_S 1 100 0 2559.9609375 ECU_ADDRESS 0xFFFFAF42 /begin FUNCTION_LIST KF7-500.25A[7] /end FUNCTION_LIST /end MEASUREMENT
/begin MEASUREMENT vRHBDY1_R#11 "Rear O2 sensor heater duty time series data (bank1)" UWORD COMP_0133_S 1 100 0 2559.9609375 ECU_ADDRESS 0xFFFFAF44 /begin FUNCTION_LIST KF7-500.25A[7] /end FUNCTION_LIST /end MEASUREMENT
/begin MEASUREMENT vRHBDY2 "Rear O2 sensor heater duty time series data (bank2)" UWORD COMP_0133_S 1 100 0 2559.9609375 ECU_ADDRESS 0xFFFFAF46 /begin FUNCTION_LIST KF7-500.25A[7] /end FUNCTION_LIST /end MEASUREMENT
/begin MEASUREMENT vRHBDY2_R#1 "Rear O2 sensor heater duty time series data (bank2)" UWORD COMP_0133_S 1 100 0 2559.9609375 ECU_ADDRESS 0xFFFFAF46 /begin FUNCTION_LIST KF7-500.25A[7] /end FUNCTION_LIST /end MEASUREMENT
/begin MEASUREMENT vRHBDY2_R#2 "Rear O2 sensor heater duty time series data (bank2)" UWORD COMP_0133_S 1 100 0 2559.9609375 ECU_ADDRESS 0xFFFFAF48 /begin FUNCTION_LIST KF7-500.25A[7] /end FUNCTION_LIST /end MEASUREMENT
/begin MEASUREMENT vRHBDY2_R#3 "Rear O2 sensor heater duty time series data (bank2)" UWORD COMP_0133_S 1 100 0 2559.9609375 ECU_ADDRESS 0xFFFFAF4A /begin FUNCTION_LIST KF7-500.25A[7] /end FUNCTION_LIST /end MEASUREMENT
/begin MEASUREMENT vRHBDY2_R#4 "Rear O2 sensor heater duty time series data (bank2)" UWORD COMP_0133_S 1 100 0 2559.9609375 ECU_ADDRESS 0xFFFFAF4C /begin FUNCTION_LIST KF7-500.25A[7] /end FUNCTION_LIST /end MEASUREMENT
/begin MEASUREMENT vRHBDY2_R#5 "Rear O2 sensor heater duty time series data (bank2)" UWORD COMP_0133_S 1 100 0 2559.9609375 ECU_ADDRESS 0xFFFFAF4E /begin FUNCTION_LIST KF7-500.25A[7] /end FUNCTION_LIST /end MEASUREMENT
/begin MEASUREMENT vRHBDY2_R#6 "Rear O2 sensor heater duty time series data (bank2)" UWORD COMP_0133_S 1 100 0 2559.9609375 ECU_ADDRESS 0xFFFFAF50 /begin FUNCTION_LIST KF7-500.25A[7] /end FUNCTION_LIST /end MEASUREMENT
/begin MEASUREMENT vRHBDY2_R#7 "Rear O2 sensor heater duty time series data (bank2)" UWORD COMP_0133_S 1 100 0 2559.9609375 ECU_ADDRESS 0xFFFFAF52 /begin FUNCTION_LIST KF7-500.25A[7] /end FUNCTION_LIST /end MEASUREMENT
/begin MEASUREMENT vRHBDY2_R#8 "Rear O2 sensor heater duty time series data (bank2)" UWORD COMP_0133_S 1 100 0 2559.9609375 ECU_ADDRESS 0xFFFFAF54 /begin FUNCTION_LIST KF7-500.25A[7] /end FUNCTION_LIST /end MEASUREMENT
/begin MEASUREMENT vRHBDY2_R#9 "Rear O2 sensor heater duty time series data (bank2)" UWORD COMP_0133_S 1 100 0 2559.9609375 ECU_ADDRESS 0xFFFFAF56 /begin FUNCTION_LIST KF7-500.25A[7] /end FUNCTION_LIST /end MEASUREMENT
/begin MEASUREMENT vRHBDY2_R#10 "Rear O2 sensor heater duty time series data (bank2)" UWORD COMP_0133_S 1 100 0 2559.9609375 ECU_ADDRESS 0xFFFFAF58 /begin FUNCTION_LIST KF7-500.25A[7] /end FUNCTION_LIST /end MEASUREMENT
/begin MEASUREMENT vRHBDY2_R#11 "Rear O2 sensor heater duty time series data (bank2)" UWORD COMP_0133_S 1 100 0 2559.9609375 ECU_ADDRESS 0xFFFFAF5A /begin FUNCTION_LIST KF7-500.25A[7] /end FUNCTION_LIST /end MEASUREMENT
/begin MEASUREMENT vRHBMN "The rest O2/H engine speed time series data" UBYTE COMP_0000 1 100 0 6375 ECU_ADDRESS 0xFFFFAF5C /begin FUNCTION_LIST KF7-500.25A[7] /end FUNCTION_LIST /end MEASUREMENT
/begin MEASUREMENT vRHBMN_R#1 "The rest O2/H engine speed time series data" UBYTE COMP_0000 1 100 0 6375 ECU_ADDRESS 0xFFFFAF5C /begin FUNCTION_LIST KF7-500.25A[7] /end FUNCTION_LIST /end MEASUREMENT
/begin MEASUREMENT vRHBMN_R#2 "The rest O2/H engine speed time series data" UBYTE COMP_0000 1 100 0 6375 ECU_ADDRESS 0xFFFFAF5D /begin FUNCTION_LIST KF7-500.25A[7] /end FUNCTION_LIST /end MEASUREMENT
/begin MEASUREMENT vRHBMN_R#3 "The rest O2/H engine speed time series data" UBYTE COMP_0000 1 100 0 6375 ECU_ADDRESS 0xFFFFAF5E /begin FUNCTION_LIST KF7-500.25A[7] /end FUNCTION_LIST /end MEASUREMENT
/begin MEASUREMENT vRHBMN_R#4 "The rest O2/H engine speed time series data" UBYTE COMP_0000 1 100 0 6375 ECU_ADDRESS 0xFFFFAF5F /begin FUNCTION_LIST KF7-500.25A[7] /end FUNCTION_LIST /end MEASUREMENT
/begin MEASUREMENT vRHBMN_R#5 "The rest O2/H engine speed time series data" UBYTE COMP_0000 1 100 0 6375 ECU_ADDRESS 0xFFFFAF60 /begin FUNCTION_LIST KF7-500.25A[7] /end FUNCTION_LIST /end MEASUREMENT
/begin MEASUREMENT vRHBMN_R#6 "The rest O2/H engine speed time series data" UBYTE COMP_0000 1 100 0 6375 ECU_ADDRESS 0xFFFFAF61 /begin FUNCTION_LIST KF7-500.25A[7] /end FUNCTION_LIST /end MEASUREMENT
/begin MEASUREMENT vRHBMN_R#7 "The rest O2/H engine speed time series data" UBYTE COMP_0000 1 100 0 6375 ECU_ADDRESS 0xFFFFAF62 /begin FUNCTION_LIST KF7-500.25A[7] /end FUNCTION_LIST /end MEASUREMENT
/begin MEASUREMENT vRHBMN_R#8 "The rest O2/H engine speed time series data" UBYTE COMP_0000 1 100 0 6375 ECU_ADDRESS 0xFFFFAF63 /begin FUNCTION_LIST KF7-500.25A[7] /end FUNCTION_LIST /end MEASUREMENT
/begin MEASUREMENT vRHBMN_R#9 "The rest O2/H engine speed time series data" UBYTE COMP_0000 1 100 0 6375 ECU_ADDRESS 0xFFFFAF64 /begin FUNCTION_LIST KF7-500.25A[7] /end FUNCTION_LIST /end MEASUREMENT
/begin MEASUREMENT vRHBMN_R#10 "The rest O2/H engine speed time series data" UBYTE COMP_0000 1 100 0 6375 ECU_ADDRESS 0xFFFFAF65 /begin FUNCTION_LIST KF7-500.25A[7] /end FUNCTION_LIST /end MEASUREMENT
/begin MEASUREMENT vRHBMN_R#11 "The rest O2/H engine speed time series data" UBYTE COMP_0000 1 100 0 6375 ECU_ADDRESS 0xFFFFAF66 /begin FUNCTION_LIST KF7-500.25A[7] /end FUNCTION_LIST /end MEASUREMENT
/begin MEASUREMENT vRHBMN2 "The rest O2/H engine speed time series data (bank2)" UBYTE COMP_0000 1 100 0 6375 ECU_ADDRESS 0xFFFFAF67 /begin FUNCTION_LIST KF7-500.25A[7] /end FUNCTION_LIST /end MEASUREMENT
/begin MEASUREMENT vRHBMN2_R#1 "The rest O2/H engine speed time series data (bank2)" UBYTE COMP_0000 1 100 0 6375 ECU_ADDRESS 0xFFFFAF67 /begin FUNCTION_LIST KF7-500.25A[7] /end FUNCTION_LIST /end MEASUREMENT
/begin MEASUREMENT vRHBMN2_R#2 "The rest O2/H engine speed time series data (bank2)" UBYTE COMP_0000 1 100 0 6375 ECU_ADDRESS 0xFFFFAF68 /begin FUNCTION_LIST KF7-500.25A[7] /end FUNCTION_LIST /end MEASUREMENT
/begin MEASUREMENT vRHBMN2_R#3 "The rest O2/H engine speed time series data (bank2)" UBYTE COMP_0000 1 100 0 6375 ECU_ADDRESS 0xFFFFAF69 /begin FUNCTION_LIST KF7-500.25A[7] /end FUNCTION_LIST /end MEASUREMENT
/begin MEASUREMENT vRHBMN2_R#4 "The rest O2/H engine speed time series data (bank2)" UBYTE COMP_0000 1 100 0 6375 ECU_ADDRESS 0xFFFFAF6A /begin FUNCTION_LIST KF7-500.25A[7] /end FUNCTION_LIST /end MEASUREMENT
/begin MEASUREMENT vRHBMN2_R#5 "The rest O2/H engine speed time series data (bank2)" UBYTE COMP_0000 1 100 0 6375 ECU_ADDRESS 0xFFFFAF6B /begin FUNCTION_LIST KF7-500.25A[7] /end FUNCTION_LIST /end MEASUREMENT
/begin MEASUREMENT vRHBMN2_R#6 "The rest O2/H engine speed time series data (bank2)" UBYTE COMP_0000 1 100 0 6375 ECU_ADDRESS 0xFFFFAF6C /begin FUNCTION_LIST KF7-500.25A[7] /end FUNCTION_LIST /end MEASUREMENT
/begin MEASUREMENT vRHBMN2_R#7 "The rest O2/H engine speed time series data (bank2)" UBYTE COMP_0000 1 100 0 6375 ECU_ADDRESS 0xFFFFAF6D /begin FUNCTION_LIST KF7-500.25A[7] /end FUNCTION_LIST /end MEASUREMENT
/begin MEASUREMENT vRHBMN2_R#8 "The rest O2/H engine speed time series data (bank2)" UBYTE COMP_0000 1 100 0 6375 ECU_ADDRESS 0xFFFFAF6E /begin FUNCTION_LIST KF7-500.25A[7] /end FUNCTION_LIST /end MEASUREMENT
/begin MEASUREMENT vRHBMN2_R#9 "The rest O2/H engine speed time series data (bank2)" UBYTE COMP_0000 1 100 0 6375 ECU_ADDRESS 0xFFFFAF6F /begin FUNCTION_LIST KF7-500.25A[7] /end FUNCTION_LIST /end MEASUREMENT
/begin MEASUREMENT vRHBMN2_R#10 "The rest O2/H engine speed time series data (bank2)" UBYTE COMP_0000 1 100 0 6375 ECU_ADDRESS 0xFFFFAF70 /begin FUNCTION_LIST KF7-500.25A[7] /end FUNCTION_LIST /end MEASUREMENT
/begin MEASUREMENT vRHBMN2_R#11 "The rest O2/H engine speed time series data (bank2)" UBYTE COMP_0000 1 100 0 6375 ECU_ADDRESS 0xFFFFAF71 /begin FUNCTION_LIST KF7-500.25A[7] /end FUNCTION_LIST /end MEASUREMENT
/begin MEASUREMENT vRHBTP "The rest O2/H cylinder air quantity equivalent pulse width time series data" UWORD COMP_0144 1 100 0 31.999495335 ECU_ADDRESS 0xFFFFAF72 /begin FUNCTION_LIST KF7-500.25A[7] /end FUNCTION_LIST /end MEASUREMENT
/begin MEASUREMENT vRHBTP_R#1 "The rest O2/H cylinder air quantity equivalent pulse width time series data" UWORD COMP_0144 1 100 0 31.999495335 ECU_ADDRESS 0xFFFFAF72 /begin FUNCTION_LIST KF7-500.25A[7] /end FUNCTION_LIST /end MEASUREMENT
/begin MEASUREMENT vRHBTP_R#2 "The rest O2/H cylinder air quantity equivalent pulse width time series data" UWORD COMP_0144 1 100 0 31.999495335 ECU_ADDRESS 0xFFFFAF74 /begin FUNCTION_LIST KF7-500.25A[7] /end FUNCTION_LIST /end MEASUREMENT
/begin MEASUREMENT vRHBTP_R#3 "The rest O2/H cylinder air quantity equivalent pulse width time series data" UWORD COMP_0144 1 100 0 31.999495335 ECU_ADDRESS 0xFFFFAF76 /begin FUNCTION_LIST KF7-500.25A[7] /end FUNCTION_LIST /end MEASUREMENT
/begin MEASUREMENT vRHBTP_R#4 "The rest O2/H cylinder air quantity equivalent pulse width time series data" UWORD COMP_0144 1 100 0 31.999495335 ECU_ADDRESS 0xFFFFAF78 /begin FUNCTION_LIST KF7-500.25A[7] /end FUNCTION_LIST /end MEASUREMENT
/begin MEASUREMENT vRHBTP_R#5 "The rest O2/H cylinder air quantity equivalent pulse width time series data" UWORD COMP_0144 1 100 0 31.999495335 ECU_ADDRESS 0xFFFFAF7A /begin FUNCTION_LIST KF7-500.25A[7] /end FUNCTION_LIST /end MEASUREMENT
/begin MEASUREMENT vRHBTP_R#6 "The rest O2/H cylinder air quantity equivalent pulse width time series data" UWORD COMP_0144 1 100 0 31.999495335 ECU_ADDRESS 0xFFFFAF7C /begin FUNCTION_LIST KF7-500.25A[7] /end FUNCTION_LIST /end MEASUREMENT
/begin MEASUREMENT vRHBTP_R#7 "The rest O2/H cylinder air quantity equivalent pulse width time series data" UWORD COMP_0144 1 100 0 31.999495335 ECU_ADDRESS 0xFFFFAF7E /begin FUNCTION_LIST KF7-500.25A[7] /end FUNCTION_LIST /end MEASUREMENT
/begin MEASUREMENT vRHBTP_R#8 "The rest O2/H cylinder air quantity equivalent pulse width time series data" UWORD COMP_0144 1 100 0 31.999495335 ECU_ADDRESS 0xFFFFAF80 /begin FUNCTION_LIST KF7-500.25A[7] /end FUNCTION_LIST /end MEASUREMENT
/begin MEASUREMENT vRHBTP_R#9 "The rest O2/H cylinder air quantity equivalent pulse width time series data" UWORD COMP_0144 1 100 0 31.999495335 ECU_ADDRESS 0xFFFFAF82 /begin FUNCTION_LIST KF7-500.25A[7] /end FUNCTION_LIST /end MEASUREMENT
/begin MEASUREMENT vRHBTP_R#10 "The rest O2/H cylinder air quantity equivalent pulse width time series data" UWORD COMP_0144 1 100 0 31.999495335 ECU_ADDRESS 0xFFFFAF84 /begin FUNCTION_LIST KF7-500.25A[7] /end FUNCTION_LIST /end MEASUREMENT
/begin MEASUREMENT vRHBTP_R#11 "The rest O2/H cylinder air quantity equivalent pulse width time series data" UWORD COMP_0144 1 100 0 31.999495335 ECU_ADDRESS 0xFFFFAF86 /begin FUNCTION_LIST KF7-500.25A[7] /end FUNCTION_LIST /end MEASUREMENT
/begin MEASUREMENT vRHBTP2 "The rest O2/H cylinder air quantity equivalent pulse width time series data (bank2)" UWORD COMP_0144 1 100 0 31.999495335 ECU_ADDRESS 0xFFFFAF88 /begin FUNCTION_LIST KF7-500.25A[7] /end FUNCTION_LIST /end MEASUREMENT
/begin MEASUREMENT vRHBTP2_R#1 "The rest O2/H cylinder air quantity equivalent pulse width time series data (bank2)" UWORD COMP_0144 1 100 0 31.999495335 ECU_ADDRESS 0xFFFFAF88 /begin FUNCTION_LIST KF7-500.25A[7] /end FUNCTION_LIST /end MEASUREMENT
/begin MEASUREMENT vRHBTP2_R#2 "The rest O2/H cylinder air quantity equivalent pulse width time series data (bank2)" UWORD COMP_0144 1 100 0 31.999495335 ECU_ADDRESS 0xFFFFAF8A /begin FUNCTION_LIST KF7-500.25A[7] /end FUNCTION_LIST /end MEASUREMENT
/begin MEASUREMENT vRHBTP2_R#3 "The rest O2/H cylinder air quantity equivalent pulse width time series data (bank2)" UWORD COMP_0144 1 100 0 31.999495335 ECU_ADDRESS 0xFFFFAF8C /begin FUNCTION_LIST KF7-500.25A[7] /end FUNCTION_LIST /end MEASUREMENT
/begin MEASUREMENT vRHBTP2_R#4 "The rest O2/H cylinder air quantity equivalent pulse width time series data (bank2)" UWORD COMP_0144 1 100 0 31.999495335 ECU_ADDRESS 0xFFFFAF8E /begin FUNCTION_LIST KF7-500.25A[7] /end FUNCTION_LIST /end MEASUREMENT
/begin MEASUREMENT vRHBTP2_R#5 "The rest O2/H cylinder air quantity equivalent pulse width time series data (bank2)" UWORD COMP_0144 1 100 0 31.999495335 ECU_ADDRESS 0xFFFFAF90 /begin FUNCTION_LIST KF7-500.25A[7] /end FUNCTION_LIST /end MEASUREMENT
/begin MEASUREMENT vRHBTP2_R#6 "The rest O2/H cylinder air quantity equivalent pulse width time series data (bank2)" UWORD COMP_0144 1 100 0 31.999495335 ECU_ADDRESS 0xFFFFAF92 /begin FUNCTION_LIST KF7-500.25A[7] /end FUNCTION_LIST /end MEASUREMENT
/begin MEASUREMENT vRHBTP2_R#7 "The rest O2/H cylinder air quantity equivalent pulse width time series data (bank2)" UWORD COMP_0144 1 100 0 31.999495335 ECU_ADDRESS 0xFFFFAF94 /begin FUNCTION_LIST KF7-500.25A[7] /end FUNCTION_LIST /end MEASUREMENT
/begin MEASUREMENT vRHBTP2_R#8 "The rest O2/H cylinder air quantity equivalent pulse width time series data (bank2)" UWORD COMP_0144 1 100 0 31.999495335 ECU_ADDRESS 0xFFFFAF96 /begin FUNCTION_LIST KF7-500.25A[7] /end FUNCTION_LIST /end MEASUREMENT
/begin MEASUREMENT vRHBTP2_R#9 "The rest O2/H cylinder air quantity equivalent pulse width time series data (bank2)" UWORD COMP_0144 1 100 0 31.999495335 ECU_ADDRESS 0xFFFFAF98 /begin FUNCTION_LIST KF7-500.25A[7] /end FUNCTION_LIST /end MEASUREMENT
/begin MEASUREMENT vRHBTP2_R#10 "The rest O2/H cylinder air quantity equivalent pulse width time series data (bank2)" UWORD COMP_0144 1 100 0 31.999495335 ECU_ADDRESS 0xFFFFAF9A /begin FUNCTION_LIST KF7-500.25A[7] /end FUNCTION_LIST /end MEASUREMENT
/begin MEASUREMENT vRHBTP2_R#11 "The rest O2/H cylinder air quantity equivalent pulse width time series data (bank2)" UWORD COMP_0144 1 100 0 31.999495335 ECU_ADDRESS 0xFFFFAF9C /begin FUNCTION_LIST KF7-500.25A[7] /end FUNCTION_LIST /end MEASUREMENT
/begin MEASUREMENT vRHBVB "The rest O2/H battery voltage time series data" UBYTE COMP_0033 1 100 0 20400 ECU_ADDRESS 0xFFFFAF9E /begin FUNCTION_LIST KF7-500.25A[7] /end FUNCTION_LIST /end MEASUREMENT
/begin MEASUREMENT vRHBVB_R#1 "The rest O2/H battery voltage time series data" UBYTE COMP_0033 1 100 0 20400 ECU_ADDRESS 0xFFFFAF9E /begin FUNCTION_LIST KF7-500.25A[7] /end FUNCTION_LIST /end MEASUREMENT
/begin MEASUREMENT vRHBVB_R#2 "The rest O2/H battery voltage time series data" UBYTE COMP_0033 1 100 0 20400 ECU_ADDRESS 0xFFFFAF9F /begin FUNCTION_LIST KF7-500.25A[7] /end FUNCTION_LIST /end MEASUREMENT
/begin MEASUREMENT vRHBVB_R#3 "The rest O2/H battery voltage time series data" UBYTE COMP_0033 1 100 0 20400 ECU_ADDRESS 0xFFFFAFA0 /begin FUNCTION_LIST KF7-500.25A[7] /end FUNCTION_LIST /end MEASUREMENT
/begin MEASUREMENT vRHBVB_R#4 "The rest O2/H battery voltage time series data" UBYTE COMP_0033 1 100 0 20400 ECU_ADDRESS 0xFFFFAFA1 /begin FUNCTION_LIST KF7-500.25A[7] /end FUNCTION_LIST /end MEASUREMENT
/begin MEASUREMENT vRHBVB_R#5 "The rest O2/H battery voltage time series data" UBYTE COMP_0033 1 100 0 20400 ECU_ADDRESS 0xFFFFAFA2 /begin FUNCTION_LIST KF7-500.25A[7] /end FUNCTION_LIST /end MEASUREMENT
/begin MEASUREMENT vRHBVB_R#6 "The rest O2/H battery voltage time series data" UBYTE COMP_0033 1 100 0 20400 ECU_ADDRESS 0xFFFFAFA3 /begin FUNCTION_LIST KF7-500.25A[7] /end FUNCTION_LIST /end MEASUREMENT
/begin MEASUREMENT vRHBVB_R#7 "The rest O2/H battery voltage time series data" UBYTE COMP_0033 1 100 0 20400 ECU_ADDRESS 0xFFFFAFA4 /begin FUNCTION_LIST KF7-500.25A[7] /end FUNCTION_LIST /end MEASUREMENT
/begin MEASUREMENT vRHBVB_R#8 "The rest O2/H battery voltage time series data" UBYTE COMP_0033 1 100 0 20400 ECU_ADDRESS 0xFFFFAFA5 /begin FUNCTION_LIST KF7-500.25A[7] /end FUNCTION_LIST /end MEASUREMENT
/begin MEASUREMENT vRHBVB_R#9 "The rest O2/H battery voltage time series data" UBYTE COMP_0033 1 100 0 20400 ECU_ADDRESS 0xFFFFAFA6 /begin FUNCTION_LIST KF7-500.25A[7] /end FUNCTION_LIST /end MEASUREMENT
/begin MEASUREMENT vRHBVB_R#10 "The rest O2/H battery voltage time series data" UBYTE COMP_0033 1 100 0 20400 ECU_ADDRESS 0xFFFFAFA7 /begin FUNCTION_LIST KF7-500.25A[7] /end FUNCTION_LIST /end MEASUREMENT
/begin MEASUREMENT vRHBVB_R#11 "The rest O2/H battery voltage time series data" UBYTE COMP_0033 1 100 0 20400 ECU_ADDRESS 0xFFFFAFA8 /begin FUNCTION_LIST KF7-500.25A[7] /end FUNCTION_LIST /end MEASUREMENT
/begin MEASUREMENT vRHBVB2 "The rest O2/H battery voltage time series data (bank2)" UBYTE COMP_0033 1 100 0 20400 ECU_ADDRESS 0xFFFFAFA9 /begin FUNCTION_LIST KF7-500.25A[7] /end FUNCTION_LIST /end MEASUREMENT
/begin MEASUREMENT vRHBVB2_R#1 "The rest O2/H battery voltage time series data (bank2)" UBYTE COMP_0033 1 100 0 20400 ECU_ADDRESS 0xFFFFAFA9 /begin FUNCTION_LIST KF7-500.25A[7] /end FUNCTION_LIST /end MEASUREMENT
/begin MEASUREMENT vRHBVB2_R#2 "The rest O2/H battery voltage time series data (bank2)" UBYTE COMP_0033 1 100 0 20400 ECU_ADDRESS 0xFFFFAFAA /begin FUNCTION_LIST KF7-500.25A[7] /end FUNCTION_LIST /end MEASUREMENT
/begin MEASUREMENT vRHBVB2_R#3 "The rest O2/H battery voltage time series data (bank2)" UBYTE COMP_0033 1 100 0 20400 ECU_ADDRESS 0xFFFFAFAB /begin FUNCTION_LIST KF7-500.25A[7] /end FUNCTION_LIST /end MEASUREMENT
/begin MEASUREMENT vRHBVB2_R#4 "The rest O2/H battery voltage time series data (bank2)" UBYTE COMP_0033 1 100 0 20400 ECU_ADDRESS 0xFFFFAFAC /begin FUNCTION_LIST KF7-500.25A[7] /end FUNCTION_LIST /end MEASUREMENT
/begin MEASUREMENT vRHBVB2_R#5 "The rest O2/H battery voltage time series data (bank2)" UBYTE COMP_0033 1 100 0 20400 ECU_ADDRESS 0xFFFFAFAD /begin FUNCTION_LIST KF7-500.25A[7] /end FUNCTION_LIST /end MEASUREMENT
/begin MEASUREMENT vRHBVB2_R#6 "The rest O2/H battery voltage time series data (bank2)" UBYTE COMP_0033 1 100 0 20400 ECU_ADDRESS 0xFFFFAFAE /begin FUNCTION_LIST KF7-500.25A[7] /end FUNCTION_LIST /end MEASUREMENT
/begin MEASUREMENT vRHBVB2_R#7 "The rest O2/H battery voltage time series data (bank2)" UBYTE COMP_0033 1 100 0 20400 ECU_ADDRESS 0xFFFFAFAF /begin FUNCTION_LIST KF7-500.25A[7] /end FUNCTION_LIST /end MEASUREMENT
/begin MEASUREMENT vRHBVB2_R#8 "The rest O2/H battery voltage time series data (bank2)" UBYTE COMP_0033 1 100 0 20400 ECU_ADDRESS 0xFFFFAFB0 /begin FUNCTION_LIST KF7-500.25A[7] /end FUNCTION_LIST /end MEASUREMENT
/begin MEASUREMENT vRHBVB2_R#9 "The rest O2/H battery voltage time series data (bank2)" UBYTE COMP_0033 1 100 0 20400 ECU_ADDRESS 0xFFFFAFB1 /begin FUNCTION_LIST KF7-500.25A[7] /end FUNCTION_LIST /end MEASUREMENT
/begin MEASUREMENT vRHBVB2_R#10 "The rest O2/H battery voltage time series data (bank2)" UBYTE COMP_0033 1 100 0 20400 ECU_ADDRESS 0xFFFFAFB2 /begin FUNCTION_LIST KF7-500.25A[7] /end FUNCTION_LIST /end MEASUREMENT
/begin MEASUREMENT vRHBVB2_R#11 "The rest O2/H battery voltage time series data (bank2)" UBYTE COMP_0033 1 100 0 20400 ECU_ADDRESS 0xFFFFAFB3 /begin FUNCTION_LIST KF7-500.25A[7] /end FUNCTION_LIST /end MEASUREMENT
/begin MEASUREMENT vRHBVS2 "The rest O2/H vehicle speed time series data (bank2)" UBYTE COMP_0007 1 100 0 510 ECU_ADDRESS 0xFFFFAFB4 /begin FUNCTION_LIST KF7-500.25A[7] /end FUNCTION_LIST /end MEASUREMENT
/begin MEASUREMENT vRHBVS2_R#1 "The rest O2/H vehicle speed time series data (bank2)" UBYTE COMP_0007 1 100 0 510 ECU_ADDRESS 0xFFFFAFB4 /begin FUNCTION_LIST KF7-500.25A[7] /end FUNCTION_LIST /end MEASUREMENT
/begin MEASUREMENT vRHBVS2_R#2 "The rest O2/H vehicle speed time series data (bank2)" UBYTE COMP_0007 1 100 0 510 ECU_ADDRESS 0xFFFFAFB5 /begin FUNCTION_LIST KF7-500.25A[7] /end FUNCTION_LIST /end MEASUREMENT
/begin MEASUREMENT vRHBVS2_R#3 "The rest O2/H vehicle speed time series data (bank2)" UBYTE COMP_0007 1 100 0 510 ECU_ADDRESS 0xFFFFAFB6 /begin FUNCTION_LIST KF7-500.25A[7] /end FUNCTION_LIST /end MEASUREMENT
/begin MEASUREMENT vRHBVS2_R#4 "The rest O2/H vehicle speed time series data (bank2)" UBYTE COMP_0007 1 100 0 510 ECU_ADDRESS 0xFFFFAFB7 /begin FUNCTION_LIST KF7-500.25A[7] /end FUNCTION_LIST /end MEASUREMENT
/begin MEASUREMENT vRHBVS2_R#5 "The rest O2/H vehicle speed time series data (bank2)" UBYTE COMP_0007 1 100 0 510 ECU_ADDRESS 0xFFFFAFB8 /begin FUNCTION_LIST KF7-500.25A[7] /end FUNCTION_LIST /end MEASUREMENT
/begin MEASUREMENT vRHBVS2_R#6 "The rest O2/H vehicle speed time series data (bank2)" UBYTE COMP_0007 1 100 0 510 ECU_ADDRESS 0xFFFFAFB9 /begin FUNCTION_LIST KF7-500.25A[7] /end FUNCTION_LIST /end MEASUREMENT
/begin MEASUREMENT vRHBVS2_R#7 "The rest O2/H vehicle speed time series data (bank2)" UBYTE COMP_0007 1 100 0 510 ECU_ADDRESS 0xFFFFAFBA /begin FUNCTION_LIST KF7-500.25A[7] /end FUNCTION_LIST /end MEASUREMENT
/begin MEASUREMENT vRHBVS2_R#8 "The rest O2/H vehicle speed time series data (bank2)" UBYTE COMP_0007 1 100 0 510 ECU_ADDRESS 0xFFFFAFBB /begin FUNCTION_LIST KF7-500.25A[7] /end FUNCTION_LIST /end MEASUREMENT
/begin MEASUREMENT vRHBVS2_R#9 "The rest O2/H vehicle speed time series data (bank2)" UBYTE COMP_0007 1 100 0 510 ECU_ADDRESS 0xFFFFAFBC /begin FUNCTION_LIST KF7-500.25A[7] /end FUNCTION_LIST /end MEASUREMENT
/begin MEASUREMENT vRHBVS2_R#10 "The rest O2/H vehicle speed time series data (bank2)" UBYTE COMP_0007 1 100 0 510 ECU_ADDRESS 0xFFFFAFBD /begin FUNCTION_LIST KF7-500.25A[7] /end FUNCTION_LIST /end MEASUREMENT
/begin MEASUREMENT vRHBVS2_R#11 "The rest O2/H vehicle speed time series data (bank2)" UBYTE COMP_0007 1 100 0 510 ECU_ADDRESS 0xFFFFAFBE /begin FUNCTION_LIST KF7-500.25A[7] /end FUNCTION_LIST /end MEASUREMENT
/begin MEASUREMENT vRHBVSP "The rest O2/H vehicle speed time series data" UBYTE COMP_0007 1 100 0 510 ECU_ADDRESS 0xFFFFAFBF /begin FUNCTION_LIST KF7-500.25A[7] /end FUNCTION_LIST /end MEASUREMENT
/begin MEASUREMENT vRHBVSP_R#1 "The rest O2/H vehicle speed time series data" UBYTE COMP_0007 1 100 0 510 ECU_ADDRESS 0xFFFFAFBF /begin FUNCTION_LIST KF7-500.25A[7] /end FUNCTION_LIST /end MEASUREMENT
/begin MEASUREMENT vRHBVSP_R#2 "The rest O2/H vehicle speed time series data" UBYTE COMP_0007 1 100 0 510 ECU_ADDRESS 0xFFFFAFC0 /begin FUNCTION_LIST KF7-500.25A[7] /end FUNCTION_LIST /end MEASUREMENT
/begin MEASUREMENT vRHBVSP_R#3 "The rest O2/H vehicle speed time series data" UBYTE COMP_0007 1 100 0 510 ECU_ADDRESS 0xFFFFAFC1 /begin FUNCTION_LIST KF7-500.25A[7] /end FUNCTION_LIST /end MEASUREMENT
/begin MEASUREMENT vRHBVSP_R#4 "The rest O2/H vehicle speed time series data" UBYTE COMP_0007 1 100 0 510 ECU_ADDRESS 0xFFFFAFC2 /begin FUNCTION_LIST KF7-500.25A[7] /end FUNCTION_LIST /end MEASUREMENT
/begin MEASUREMENT vRHBVSP_R#5 "The rest O2/H vehicle speed time series data" UBYTE COMP_0007 1 100 0 510 ECU_ADDRESS 0xFFFFAFC3 /begin FUNCTION_LIST KF7-500.25A[7] /end FUNCTION_LIST /end MEASUREMENT
/begin MEASUREMENT vRHBVSP_R#6 "The rest O2/H vehicle speed time series data" UBYTE COMP_0007 1 100 0 510 ECU_ADDRESS 0xFFFFAFC4 /begin FUNCTION_LIST KF7-500.25A[7] /end FUNCTION_LIST /end MEASUREMENT
/begin MEASUREMENT vRHBVSP_R#7 "The rest O2/H vehicle speed time series data" UBYTE COMP_0007 1 100 0 510 ECU_ADDRESS 0xFFFFAFC5 /begin FUNCTION_LIST KF7-500.25A[7] /end FUNCTION_LIST /end MEASUREMENT
/begin MEASUREMENT vRHBVSP_R#8 "The rest O2/H vehicle speed time series data" UBYTE COMP_0007 1 100 0 510 ECU_ADDRESS 0xFFFFAFC6 /begin FUNCTION_LIST KF7-500.25A[7] /end FUNCTION_LIST /end MEASUREMENT
/begin MEASUREMENT vRHBVSP_R#9 "The rest O2/H vehicle speed time series data" UBYTE COMP_0007 1 100 0 510 ECU_ADDRESS 0xFFFFAFC7 /begin FUNCTION_LIST KF7-500.25A[7] /end FUNCTION_LIST /end MEASUREMENT
/begin MEASUREMENT vRHBVSP_R#10 "The rest O2/H vehicle speed time series data" UBYTE COMP_0007 1 100 0 510 ECU_ADDRESS 0xFFFFAFC8 /begin FUNCTION_LIST KF7-500.25A[7] /end FUNCTION_LIST /end MEASUREMENT
/begin MEASUREMENT vRHBVSP_R#11 "The rest O2/H vehicle speed time series data" UBYTE COMP_0007 1 100 0 510 ECU_ADDRESS 0xFFFFAFC9 /begin FUNCTION_LIST KF7-500.25A[7] /end FUNCTION_LIST /end MEASUREMENT
/begin MEASUREMENT vRKTI "TINT compensation coefficient learning value by the cylinder" UWORD COMP_0456 1 100 0 1.999970916 ECU_ADDRESS 0xFFFFB538 /begin FUNCTION_LIST KF7-500.26[17] /end FUNCTION_LIST /end MEASUREMENT
/begin MEASUREMENT vRNA "All the diagnosis region rotation number of times integration value" ULONG COMP_0619_S 1 100 0 429496729.5 ECU_ADDRESS 0xFFFFAFCC /begin FUNCTION_LIST KF7-500.26[17] /end FUNCTION_LIST /end MEASUREMENT
/begin MEASUREMENT vRNB11 "New diagnosis region rotation number of times integration value" ULONG COMP_0620_S 1 100 0 4294967.295 ECU_ADDRESS 0xFFFFAFD0 /begin FUNCTION_LIST KF7-500.26[17] /end FUNCTION_LIST /end MEASUREMENT
/begin MEASUREMENT vRNB12 "New diagnosis region rotation number of times integration value" ULONG COMP_0620_S 1 100 0 4294967.295 ECU_ADDRESS 0xFFFFAFD4 /begin FUNCTION_LIST KF7-500.26[17] /end FUNCTION_LIST /end MEASUREMENT
/begin MEASUREMENT vRNB13 "New diagnosis region rotation number of times integration value" ULONG COMP_0620_S 1 100 0 4294967.295 ECU_ADDRESS 0xFFFFAFD8 /begin FUNCTION_LIST KF7-500.26[17] /end FUNCTION_LIST /end MEASUREMENT
/begin MEASUREMENT vRNB14 "New diagnosis region rotation number of times integration value" ULONG COMP_0620_S 1 100 0 4294967.295 ECU_ADDRESS 0xFFFFAFDC /begin FUNCTION_LIST KF7-500.26[17] /end FUNCTION_LIST /end MEASUREMENT
/begin MEASUREMENT vRNB21 "New diagnosis region rotation number of times integration value" ULONG COMP_0620_S 1 100 0 4294967.295 ECU_ADDRESS 0xFFFFAFE0 /begin FUNCTION_LIST KF7-500.26[17] /end FUNCTION_LIST /end MEASUREMENT
/begin MEASUREMENT vRNB22 "New diagnosis region rotation number of times integration value" ULONG COMP_0620_S 1 100 0 4294967.295 ECU_ADDRESS 0xFFFFAFE4 /begin FUNCTION_LIST KF7-500.26[17] /end FUNCTION_LIST /end MEASUREMENT
/begin MEASUREMENT vRNB23 "New diagnosis region rotation number of times integration value" ULONG COMP_0620_S 1 100 0 4294967.295 ECU_ADDRESS 0xFFFFAFE8 /begin FUNCTION_LIST KF7-500.26[17] /end FUNCTION_LIST /end MEASUREMENT
/begin MEASUREMENT vRNB24 "New diagnosis region rotation number of times integration value" ULONG COMP_0620_S 1 100 0 4294967.295 ECU_ADDRESS 0xFFFFAFEC /begin FUNCTION_LIST KF7-500.26[17] /end FUNCTION_LIST /end MEASUREMENT
/begin MEASUREMENT vRO2DCNT1 "A counter (bank 1) for RrO2 sensor diagnosis frequency measuring" UWORD COMP_0016 1 100 0 65535 ECU_ADDRESS 0xFFFFAFF8 /begin FUNCTION_LIST KF7-500.24[10] KF7-580.1[8] /end FUNCTION_LIST /end MEASUREMENT
/begin MEASUREMENT vRO2DCNT2 "A counter (bank 2) for RrO2 sensor diagnosis frequency measuring" UWORD COMP_0016 1 100 0 65535 ECU_ADDRESS 0xFFFFAFFA /begin FUNCTION_LIST KF7-500.24[10] KF7-580.1[8] /end FUNCTION_LIST /end MEASUREMENT
/begin MEASUREMENT vROJFCC "Fuel cut number of times" UBYTE COMP_0030 1 100 0 255 ECU_ADDRESS 0xFFFF3179 /begin FUNCTION_LIST KF7-500.24[10] KF7-580.1[8] /end FUNCTION_LIST /end MEASUREMENT
/begin MEASUREMENT vROXMN "VRO2 minimum value" UBYTE COMP_0104 1 100 0 2550 ECU_ADDRESS 0xFFFF4968 /begin FUNCTION_LIST KF7-500.24[10] R901.1.Diag_on_can_app_1_6_2 /end FUNCTION_LIST /end MEASUREMENT
/begin MEASUREMENT vROXMX "VRO2 maximum value" UBYTE COMP_0104 1 100 0 2550 ECU_ADDRESS 0xFFFF496A /begin FUNCTION_LIST KF7-500.24[10] R901.1.Diag_on_can_app_1_6_2 /end FUNCTION_LIST /end MEASUREMENT
/begin MEASUREMENT vSHSOSQ "O2 storage ability for the operation" ULONG COMP_0555_S 1 100 0 42949672.95 ECU_ADDRESS 0xFFFF31CC /begin FUNCTION_LIST KF7-500.21[19] /end FUNCTION_LIST /end MEASUREMENT
/begin MEASUREMENT vSHSOSQ_R#1 "O2 storage ability for the operation" ULONG COMP_0555_S 1 100 0 42949672.95 ECU_ADDRESS 0xFFFF31CC /begin FUNCTION_LIST KF7-500.21[19] /end FUNCTION_LIST /end MEASUREMENT
/begin MEASUREMENT vSHSOSQ_R#2 "O2 storage ability for the operation" ULONG COMP_0555_S 1 100 0 42949672.95 ECU_ADDRESS 0xFFFF31D0 /begin FUNCTION_LIST KF7-500.21[19] /end FUNCTION_LIST /end MEASUREMENT
/begin MEASUREMENT vSKTNT "KTNTi integration value" ULONG COMP_0456 1 100 0 131072.093921892 ECU_ADDRESS 0xFFFF372C /begin FUNCTION_LIST KF7-500.26[17] /end FUNCTION_LIST /end MEASUREMENT
/begin MEASUREMENT vSMATH1 "Judgement cancellation threshold" UBYTE COMP_0605_S 1 100 -128 127 ECU_ADDRESS 0xFFFF31D4 /begin FUNCTION_LIST KF7-500.26[17] /end FUNCTION_LIST /end MEASUREMENT
/begin MEASUREMENT vSMISA "Misfire parameter" UBYTE COMP_0605_S 1 100 -128 127 ECU_ADDRESS 0xFFFF3740 /begin FUNCTION_LIST KF7-500.26[17] /end FUNCTION_LIST /end MEASUREMENT
/begin MEASUREMENT vSQASL "A water evaporating delay in the catalyst" UWORD COMP_0497 1 100 0 2621.4 ECU_ADDRESS 0xFFFF31F6 /begin FUNCTION_LIST KF7-500.21[19] /end FUNCTION_LIST /end MEASUREMENT
/begin MEASUREMENT vSRTEND "Diagnosis completion monitor flag" UBYTE COMP_0004 1 100 0 255 ECU_ADDRESS 0xFFFF422F
 /begin FUNCTION_LIST KF7-500.30[8] KF7-500.74[11] KF7-500.74B[5] KF7-500.76[8] KF7-580.1[8] /end FUNCTION_LIST
/end MEASUREMENT
/begin MEASUREMENT vSRTEND_R#1 "Diagnosis completion monitor flag" UBYTE COMP_0004 1 100 0 255 ECU_ADDRESS 0xFFFF422F
 /begin FUNCTION_LIST KF7-500.30[8] KF7-500.74[11] KF7-500.74B[5] KF7-500.76[8] KF7-580.1[8] /end FUNCTION_LIST
/end MEASUREMENT
/begin MEASUREMENT vSRTEND_R#2 "Diagnosis completion monitor flag" UBYTE COMP_0004 1 100 0 255 ECU_ADDRESS 0xFFFF4230
 /begin FUNCTION_LIST KF7-500.30[8] KF7-500.74[11] KF7-500.74B[5] KF7-500.76[8] KF7-580.1[8] /end FUNCTION_LIST
/end MEASUREMENT
/begin MEASUREMENT vSRTEND_R#3 "Diagnosis completion monitor flag" UBYTE COMP_0004 1 100 0 255 ECU_ADDRESS 0xFFFF4231
 /begin FUNCTION_LIST KF7-500.30[8] KF7-500.74[11] KF7-500.74B[5] KF7-500.76[8] KF7-580.1[8] /end FUNCTION_LIST
/end MEASUREMENT
/begin MEASUREMENT vSRTEND_R#4 "Diagnosis completion monitor flag" UBYTE COMP_0004 1 100 0 255 ECU_ADDRESS 0xFFFF4232
 /begin FUNCTION_LIST KF7-500.30[8] KF7-500.74[11] KF7-500.74B[5] KF7-500.76[8] KF7-580.1[8] /end FUNCTION_LIST
/end MEASUREMENT
/begin MEASUREMENT vSRTEND_R#5 "Diagnosis completion monitor flag" UBYTE COMP_0004 1 100 0 255 ECU_ADDRESS 0xFFFF4233
 /begin FUNCTION_LIST KF7-500.30[8] KF7-500.74[11] KF7-500.74B[5] KF7-500.76[8] KF7-580.1[8] /end FUNCTION_LIST
/end MEASUREMENT
/begin MEASUREMENT vSRTEND_R#6 "Diagnosis completion monitor flag" UBYTE COMP_0004 1 100 0 255 ECU_ADDRESS 0xFFFF4234
 /begin FUNCTION_LIST KF7-500.30[8] KF7-500.74[11] KF7-500.74B[5] KF7-500.76[8] KF7-580.1[8] /end FUNCTION_LIST
/end MEASUREMENT
/begin MEASUREMENT vSRTRSL "Diagnosis result monitor flag" UBYTE COMP_0004 1 100 0 255 ECU_ADDRESS 0xFFFF4235
 /begin FUNCTION_LIST KF7-500.30[8] KF7-500.74[11] KF7-500.74B[5] KF7-500.76[8] KF7-580.1[8] /end FUNCTION_LIST
/end MEASUREMENT
/begin MEASUREMENT vSRTRSL_R#1 "Diagnosis result monitor flag" UBYTE COMP_0004 1 100 0 255 ECU_ADDRESS 0xFFFF4235
 /begin FUNCTION_LIST KF7-500.30[8] KF7-500.74[11] KF7-500.74B[5] KF7-500.76[8] KF7-580.1[8] /end FUNCTION_LIST
/end MEASUREMENT
/begin MEASUREMENT vSRTRSL_R#2 "Diagnosis result monitor flag" UBYTE COMP_0004 1 100 0 255 ECU_ADDRESS 0xFFFF4236
 /begin FUNCTION_LIST KF7-500.30[8] KF7-500.74[11] KF7-500.74B[5] KF7-500.76[8] KF7-580.1[8] /end FUNCTION_LIST
/end MEASUREMENT
/begin MEASUREMENT vSRTRSL_R#3 "Diagnosis result monitor flag" UBYTE COMP_0004 1 100 0 255 ECU_ADDRESS 0xFFFF4237
 /begin FUNCTION_LIST KF7-500.30[8] KF7-500.74[11] KF7-500.74B[5] KF7-500.76[8] KF7-580.1[8] /end FUNCTION_LIST
/end MEASUREMENT
/begin MEASUREMENT vSRTRSL_R#4 "Diagnosis result monitor flag" UBYTE COMP_0004 1 100 0 255 ECU_ADDRESS 0xFFFF4238
 /begin FUNCTION_LIST KF7-500.30[8] KF7-500.74[11] KF7-500.74B[5] KF7-500.76[8] KF7-580.1[8] /end FUNCTION_LIST
/end MEASUREMENT
/begin MEASUREMENT vSRTRSL_R#5 "Diagnosis result monitor flag" UBYTE COMP_0004 1 100 0 255 ECU_ADDRESS 0xFFFF4239
 /begin FUNCTION_LIST KF7-500.30[8] KF7-500.74[11] KF7-500.74B[5] KF7-500.76[8] KF7-580.1[8] /end FUNCTION_LIST
/end MEASUREMENT
/begin MEASUREMENT vSRTRSL_R#6 "Diagnosis result monitor flag" UBYTE COMP_0004 1 100 0 255 ECU_ADDRESS 0xFFFF423A
 /begin FUNCTION_LIST KF7-500.30[8] KF7-500.74[11] KF7-500.74B[5] KF7-500.76[8] KF7-580.1[8] /end FUNCTION_LIST
/end MEASUREMENT
/begin MEASUREMENT vSRTTST "Diagnosis region monitor flag" UBYTE COMP_0004 1 100 0 255 ECU_ADDRESS 0xFFFF423B
 /begin FUNCTION_LIST KF7-500.30[8] KF7-500.74[11] KF7-500.74B[5] KF7-500.76[8] KF7-580.1[8] /end FUNCTION_LIST
/end MEASUREMENT
/begin MEASUREMENT vSRTTST_R#1 "Diagnosis region monitor flag" UBYTE COMP_0004 1 100 0 255 ECU_ADDRESS 0xFFFF423B
 /begin FUNCTION_LIST KF7-500.30[8] KF7-500.74[11] KF7-500.74B[5] KF7-500.76[8] KF7-580.1[8] /end FUNCTION_LIST
/end MEASUREMENT
/begin MEASUREMENT vSRTTST_R#2 "Diagnosis region monitor flag" UBYTE COMP_0004 1 100 0 255 ECU_ADDRESS 0xFFFF423C
 /begin FUNCTION_LIST KF7-500.30[8] KF7-500.74[11] KF7-500.74B[5] KF7-500.76[8] KF7-580.1[8] /end FUNCTION_LIST
/end MEASUREMENT
/begin MEASUREMENT vSRTTST_R#3 "Diagnosis region monitor flag" UBYTE COMP_0004 1 100 0 255 ECU_ADDRESS 0xFFFF423D
 /begin FUNCTION_LIST KF7-500.30[8] KF7-500.74[11] KF7-500.74B[5] KF7-500.76[8] KF7-580.1[8] /end FUNCTION_LIST
/end MEASUREMENT
/begin MEASUREMENT vSRTTST_R#4 "Diagnosis region monitor flag" UBYTE COMP_0004 1 100 0 255 ECU_ADDRESS 0xFFFF423E
 /begin FUNCTION_LIST KF7-500.30[8] KF7-500.74[11] KF7-500.74B[5] KF7-500.76[8] KF7-580.1[8] /end FUNCTION_LIST
/end MEASUREMENT
/begin MEASUREMENT vSRTTST_R#5 "Diagnosis region monitor flag" UBYTE COMP_0004 1 100 0 255 ECU_ADDRESS 0xFFFF423F
 /begin FUNCTION_LIST KF7-500.30[8] KF7-500.74[11] KF7-500.74B[5] KF7-500.76[8] KF7-580.1[8] /end FUNCTION_LIST
/end MEASUREMENT
/begin MEASUREMENT vSRTTST_R#6 "Diagnosis region monitor flag" UBYTE COMP_0004 1 100 0 255 ECU_ADDRESS 0xFFFF4240
 /begin FUNCTION_LIST KF7-500.30[8] KF7-500.74[11] KF7-500.74B[5] KF7-500.76[8] KF7-580.1[8] /end FUNCTION_LIST
/end MEASUREMENT
/begin MEASUREMENT vSTAO2S "When an O2 sensor diagnosis starts, mileage" UWORD COMP_0385 1 100 0 105380.28 ECU_ADDRESS 0xFFFFB236 /begin FUNCTION_LIST KF7-500.24[10] /end FUNCTION_LIST /end MEASUREMENT
/begin MEASUREMENT vSUMCNT "O2 storage ability integration counter" UWORD COMP_0030 1 100 0 65535 ECU_ADDRESS 0xFFFF17C8 /begin FUNCTION_LIST KF7-500.21[19] /end FUNCTION_LIST /end MEASUREMENT
/begin MEASUREMENT vSUMCNT_R#1 "O2 storage ability integration counter" UWORD COMP_0030 1 100 0 65535 ECU_ADDRESS 0xFFFF17C8 /begin FUNCTION_LIST KF7-500.21[19] /end FUNCTION_LIST /end MEASUREMENT
/begin MEASUREMENT vSUMCNT_R#2 "O2 storage ability integration counter" UWORD COMP_0030 1 100 0 65535 ECU_ADDRESS 0xFFFF17CA /begin FUNCTION_LIST KF7-500.21[19] /end FUNCTION_LIST /end MEASUREMENT
/begin MEASUREMENT vSUMOSC "O2 storage ability integration value" ULONG COMP_0555_S 1 100 0 42949672.95 ECU_ADDRESS 0xFFFF17CC /begin FUNCTION_LIST KF7-500.21[19] /end FUNCTION_LIST /end MEASUREMENT
/begin MEASUREMENT vSUMOSC_R#1 "O2 storage ability integration value" ULONG COMP_0555_S 1 100 0 42949672.95 ECU_ADDRESS 0xFFFF17CC /begin FUNCTION_LIST KF7-500.21[19] /end FUNCTION_LIST /end MEASUREMENT
/begin MEASUREMENT vSUMOSC_R#2 "O2 storage ability integration value" ULONG COMP_0555_S 1 100 0 42949672.95 ECU_ADDRESS 0xFFFF17D0 /begin FUNCTION_LIST KF7-500.21[19] /end FUNCTION_LIST /end MEASUREMENT
/begin MEASUREMENT vSUMQI "An integration air flow-quantity in the catalyst" UWORD COMP_0497 1 100 0 2621.4 ECU_ADDRESS 0xFFFF3248 /begin FUNCTION_LIST KF7-500.21[19] /end FUNCTION_LIST /end MEASUREMENT
/begin MEASUREMENT vSUMSTG "STRAG integration value" UWORD COMP_0085_S 1 100 0 65535 ECU_ADDRESS 0xFFFF324A /begin FUNCTION_LIST KF7-500.21[19] /end FUNCTION_LIST /end MEASUREMENT
/begin MEASUREMENT vSUMSTG_R#1 "STRAG integration value" UWORD COMP_0085_S 1 100 0 65535 ECU_ADDRESS 0xFFFF324A /begin FUNCTION_LIST KF7-500.21[19] /end FUNCTION_LIST /end MEASUREMENT
/begin MEASUREMENT vSUMSTG_R#2 "STRAG integration value" UWORD COMP_0085_S 1 100 0 65535 ECU_ADDRESS 0xFFFF324C /begin FUNCTION_LIST KF7-500.21[19] /end FUNCTION_LIST /end MEASUREMENT
/begin MEASUREMENT vTCAJA2V "Imaginary stage 2 diagnosis region timer" UBYTE COMP_0013 1 100 0 255 ECU_ADDRESS 0xFFFF32BA /begin FUNCTION_LIST KF7-500.21[19] /end FUNCTION_LIST /end MEASUREMENT
/begin MEASUREMENT vTCAJA2V_R#1 "Imaginary stage 2 diagnosis region timer" UBYTE COMP_0013 1 100 0 255 ECU_ADDRESS 0xFFFF32BA /begin FUNCTION_LIST KF7-500.21[19] /end FUNCTION_LIST /end MEASUREMENT
/begin MEASUREMENT vTCAJA2V_R#2 "Imaginary stage 2 diagnosis region timer" UBYTE COMP_0013 1 100 0 255 ECU_ADDRESS 0xFFFF32BB /begin FUNCTION_LIST KF7-500.21[19] /end FUNCTION_LIST /end MEASUREMENT
/begin MEASUREMENT vTCATKO "IGN SW At the time of off, catalyst estimated temperature" UBYTE COMP_0062 1 100 0 1020 ECU_ADDRESS 0xFFFFB23F /begin FUNCTION_LIST KF7-500.21[19] R000.4.EepAlloc_1_2_2 /end FUNCTION_LIST /end MEASUREMENT
/begin MEASUREMENT vTCATL "Catalyst estimated temperature, at least, value region A" UBYTE COMP_0062 1 100 0 1020 ECU_ADDRESS 0xFFFF1811 /begin FUNCTION_LIST KF7-500.21[19] /end FUNCTION_LIST /end MEASUREMENT
/begin MEASUREMENT vTCATL_R#1 "Catalyst estimated temperature, at least, value region A" UBYTE COMP_0062 1 100 0 1020 ECU_ADDRESS 0xFFFF1811 /begin FUNCTION_LIST KF7-500.21[19] /end FUNCTION_LIST /end MEASUREMENT
/begin MEASUREMENT vTCATL_R#2 "Catalyst estimated temperature, at least, value region A" UBYTE COMP_0062 1 100 0 1020 ECU_ADDRESS 0xFFFF1812 /begin FUNCTION_LIST KF7-500.21[19] /end FUNCTION_LIST /end MEASUREMENT
/begin MEASUREMENT vTCATL_R#3 "Catalyst estimated temperature, at least, value region A" UBYTE COMP_0062 1 100 0 1020 ECU_ADDRESS 0xFFFF1813 /begin FUNCTION_LIST KF7-500.21[19] /end FUNCTION_LIST /end MEASUREMENT
/begin MEASUREMENT vTCATL_R#4 "Catalyst estimated temperature, at least, value region A" UBYTE COMP_0062 1 100 0 1020 ECU_ADDRESS 0xFFFF1814 /begin FUNCTION_LIST KF7-500.21[19] /end FUNCTION_LIST /end MEASUREMENT
/begin MEASUREMENT vTEXB "Basic catalyst temperature (after the filter)" UWORD COMP_0504 1 100 0 1023.984375 ECU_ADDRESS 0xFFFF32E6 /begin FUNCTION_LIST KF7-500.21[19] /end FUNCTION_LIST /end MEASUREMENT
/begin MEASUREMENT vTEXB1 "Filter leak 1" UWORD COMP_0504 1 100 0 1023.984375 ECU_ADDRESS 0xFFFF32E8 /begin FUNCTION_LIST KF7-500.21[19] /end FUNCTION_LIST /end MEASUREMENT
/begin MEASUREMENT vTEXB2 "Filter leak 2" UWORD COMP_0504 1 100 0 1023.984375 ECU_ADDRESS 0xFFFF32EA /begin FUNCTION_LIST KF7-500.21[19] /end FUNCTION_LIST /end MEASUREMENT
/begin MEASUREMENT vTEXST "At the time of the steady state, catalyst temperature" UBYTE COMP_0062 1 100 0 1020 ECU_ADDRESS 0xFFFF32EC /begin FUNCTION_LIST KF7-500.21[19] /end FUNCTION_LIST /end MEASUREMENT
/begin MEASUREMENT vTFA "Average fuel temperature" UBYTE COMP_0035 1 100 -50 205 ECU_ADDRESS 0xFFFF89CA /begin FUNCTION_LIST KF7-500.30[8] KF7-580.1[8] /end FUNCTION_LIST /end MEASUREMENT
/begin MEASUREMENT vTROXM "The rest O2/S diagnosis monitor time timer" UWORD COMP_0049 1 100 0 65535 ECU_ADDRESS 0xFFFF33C4 /begin FUNCTION_LIST KF7-500.24[10] /end FUNCTION_LIST /end MEASUREMENT
/begin MEASUREMENT vTVOIMN "At the time of the throttle full-close for the ISC diagnosis, minimum value" UWORD COMP_0023 1 100 0 327675 ECU_ADDRESS 0xFFFF341E /begin FUNCTION_LIST KF7-500.38A[4] /end FUNCTION_LIST /end MEASUREMENT
/begin MEASUREMENT vWKSTRGRV "Imaginary STRAG operation work RAM for the RrO2 sensor diagnosis" ULONG COMP_0068 1 100 0 4294967295 ECU_ADDRESS 0xFFFF34C4 /begin FUNCTION_LIST KF7-500.24[10] /end FUNCTION_LIST /end MEASUREMENT
/begin MEASUREMENT vWKSTRGRV_R#1 "Imaginary STRAG operation work RAM for the RrO2 sensor diagnosis" ULONG COMP_0068 1 100 0 4294967295 ECU_ADDRESS 0xFFFF34C4 /begin FUNCTION_LIST KF7-500.24[10] /end FUNCTION_LIST /end MEASUREMENT
/begin MEASUREMENT vWKSTRGRV_R#2 "Imaginary STRAG operation work RAM for the RrO2 sensor diagnosis" ULONG COMP_0068 1 100 0 4294967295 ECU_ADDRESS 0xFFFF34C8 /begin FUNCTION_LIST KF7-500.24[10] /end FUNCTION_LIST /end MEASUREMENT
/begin MEASUREMENT vWKSTRGV "STRAG operation work RAM for imaginary stage 2" ULONG COMP_0068 1 100 0 4294967295 ECU_ADDRESS 0xFFFF34CC /begin FUNCTION_LIST KF7-500.21[19] /end FUNCTION_LIST /end MEASUREMENT
/begin MEASUREMENT vWKSTRGV_R#1 "STRAG operation work RAM for imaginary stage 2" ULONG COMP_0068 1 100 0 4294967295 ECU_ADDRESS 0xFFFF34CC /begin FUNCTION_LIST KF7-500.21[19] /end FUNCTION_LIST /end MEASUREMENT
/begin MEASUREMENT vWKSTRGV_R#2 "STRAG operation work RAM for imaginary stage 2" ULONG COMP_0068 1 100 0 4294967295 ECU_ADDRESS 0xFFFF34D0 /begin FUNCTION_LIST KF7-500.21[19] /end FUNCTION_LIST /end MEASUREMENT
/begin MEASUREMENT vZURASI "TINT measuring section movement fee" SBYTE COMP_0495 1 100 -128 127 ECU_ADDRESS 0xFFFF4094 /begin FUNCTION_LIST KF7-500.26[17] /end FUNCTION_LIST /end MEASUREMENT
/begin MEASUREMENT wvAPOK30 "For 30mS, the amount of a change in APOK" UBYTE COMP_0127 1 100 -44.8 44.45 ECU_ADDRESS 0xFFFF47CB /begin FUNCTION_LIST KF7-500.26[17] /end FUNCTION_LIST /end MEASUREMENT
/begin MEASUREMENT wvDLTN1 "The amount of a change in NRPM" UBYTE COMP_0070 1 100 0 3187.5 ECU_ADDRESS 0xFFFF4819 /begin FUNCTION_LIST KF7-500.21[19] KF7-500.38A[4] /end FUNCTION_LIST /end MEASUREMENT
/begin MEASUREMENT wvDLTTP "TP change absolute value" UBYTE COMP_0124 1 100 0 31.875 ECU_ADDRESS 0xFFFF481A /begin FUNCTION_LIST KF7-500.21[19] /end FUNCTION_LIST /end MEASUREMENT
/begin MEASUREMENT wvDTVO30 "For 30mS, the amount of a change in TVO" UBYTE COMP_0127 1 100 -44.8 44.45 ECU_ADDRESS 0xFFFF4821 /begin FUNCTION_LIST KF7-500.26[17] /end FUNCTION_LIST /end MEASUREMENT
/begin MEASUREMENT wvDVLRX "The proper side (LR) change quantity maximum value" UBYTE COMP_0586_S 1 100 0 2550 ECU_ADDRESS 0xFFFF4822 /begin FUNCTION_LIST KF7-500.24[10] /end FUNCTION_LIST /end MEASUREMENT
/begin MEASUREMENT wvDVRLX "Negative side (RL) change quantity maximum value" UBYTE COMP_0586_S 1 100 0 2550 ECU_ADDRESS 0xFFFF4824 /begin FUNCTION_LIST KF7-500.24[10] /end FUNCTION_LIST /end MEASUREMENT
/begin MEASUREMENT wvROXMN "VRO2 minimum value" UBYTE COMP_0104 1 100 0 2550 ECU_ADDRESS 0xFFFF4866 /begin FUNCTION_LIST KF7-500.24[10] /end FUNCTION_LIST /end MEASUREMENT
/begin MEASUREMENT wvROXMX "VRO2 maximum value" UBYTE COMP_0104 1 100 0 2550 ECU_ADDRESS 0xFFFF4868 /begin FUNCTION_LIST KF7-500.24[10] /end FUNCTION_LIST /end MEASUREMENT
/begin MEASUREMENT wvTFA "Average fuel temperature" UBYTE COMP_0035 1 100 -50 205 ECU_ADDRESS 0xFFFF893E /begin FUNCTION_LIST KF7-500.30[8] KF7-580.1[8] /end FUNCTION_LIST /end MEASUREMENT
/begin COMPU_METHOD COMP_0205_S "fixed axis Long" RAT_FUNC "%8.2" "Long" COEFFS 0 1 0 0 0 1 /end COMPU_METHOD
/begin COMPU_METHOD COMP_0068 "1-" RAT_FUNC "%8.2" "-" COEFFS 0 1 0 0 0 1 /end COMPU_METHOD
/begin COMPU_METHOD COMP_0004 "1Å|" RAT_FUNC "%8.2" "Å|" COEFFS 0 1 0 0 0 1 /end COMPU_METHOD
/begin COMPU_METHOD COMP_0023 "5mV" RAT_FUNC "%8.2" "mV" COEFFS 0 1 0 0 0 5 /end COMPU_METHOD
/begin COMPU_METHOD COMP_0074 "1/256count" RAT_FUNC "%8.4" "count" COEFFS 0 1 0 0 0 0.00390625 /end COMPU_METHOD
/begin COMPU_METHOD COMP_0045 "1/128-" RAT_FUNC "%8.4" "-" COEFFS 0 1 0 0 0 0.0078125 /end COMPU_METHOD
/begin COMPU_METHOD COMP_0001 "1/8ms" RAT_FUNC "%8.2" "ms" COEFFS 0 1 0 0 0 0.125 /end COMPU_METHOD
/begin COMPU_METHOD COMP_0020 "50rpm" RAT_FUNC "%8.2" "rpm" COEFFS 0 1 0 0 0 50 /end COMPU_METHOD
/begin COMPU_METHOD COMP_0002 "0.35deg" RAT_FUNC "%8.2" "deg" COEFFS 0 1 0 0 0 0.35 /end COMPU_METHOD
/begin COMPU_METHOD COMP_0003 "1Åé" RAT_FUNC "%8.2" "Åé" COEFFS 0 1 0 0 0 1 /end COMPU_METHOD
/begin COMPU_METHOD COMP_0014 "10ms" RAT_FUNC "%8.2" "ms" COEFFS 0 1 0 0 0 10 /end COMPU_METHOD
/begin COMPU_METHOD COMP_0006 "12.5rpm" RAT_FUNC "%8.2" "rpm" COEFFS 0 1 0 0 0 12.5 /end COMPU_METHOD
/begin COMPU_METHOD COMP_0008 "100ms" RAT_FUNC "%8.2" "ms" COEFFS 0 1 0 0 0 100 /end COMPU_METHOD
/begin COMPU_METHOD COMP_0009 "100/128%" RAT_FUNC "%8.2" "%" COEFFS 0 1 0 0 0 0.78125 /end COMPU_METHOD
/begin COMPU_METHOD COMP_0013 "1s" RAT_FUNC "%8.2" "s" COEFFS 0 1 0 0 0 1 /end COMPU_METHOD
/begin COMPU_METHOD COMP_0000 "25rpm" RAT_FUNC "%8.2" "rpm" COEFFS 0 1 0 0 0 25 /end COMPU_METHOD
/begin COMPU_METHOD COMP_0007 "2km/h" RAT_FUNC "%8.2" "km/h" COEFFS 0 1 0 0 0 2 /end COMPU_METHOD
/begin COMPU_METHOD COMP_0021 "100/256%" RAT_FUNC "%8.2" "%" COEFFS 0 1 0 0 0 0.390625 /end COMPU_METHOD
/begin COMPU_METHOD COMP_0033 "80mV" RAT_FUNC "%8.2" "mV" COEFFS 0 1 0 0 0 80 /end COMPU_METHOD
/begin COMPU_METHOD COMP_0027 "1%" RAT_FUNC "%8.2" "%" COEFFS 0 1 0 0 0 1 /end COMPU_METHOD
/begin COMPU_METHOD COMP_0049 "1sec" RAT_FUNC "%8.2" "sec" COEFFS 0 1 0 0 0 1 /end COMPU_METHOD
/begin COMPU_METHOD COMP_0030 "1âÒ" RAT_FUNC "%8.2" "âÒ" COEFFS 0 1 0 0 0 1 /end COMPU_METHOD
/begin COMPU_METHOD COMP_0044 "1/128Å|" RAT_FUNC "%8.4" "Å|" COEFFS 0 1 0 0 0 0.0078125 /end COMPU_METHOD
/begin COMPU_METHOD COMP_0016 "1count" RAT_FUNC "%8.2" "count" COEFFS 0 1 0 0 0 1 /end COMPU_METHOD
/begin COMPU_METHOD COMP_0054 "20mV" RAT_FUNC "%8.2" "mV" COEFFS 0 1 0 0 0 20 /end COMPU_METHOD
/begin COMPU_METHOD COMP_0056 "25rmp" RAT_FUNC "%8.2" "rmp" COEFFS 0 1 0 0 0 25 /end COMPU_METHOD
/begin COMPU_METHOD COMP_0050 "5/64mV" RAT_FUNC "%8.3" "mV" COEFFS 0 1 0 0 0 0.078125 /end COMPU_METHOD
/begin COMPU_METHOD COMP_0035 "X-50Åé" RAT_FUNC "%8.2" "Åé" COEFFS 0 1 50 0 0 1 /end COMPU_METHOD
/begin COMPU_METHOD COMP_0070 "12.5rpm/s" RAT_FUNC "%8.2" "rpm/s" COEFFS 0 1 0 0 0 12.5 /end COMPU_METHOD
/begin COMPU_METHOD COMP_0085_S "ms/2^(STUG#-13)ms/2^(ST" RAT_FUNC "%8.2" "ms/2^(ST" COEFFS 0 1 0 0 0 1 /end COMPU_METHOD
/begin COMPU_METHOD COMP_0075 "1count" RAT_FUNC "%8.2" "count" COEFFS 0 1 0 0 0 1 /end COMPU_METHOD
/begin COMPU_METHOD COMP_0096 "10s" RAT_FUNC "%8.2" "s" COEFFS 0 1 0 0 0 10 /end COMPU_METHOD
/begin COMPU_METHOD COMP_0410 "100/256/256%" RAT_FUNC "%8.4" "%" COEFFS 0 1 0 0 0 0.00152588 /end COMPU_METHOD
/begin COMPU_METHOD COMP_0069 "1/(128*256)Å|" RAT_FUNC "%8.6" "Å|" COEFFS 0 1 0 0 0 0.0000305176 /end COMPU_METHOD
/begin COMPU_METHOD COMP_0124 "0.125ms/100ms" RAT_FUNC "%8.2" "ms/100ms" COEFFS 0 1 0 0 0 0.125 /end COMPU_METHOD
/begin COMPU_METHOD COMP_0129 "0.35deg" RAT_FUNC "%8.2" "deg" COEFFS 0 1 44.8 0 0 0.35 /end COMPU_METHOD
/begin COMPU_METHOD COMP_0456 "1/(256Å~128)-" RAT_FUNC "%8.6" "-" COEFFS 0 1 0 0 0 0.0000305176 /end COMPU_METHOD
/begin COMPU_METHOD COMP_0104 "10mV" RAT_FUNC "%8.2" "mV" COEFFS 0 1 0 0 0 10 /end COMPU_METHOD
/begin COMPU_METHOD COMP_0205 "100/32%" RAT_FUNC "%8.2" "%" COEFFS 0 1 0 0 0 3.125 /end COMPU_METHOD
/begin COMPU_METHOD COMP_0062 "4Åé" RAT_FUNC "%8.2" "Åé" COEFFS 0 1 0 0 0 4 /end COMPU_METHOD
/begin COMPU_METHOD COMP_0133_S "%%" RAT_FUNC "%8.3" "%" COEFFS 0 1 0 0 0 0.0390625 /end COMPU_METHOD
/begin COMPU_METHOD COMP_0435_S "1/321" RAT_FUNC "%8.3" "1" COEFFS 0 1 0 0 0 0.03125 /end COMPU_METHOD
/begin COMPU_METHOD COMP_0132_S "%%" RAT_FUNC "%8.2" "%" COEFFS 0 1 0 0 0 10 /end COMPU_METHOD
/begin COMPU_METHOD COMP_0092 "1bit" RAT_FUNC "%8.2" "bit" COEFFS 0 1 0 0 0 1 /end COMPU_METHOD
/begin COMPU_METHOD COMP_0291 "0.04*256gÅé" RAT_FUNC "%8.2" "gÅé" COEFFS 0 1 0 0 0 10.24 /end COMPU_METHOD
/begin COMPU_METHOD COMP_0144 "1/2048ms" RAT_FUNC "%8.5" "ms" COEFFS 0 1 0 0 0 0.000488281 /end COMPU_METHOD
/begin COMPU_METHOD COMP_0273_S "fixed axis rpm" RAT_FUNC "%8.2" "rpm" COEFFS 0 1 -400 0 0 400 /end COMPU_METHOD
/begin COMPU_METHOD COMP_0482_S "11/2^(32+" RAT_FUNC "%8.2" "1/2^(32+" COEFFS 0 1 0 0 0 1 /end COMPU_METHOD
/begin COMPU_METHOD COMP_0278_S "fixed axis Åé" RAT_FUNC "%8.2" "Åé" COEFFS 0 1 40 0 0 20 /end COMPU_METHOD
/begin COMPU_METHOD COMP_0271_S "fixed axis rpm" RAT_FUNC "%8.2" "rpm" COEFFS 0 1 0 0 0 400 /end COMPU_METHOD
/begin COMPU_METHOD COMP_0280_S "fixed axis Åé" RAT_FUNC "%8.2" "Åé" COEFFS 0 1 40 0 0 10 /end COMPU_METHOD
/begin COMPU_METHOD COMP_0505_S "fixed axis Åé" RAT_FUNC "%8.2" "Åé" COEFFS 0 1 20 0 0 20 /end COMPU_METHOD
/begin COMPU_METHOD COMP_0514_S "1ms/2'(ST" RAT_FUNC "%8.2" "ms/2'(ST" COEFFS 0 1 0 0 0 1 /end COMPU_METHOD
/begin COMPU_METHOD COMP_0329_S "fixed axis km/h" RAT_FUNC "%8.2" "km/h" COEFFS 0 1 0 0 0 16 /end COMPU_METHOD
/begin COMPU_METHOD COMP_0521_S "100/65536%" RAT_FUNC "%8.4" "%" COEFFS 0 1 0 0 0 0.00152879 /end COMPU_METHOD
/begin COMPU_METHOD COMP_0283 "1flag" RAT_FUNC "%8.2" "flag" COEFFS 0 1 0 0 0 1 /end COMPU_METHOD
/begin COMPU_METHOD COMP_0201_S "1s1s" RAT_FUNC "%8.2" "1s" COEFFS 0 1 0 0 0 1 /end COMPU_METHOD
/begin COMPU_METHOD COMP_0202_S "100ms100ms" RAT_FUNC "%8.2" "100ms" COEFFS 0 1 0 0 0 1 /end COMPU_METHOD
/begin COMPU_METHOD COMP_0203_S "10ms10ms" RAT_FUNC "%8.2" "10ms" COEFFS 0 1 0 0 0 1 /end COMPU_METHOD
/begin COMPU_METHOD COMP_0265 "1/4096%" RAT_FUNC "%8.5" "%" COEFFS 0 1 8.000012288 0 0 0.000244141 /end COMPU_METHOD
/begin COMPU_METHOD COMP_0127 "0.35X-0x80deg/30ms" RAT_FUNC "%8.2" "deg/30ms" COEFFS 0 1 44.8 0 0 0.35 /end COMPU_METHOD
/begin COMPU_METHOD COMP_0376 "0.1É S" RAT_FUNC "%8.2" "É S" COEFFS 0 1 0 0 0 0.1 /end COMPU_METHOD
/begin COMPU_METHOD COMP_0555_S "mgmg" RAT_FUNC "%8.3" "mg" COEFFS 0 1 0 0 0 0.01 /end COMPU_METHOD
/begin COMPU_METHOD COMP_0382 "10mV/500mV" RAT_FUNC "%8.2" "mV/500mV" COEFFS 0 1 0 0 0 10 /end COMPU_METHOD
/begin COMPU_METHOD COMP_0385 "1.608km" RAT_FUNC "%8.2" "km" COEFFS 0 1 0 0 0 1.608 /end COMPU_METHOD
/begin COMPU_METHOD COMP_0102 "20mV/s" RAT_FUNC "%8.2" "mV/s" COEFFS 0 1 0 0 0 20 /end COMPU_METHOD
/begin COMPU_METHOD COMP_0586_S "mV/500msmV/500ms" RAT_FUNC "%8.2" "mV/500ms" COEFFS 0 1 0 0 0 10 /end COMPU_METHOD
/begin COMPU_METHOD COMP_0433 "0.1É S" RAT_FUNC "%8.2" "É S" COEFFS 0 1 0 0 0 0.1 /end COMPU_METHOD
/begin COMPU_METHOD COMP_0605_S "(É S)^-2(ms)^-1(É S)^-2" RAT_FUNC "%8.2" "(É S)^-2" COEFFS 0 1 128 0 0 1 /end COMPU_METHOD
/begin COMPU_METHOD COMP_0463 "1/256-" RAT_FUNC "%8.2" "-" COEFFS 0 1 0 0 0 0.392156862 /end COMPU_METHOD
/begin COMPU_METHOD COMP_0607_S "kmkm" RAT_FUNC "%8.2" "km" COEFFS 0 1 0 0 0 25.7 /end COMPU_METHOD
/begin COMPU_METHOD COMP_0468 "1ﬂC" RAT_FUNC "%8.2" "ﬂC" COEFFS 0 1 40 0 0 1 /end COMPU_METHOD
/begin COMPU_METHOD COMP_0608_S "(É S)^-2(ms)^-1(É S)^-2" RAT_FUNC "%8.2" "(É S)^-2" COEFFS 0 1 0 0 0 1 /end COMPU_METHOD
/begin COMPU_METHOD COMP_0489 "1/4096%" RAT_FUNC "%8.5" "%" COEFFS 0 1 7.995392 0 0 0.000244 /end COMPU_METHOD
/begin COMPU_METHOD COMP_0495 "1éï" RAT_FUNC "%8.2" "éï" COEFFS 0 1 0 0 0 1 /end COMPU_METHOD
/begin COMPU_METHOD COMP_0619_S "âÒì]âÒì]" RAT_FUNC "%8.2" "âÒì]" COEFFS 0 1 0 0 0 0.1 /end COMPU_METHOD
/begin COMPU_METHOD COMP_0620_S "âÒì]âÒì]" RAT_FUNC "%8.4" "âÒì]" COEFFS 0 1 0 0 0 0.001 /end COMPU_METHOD
/begin COMPU_METHOD COMP_0497 "0.04gÅé" RAT_FUNC "%8.3" "gÅé" COEFFS 0 1 0 0 0 0.04 /end COMPU_METHOD
/begin COMPU_METHOD COMP_0504 "1/64Åé" RAT_FUNC "%8.3" "Åé" COEFFS 0 1 0 0 0 0.015625 /end COMPU_METHOD
/* RECORD_LAYOUT ------------------------------------------------------ */
/begin RECORD_LAYOUT REC_UBYTE_C FNC_VALUES 1 UBYTE COLUMN_DIR DIRECT /end RECORD_LAYOUT
/begin RECORD_LAYOUT REC_UWORD_C FNC_VALUES 1 UWORD COLUMN_DIR DIRECT /end RECORD_LAYOUT
/begin RECORD_LAYOUT REC_SBYTE_C FNC_VALUES 1 SBYTE COLUMN_DIR DIRECT /end RECORD_LAYOUT
/begin RECORD_LAYOUT REC_ULONG_C FNC_VALUES 1 ULONG COLUMN_DIR DIRECT /end RECORD_LAYOUT
/begin RECORD_LAYOUT REC_AXIS_UBYTE AXIS_PTS_X 1 UBYTE INDEX_INCR DIRECT /end RECORD_LAYOUT
/begin RECORD_LAYOUT REC_AXIS_UWORD AXIS_PTS_X 1 UWORD INDEX_INCR DIRECT /end RECORD_LAYOUT
/end MODULE
/end PROJECT
