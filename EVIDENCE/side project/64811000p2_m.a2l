ASAP2_VERSION 1 3_BETA
/begin PROJECT TK_X91_EUR_VC ""
/begin HEADER "" /* key HEADER ++ "comment" Ç… Par.scomment */ PROJECT_NO TK_X91_EUR_VC /* key PROJECT_NO ++ project number Ç… car_eng_desti_lot */ VERSION "7V4YHZEB2" /* key VERSION ++ version number Ç… mProgver */ /end HEADER
/begin MODULE DIM ""
/begin MOD_COMMON "" DEPOSIT ABSOLUTE BYTE_ORDER MSB_FIRST /* ﬁ≤ƒµ∞¿ﬁ∞Ç™ÿÃﬂ⁄∞ΩÇ≥ÇÍÇÈ */ /end MOD_COMMON
/begin MEASUREMENT vDLTO2 "FrO2/s element department temperature" UBYTE COMP_0399 1 100 -512 508 ECU_ADDRESS 0xFFFF2A69 /begin FUNCTION_LIST /end FUNCTION_LIST /end MEASUREMENT
/begin MEASUREMENT vDLTP2 "At the time of the first time leak-down, a change in the slosh partial pressure power" UWORD COMP_0050 1 100 0 5119.921875 ECU_ADDRESS 0xFFFF2A6C /begin FUNCTION_LIST /end FUNCTION_LIST /end MEASUREMENT
/begin MEASUREMENT vDLTPEDAL "Delta accelerator pedal ratio" UWORD COMP_0583_S 1 100 0 8191.875 ECU_ADDRESS 0xFFFF2A6E /begin FUNCTION_LIST /end FUNCTION_LIST /end MEASUREMENT
/begin MEASUREMENT vDLTPI2 "When a function is diagnosed, a change in pressure" UWORD COMP_0050 1 100 0 5119.921875 ECU_ADDRESS 0xFFFF2A70 /begin FUNCTION_LIST /end FUNCTION_LIST /end MEASUREMENT
/begin MEASUREMENT vDLTPRS "Pressure ceremony slosh judgement parameter" UWORD COMP_0050 1 100 0 5119.921875 ECU_ADDRESS 0xFFFF2A72 /begin FUNCTION_LIST /end FUNCTION_LIST /end MEASUREMENT
/begin MEASUREMENT vDLTPS1V "TPS deviation (a parameter for the un-adjustment diagnosis)" UWORD COMP_0023 1 100 0 327675 ECU_ADDRESS 0xFFFF3C0C /begin FUNCTION_LIST /end FUNCTION_LIST /end MEASUREMENT
/begin MEASUREMENT vDLTPX "At the time of the second time leak-down, a change in the slosh partial pressure power" UWORD COMP_0050 1 100 0 5119.921875 ECU_ADDRESS 0xFFFF2A74 /begin FUNCTION_LIST /end FUNCTION_LIST /end MEASUREMENT
/begin MEASUREMENT vDLTTPR "A change in TP before 100mS" UBYTE COMP_0001 1 100 0 31.875 ECU_ADDRESS 0xFFFF2A78 /begin FUNCTION_LIST /end FUNCTION_LIST /end MEASUREMENT
/begin MEASUREMENT vDLTTVOR "A change in TVO before 100mS" UBYTE COMP_0002 1 100 0 89.25 ECU_ADDRESS 0xFFFF2A79 /begin FUNCTION_LIST /end FUNCTION_LIST /end MEASUREMENT
/begin MEASUREMENT vDLTV100 "The amount of change of TVO for 100mS" UBYTE COMP_0584_S 1 100 0 89.25 ECU_ADDRESS 0xFFFF491D /begin FUNCTION_LIST /end FUNCTION_LIST /end MEASUREMENT
/begin MEASUREMENT vDLTVRO2f "The rest O2/S diagnosis parameter acquisition permission distinction" UBYTE COMP_0004 1 100 0 255 ECU_ADDRESS 0xFFFF2A7A /begin FUNCTION_LIST /end FUNCTION_LIST /end MEASUREMENT
/begin MEASUREMENT vDLTVS2 "VSP computed every delta-VSP absolute value" UBYTE COMP_0229 1 100 -256 254 ECU_ADDRESS 0xFFFF491E /begin FUNCTION_LIST /end FUNCTION_LIST /end MEASUREMENT
/begin MEASUREMENT vDLTVSP "VSP computed every delta-VSP (80H center)" UBYTE COMP_0007 1 100 0 510 ECU_ADDRESS 0xFFFF491F /begin FUNCTION_LIST /end FUNCTION_LIST /end MEASUREMENT
/begin MEASUREMENT vDLYEGT "DLYEGT hold value" UBYTE COMP_0008 1 100 0 25500 ECU_ADDRESS 0xFFFF2A7B /begin FUNCTION_LIST /end FUNCTION_LIST /end MEASUREMENT
/begin MEASUREMENT vDLYEGT2 "DLYEGT2 hold value" UBYTE COMP_0008 1 100 0 25500 ECU_ADDRESS 0xFFFF2A7C /begin FUNCTION_LIST /end FUNCTION_LIST /end MEASUREMENT
/begin MEASUREMENT vDLYOFCNT "DURLYOF# delay measuring counter" UBYTE COMP_0014 1 100 0 2550 ECU_ADDRESS 0xFFFF1E77 /begin FUNCTION_LIST /end FUNCTION_LIST /end MEASUREMENT
/begin MEASUREMENT vDLYSTCNT "Purge control valve start on counter" UWORD COMP_0068 1 100 0 65535 ECU_ADDRESS 0xFFFF1FBA /begin FUNCTION_LIST /end FUNCTION_LIST /end MEASUREMENT
/begin MEASUREMENT vDLYTMPE "Judgement delay time map reference value" UBYTE COMP_0008 1 100 0 25500 ECU_ADDRESS 0xFFFF1283 /begin FUNCTION_LIST /end FUNCTION_LIST /end MEASUREMENT
/begin MEASUREMENT vDLYTMPI "Judgement delay time map reference value" UBYTE COMP_0008 1 100 0 25500 ECU_ADDRESS 0xFFFF1284 /begin FUNCTION_LIST /end FUNCTION_LIST /end MEASUREMENT
/begin MEASUREMENT vDMALP "ALPHA change quantity (R/L)" UBYTE COMP_0153 1 100 -128 127 ECU_ADDRESS 0xFFFF1285 /begin FUNCTION_LIST /end FUNCTION_LIST /end MEASUREMENT
/begin MEASUREMENT vDMALP_R#1 "ALPHA change quantity (R/L)" UBYTE COMP_0153 1 100 -128 127 ECU_ADDRESS 0xFFFF1285 /begin FUNCTION_LIST /end FUNCTION_LIST /end MEASUREMENT
/begin MEASUREMENT vDMALP_R#2 "ALPHA change quantity (R/L)" UBYTE COMP_0153 1 100 -128 127 ECU_ADDRESS 0xFFFF1286 /begin FUNCTION_LIST /end FUNCTION_LIST /end MEASUREMENT
/begin MEASUREMENT vDMOFSTE "An initial spring offset angle" UWORD COMP_0026_S 1 100 0 6553.5 ECU_ADDRESS 0xFFFF1288 /begin FUNCTION_LIST /end FUNCTION_LIST /end MEASUREMENT
/begin MEASUREMENT vDMOFSTE_R#1 "An initial spring offset angle" UWORD COMP_0026_S 1 100 0 6553.5 ECU_ADDRESS 0xFFFF1288 /begin FUNCTION_LIST /end FUNCTION_LIST /end MEASUREMENT
/begin MEASUREMENT vDMOFSTE_R#2 "An initial spring offset angle" UWORD COMP_0026_S 1 100 0 6553.5 ECU_ADDRESS 0xFFFF128A /begin FUNCTION_LIST /end FUNCTION_LIST /end MEASUREMENT
/begin MEASUREMENT vDMOFSTI "An initial spring offset angle" UWORD COMP_0026_S 1 100 0 6553.5 ECU_ADDRESS 0xFFFF128C /begin FUNCTION_LIST /end FUNCTION_LIST /end MEASUREMENT
/begin MEASUREMENT vDMOFSTI_R#1 "An initial spring offset angle" UWORD COMP_0026_S 1 100 0 6553.5 ECU_ADDRESS 0xFFFF128C /begin FUNCTION_LIST /end FUNCTION_LIST /end MEASUREMENT
/begin MEASUREMENT vDMOFSTI_R#2 "An initial spring offset angle" UWORD COMP_0026_S 1 100 0 6553.5 ECU_ADDRESS 0xFFFF128E /begin FUNCTION_LIST /end FUNCTION_LIST /end MEASUREMENT
/begin MEASUREMENT vDOSLN1f "PHOS operation condition judgement" UBYTE COMP_0004 1 100 0 255 ECU_ADDRESS 0xFFFF1292 /begin FUNCTION_LIST /end FUNCTION_LIST /end MEASUREMENT
/begin MEASUREMENT vDOSPHSf "DOS/PHOS operation condition experience distinction" UBYTE COMP_0004 1 100 0 255 ECU_ADDRESS 0xFFFF2A8A /begin FUNCTION_LIST /end FUNCTION_LIST /end MEASUREMENT
/begin MEASUREMENT vDPAMBL "During the diagnosis, a change in an atomospheric pressure" UWORD COMP_0050 1 100 0 5119.921875 ECU_ADDRESS 0xFFFF2A8C /begin FUNCTION_LIST /end FUNCTION_LIST /end MEASUREMENT
/begin MEASUREMENT vDPRES "É¢EVPRES" UWORD COMP_0585_S 1 100 -2560 2559.921875 ECU_ADDRESS 0xFFFF2A8E /begin FUNCTION_LIST /end FUNCTION_LIST /end MEASUREMENT
/begin MEASUREMENT vDQAGBDY2 "Timer of dynamic compensation for AGBCOR" UBYTE COMP_0183 1 100 0 5100 ECU_ADDRESS 0xFFFF2A90 /begin FUNCTION_LIST /end FUNCTION_LIST /end MEASUREMENT
/begin MEASUREMENT vDRGBMX "DragReduction" UBYTE COMP_0068 1 100 0 255 ECU_ADDRESS 0xFFFF3C0E /begin FUNCTION_LIST /end FUNCTION_LIST /end MEASUREMENT
/begin MEASUREMENT vDRPTSP_S "Driver powertrain setpoint (vice-operation part)" UWORD COMP_0362_S 1 100 0 8191.875 ECU_ADDRESS 0xFFFF34E8 /begin FUNCTION_LIST /end FUNCTION_LIST /end MEASUREMENT
/begin MEASUREMENT vDRTDESEf "Polarity renewal prohibition flag" UBYTE COMP_0004 1 100 0 255 ECU_ADDRESS 0xFFFF1293 /begin FUNCTION_LIST /end FUNCTION_LIST /end MEASUREMENT
/begin MEASUREMENT vDRTDESIf "Polarity renewal prohibition flag" UBYTE COMP_0004 1 100 0 255 ECU_ADDRESS 0xFFFF1294 /begin FUNCTION_LIST /end FUNCTION_LIST /end MEASUREMENT
/begin MEASUREMENT vDRTQS0_S "Driver requirement engine torque basic value (vice-operation part)" SWORD COMP_0228 1 100 -3276.8 3276.7 ECU_ADDRESS 0xFFFF34EA /begin FUNCTION_LIST /end FUNCTION_LIST /end MEASUREMENT
/begin MEASUREMENT vDRTQSP0 "Driver requirement engine torque basic value" SWORD COMP_0228 1 100 -3276.8 3276.7 ECU_ADDRESS 0xFFFF2AA4 /begin FUNCTION_LIST /end FUNCTION_LIST /end MEASUREMENT
/begin MEASUREMENT vDRV0MN "AVDRV0 minimum value" UBYTE COMP_0118 1 100 0 10200 ECU_ADDRESS 0xFFFFA2E6 /begin FUNCTION_LIST /end FUNCTION_LIST /end MEASUREMENT
/begin MEASUREMENT vDRV0MX "AVDRV0 maximum value" UBYTE COMP_0118 1 100 0 10200 ECU_ADDRESS 0xFFFFA2E7 /begin FUNCTION_LIST /end FUNCTION_LIST /end MEASUREMENT
/begin MEASUREMENT vDRV1MN "AVDRV1 minimum value" UBYTE COMP_0118 1 100 0 10200 ECU_ADDRESS 0xFFFFA2E8 /begin FUNCTION_LIST /end FUNCTION_LIST /end MEASUREMENT
/begin MEASUREMENT vDRV1MX "AVDRV1 maximum value" UBYTE COMP_0118 1 100 0 10200 ECU_ADDRESS 0xFFFFA2E9 /begin FUNCTION_LIST /end FUNCTION_LIST /end MEASUREMENT
/begin MEASUREMENT vDRV2MN "AVDRV2 minimum value" UBYTE COMP_0118 1 100 0 10200 ECU_ADDRESS 0xFFFFA2EA /begin FUNCTION_LIST /end FUNCTION_LIST /end MEASUREMENT
/begin MEASUREMENT vDRV2MX "AVDRV2 maximum value" UBYTE COMP_0118 1 100 0 10200 ECU_ADDRESS 0xFFFFA2EB /begin FUNCTION_LIST /end FUNCTION_LIST /end MEASUREMENT
/begin MEASUREMENT vDRVFBf "Operation countermeasure lambda control control flag" UBYTE COMP_0004 1 100 0 255 ECU_ADDRESS 0xFFFF2AA6 /begin FUNCTION_LIST /end FUNCTION_LIST /end MEASUREMENT
/begin MEASUREMENT vDRVJUGf "Operation countermeasure region judgement flag" UBYTE COMP_0004 1 100 0 255 ECU_ADDRESS 0xFFFF2AA7 /begin FUNCTION_LIST /end FUNCTION_LIST /end MEASUREMENT
/begin MEASUREMENT vDSOKUD "A difference in pressure change speed for the 0.04inch diagnosis slosh judgement" SWORD COMP_0370_S 1 100 -2560 2559.921875 ECU_ADDRESS 0xFFFF2AB2 /begin FUNCTION_LIST /end FUNCTION_LIST /end MEASUREMENT
/begin MEASUREMENT vDTBMAXI "Retard side waste time maximum value" UBYTE COMP_0183 1 100 0 5100 ECU_ADDRESS 0xFFFFA2EC /begin FUNCTION_LIST /end FUNCTION_LIST /end MEASUREMENT
/begin MEASUREMENT vDTBMAXI_R#1 "Retard side waste time maximum value" UBYTE COMP_0183 1 100 0 5100 ECU_ADDRESS 0xFFFFA2EC /begin FUNCTION_LIST /end FUNCTION_LIST /end MEASUREMENT
/begin MEASUREMENT vDTBMAXI_R#2 "Retard side waste time maximum value" UBYTE COMP_0183 1 100 0 5100 ECU_ADDRESS 0xFFFFA2ED /begin FUNCTION_LIST /end FUNCTION_LIST /end MEASUREMENT
/begin MEASUREMENT vDTBTIMI "Retard side waste time" UBYTE COMP_0183 1 100 0 5100 ECU_ADDRESS 0xFFFF1299 /begin FUNCTION_LIST /end FUNCTION_LIST /end MEASUREMENT
/begin MEASUREMENT vDTBTIMI_R#1 "Retard side waste time" UBYTE COMP_0183 1 100 0 5100 ECU_ADDRESS 0xFFFF1299 /begin FUNCTION_LIST /end FUNCTION_LIST /end MEASUREMENT
/begin MEASUREMENT vDTBTIMI_R#2 "Retard side waste time" UBYTE COMP_0183 1 100 0 5100 ECU_ADDRESS 0xFFFF129A /begin FUNCTION_LIST /end FUNCTION_LIST /end MEASUREMENT
/begin MEASUREMENT vDTCAT "A difference in catalyst temperature 1 estimated value temperature" UBYTE COMP_0399 1 100 -512 508 ECU_ADDRESS 0xFFFF2AB8 /begin FUNCTION_LIST /end FUNCTION_LIST /end MEASUREMENT
/begin MEASUREMENT vDTCAT_R#1 "A difference in catalyst temperature 1 estimated value temperature" UBYTE COMP_0399 1 100 -512 508 ECU_ADDRESS 0xFFFF2AB8 /begin FUNCTION_LIST /end FUNCTION_LIST /end MEASUREMENT
/begin MEASUREMENT vDTCAT_R#2 "A difference in catalyst temperature 1 estimated value temperature" UBYTE COMP_0399 1 100 -512 508 ECU_ADDRESS 0xFFFF2AB9 /begin FUNCTION_LIST /end FUNCTION_LIST /end MEASUREMENT
/begin MEASUREMENT vDTCLEV "sub-function (for Read DTC Information)" UBYTE COMP_0004 1 100 0 255 ECU_ADDRESS 0xFFFF3C12 /begin FUNCTION_LIST /end FUNCTION_LIST /end MEASUREMENT
/begin MEASUREMENT vDTCMASK "DTC Status Mask (for Read DTC Information)" UBYTE COMP_0004 1 100 0 255 ECU_ADDRESS 0xFFFF3C13 /begin FUNCTION_LIST /end FUNCTION_LIST /end MEASUREMENT
/begin MEASUREMENT vDTCMN "Catalyst temperature 1 estimated value temperature difference maximum value" UBYTE COMP_0399 1 100 -512 508 ECU_ADDRESS 0xFFFFA2EE /begin FUNCTION_LIST /end FUNCTION_LIST /end MEASUREMENT
/begin MEASUREMENT vDTCMN_R#1 "Catalyst temperature 1 estimated value temperature difference maximum value" UBYTE COMP_0399 1 100 -512 508 ECU_ADDRESS 0xFFFFA2EE /begin FUNCTION_LIST /end FUNCTION_LIST /end MEASUREMENT
/begin MEASUREMENT vDTCMN_R#2 "Catalyst temperature 1 estimated value temperature difference maximum value" UBYTE COMP_0399 1 100 -512 508 ECU_ADDRESS 0xFFFFA2EF /begin FUNCTION_LIST /end FUNCTION_LIST /end MEASUREMENT
/begin MEASUREMENT vDTDEC2IN "For the DT1,2,4 input condition urgent slowdown 2" UBYTE COMP_0004 1 100 0 255 ECU_ADDRESS 0xFFFF129B /begin FUNCTION_LIST /end FUNCTION_LIST /end MEASUREMENT
/begin MEASUREMENT vDTEGR "É¢TEGR (for 10s)" UBYTE COMP_0403 1 100 0 255 ECU_ADDRESS 0xFFFF4922 /begin FUNCTION_LIST /end FUNCTION_LIST /end MEASUREMENT
/begin MEASUREMENT vDTEGR1 "É¢EGRT (for EGRTM1#)" UBYTE COMP_0050_S 1 100 0 255 ECU_ADDRESS 0xFFFF2ABA /begin FUNCTION_LIST /end FUNCTION_LIST /end MEASUREMENT
/begin MEASUREMENT vDTEGR2 "É¢EGRT (for EGRTM2#)" UBYTE COMP_0050_S 1 100 0 255 ECU_ADDRESS 0xFFFF2ABB /begin FUNCTION_LIST /end FUNCTION_LIST /end MEASUREMENT
/begin MEASUREMENT vDTEGR3 "The difference in the EGR temperature maximum and EGR temperature" UBYTE COMP_0003 1 100 0 255 ECU_ADDRESS 0xFFFF2ABC /begin FUNCTION_LIST /end FUNCTION_LIST /end MEASUREMENT
/begin MEASUREMENT vDTFMAXI "Advance side waste time maximum value" UBYTE COMP_0183 1 100 0 5100 ECU_ADDRESS 0xFFFFA2F0 /begin FUNCTION_LIST /end FUNCTION_LIST /end MEASUREMENT
/begin MEASUREMENT vDTFMAXI_R#1 "Advance side waste time maximum value" UBYTE COMP_0183 1 100 0 5100 ECU_ADDRESS 0xFFFFA2F0 /begin FUNCTION_LIST /end FUNCTION_LIST /end MEASUREMENT
/begin MEASUREMENT vDTFMAXI_R#2 "Advance side waste time maximum value" UBYTE COMP_0183 1 100 0 5100 ECU_ADDRESS 0xFFFFA2F1 /begin FUNCTION_LIST /end FUNCTION_LIST /end MEASUREMENT
/begin MEASUREMENT vDTFTIMI "Advance side waste time" UBYTE COMP_0183 1 100 0 5100 ECU_ADDRESS 0xFFFF12A0 /begin FUNCTION_LIST /end FUNCTION_LIST /end MEASUREMENT
/begin MEASUREMENT vDTFTIMI_R#1 "Advance side waste time" UBYTE COMP_0183 1 100 0 5100 ECU_ADDRESS 0xFFFF12A0 /begin FUNCTION_LIST /end FUNCTION_LIST /end MEASUREMENT
/begin MEASUREMENT vDTFTIMI_R#2 "Advance side waste time" UBYTE COMP_0183 1 100 0 5100 ECU_ADDRESS 0xFFFF12A1 /begin FUNCTION_LIST /end FUNCTION_LIST /end MEASUREMENT
/begin MEASUREMENT vDTIME "Leak-down time" UWORD COMP_0008 1 100 0 6553500 ECU_ADDRESS 0xFFFF2ABE /begin FUNCTION_LIST /end FUNCTION_LIST /end MEASUREMENT
/begin MEASUREMENT vDTVO15 "For 150mS, delta-TVO" UBYTE COMP_0053_S 1 100 0 89.25 ECU_ADDRESS 0xFFFF1E7D /begin FUNCTION_LIST /end FUNCTION_LIST /end MEASUREMENT
/begin MEASUREMENT vDUDMY291 "ST drive output value for the UH diagnosis" UWORD COMP_0068 1 100 0 65535 ECU_ADDRESS 0xFFFF1E80 /begin FUNCTION_LIST /end FUNCTION_LIST /end MEASUREMENT
/begin MEASUREMENT vDUDMY292 "ST drive output value for the UH diagnosis" UWORD COMP_0068 1 100 0 65535 ECU_ADDRESS 0xFFFF1E82 /begin FUNCTION_LIST /end FUNCTION_LIST /end MEASUREMENT
/begin MEASUREMENT vDUDMY293 "ST drive output value for the UH diagnosis" UWORD COMP_0068 1 100 0 65535 ECU_ADDRESS 0xFFFF1E84 /begin FUNCTION_LIST /end FUNCTION_LIST /end MEASUREMENT
/begin MEASUREMENT vDUHDMY "ST drive output value for the UH diagnosis" UWORD COMP_0068 1 100 0 65535 ECU_ADDRESS 0xFFFF1E86 /begin FUNCTION_LIST /end FUNCTION_LIST /end MEASUREMENT
/begin MEASUREMENT vDUHIGN39 "ST drive output value for the UH diagnosis" UWORD COMP_0068 1 100 0 65535 ECU_ADDRESS 0xFFFF1E88 /begin FUNCTION_LIST /end FUNCTION_LIST /end MEASUREMENT
/begin MEASUREMENT vDUHINJ29 "ST drive output value for the UH diagnosis" UWORD COMP_0068 1 100 0 65535 ECU_ADDRESS 0xFFFF1E8A /begin FUNCTION_LIST /end FUNCTION_LIST /end MEASUREMENT
/begin MEASUREMENT vDUHINJ39 "ST drive output value for the UH diagnosis" UWORD COMP_0068 1 100 0 65535 ECU_ADDRESS 0xFFFF1E8C /begin FUNCTION_LIST /end FUNCTION_LIST /end MEASUREMENT
/begin MEASUREMENT vDUHSOL29 "ST drive output value for the UH diagnosis" UWORD COMP_0068 1 100 0 65535 ECU_ADDRESS 0xFFFF1E8E /begin FUNCTION_LIST /end FUNCTION_LIST /end MEASUREMENT
/begin MEASUREMENT vDUHSOL39 "ST drive output value for the UH diagnosis" UWORD COMP_0068 1 100 0 65535 ECU_ADDRESS 0xFFFF1E90 /begin FUNCTION_LIST /end FUNCTION_LIST /end MEASUREMENT
/begin MEASUREMENT vDUREG28 "ST drive output value for the UH diagnosis" UWORD COMP_0068 1 100 0 65535 ECU_ADDRESS 0xFFFF1E92 /begin FUNCTION_LIST /end FUNCTION_LIST /end MEASUREMENT
/begin MEASUREMENT vDUREG291 "ST drive output value for the UH diagnosis" UWORD COMP_0068 1 100 0 65535 ECU_ADDRESS 0xFFFF1E94 /begin FUNCTION_LIST /end FUNCTION_LIST /end MEASUREMENT
/begin MEASUREMENT vDUREG292 "ST drive output value for the UH diagnosis" UWORD COMP_0068 1 100 0 65535 ECU_ADDRESS 0xFFFF1E96 /begin FUNCTION_LIST /end FUNCTION_LIST /end MEASUREMENT
/begin MEASUREMENT vDUREG293 "ST drive output value for the UH diagnosis" UWORD COMP_0068 1 100 0 65535 ECU_ADDRESS 0xFFFF1E98 /begin FUNCTION_LIST /end FUNCTION_LIST /end MEASUREMENT
/begin MEASUREMENT vDUREG391 "ST drive output value for the UH diagnosis" UWORD COMP_0068 1 100 0 65535 ECU_ADDRESS 0xFFFF1E9A /begin FUNCTION_LIST /end FUNCTION_LIST /end MEASUREMENT
/begin MEASUREMENT vDUREG392 "ST drive output value for the UH diagnosis" UWORD COMP_0068 1 100 0 65535 ECU_ADDRESS 0xFFFF1E9C /begin FUNCTION_LIST /end FUNCTION_LIST /end MEASUREMENT
/begin MEASUREMENT vDUREG393 "ST drive output value for the UH diagnosis" UWORD COMP_0068 1 100 0 65535 ECU_ADDRESS 0xFFFF1E9E /begin FUNCTION_LIST /end FUNCTION_LIST /end MEASUREMENT
/begin MEASUREMENT vDUREG394 "ST drive output value for the UH diagnosis" UWORD COMP_0068 1 100 0 65535 ECU_ADDRESS 0xFFFF1EA0 /begin FUNCTION_LIST /end FUNCTION_LIST /end MEASUREMENT
/begin MEASUREMENT vDUREG395 "ST drive output value for the UH diagnosis" UWORD COMP_0068 1 100 0 65535 ECU_ADDRESS 0xFFFF1EA2 /begin FUNCTION_LIST /end FUNCTION_LIST /end MEASUREMENT
/begin MEASUREMENT vDUREG396 "ST drive output value for the UH diagnosis" UWORD COMP_0068 1 100 0 65535 ECU_ADDRESS 0xFFFF1EA4 /begin FUNCTION_LIST /end FUNCTION_LIST /end MEASUREMENT
/begin MEASUREMENT vDUVBTM "D/U diagnosis lower limit voltage judgement delay counter" UBYTE COMP_0014 1 100 0 2550 ECU_ADDRESS 0xFFFF1EA6 /begin FUNCTION_LIST /end FUNCTION_LIST /end MEASUREMENT
/begin MEASUREMENT vDV1MIN "DVP1 minimum value" UBYTE COMP_0054 1 100 0 5100 ECU_ADDRESS 0xFFFFA2F4 /begin FUNCTION_LIST /end FUNCTION_LIST /end MEASUREMENT
/begin MEASUREMENT vDVAPOM "|VAPO-VAPO_S| monitor value" UWORD COMP_0005 1 100 0 7208.85 ECU_ADDRESS 0xFFFF2AC0 /begin FUNCTION_LIST /end FUNCTION_LIST /end MEASUREMENT
/begin MEASUREMENT vDVP0 "At the time of the pull-down completion purge cut, line pressure" UWORD COMP_0050 1 100 0 5119.921875 ECU_ADDRESS 0xFFFF2AC2 /begin FUNCTION_LIST /end FUNCTION_LIST /end MEASUREMENT
/begin MEASUREMENT vDVP1 "Pressure 1 in the system" UWORD COMP_0050 1 100 0 5119.921875 ECU_ADDRESS 0xFFFF2AC4 /begin FUNCTION_LIST /end FUNCTION_LIST /end MEASUREMENT
/begin MEASUREMENT vDVP1CCM "Inside" UBYTE COMP_0054 1 100 0 5100 ECU_ADDRESS 0xFFFF2AC6 /begin FUNCTION_LIST /end FUNCTION_LIST /end MEASUREMENT
/begin MEASUREMENT vDVP4 "In front of the leak-down, pressure" UWORD COMP_0050 1 100 0 5119.921875 ECU_ADDRESS 0xFFFF2AC8 /begin FUNCTION_LIST /end FUNCTION_LIST /end MEASUREMENT
/begin MEASUREMENT vDVP4MN "DVP4 minimum value" UBYTE COMP_0054 1 100 0 5100 ECU_ADDRESS 0xFFFFA2F5 /begin FUNCTION_LIST /end FUNCTION_LIST /end MEASUREMENT
/begin MEASUREMENT vDVP5 "Leak-down pressure" UWORD COMP_0050 1 100 0 5119.921875 ECU_ADDRESS 0xFFFF2ACA /begin FUNCTION_LIST /end FUNCTION_LIST /end MEASUREMENT
/begin MEASUREMENT vDVP5DS "After DVP5 slosh compensation" UWORD COMP_0050 1 100 0 5119.921875 ECU_ADDRESS 0xFFFF2ACC /begin FUNCTION_LIST /end FUNCTION_LIST /end MEASUREMENT
/begin MEASUREMENT vDVP8 "Vapor occurrence speed measurement line pressure" UWORD COMP_0050 1 100 0 5119.921875 ECU_ADDRESS 0xFFFF2ACE /begin FUNCTION_LIST /end FUNCTION_LIST /end MEASUREMENT
/begin MEASUREMENT vDVP802 "At the time of the 0.02inch diagnosis, after compensation, DVP8" UWORD COMP_0050 1 100 0 5119.921875 ECU_ADDRESS 0xFFFF2AD0 /begin FUNCTION_LIST /end FUNCTION_LIST /end MEASUREMENT
/begin MEASUREMENT vDVP804 "At the time of the 0.04inch diagnosis, after compensation, DVP8" UWORD COMP_0050 1 100 0 5119.921875 ECU_ADDRESS 0xFFFF2AD2 /begin FUNCTION_LIST /end FUNCTION_LIST /end MEASUREMENT
/begin MEASUREMENT vDVPIGL2 "At the time of the first time leak-down, slosh compensation value" UWORD COMP_0050 1 100 0 5119.921875 ECU_ADDRESS 0xFFFF2AD4 /begin FUNCTION_LIST /end FUNCTION_LIST /end MEASUREMENT
/begin MEASUREMENT vDVPIGL2WK "At the time of the first time leak-down, slosh compensation value (for the work)" UWORD COMP_0050 1 100 0 5119.921875 ECU_ADDRESS 0xFFFF2AD6 /begin FUNCTION_LIST /end FUNCTION_LIST /end MEASUREMENT
/begin MEASUREMENT vDVPIGLX "At the time of the second time leak-down, slosh compensation value" UWORD COMP_0050 1 100 0 5119.921875 ECU_ADDRESS 0xFFFF2AD8 /begin FUNCTION_LIST /end FUNCTION_LIST /end MEASUREMENT
/begin MEASUREMENT vDVPIGLXWK "At the time of the second time leak-down, slosh compensation value (for the work)" UWORD COMP_0050 1 100 0 5119.921875 ECU_ADDRESS 0xFFFF2ADA /begin FUNCTION_LIST /end FUNCTION_LIST /end MEASUREMENT
/begin MEASUREMENT vDVPII "At the time of the first time leak-down, slosh compensation value final value" UWORD COMP_0050 1 100 0 5119.921875 ECU_ADDRESS 0xFFFF2ADC /begin FUNCTION_LIST /end FUNCTION_LIST /end MEASUREMENT
/begin MEASUREMENT vDVPILI2 "A parameter for the function diagnosis" UWORD COMP_0050 1 100 0 5119.921875 ECU_ADDRESS 0xFFFF2ADE /begin FUNCTION_LIST /end FUNCTION_LIST /end MEASUREMENT
/begin MEASUREMENT vDVPX "At the time of the second time leak-down, slosh compensation value final value" UWORD COMP_0050 1 100 0 5119.921875 ECU_ADDRESS 0xFFFF2AE0 /begin FUNCTION_LIST /end FUNCTION_LIST /end MEASUREMENT
/begin MEASUREMENT vDVSPCNT "1400mS counter for the VDSP setup" UBYTE COMP_0014 1 100 0 2550 ECU_ADDRESS 0xFFFF1EA7 /begin FUNCTION_LIST /end FUNCTION_LIST /end MEASUREMENT
/begin MEASUREMENT vDWCNT01 "Energizing limitation position target value 1" ULONG COMP_0189 1 100 0 13743895344 ECU_ADDRESS 0xFFFF12B4 /begin FUNCTION_LIST /end FUNCTION_LIST /end MEASUREMENT
/begin MEASUREMENT vDWCNT02 "Energizing limitation position target value 2" ULONG COMP_0189 1 100 0 13743895344 ECU_ADDRESS 0xFFFF12B8 /begin FUNCTION_LIST /end FUNCTION_LIST /end MEASUREMENT
/begin MEASUREMENT vDWLCT2 "Energizing start timing angle (2,4CYL)" UWORD COMP_0390 1 100 0 655350 ECU_ADDRESS 0xFFFF12BE /begin FUNCTION_LIST /end FUNCTION_LIST /end MEASUREMENT
/begin MEASUREMENT vDWLTM2 "Energizing start timing time (2,4CYL)" UBYTE COMP_0073 1 100 0 816 ECU_ADDRESS 0xFFFF12C3 /begin FUNCTION_LIST /end FUNCTION_LIST /end MEASUREMENT
/begin MEASUREMENT vDYHTMPf "At the time of the high exhaust temperature, lambda control delay flag" UBYTE COMP_0004 1 100 0 255 ECU_ADDRESS 0xFFFF12C6 /begin FUNCTION_LIST /end FUNCTION_LIST /end MEASUREMENT
/begin MEASUREMENT vDYNCOUNT "10mS counter for the urgent slowdown judgement" UBYTE COMP_0014 1 100 0 2550 ECU_ADDRESS 0xFFFF12C7 /begin FUNCTION_LIST /end FUNCTION_LIST /end MEASUREMENT
/begin MEASUREMENT vECMSUM "ECM SUM value" UBYTE COMP_0068 1 100 0 255 ECU_ADDRESS 0xFFFFB746 /begin FUNCTION_LIST /end FUNCTION_LIST /end MEASUREMENT
/begin MEASUREMENT vECMSUM_R#1 "ECM SUM value" UBYTE COMP_0068 1 100 0 255 ECU_ADDRESS 0xFFFFB746 /begin FUNCTION_LIST /end FUNCTION_LIST /end MEASUREMENT
/begin MEASUREMENT vECMSUM_R#2 "ECM SUM value" UBYTE COMP_0068 1 100 0 255 ECU_ADDRESS 0xFFFFB747 /begin FUNCTION_LIST /end FUNCTION_LIST /end MEASUREMENT
/begin MEASUREMENT vECMSUM_R#3 "ECM SUM value" UBYTE COMP_0068 1 100 0 255 ECU_ADDRESS 0xFFFFB748 /begin FUNCTION_LIST /end FUNCTION_LIST /end MEASUREMENT
/begin MEASUREMENT vECMSUM_R#4 "ECM SUM value" UBYTE COMP_0068 1 100 0 255 ECU_ADDRESS 0xFFFFB749 /begin FUNCTION_LIST /end FUNCTION_LIST /end MEASUREMENT
/begin MEASUREMENT vECURM "ECU Reset Mode" UBYTE COMP_0068 1 100 0 255 ECU_ADDRESS 0xFFFF3C16 /begin FUNCTION_LIST /end FUNCTION_LIST /end MEASUREMENT
/begin MEASUREMENT vEDO1BUF "Expansion DO1 (S/M OUTPUT) buffer" UWORD COMP_0004 1 100 0 65535 ECU_ADDRESS 0xFFFF37D2 /begin FUNCTION_LIST /end FUNCTION_LIST /end MEASUREMENT
/begin MEASUREMENT vEEPADDW "eep write" UBYTE COMP_0068 1 100 0 255 ECU_ADDRESS 0xFFFF35BA /begin FUNCTION_LIST /end FUNCTION_LIST /end MEASUREMENT
/begin MEASUREMENT vEEPADRCHK "4K Check object EEPROM address for the EEPROM check" UWORD COMP_0068 1 100 0 65535 ECU_ADDRESS 0xFFFF2AE2 /begin FUNCTION_LIST /end FUNCTION_LIST /end MEASUREMENT
/begin MEASUREMENT vEEPADRHC "A check object EEPROM address for the EEPROM check" UWORD COMP_0068 1 100 0 65535 ECU_ADDRESS 0xFFFF2AE4 /begin FUNCTION_LIST /end FUNCTION_LIST /end MEASUREMENT
/begin MEASUREMENT vEEPCDAT "A data RAM for the EEPROM check" UWORD COMP_0068 1 100 0 65535 ECU_ADDRESS 0xFFFF2AE6 /begin FUNCTION_LIST /end FUNCTION_LIST /end MEASUREMENT
/begin MEASUREMENT vEEPCHKM "A hard check program EEPROM check result RAM (MAIN)" UBYTE COMP_0068 1 100 0 255 ECU_ADDRESS 0xFFFF2AE8 /begin FUNCTION_LIST /end FUNCTION_LIST /end MEASUREMENT
/begin MEASUREMENT vEEPJOB "EEPROM treatment number" UBYTE COMP_0004 1 100 0 255 ECU_ADDRESS 0xFFFF2AE9 /begin FUNCTION_LIST /end FUNCTION_LIST /end MEASUREMENT
/begin MEASUREMENT vEEPKEYC "Imombilizer strategy" UBYTE COMP_0068 1 100 0 255 ECU_ADDRESS 0xFFFF3C17 /begin FUNCTION_LIST /end FUNCTION_LIST /end MEASUREMENT
/begin MEASUREMENT vEEPPTY "A parity value computation RAM for the EEPROM check" UWORD COMP_0068 1 100 0 65535 ECU_ADDRESS 0xFFFF2AEA /begin FUNCTION_LIST /end FUNCTION_LIST /end MEASUREMENT
/begin MEASUREMENT vEEPRA0 "EEPROM reading address 0" UBYTE COMP_0004 1 100 0 255 ECU_ADDRESS 0xFFFF2AEC /begin FUNCTION_LIST /end FUNCTION_LIST /end MEASUREMENT
/begin MEASUREMENT vEEPRA1 "EEPROM reading address 1" UBYTE COMP_0004 1 100 0 255 ECU_ADDRESS 0xFFFF2AED /begin FUNCTION_LIST /end FUNCTION_LIST /end MEASUREMENT
/begin MEASUREMENT vEEPRA2 "EEPROM reading address 2" UBYTE COMP_0004 1 100 0 255 ECU_ADDRESS 0xFFFF2AEE /begin FUNCTION_LIST /end FUNCTION_LIST /end MEASUREMENT
/begin MEASUREMENT vEEPRA3 "EEPROM reading address 3" UBYTE COMP_0004 1 100 0 255 ECU_ADDRESS 0xFFFF2AEF /begin FUNCTION_LIST /end FUNCTION_LIST /end MEASUREMENT
/begin MEASUREMENT vEEPRA4 "EEPROM reading address 4" UBYTE COMP_0004 1 100 0 255 ECU_ADDRESS 0xFFFF2AF0 /begin FUNCTION_LIST /end FUNCTION_LIST /end MEASUREMENT
/begin MEASUREMENT vEEPRA5 "EEPROM reading address 5" UBYTE COMP_0004 1 100 0 255 ECU_ADDRESS 0xFFFF2AF1 /begin FUNCTION_LIST /end FUNCTION_LIST /end MEASUREMENT
/begin MEASUREMENT vEEPRA6 "EEPROM reading address 6" UBYTE COMP_0004 1 100 0 255 ECU_ADDRESS 0xFFFF2AF2 /begin FUNCTION_LIST /end FUNCTION_LIST /end MEASUREMENT
/begin MEASUREMENT vEEPRA7 "EEPROM reading address 7" UBYTE COMP_0004 1 100 0 255 ECU_ADDRESS 0xFFFF2AF3 /begin FUNCTION_LIST /end FUNCTION_LIST /end MEASUREMENT
/begin MEASUREMENT vEEPRA8 "The address 8 which reads EEPROM" UBYTE COMP_0004 1 100 0 255 ECU_ADDRESS 0xFFFF2AF4 /begin FUNCTION_LIST /end FUNCTION_LIST /end MEASUREMENT
/begin MEASUREMENT vEEPRAN "EEPROM reading address" UBYTE COMP_0004 1 100 0 255 ECU_ADDRESS 0xFFFF2AF5 /begin FUNCTION_LIST /end FUNCTION_LIST /end MEASUREMENT
/begin MEASUREMENT vEEPRB0 "EEPROM reading buffer 0" UWORD COMP_0004 1 100 0 65535 ECU_ADDRESS 0xFFFF2AF6 /begin FUNCTION_LIST /end FUNCTION_LIST /end MEASUREMENT
/begin MEASUREMENT vEEPRB1 "EEPROM reading buffer 1" UWORD COMP_0004 1 100 0 65535 ECU_ADDRESS 0xFFFF2AF8 /begin FUNCTION_LIST /end FUNCTION_LIST /end MEASUREMENT
/begin MEASUREMENT vEEPRB2 "EEPROM reading buffer 2" UWORD COMP_0004 1 100 0 65535 ECU_ADDRESS 0xFFFF2AFA /begin FUNCTION_LIST /end FUNCTION_LIST /end MEASUREMENT
/begin MEASUREMENT vEEPRB3 "EEPROM reading buffer 3" UWORD COMP_0004 1 100 0 65535 ECU_ADDRESS 0xFFFF2AFC /begin FUNCTION_LIST /end FUNCTION_LIST /end MEASUREMENT
/begin MEASUREMENT vEEPRB4 "EEPROM reading buffer 4" UWORD COMP_0004 1 100 0 65535 ECU_ADDRESS 0xFFFF2AFE /begin FUNCTION_LIST /end FUNCTION_LIST /end MEASUREMENT
/begin MEASUREMENT vEEPRB5 "EEPROM reading buffer 5" UWORD COMP_0004 1 100 0 65535 ECU_ADDRESS 0xFFFF2B00 /begin FUNCTION_LIST /end FUNCTION_LIST /end MEASUREMENT
/begin MEASUREMENT vEEPRB6 "EEPROM reading buffer 6" UWORD COMP_0004 1 100 0 65535 ECU_ADDRESS 0xFFFF2B02 /begin FUNCTION_LIST /end FUNCTION_LIST /end MEASUREMENT
/begin MEASUREMENT vEEPRB7 "EEPROM reading buffer 7" UWORD COMP_0004 1 100 0 65535 ECU_ADDRESS 0xFFFF2B04 /begin FUNCTION_LIST /end FUNCTION_LIST /end MEASUREMENT
/begin MEASUREMENT vEEPRB8 "The buffer 8 which reads EEPROM" UWORD COMP_0004 1 100 0 65535 ECU_ADDRESS 0xFFFF2B06 /begin FUNCTION_LIST /end FUNCTION_LIST /end MEASUREMENT
/begin MEASUREMENT vEEPRBN "EEPROM reading buffer" UWORD COMP_0004 1 100 0 65535 ECU_ADDRESS 0xFFFF2B08 /begin FUNCTION_LIST /end FUNCTION_LIST /end MEASUREMENT
/begin MEASUREMENT vEEPRDAT_M "EEPROM reading data" UWORD COMP_0004 1 100 0 65535 ECU_ADDRESS 0xFFFF2B0A /begin FUNCTION_LIST /end FUNCTION_LIST /end MEASUREMENT
/begin MEASUREMENT vEEPSTG "EEPROM treatment stage" UBYTE COMP_0004 1 100 0 255 ECU_ADDRESS 0xFFFF2B0C /begin FUNCTION_LIST /end FUNCTION_LIST /end MEASUREMENT
/begin MEASUREMENT vEEPSUM "A sum value computation RAM for the EEPROM check" UWORD COMP_0068 1 100 0 65535 ECU_ADDRESS 0xFFFF2B0E /begin FUNCTION_LIST /end FUNCTION_LIST /end MEASUREMENT
/begin MEASUREMENT vEEPWA0 "EEPROM writing address 0" UBYTE COMP_0004 1 100 0 255 ECU_ADDRESS 0xFFFF2B10 /begin FUNCTION_LIST /end FUNCTION_LIST /end MEASUREMENT
/begin MEASUREMENT vEEPWA1 "EEPROM writing address 1" UBYTE COMP_0004 1 100 0 255 ECU_ADDRESS 0xFFFF2B11 /begin FUNCTION_LIST /end FUNCTION_LIST /end MEASUREMENT
/begin MEASUREMENT vEEPWA2 "EEPROM writing address 2" UBYTE COMP_0004 1 100 0 255 ECU_ADDRESS 0xFFFF2B12 /begin FUNCTION_LIST /end FUNCTION_LIST /end MEASUREMENT
/begin MEASUREMENT vEEPWA3 "EEPROM writing address 3" UBYTE COMP_0004 1 100 0 255 ECU_ADDRESS 0xFFFF2B13 /begin FUNCTION_LIST /end FUNCTION_LIST /end MEASUREMENT
/begin MEASUREMENT vEEPWA4 "EEPROM writing address 4" UBYTE COMP_0004 1 100 0 255 ECU_ADDRESS 0xFFFF2B14 /begin FUNCTION_LIST /end FUNCTION_LIST /end MEASUREMENT
/begin MEASUREMENT vEEPWA5 "EEPROM writing address 5" UBYTE COMP_0004 1 100 0 255 ECU_ADDRESS 0xFFFF2B15 /begin FUNCTION_LIST /end FUNCTION_LIST /end MEASUREMENT
/begin MEASUREMENT vEEPWA6 "EEPROM writing address 6" UBYTE COMP_0004 1 100 0 255 ECU_ADDRESS 0xFFFF2B16 /begin FUNCTION_LIST /end FUNCTION_LIST /end MEASUREMENT
/begin MEASUREMENT vEEPWA7 "EEPROM writing address 7" UBYTE COMP_0004 1 100 0 255 ECU_ADDRESS 0xFFFF2B17 /begin FUNCTION_LIST /end FUNCTION_LIST /end MEASUREMENT
/begin MEASUREMENT vEEPWA8 "EEPROM writing address 8" UBYTE COMP_0004 1 100 0 255 ECU_ADDRESS 0xFFFF2B18 /begin FUNCTION_LIST /end FUNCTION_LIST /end MEASUREMENT
/begin MEASUREMENT vEEPWAIT "The wait rest number of times for the EEPROM check" UBYTE COMP_0030 1 100 0 255 ECU_ADDRESS 0xFFFF2B19 /begin FUNCTION_LIST /end FUNCTION_LIST /end MEASUREMENT
/begin MEASUREMENT vEEPWAN "EEPROM writing address" UBYTE COMP_0004 1 100 0 255 ECU_ADDRESS 0xFFFF2B1A /begin FUNCTION_LIST /end FUNCTION_LIST /end MEASUREMENT
/begin MEASUREMENT vEEPWB0 "EEPROM writing buffer 0" UWORD COMP_0004 1 100 0 65535 ECU_ADDRESS 0xFFFF2B1C /begin FUNCTION_LIST /end FUNCTION_LIST /end MEASUREMENT
/begin MEASUREMENT vEEPWB1 "EEPROM writing buffer 1" UWORD COMP_0004 1 100 0 65535 ECU_ADDRESS 0xFFFF2B1E /begin FUNCTION_LIST /end FUNCTION_LIST /end MEASUREMENT
/begin MEASUREMENT vEEPWB2 "EEPROM writing buffer 2" UWORD COMP_0004 1 100 0 65535 ECU_ADDRESS 0xFFFF2B20 /begin FUNCTION_LIST /end FUNCTION_LIST /end MEASUREMENT
/begin MEASUREMENT vEEPWB3 "EEPROM writing buffer 3" UWORD COMP_0004 1 100 0 65535 ECU_ADDRESS 0xFFFF2B22 /begin FUNCTION_LIST /end FUNCTION_LIST /end MEASUREMENT
/begin MEASUREMENT vEEPWB4 "EEPROM writing buffer 4" UWORD COMP_0004 1 100 0 65535 ECU_ADDRESS 0xFFFF2B24 /begin FUNCTION_LIST /end FUNCTION_LIST /end MEASUREMENT
/begin MEASUREMENT vEEPWB5 "EEPROM writing buffer 5" UWORD COMP_0004 1 100 0 65535 ECU_ADDRESS 0xFFFF2B26 /begin FUNCTION_LIST /end FUNCTION_LIST /end MEASUREMENT
/begin MEASUREMENT vEEPWB6 "EEPROM writing buffer 6" UWORD COMP_0004 1 100 0 65535 ECU_ADDRESS 0xFFFF2B28 /begin FUNCTION_LIST /end FUNCTION_LIST /end MEASUREMENT
/begin MEASUREMENT vEEPWB7 "EEPROM writing buffer 7" UWORD COMP_0004 1 100 0 65535 ECU_ADDRESS 0xFFFF2B2A /begin FUNCTION_LIST /end FUNCTION_LIST /end MEASUREMENT
/begin MEASUREMENT vEEPWB8 "EEPROM writing buffer 8" UWORD COMP_0004 1 100 0 65535 ECU_ADDRESS 0xFFFF2B2C /begin FUNCTION_LIST /end FUNCTION_LIST /end MEASUREMENT
/begin MEASUREMENT vEEPWBN "EEPROM writing buffer" UWORD COMP_0004 1 100 0 65535 ECU_ADDRESS 0xFFFF2B2E /begin FUNCTION_LIST /end FUNCTION_LIST /end MEASUREMENT
/begin MEASUREMENT vEEPWCNT_M "EEPROM writing counter" UBYTE COMP_0016 1 100 0 255 ECU_ADDRESS 0xFFFF2B30 /begin FUNCTION_LIST /end FUNCTION_LIST /end MEASUREMENT
/begin MEASUREMENT vEEPWRCHK "A treatment condition counter for the EEPROM check" UBYTE COMP_0068 1 100 0 255 ECU_ADDRESS 0xFFFF2B31 /begin FUNCTION_LIST /end FUNCTION_LIST /end MEASUREMENT
/begin MEASUREMENT vEEPWST "EEPROM writing treatment stage" UBYTE COMP_0004 1 100 0 255 ECU_ADDRESS 0xFFFF2B32 /begin FUNCTION_LIST /end FUNCTION_LIST /end MEASUREMENT
/begin MEASUREMENT vEGQJMN "QA-type diagnosis parameter minimum value" UWORD COMP_0456 1 100 0 1.999970916 ECU_ADDRESS 0xFFFFA2F6 /begin FUNCTION_LIST /end FUNCTION_LIST /end MEASUREMENT
/begin MEASUREMENT vEGQJMN_R#1 "QA-type diagnosis parameter minimum value" UWORD COMP_0456 1 100 0 1.999970916 ECU_ADDRESS 0xFFFFA2F6 /begin FUNCTION_LIST /end FUNCTION_LIST /end MEASUREMENT
/begin MEASUREMENT vEGQJMN_R#2 "QA-type diagnosis parameter minimum value" UWORD COMP_0456 1 100 0 1.999970916 ECU_ADDRESS 0xFFFFA2F8 /begin FUNCTION_LIST /end FUNCTION_LIST /end MEASUREMENT
/begin MEASUREMENT vEGQJMN_R#3 "QA-type diagnosis parameter minimum value" UWORD COMP_0456 1 100 0 1.999970916 ECU_ADDRESS 0xFFFFA2FA /begin FUNCTION_LIST /end FUNCTION_LIST /end MEASUREMENT
/begin MEASUREMENT vEGQJMN_R#4 "QA-type diagnosis parameter minimum value" UWORD COMP_0456 1 100 0 1.999970916 ECU_ADDRESS 0xFFFFA2FC /begin FUNCTION_LIST /end FUNCTION_LIST /end MEASUREMENT
/begin MEASUREMENT vEGQJMN_R#5 "QA-type diagnosis parameter minimum value" UWORD COMP_0456 1 100 0 1.999970916 ECU_ADDRESS 0xFFFFA2FE /begin FUNCTION_LIST /end FUNCTION_LIST /end MEASUREMENT
/begin MEASUREMENT vEGRAR "Target opening area" UBYTE COMP_0345 1 100 0 0.816 ECU_ADDRESS 0xFFFF12C8 /begin FUNCTION_LIST /end FUNCTION_LIST /end MEASUREMENT
/begin MEASUREMENT vEGRCHK "EGR breakage check" UWORD COMP_0068 1 100 0 65535 ECU_ADDRESS 0xFFFF1DAC /begin FUNCTION_LIST /end FUNCTION_LIST /end MEASUREMENT
/begin MEASUREMENT vEGRCJNG "EGR close diagnosis condition value" UBYTE COMP_0004 1 100 0 255 ECU_ADDRESS 0xFFFF2B33 /begin FUNCTION_LIST /end FUNCTION_LIST /end MEASUREMENT
/begin MEASUREMENT vEGRCNT "Close diagnosis diagnosis region timer" UBYTE COMP_0016 1 100 0 255 ECU_ADDRESS 0xFFFF2B34 /begin FUNCTION_LIST /end FUNCTION_LIST /end MEASUREMENT
/begin MEASUREMENT vEGRDMP "EGR cut coefficient" UWORD COMP_0410 1 100 0 99.9985458 ECU_ADDRESS 0xFFFF101C /begin FUNCTION_LIST /end FUNCTION_LIST /end MEASUREMENT
/begin MEASUREMENT vEGRIMR "EGR diagnosis completion flag inclusion byte for for 2trip" UBYTE COMP_0004 1 100 0 255 ECU_ADDRESS 0xFFFFA300 /begin FUNCTION_LIST /end FUNCTION_LIST /end MEASUREMENT
/begin MEASUREMENT vEGRINT "At the time of the start, EGR temperature" UBYTE COMP_0035 1 100 -50 205 ECU_ADDRESS 0xFFFF4928 /begin FUNCTION_LIST /end FUNCTION_LIST /end MEASUREMENT
/begin MEASUREMENT vEGRMIL "EGR diagnosis completion mileage integration value" UWORD COMP_0385 1 100 0 105380.28 ECU_ADDRESS 0xFFFFA302 /begin FUNCTION_LIST /end FUNCTION_LIST /end MEASUREMENT
/begin MEASUREMENT vEGRRTTM "A region timer for diagnosis frequency measuring" UBYTE COMP_0016 1 100 0 255 ECU_ADDRESS 0xFFFF2B35 /begin FUNCTION_LIST /end FUNCTION_LIST /end MEASUREMENT
/begin MEASUREMENT vEGRT00 "EGR temperature" UBYTE COMP_0035 1 100 -50 205 ECU_ADDRESS 0xFFFF2B36 /begin FUNCTION_LIST /end FUNCTION_LIST /end MEASUREMENT
/begin MEASUREMENT vEGRT05 "EGR temperature (before 5s)" UBYTE COMP_0035 1 100 -50 205 ECU_ADDRESS 0xFFFF2B37 /begin FUNCTION_LIST /end FUNCTION_LIST /end MEASUREMENT
/begin MEASUREMENT vEGRT10 "EGR temperature (before 10s)" UBYTE COMP_0035 1 100 -50 205 ECU_ADDRESS 0xFFFF2B38 /begin FUNCTION_LIST /end FUNCTION_LIST /end MEASUREMENT
/begin MEASUREMENT vEGRT15 "EGR temperature (before 15s)" UBYTE COMP_0035 1 100 -50 205 ECU_ADDRESS 0xFFFF2B39 /begin FUNCTION_LIST /end FUNCTION_LIST /end MEASUREMENT
/begin MEASUREMENT vEGRT20 "EGR temperature (before 20s)" UBYTE COMP_0035 1 100 -50 205 ECU_ADDRESS 0xFFFF2B3A /begin FUNCTION_LIST /end FUNCTION_LIST /end MEASUREMENT
/begin MEASUREMENT vEGRT25 "EGR temperature (before 25s)" UBYTE COMP_0035 1 100 -50 205 ECU_ADDRESS 0xFFFF2B3B /begin FUNCTION_LIST /end FUNCTION_LIST /end MEASUREMENT
/begin MEASUREMENT vEGRT30 "EGR temperature (before 30s)" UBYTE COMP_0035 1 100 -50 205 ECU_ADDRESS 0xFFFF2B3C /begin FUNCTION_LIST /end FUNCTION_LIST /end MEASUREMENT
/begin MEASUREMENT vEGRTVH "EGR permission TVO upper limit" UBYTE COMP_0002 1 100 0 89.25 ECU_ADDRESS 0xFFFF12CD /begin FUNCTION_LIST /end FUNCTION_LIST /end MEASUREMENT
/begin MEASUREMENT vEGSADJRAM "EGS S/M   0 point proofreading compensation value" UBYTE COMP_0411 1 100 0 255 ECU_ADDRESS 0xFFFF37D4 /begin FUNCTION_LIST /end FUNCTION_LIST /end MEASUREMENT
/begin MEASUREMENT vEGSADR "EGR S/M   Motor drive pattern pointer" ULONG COMP_0588_S 1 100 0 4294967295 ECU_ADDRESS 0xFFFFB548 /begin FUNCTION_LIST /end FUNCTION_LIST /end MEASUREMENT
/begin MEASUREMENT vEGSAJMOD "EGR/V S/M 0 point proofreading mode" UBYTE COMP_0068 1 100 0 255 ECU_ADDRESS 0xFFFF37D5 /begin FUNCTION_LIST /end FUNCTION_LIST /end MEASUREMENT
/begin MEASUREMENT vEGSDLSTP "EGS S/M   For the target position difference advantage" SWORD COMP_0413 1 100 -16384 16383.5 ECU_ADDRESS 0xFFFF37D6 /begin FUNCTION_LIST /end FUNCTION_LIST /end MEASUREMENT
/begin MEASUREMENT vEGSDLSTP0 "EGS S/M   Target position difference previous value" SWORD COMP_0413 1 100 -16384 16383.5 ECU_ADDRESS 0xFFFF37D8 /begin FUNCTION_LIST /end FUNCTION_LIST /end MEASUREMENT
/begin MEASUREMENT vEGSHOLD "EGS S/M    Reversal tense hold period" UBYTE COMP_0139 1 100 0 255 ECU_ADDRESS 0xFFFF37DA /begin FUNCTION_LIST /end FUNCTION_LIST /end MEASUREMENT
/begin MEASUREMENT vEGSIDX "EGS S/M   Excitation pattern index value" UBYTE COMP_0004 1 100 0 255 ECU_ADDRESS 0xFFFFB54C /begin FUNCTION_LIST /end FUNCTION_LIST /end MEASUREMENT
/begin MEASUREMENT vEGSMCNT "EGS S/M   Drive period" UBYTE COMP_0139 1 100 0 255 ECU_ADDRESS 0xFFFF37DB /begin FUNCTION_LIST /end FUNCTION_LIST /end MEASUREMENT
/begin MEASUREMENT vEGSMCNT0 "EGS S/M   Drive periodic previous value" UBYTE COMP_0139 1 100 0 255 ECU_ADDRESS 0xFFFF37DC /begin FUNCTION_LIST /end FUNCTION_LIST /end MEASUREMENT
/begin MEASUREMENT vEGSMDIR "EGS S/M Drive direction value" SBYTE COMP_0264 1 100 -128 127 ECU_ADDRESS 0xFFFF37DD /begin FUNCTION_LIST /end FUNCTION_LIST /end MEASUREMENT
/begin MEASUREMENT vEGSMPHS "EGS S/M Excitation value" UBYTE COMP_0411 1 100 0 255 ECU_ADDRESS 0xFFFF37DE /begin FUNCTION_LIST /end FUNCTION_LIST /end MEASUREMENT
/begin MEASUREMENT vEGSRSMCNT "EGS S/M   Control condition flag variable" UWORD COMP_0004 1 100 0 65535 ECU_ADDRESS 0xFFFF37E0 /begin FUNCTION_LIST /end FUNCTION_LIST /end MEASUREMENT
/begin MEASUREMENT vEGSSTS "S/M control status" SBYTE COMP_0264 1 100 -128 127 ECU_ADDRESS 0xFFFF37E2 /begin FUNCTION_LIST /end FUNCTION_LIST /end MEASUREMENT
/begin MEASUREMENT vEGSTD00 "The target EGR step open-degree 1 look-ization front" UWORD COMP_0140 1 100 0 32767.5 ECU_ADDRESS 0xFFFF2B3E /begin FUNCTION_LIST /end FUNCTION_LIST /end MEASUREMENT
/begin MEASUREMENT vEGSTMCNT "EGS S/M   Drive periodic measuring counter" UBYTE COMP_0139 1 100 0 255 ECU_ADDRESS 0xFFFF37E3 /begin FUNCTION_LIST /end FUNCTION_LIST /end MEASUREMENT
/begin MEASUREMENT vEGSTMG "EGR/V S/M 0 point proofreading mergin control number of times" UBYTE COMP_0068 1 100 0 255 ECU_ADDRESS 0xFFFF37E4 /begin FUNCTION_LIST /end FUNCTION_LIST /end MEASUREMENT
/begin MEASUREMENT vEGSTP "The reference result of TEGSPS" UBYTE COMP_0025 1 100 0 127.5 ECU_ADDRESS 0xFFFF12CE /begin FUNCTION_LIST /end FUNCTION_LIST /end MEASUREMENT
/begin MEASUREMENT vEGSTPD0 "The front of the target EGR step number limiter" UWORD COMP_0140 1 100 0 32767.5 ECU_ADDRESS 0xFFFF2B42 /begin FUNCTION_LIST /end FUNCTION_LIST /end MEASUREMENT
/begin MEASUREMENT vEGSTPM0 "The monitor value of EGSTPM-EGROFS" UBYTE COMP_0025 1 100 0 127.5 ECU_ADDRESS 0xFFFF12CF /begin FUNCTION_LIST /end FUNCTION_LIST /end MEASUREMENT
/begin MEASUREMENT vEGSTPMB "EGR diagnosis start reference step" UWORD COMP_0025 1 100 0 32767.5 ECU_ADDRESS 0xFFFF2B44 /begin FUNCTION_LIST /end FUNCTION_LIST /end MEASUREMENT
/begin MEASUREMENT vEGSWAIT "EGS S/M   Stable time measuring counter" UBYTE COMP_0139 1 100 0 255 ECU_ADDRESS 0xFFFF37E5 /begin FUNCTION_LIST /end FUNCTION_LIST /end MEASUREMENT
/begin MEASUREMENT vELNREVf "Learning condition 16 turns flag" UBYTE COMP_0004 1 100 0 255 ECU_ADDRESS 0xFFFF12D0 /begin FUNCTION_LIST /end FUNCTION_LIST /end MEASUREMENT
/begin MEASUREMENT vELNTIMf "O2 sensor reversal flag" UBYTE COMP_0004 1 100 0 255 ECU_ADDRESS 0xFFFF12D1 /begin FUNCTION_LIST /end FUNCTION_LIST /end MEASUREMENT
/begin MEASUREMENT vELRNOKf "A learning condition judgement flag by the region" UBYTE COMP_0004 1 100 0 255 ECU_ADDRESS 0xFFFF12D2 /begin FUNCTION_LIST /end FUNCTION_LIST /end MEASUREMENT
/begin MEASUREMENT vENGBFAC "Engine-brake region coefficient" UBYTE COMP_0378 1 100 0 100.000000065 ECU_ADDRESS 0xFFFF2B46 /begin FUNCTION_LIST /end FUNCTION_LIST /end MEASUREMENT
/begin MEASUREMENT vENGBFA_S "Engine-brake region coefficient (vice-operation part)" UBYTE COMP_0378 1 100 0 100.000000065 ECU_ADDRESS 0xFFFF34EE /begin FUNCTION_LIST /end FUNCTION_LIST /end MEASUREMENT
/begin MEASUREMENT vENGBTH "Engine-brake region accelerator ratio threshold" UWORD COMP_0362_S 1 100 0 8191.875 ECU_ADDRESS 0xFFFF2B48 /begin FUNCTION_LIST /end FUNCTION_LIST /end MEASUREMENT
/begin MEASUREMENT vENGBTH_S "Engine-brake region accelerator ratio threshold (vice-operation part)" UWORD COMP_0362_S 1 100 0 8191.875 ECU_ADDRESS 0xFFFF34F0 /begin FUNCTION_LIST /end FUNCTION_LIST /end MEASUREMENT
/begin MEASUREMENT vENGRTO "The target drive power for the CVT transmission" UBYTE COMP_0004 1 100 0 255 ECU_ADDRESS 0xFFFF380D /begin FUNCTION_LIST /end FUNCTION_LIST /end MEASUREMENT
/begin MEASUREMENT vEPADDCNT "eep write" UBYTE COMP_0068 1 100 0 255 ECU_ADDRESS 0xFFFF35BB /begin FUNCTION_LIST /end FUNCTION_LIST /end MEASUREMENT
/begin MEASUREMENT vEPARBGRQ "airbag request" UBYTE COMP_0068 1 100 0 255 ECU_ADDRESS 0xFFFF4929 /begin FUNCTION_LIST /end FUNCTION_LIST /end MEASUREMENT
/begin MEASUREMENT vEPARBGWE "airbag write end" UBYTE COMP_0068 1 100 0 255 ECU_ADDRESS 0xFFFF3C19 /begin FUNCTION_LIST /end FUNCTION_LIST /end MEASUREMENT
/begin MEASUREMENT vEPBUWNG "Bu-RAM EEPROM verify NG number of times" UBYTE COMP_0068 1 100 0 255 ECU_ADDRESS 0xFFFF2B4B /begin FUNCTION_LIST /end FUNCTION_LIST /end MEASUREMENT
/begin MEASUREMENT vEPCACT "EEP diagnosis treatment condition" UBYTE COMP_0068 1 100 0 255 ECU_ADDRESS 0xFFFF2B4C /begin FUNCTION_LIST /end FUNCTION_LIST /end MEASUREMENT
/begin MEASUREMENT vEPCKNO "EEPROM diagnosis treatment number" UBYTE COMP_0414 1 100 0 255 ECU_ADDRESS 0xFFFF2B4D /begin FUNCTION_LIST /end FUNCTION_LIST /end MEASUREMENT
/begin MEASUREMENT vEPCKSUM "EEP- ROM preservation backup RAM sum value (for the verify)" UBYTE COMP_0068 1 100 0 255 ECU_ADDRESS 0xFFFF2B4E /begin FUNCTION_LIST /end FUNCTION_LIST /end MEASUREMENT
/begin MEASUREMENT vEPCLRSZ "The number of EEPROM clear bytes" UBYTE COMP_0068 1 100 0 255 ECU_ADDRESS 0xFFFF2B4F /begin FUNCTION_LIST /end FUNCTION_LIST /end MEASUREMENT
/begin MEASUREMENT vEPLACT "EEP learning treatment condition" UBYTE COMP_0068 1 100 0 255 ECU_ADDRESS 0xFFFF2B50 /begin FUNCTION_LIST /end FUNCTION_LIST /end MEASUREMENT
/begin MEASUREMENT vEPLADR "EEP learning treatment ROM address" UBYTE COMP_0068 1 100 0 255 ECU_ADDRESS 0xFFFF2B51 /begin FUNCTION_LIST /end FUNCTION_LIST /end MEASUREMENT
/begin MEASUREMENT vEPLBUF "EEP learning treatment Read/Write buffer" UWORD COMP_0068 1 100 0 65535 ECU_ADDRESS 0xFFFF2B52 /begin FUNCTION_LIST /end FUNCTION_LIST /end MEASUREMENT
/begin MEASUREMENT vEPLCLAS "EEP treatment data group" UBYTE COMP_0068 1 100 0 255 ECU_ADDRESS 0xFFFF2B54 /begin FUNCTION_LIST /end FUNCTION_LIST /end MEASUREMENT
/begin MEASUREMENT vEPLKIND "EEP treatment data kind" UBYTE COMP_0068 1 100 0 255 ECU_ADDRESS 0xFFFF2B55 /begin FUNCTION_LIST /end FUNCTION_LIST /end MEASUREMENT
/begin MEASUREMENT vEPLRCLR "fEPLRSET compulsory clear counter" UBYTE COMP_0068 1 100 0 255 ECU_ADDRESS 0xFFFF2B56 /begin FUNCTION_LIST /end FUNCTION_LIST /end MEASUREMENT
/begin MEASUREMENT vEPMODE "EEP- ROM writing mode" UBYTE COMP_0068 1 100 0 255 ECU_ADDRESS 0xFFFF2B57 /begin FUNCTION_LIST /end FUNCTION_LIST /end MEASUREMENT
/begin MEASUREMENT vEPRADR "The address which reads EEPROM" UWORD COMP_0068 1 100 0 65535 ECU_ADDRESS 0xFFFF2B58 /begin FUNCTION_LIST /end FUNCTION_LIST /end MEASUREMENT
/begin MEASUREMENT vEPRAW0 "EEPROM reading address 0" UWORD COMP_0004 1 100 0 65535 ECU_ADDRESS 0xFFFF3C1A /begin FUNCTION_LIST /end FUNCTION_LIST /end MEASUREMENT
/begin MEASUREMENT vEPRAW1 "EEPROM reading address 1" UWORD COMP_0004 1 100 0 65535 ECU_ADDRESS 0xFFFF3C1C /begin FUNCTION_LIST /end FUNCTION_LIST /end MEASUREMENT
/begin MEASUREMENT vEPRAW2 "EEPROM reading address 2" UWORD COMP_0004 1 100 0 65535 ECU_ADDRESS 0xFFFF3C1E /begin FUNCTION_LIST /end FUNCTION_LIST /end MEASUREMENT
/begin MEASUREMENT vEPRAW3 "EEPROM reading address 3" UWORD COMP_0004 1 100 0 65535 ECU_ADDRESS 0xFFFF3C20 /begin FUNCTION_LIST /end FUNCTION_LIST /end MEASUREMENT
/begin MEASUREMENT vEPRAW4 "EEPROM reading address 4" UWORD COMP_0004 1 100 0 65535 ECU_ADDRESS 0xFFFF3C22 /begin FUNCTION_LIST /end FUNCTION_LIST /end MEASUREMENT
/begin MEASUREMENT vEPRAW5 "EEPROM reading address 5" UWORD COMP_0004 1 100 0 65535 ECU_ADDRESS 0xFFFF3C24 /begin FUNCTION_LIST /end FUNCTION_LIST /end MEASUREMENT
/begin MEASUREMENT vEPRAW6 "EEPROM reading address 6" UWORD COMP_0004 1 100 0 65535 ECU_ADDRESS 0xFFFF3C26 /begin FUNCTION_LIST /end FUNCTION_LIST /end MEASUREMENT
/begin MEASUREMENT vEPRAW7 "EEPROM reading address 7" UWORD COMP_0004 1 100 0 65535 ECU_ADDRESS 0xFFFF3C28 /begin FUNCTION_LIST /end FUNCTION_LIST /end MEASUREMENT
/begin MEASUREMENT vEPRAWN "EEPROM reading address" UWORD COMP_0004 1 100 0 65535 ECU_ADDRESS 0xFFFF3C2A /begin FUNCTION_LIST /end FUNCTION_LIST /end MEASUREMENT
/begin MEASUREMENT vEPRBW0 "EEPROM reading buffer 0" UBYTE COMP_0004 1 100 0 255 ECU_ADDRESS 0xFFFF3C2C /begin FUNCTION_LIST /end FUNCTION_LIST /end MEASUREMENT
/begin MEASUREMENT vEPRBW1 "EEPROM reading buffer 1" UBYTE COMP_0004 1 100 0 255 ECU_ADDRESS 0xFFFF3C2D /begin FUNCTION_LIST /end FUNCTION_LIST /end MEASUREMENT
/begin MEASUREMENT vEPRBW2 "EEPROM reading buffer 2" UBYTE COMP_0004 1 100 0 255 ECU_ADDRESS 0xFFFF3C2E /begin FUNCTION_LIST /end FUNCTION_LIST /end MEASUREMENT
/begin MEASUREMENT vEPRBW3 "EEPROM reading buffer 3" UBYTE COMP_0004 1 100 0 255 ECU_ADDRESS 0xFFFF3C2F /begin FUNCTION_LIST /end FUNCTION_LIST /end MEASUREMENT
/begin MEASUREMENT vEPRBW4 "EEPROM reading buffer 4" UBYTE COMP_0004 1 100 0 255 ECU_ADDRESS 0xFFFF3C30 /begin FUNCTION_LIST /end FUNCTION_LIST /end MEASUREMENT
/begin MEASUREMENT vEPRBW5 "EEPROM reading buffer 5" UBYTE COMP_0004 1 100 0 255 ECU_ADDRESS 0xFFFF3C31 /begin FUNCTION_LIST /end FUNCTION_LIST /end MEASUREMENT
/begin MEASUREMENT vEPRBW6 "EEPROM reading buffer 6" UBYTE COMP_0004 1 100 0 255 ECU_ADDRESS 0xFFFF3C32 /begin FUNCTION_LIST /end FUNCTION_LIST /end MEASUREMENT
/begin MEASUREMENT vEPRBW7 "EEPROM reading buffer 7" UBYTE COMP_0004 1 100 0 255 ECU_ADDRESS 0xFFFF3C33 /begin FUNCTION_LIST /end FUNCTION_LIST /end MEASUREMENT
/begin MEASUREMENT vEPRBWN "EEPROM reading buffer" UBYTE COMP_0004 1 100 0 255 ECU_ADDRESS 0xFFFF3C34 /begin FUNCTION_LIST /end FUNCTION_LIST /end MEASUREMENT
/begin MEASUREMENT vEPRS11 "The MIN value of EVPRES of the stage 1" UBYTE COMP_0054 1 100 0 5100 ECU_ADDRESS 0xFFFF12D6 /begin FUNCTION_LIST /end FUNCTION_LIST /end MEASUREMENT
/begin MEASUREMENT vEPRS11R "The MIN value of EVPRES of the stage 1" UWORD COMP_0050 1 100 0 5119.921875 ECU_ADDRESS 0xFFFF12D8 /begin FUNCTION_LIST /end FUNCTION_LIST /end MEASUREMENT
/begin MEASUREMENT vEPRS11RV "The MIN value (for the pressure sensor unification) of EVPRES of the stage 1 for diagnosis frequency measuring" UWORD COMP_0050 1 100 0 5119.921875 ECU_ADDRESS 0xFFFF12DA /begin FUNCTION_LIST /end FUNCTION_LIST /end MEASUREMENT
/begin MEASUREMENT vEPRS11V "The MIN value of EVPRES of the stage 1 for diagnosis frequency measuring" UBYTE COMP_0054 1 100 0 5100 ECU_ADDRESS 0xFFFF12DC /begin FUNCTION_LIST /end FUNCTION_LIST /end MEASUREMENT
/begin MEASUREMENT vEPRS12 "The MAX value of EVPRES of the stage 1" UBYTE COMP_0054 1 100 0 5100 ECU_ADDRESS 0xFFFF12DD /begin FUNCTION_LIST /end FUNCTION_LIST /end MEASUREMENT
/begin MEASUREMENT vEPRS12R "The MAX value of EVPRES of the stage 1" UWORD COMP_0050 1 100 0 5119.921875 ECU_ADDRESS 0xFFFF12DE /begin FUNCTION_LIST /end FUNCTION_LIST /end MEASUREMENT
/begin MEASUREMENT vEPRS12RV "The MAX value (for the pressure sensor unification) of EVPRES of the stage 1 for diagnosis frequency measuring" UWORD COMP_0050 1 100 0 5119.921875 ECU_ADDRESS 0xFFFF12E0 /begin FUNCTION_LIST /end FUNCTION_LIST /end MEASUREMENT
/begin MEASUREMENT vEPRS12V "The MAX value of EVPRES of the stage 1 for diagnosis frequency measuring" UBYTE COMP_0054 1 100 0 5100 ECU_ADDRESS 0xFFFF12E2 /begin FUNCTION_LIST /end FUNCTION_LIST /end MEASUREMENT
/begin MEASUREMENT vEPRS21 "The MIN value of EVPRES of the stage 2" UBYTE COMP_0054 1 100 0 5100 ECU_ADDRESS 0xFFFF12E3 /begin FUNCTION_LIST /end FUNCTION_LIST /end MEASUREMENT
/begin MEASUREMENT vEPRS22 "The MAX value of EVPRES of the stage 2" UBYTE COMP_0054 1 100 0 5100 ECU_ADDRESS 0xFFFF12E4 /begin FUNCTION_LIST /end FUNCTION_LIST /end MEASUREMENT
/begin MEASUREMENT vEPRSIZE "The number of bytes which reads EEPROM" UBYTE COMP_0068 1 100 0 255 ECU_ADDRESS 0xFFFF2B5A /begin FUNCTION_LIST /end FUNCTION_LIST /end MEASUREMENT
/begin MEASUREMENT vEPSA "Electromotive style power steering battery electric current" UBYTE COMP_0062_S 1 100 0 255 ECU_ADDRESS 0xFFFF1EA8 /begin FUNCTION_LIST /end FUNCTION_LIST /end MEASUREMENT
/begin MEASUREMENT vEPSEQN "Learning value EEPROM treatment number" UBYTE COMP_0414 1 100 0 255 ECU_ADDRESS 0xFFFF2B5B /begin FUNCTION_LIST /end FUNCTION_LIST /end MEASUREMENT
/begin MEASUREMENT vEPWADR "EEPROM writing address" UWORD COMP_0068 1 100 0 65535 ECU_ADDRESS 0xFFFF2B5C /begin FUNCTION_LIST /end FUNCTION_LIST /end MEASUREMENT
/begin MEASUREMENT vEPWAW0 "EEPROM writing address 0" UWORD COMP_0004 1 100 0 65535 ECU_ADDRESS 0xFFFF3C36 /begin FUNCTION_LIST /end FUNCTION_LIST /end MEASUREMENT
/begin MEASUREMENT vEPWAW1 "EEPROM writing address 1" UWORD COMP_0004 1 100 0 65535 ECU_ADDRESS 0xFFFF3C38 /begin FUNCTION_LIST /end FUNCTION_LIST /end MEASUREMENT
/begin MEASUREMENT vEPWAW2 "EEPROM writing address 2" UWORD COMP_0004 1 100 0 65535 ECU_ADDRESS 0xFFFF3C3A /begin FUNCTION_LIST /end FUNCTION_LIST /end MEASUREMENT
/begin MEASUREMENT vEPWAW3 "EEPROM writing address 3" UWORD COMP_0004 1 100 0 65535 ECU_ADDRESS 0xFFFF3C3C /begin FUNCTION_LIST /end FUNCTION_LIST /end MEASUREMENT
/begin MEASUREMENT vEPWAW4 "EEPROM writing address 4" UWORD COMP_0004 1 100 0 65535 ECU_ADDRESS 0xFFFF3C3E /begin FUNCTION_LIST /end FUNCTION_LIST /end MEASUREMENT
/begin MEASUREMENT vEPWAW5 "EEPROM writing address 5" UWORD COMP_0004 1 100 0 65535 ECU_ADDRESS 0xFFFF3C40 /begin FUNCTION_LIST /end FUNCTION_LIST /end MEASUREMENT
/begin MEASUREMENT vEPWAW6 "EEPROM writing address 6" UWORD COMP_0004 1 100 0 65535 ECU_ADDRESS 0xFFFF3C42 /begin FUNCTION_LIST /end FUNCTION_LIST /end MEASUREMENT
/begin MEASUREMENT vEPWAW7 "EEPROM writing address 7" UWORD COMP_0004 1 100 0 65535 ECU_ADDRESS 0xFFFF3C44 /begin FUNCTION_LIST /end FUNCTION_LIST /end MEASUREMENT
/begin MEASUREMENT vEPWAWN "EEPROM writing address" UWORD COMP_0004 1 100 0 65535 ECU_ADDRESS 0xFFFF3C46 /begin FUNCTION_LIST /end FUNCTION_LIST /end MEASUREMENT
/begin MEASUREMENT vEPWBP2 "4K EEPROM Page writing buffer 2" UBYTE COMP_0068 1 100 0 255 ECU_ADDRESS 0xFFFF3C48 /begin FUNCTION_LIST /end FUNCTION_LIST /end MEASUREMENT
/begin MEASUREMENT vEPWBP2_C#1_R#1 "4K EEPROM Page writing buffer 2" UBYTE COMP_0068 1 100 0 255 ECU_ADDRESS 0xFFFF3C48 /begin FUNCTION_LIST /end FUNCTION_LIST /end MEASUREMENT
/begin MEASUREMENT vEPWBP2_C#2_R#1 "4K EEPROM Page writing buffer 2" UBYTE COMP_0068 1 100 0 255 ECU_ADDRESS 0xFFFF3C49 /begin FUNCTION_LIST /end FUNCTION_LIST /end MEASUREMENT
/begin MEASUREMENT vEPWBP2_C#3_R#1 "4K EEPROM Page writing buffer 2" UBYTE COMP_0068 1 100 0 255 ECU_ADDRESS 0xFFFF3C4A /begin FUNCTION_LIST /end FUNCTION_LIST /end MEASUREMENT
/begin MEASUREMENT vEPWBP2_C#4_R#1 "4K EEPROM Page writing buffer 2" UBYTE COMP_0068 1 100 0 255 ECU_ADDRESS 0xFFFF3C4B /begin FUNCTION_LIST /end FUNCTION_LIST /end MEASUREMENT
/begin MEASUREMENT vEPWBP2_C#5_R#1 "4K EEPROM Page writing buffer 2" UBYTE COMP_0068 1 100 0 255 ECU_ADDRESS 0xFFFF3C4C /begin FUNCTION_LIST /end FUNCTION_LIST /end MEASUREMENT
/begin MEASUREMENT vEPWBP2_C#6_R#1 "4K EEPROM Page writing buffer 2" UBYTE COMP_0068 1 100 0 255 ECU_ADDRESS 0xFFFF3C4D /begin FUNCTION_LIST /end FUNCTION_LIST /end MEASUREMENT
/begin MEASUREMENT vEPWBP2_C#7_R#1 "4K EEPROM Page writing buffer 2" UBYTE COMP_0068 1 100 0 255 ECU_ADDRESS 0xFFFF3C4E /begin FUNCTION_LIST /end FUNCTION_LIST /end MEASUREMENT
/begin MEASUREMENT vEPWBP2_C#8_R#1 "4K EEPROM Page writing buffer 2" UBYTE COMP_0068 1 100 0 255 ECU_ADDRESS 0xFFFF3C4F /begin FUNCTION_LIST /end FUNCTION_LIST /end MEASUREMENT
/begin MEASUREMENT vEPWBP2_C#9_R#1 "4K EEPROM Page writing buffer 2" UBYTE COMP_0068 1 100 0 255 ECU_ADDRESS 0xFFFF3C50 /begin FUNCTION_LIST /end FUNCTION_LIST /end MEASUREMENT
/begin MEASUREMENT vEPWBP2_C#10_R#1 "4K EEPROM Page writing buffer 2" UBYTE COMP_0068 1 100 0 255 ECU_ADDRESS 0xFFFF3C51 /begin FUNCTION_LIST /end FUNCTION_LIST /end MEASUREMENT
/begin MEASUREMENT vEPWBP2_C#11_R#1 "4K EEPROM Page writing buffer 2" UBYTE COMP_0068 1 100 0 255 ECU_ADDRESS 0xFFFF3C52 /begin FUNCTION_LIST /end FUNCTION_LIST /end MEASUREMENT
/begin MEASUREMENT vEPWBP2_C#12_R#1 "4K EEPROM Page writing buffer 2" UBYTE COMP_0068 1 100 0 255 ECU_ADDRESS 0xFFFF3C53 /begin FUNCTION_LIST /end FUNCTION_LIST /end MEASUREMENT
/begin MEASUREMENT vEPWBP2_C#13_R#1 "4K EEPROM Page writing buffer 2" UBYTE COMP_0068 1 100 0 255 ECU_ADDRESS 0xFFFF3C54 /begin FUNCTION_LIST /end FUNCTION_LIST /end MEASUREMENT
/begin MEASUREMENT vEPWBP2_C#14_R#1 "4K EEPROM Page writing buffer 2" UBYTE COMP_0068 1 100 0 255 ECU_ADDRESS 0xFFFF3C55 /begin FUNCTION_LIST /end FUNCTION_LIST /end MEASUREMENT
/begin MEASUREMENT vEPWBP2_C#15_R#1 "4K EEPROM Page writing buffer 2" UBYTE COMP_0068 1 100 0 255 ECU_ADDRESS 0xFFFF3C56 /begin FUNCTION_LIST /end FUNCTION_LIST /end MEASUREMENT
/begin MEASUREMENT vEPWBP2_C#16_R#1 "4K EEPROM Page writing buffer 2" UBYTE COMP_0068 1 100 0 255 ECU_ADDRESS 0xFFFF3C57 /begin FUNCTION_LIST /end FUNCTION_LIST /end MEASUREMENT
/begin MEASUREMENT vEPWBP2_C#17_R#1 "4K EEPROM Page writing buffer 2" UBYTE COMP_0068 1 100 0 255 ECU_ADDRESS 0xFFFF3C58 /begin FUNCTION_LIST /end FUNCTION_LIST /end MEASUREMENT
/begin MEASUREMENT vEPWBP2_C#18_R#1 "4K EEPROM Page writing buffer 2" UBYTE COMP_0068 1 100 0 255 ECU_ADDRESS 0xFFFF3C59 /begin FUNCTION_LIST /end FUNCTION_LIST /end MEASUREMENT
/begin MEASUREMENT vEPWBP2_C#19_R#1 "4K EEPROM Page writing buffer 2" UBYTE COMP_0068 1 100 0 255 ECU_ADDRESS 0xFFFF3C5A /begin FUNCTION_LIST /end FUNCTION_LIST /end MEASUREMENT
/begin MEASUREMENT vEPWBP2_C#20_R#1 "4K EEPROM Page writing buffer 2" UBYTE COMP_0068 1 100 0 255 ECU_ADDRESS 0xFFFF3C5B /begin FUNCTION_LIST /end FUNCTION_LIST /end MEASUREMENT
/begin MEASUREMENT vEPWBP2_C#21_R#1 "4K EEPROM Page writing buffer 2" UBYTE COMP_0068 1 100 0 255 ECU_ADDRESS 0xFFFF3C5C /begin FUNCTION_LIST /end FUNCTION_LIST /end MEASUREMENT
/begin MEASUREMENT vEPWBP2_C#22_R#1 "4K EEPROM Page writing buffer 2" UBYTE COMP_0068 1 100 0 255 ECU_ADDRESS 0xFFFF3C5D /begin FUNCTION_LIST /end FUNCTION_LIST /end MEASUREMENT
/begin MEASUREMENT vEPWBP2_C#23_R#1 "4K EEPROM Page writing buffer 2" UBYTE COMP_0068 1 100 0 255 ECU_ADDRESS 0xFFFF3C5E /begin FUNCTION_LIST /end FUNCTION_LIST /end MEASUREMENT
/begin MEASUREMENT vEPWBP2_C#24_R#1 "4K EEPROM Page writing buffer 2" UBYTE COMP_0068 1 100 0 255 ECU_ADDRESS 0xFFFF3C5F /begin FUNCTION_LIST /end FUNCTION_LIST /end MEASUREMENT
/begin MEASUREMENT vEPWBP2_C#25_R#1 "4K EEPROM Page writing buffer 2" UBYTE COMP_0068 1 100 0 255 ECU_ADDRESS 0xFFFF3C60 /begin FUNCTION_LIST /end FUNCTION_LIST /end MEASUREMENT
/begin MEASUREMENT vEPWBP2_C#26_R#1 "4K EEPROM Page writing buffer 2" UBYTE COMP_0068 1 100 0 255 ECU_ADDRESS 0xFFFF3C61 /begin FUNCTION_LIST /end FUNCTION_LIST /end MEASUREMENT
/begin MEASUREMENT vEPWBP2_C#27_R#1 "4K EEPROM Page writing buffer 2" UBYTE COMP_0068 1 100 0 255 ECU_ADDRESS 0xFFFF3C62 /begin FUNCTION_LIST /end FUNCTION_LIST /end MEASUREMENT
/begin MEASUREMENT vEPWBP2_C#28_R#1 "4K EEPROM Page writing buffer 2" UBYTE COMP_0068 1 100 0 255 ECU_ADDRESS 0xFFFF3C63 /begin FUNCTION_LIST /end FUNCTION_LIST /end MEASUREMENT
/begin MEASUREMENT vEPWBP2_C#29_R#1 "4K EEPROM Page writing buffer 2" UBYTE COMP_0068 1 100 0 255 ECU_ADDRESS 0xFFFF3C64 /begin FUNCTION_LIST /end FUNCTION_LIST /end MEASUREMENT
/begin MEASUREMENT vEPWBP2_C#30_R#1 "4K EEPROM Page writing buffer 2" UBYTE COMP_0068 1 100 0 255 ECU_ADDRESS 0xFFFF3C65 /begin FUNCTION_LIST /end FUNCTION_LIST /end MEASUREMENT
/begin MEASUREMENT vEPWBP2_C#31_R#1 "4K EEPROM Page writing buffer 2" UBYTE COMP_0068 1 100 0 255 ECU_ADDRESS 0xFFFF3C66 /begin FUNCTION_LIST /end FUNCTION_LIST /end MEASUREMENT
/begin MEASUREMENT vEPWBP2_C#32_R#1 "4K EEPROM Page writing buffer 2" UBYTE COMP_0068 1 100 0 255 ECU_ADDRESS 0xFFFF3C67 /begin FUNCTION_LIST /end FUNCTION_LIST /end MEASUREMENT
/begin MEASUREMENT vEPWBP7 "4K EEPROM Page writing buffer 7" UBYTE COMP_0004 1 100 0 255 ECU_ADDRESS 0xFFFF3C68 /begin FUNCTION_LIST /end FUNCTION_LIST /end MEASUREMENT
/begin MEASUREMENT vEPWBP7_C#1_R#1 "4K EEPROM Page writing buffer 7" UBYTE COMP_0004 1 100 0 255 ECU_ADDRESS 0xFFFF3C68 /begin FUNCTION_LIST /end FUNCTION_LIST /end MEASUREMENT
/begin MEASUREMENT vEPWBP7_C#2_R#1 "4K EEPROM Page writing buffer 7" UBYTE COMP_0004 1 100 0 255 ECU_ADDRESS 0xFFFF3C69 /begin FUNCTION_LIST /end FUNCTION_LIST /end MEASUREMENT
/begin MEASUREMENT vEPWBP7_C#3_R#1 "4K EEPROM Page writing buffer 7" UBYTE COMP_0004 1 100 0 255 ECU_ADDRESS 0xFFFF3C6A /begin FUNCTION_LIST /end FUNCTION_LIST /end MEASUREMENT
/begin MEASUREMENT vEPWBP7_C#4_R#1 "4K EEPROM Page writing buffer 7" UBYTE COMP_0004 1 100 0 255 ECU_ADDRESS 0xFFFF3C6B /begin FUNCTION_LIST /end FUNCTION_LIST /end MEASUREMENT
/begin MEASUREMENT vEPWBP7_C#5_R#1 "4K EEPROM Page writing buffer 7" UBYTE COMP_0004 1 100 0 255 ECU_ADDRESS 0xFFFF3C6C /begin FUNCTION_LIST /end FUNCTION_LIST /end MEASUREMENT
/begin MEASUREMENT vEPWBP7_C#6_R#1 "4K EEPROM Page writing buffer 7" UBYTE COMP_0004 1 100 0 255 ECU_ADDRESS 0xFFFF3C6D /begin FUNCTION_LIST /end FUNCTION_LIST /end MEASUREMENT
/begin MEASUREMENT vEPWBP7_C#7_R#1 "4K EEPROM Page writing buffer 7" UBYTE COMP_0004 1 100 0 255 ECU_ADDRESS 0xFFFF3C6E /begin FUNCTION_LIST /end FUNCTION_LIST /end MEASUREMENT
/begin MEASUREMENT vEPWBP7_C#8_R#1 "4K EEPROM Page writing buffer 7" UBYTE COMP_0004 1 100 0 255 ECU_ADDRESS 0xFFFF3C6F /begin FUNCTION_LIST /end FUNCTION_LIST /end MEASUREMENT
/begin MEASUREMENT vEPWBP7_C#9_R#1 "4K EEPROM Page writing buffer 7" UBYTE COMP_0004 1 100 0 255 ECU_ADDRESS 0xFFFF3C70 /begin FUNCTION_LIST /end FUNCTION_LIST /end MEASUREMENT
/begin MEASUREMENT vEPWBP7_C#10_R#1 "4K EEPROM Page writing buffer 7" UBYTE COMP_0004 1 100 0 255 ECU_ADDRESS 0xFFFF3C71 /begin FUNCTION_LIST /end FUNCTION_LIST /end MEASUREMENT
/begin MEASUREMENT vEPWBP7_C#11_R#1 "4K EEPROM Page writing buffer 7" UBYTE COMP_0004 1 100 0 255 ECU_ADDRESS 0xFFFF3C72 /begin FUNCTION_LIST /end FUNCTION_LIST /end MEASUREMENT
/begin MEASUREMENT vEPWBP7_C#12_R#1 "4K EEPROM Page writing buffer 7" UBYTE COMP_0004 1 100 0 255 ECU_ADDRESS 0xFFFF3C73 /begin FUNCTION_LIST /end FUNCTION_LIST /end MEASUREMENT
/begin MEASUREMENT vEPWBP7_C#13_R#1 "4K EEPROM Page writing buffer 7" UBYTE COMP_0004 1 100 0 255 ECU_ADDRESS 0xFFFF3C74 /begin FUNCTION_LIST /end FUNCTION_LIST /end MEASUREMENT
/begin MEASUREMENT vEPWBP7_C#14_R#1 "4K EEPROM Page writing buffer 7" UBYTE COMP_0004 1 100 0 255 ECU_ADDRESS 0xFFFF3C75 /begin FUNCTION_LIST /end FUNCTION_LIST /end MEASUREMENT
/begin MEASUREMENT vEPWBP7_C#15_R#1 "4K EEPROM Page writing buffer 7" UBYTE COMP_0004 1 100 0 255 ECU_ADDRESS 0xFFFF3C76 /begin FUNCTION_LIST /end FUNCTION_LIST /end MEASUREMENT
/begin MEASUREMENT vEPWBP7_C#16_R#1 "4K EEPROM Page writing buffer 7" UBYTE COMP_0004 1 100 0 255 ECU_ADDRESS 0xFFFF3C77 /begin FUNCTION_LIST /end FUNCTION_LIST /end MEASUREMENT
/begin MEASUREMENT vEPWBP7_C#17_R#1 "4K EEPROM Page writing buffer 7" UBYTE COMP_0004 1 100 0 255 ECU_ADDRESS 0xFFFF3C78 /begin FUNCTION_LIST /end FUNCTION_LIST /end MEASUREMENT
/begin MEASUREMENT vEPWBP7_C#18_R#1 "4K EEPROM Page writing buffer 7" UBYTE COMP_0004 1 100 0 255 ECU_ADDRESS 0xFFFF3C79 /begin FUNCTION_LIST /end FUNCTION_LIST /end MEASUREMENT
/begin MEASUREMENT vEPWBP7_C#19_R#1 "4K EEPROM Page writing buffer 7" UBYTE COMP_0004 1 100 0 255 ECU_ADDRESS 0xFFFF3C7A /begin FUNCTION_LIST /end FUNCTION_LIST /end MEASUREMENT
/begin MEASUREMENT vEPWBP7_C#20_R#1 "4K EEPROM Page writing buffer 7" UBYTE COMP_0004 1 100 0 255 ECU_ADDRESS 0xFFFF3C7B /begin FUNCTION_LIST /end FUNCTION_LIST /end MEASUREMENT
/begin MEASUREMENT vEPWBP7_C#21_R#1 "4K EEPROM Page writing buffer 7" UBYTE COMP_0004 1 100 0 255 ECU_ADDRESS 0xFFFF3C7C /begin FUNCTION_LIST /end FUNCTION_LIST /end MEASUREMENT
/begin MEASUREMENT vEPWBP7_C#22_R#1 "4K EEPROM Page writing buffer 7" UBYTE COMP_0004 1 100 0 255 ECU_ADDRESS 0xFFFF3C7D /begin FUNCTION_LIST /end FUNCTION_LIST /end MEASUREMENT
/begin MEASUREMENT vEPWBP7_C#23_R#1 "4K EEPROM Page writing buffer 7" UBYTE COMP_0004 1 100 0 255 ECU_ADDRESS 0xFFFF3C7E /begin FUNCTION_LIST /end FUNCTION_LIST /end MEASUREMENT
/begin MEASUREMENT vEPWBP7_C#24_R#1 "4K EEPROM Page writing buffer 7" UBYTE COMP_0004 1 100 0 255 ECU_ADDRESS 0xFFFF3C7F /begin FUNCTION_LIST /end FUNCTION_LIST /end MEASUREMENT
/begin MEASUREMENT vEPWBP7_C#25_R#1 "4K EEPROM Page writing buffer 7" UBYTE COMP_0004 1 100 0 255 ECU_ADDRESS 0xFFFF3C80 /begin FUNCTION_LIST /end FUNCTION_LIST /end MEASUREMENT
/begin MEASUREMENT vEPWBP7_C#26_R#1 "4K EEPROM Page writing buffer 7" UBYTE COMP_0004 1 100 0 255 ECU_ADDRESS 0xFFFF3C81 /begin FUNCTION_LIST /end FUNCTION_LIST /end MEASUREMENT
/begin MEASUREMENT vEPWBP7_C#27_R#1 "4K EEPROM Page writing buffer 7" UBYTE COMP_0004 1 100 0 255 ECU_ADDRESS 0xFFFF3C82 /begin FUNCTION_LIST /end FUNCTION_LIST /end MEASUREMENT
/begin MEASUREMENT vEPWBP7_C#28_R#1 "4K EEPROM Page writing buffer 7" UBYTE COMP_0004 1 100 0 255 ECU_ADDRESS 0xFFFF3C83 /begin FUNCTION_LIST /end FUNCTION_LIST /end MEASUREMENT
/begin MEASUREMENT vEPWBP7_C#29_R#1 "4K EEPROM Page writing buffer 7" UBYTE COMP_0004 1 100 0 255 ECU_ADDRESS 0xFFFF3C84 /begin FUNCTION_LIST /end FUNCTION_LIST /end MEASUREMENT
/begin MEASUREMENT vEPWBP7_C#30_R#1 "4K EEPROM Page writing buffer 7" UBYTE COMP_0004 1 100 0 255 ECU_ADDRESS 0xFFFF3C85 /begin FUNCTION_LIST /end FUNCTION_LIST /end MEASUREMENT
/begin MEASUREMENT vEPWBP7_C#31_R#1 "4K EEPROM Page writing buffer 7" UBYTE COMP_0004 1 100 0 255 ECU_ADDRESS 0xFFFF3C86 /begin FUNCTION_LIST /end FUNCTION_LIST /end MEASUREMENT
/begin MEASUREMENT vEPWBP7_C#32_R#1 "4K EEPROM Page writing buffer 7" UBYTE COMP_0004 1 100 0 255 ECU_ADDRESS 0xFFFF3C87 /begin FUNCTION_LIST /end FUNCTION_LIST /end MEASUREMENT
/begin MEASUREMENT vEPWBPN "4K EEPROM Page writing buffer N" UBYTE COMP_0004 1 100 0 255 ECU_ADDRESS 0xFFFF3C88 /begin FUNCTION_LIST /end FUNCTION_LIST /end MEASUREMENT
/begin MEASUREMENT vEPWBPN_C#1_R#1 "4K EEPROM Page writing buffer N" UBYTE COMP_0004 1 100 0 255 ECU_ADDRESS 0xFFFF3C88 /begin FUNCTION_LIST /end FUNCTION_LIST /end MEASUREMENT
/begin MEASUREMENT vEPWBPN_C#2_R#1 "4K EEPROM Page writing buffer N" UBYTE COMP_0004 1 100 0 255 ECU_ADDRESS 0xFFFF3C89 /begin FUNCTION_LIST /end FUNCTION_LIST /end MEASUREMENT
/begin MEASUREMENT vEPWBPN_C#3_R#1 "4K EEPROM Page writing buffer N" UBYTE COMP_0004 1 100 0 255 ECU_ADDRESS 0xFFFF3C8A /begin FUNCTION_LIST /end FUNCTION_LIST /end MEASUREMENT
/begin MEASUREMENT vEPWBPN_C#4_R#1 "4K EEPROM Page writing buffer N" UBYTE COMP_0004 1 100 0 255 ECU_ADDRESS 0xFFFF3C8B /begin FUNCTION_LIST /end FUNCTION_LIST /end MEASUREMENT
/begin MEASUREMENT vEPWBPN_C#5_R#1 "4K EEPROM Page writing buffer N" UBYTE COMP_0004 1 100 0 255 ECU_ADDRESS 0xFFFF3C8C /begin FUNCTION_LIST /end FUNCTION_LIST /end MEASUREMENT
/begin MEASUREMENT vEPWBPN_C#6_R#1 "4K EEPROM Page writing buffer N" UBYTE COMP_0004 1 100 0 255 ECU_ADDRESS 0xFFFF3C8D /begin FUNCTION_LIST /end FUNCTION_LIST /end MEASUREMENT
/begin MEASUREMENT vEPWBPN_C#7_R#1 "4K EEPROM Page writing buffer N" UBYTE COMP_0004 1 100 0 255 ECU_ADDRESS 0xFFFF3C8E /begin FUNCTION_LIST /end FUNCTION_LIST /end MEASUREMENT
/begin MEASUREMENT vEPWBPN_C#8_R#1 "4K EEPROM Page writing buffer N" UBYTE COMP_0004 1 100 0 255 ECU_ADDRESS 0xFFFF3C8F /begin FUNCTION_LIST /end FUNCTION_LIST /end MEASUREMENT
/begin MEASUREMENT vEPWBPN_C#9_R#1 "4K EEPROM Page writing buffer N" UBYTE COMP_0004 1 100 0 255 ECU_ADDRESS 0xFFFF3C90 /begin FUNCTION_LIST /end FUNCTION_LIST /end MEASUREMENT
/begin MEASUREMENT vEPWBPN_C#10_R#1 "4K EEPROM Page writing buffer N" UBYTE COMP_0004 1 100 0 255 ECU_ADDRESS 0xFFFF3C91 /begin FUNCTION_LIST /end FUNCTION_LIST /end MEASUREMENT
/begin MEASUREMENT vEPWBPN_C#11_R#1 "4K EEPROM Page writing buffer N" UBYTE COMP_0004 1 100 0 255 ECU_ADDRESS 0xFFFF3C92 /begin FUNCTION_LIST /end FUNCTION_LIST /end MEASUREMENT
/begin MEASUREMENT vEPWBPN_C#12_R#1 "4K EEPROM Page writing buffer N" UBYTE COMP_0004 1 100 0 255 ECU_ADDRESS 0xFFFF3C93 /begin FUNCTION_LIST /end FUNCTION_LIST /end MEASUREMENT
/begin MEASUREMENT vEPWBPN_C#13_R#1 "4K EEPROM Page writing buffer N" UBYTE COMP_0004 1 100 0 255 ECU_ADDRESS 0xFFFF3C94 /begin FUNCTION_LIST /end FUNCTION_LIST /end MEASUREMENT
/begin MEASUREMENT vEPWBPN_C#14_R#1 "4K EEPROM Page writing buffer N" UBYTE COMP_0004 1 100 0 255 ECU_ADDRESS 0xFFFF3C95 /begin FUNCTION_LIST /end FUNCTION_LIST /end MEASUREMENT
/begin MEASUREMENT vEPWBPN_C#15_R#1 "4K EEPROM Page writing buffer N" UBYTE COMP_0004 1 100 0 255 ECU_ADDRESS 0xFFFF3C96 /begin FUNCTION_LIST /end FUNCTION_LIST /end MEASUREMENT
/begin MEASUREMENT vEPWBPN_C#16_R#1 "4K EEPROM Page writing buffer N" UBYTE COMP_0004 1 100 0 255 ECU_ADDRESS 0xFFFF3C97 /begin FUNCTION_LIST /end FUNCTION_LIST /end MEASUREMENT
/begin MEASUREMENT vEPWBPN_C#17_R#1 "4K EEPROM Page writing buffer N" UBYTE COMP_0004 1 100 0 255 ECU_ADDRESS 0xFFFF3C98 /begin FUNCTION_LIST /end FUNCTION_LIST /end MEASUREMENT
/begin MEASUREMENT vEPWBPN_C#18_R#1 "4K EEPROM Page writing buffer N" UBYTE COMP_0004 1 100 0 255 ECU_ADDRESS 0xFFFF3C99 /begin FUNCTION_LIST /end FUNCTION_LIST /end MEASUREMENT
/begin MEASUREMENT vEPWBPN_C#19_R#1 "4K EEPROM Page writing buffer N" UBYTE COMP_0004 1 100 0 255 ECU_ADDRESS 0xFFFF3C9A /begin FUNCTION_LIST /end FUNCTION_LIST /end MEASUREMENT
/begin MEASUREMENT vEPWBPN_C#20_R#1 "4K EEPROM Page writing buffer N" UBYTE COMP_0004 1 100 0 255 ECU_ADDRESS 0xFFFF3C9B /begin FUNCTION_LIST /end FUNCTION_LIST /end MEASUREMENT
/begin MEASUREMENT vEPWBPN_C#21_R#1 "4K EEPROM Page writing buffer N" UBYTE COMP_0004 1 100 0 255 ECU_ADDRESS 0xFFFF3C9C /begin FUNCTION_LIST /end FUNCTION_LIST /end MEASUREMENT
/begin MEASUREMENT vEPWBPN_C#22_R#1 "4K EEPROM Page writing buffer N" UBYTE COMP_0004 1 100 0 255 ECU_ADDRESS 0xFFFF3C9D /begin FUNCTION_LIST /end FUNCTION_LIST /end MEASUREMENT
/begin MEASUREMENT vEPWBPN_C#23_R#1 "4K EEPROM Page writing buffer N" UBYTE COMP_0004 1 100 0 255 ECU_ADDRESS 0xFFFF3C9E /begin FUNCTION_LIST /end FUNCTION_LIST /end MEASUREMENT
/begin MEASUREMENT vEPWBPN_C#24_R#1 "4K EEPROM Page writing buffer N" UBYTE COMP_0004 1 100 0 255 ECU_ADDRESS 0xFFFF3C9F /begin FUNCTION_LIST /end FUNCTION_LIST /end MEASUREMENT
/begin MEASUREMENT vEPWBPN_C#25_R#1 "4K EEPROM Page writing buffer N" UBYTE COMP_0004 1 100 0 255 ECU_ADDRESS 0xFFFF3CA0 /begin FUNCTION_LIST /end FUNCTION_LIST /end MEASUREMENT
/begin MEASUREMENT vEPWBPN_C#26_R#1 "4K EEPROM Page writing buffer N" UBYTE COMP_0004 1 100 0 255 ECU_ADDRESS 0xFFFF3CA1 /begin FUNCTION_LIST /end FUNCTION_LIST /end MEASUREMENT
/begin MEASUREMENT vEPWBPN_C#27_R#1 "4K EEPROM Page writing buffer N" UBYTE COMP_0004 1 100 0 255 ECU_ADDRESS 0xFFFF3CA2 /begin FUNCTION_LIST /end FUNCTION_LIST /end MEASUREMENT
/begin MEASUREMENT vEPWBPN_C#28_R#1 "4K EEPROM Page writing buffer N" UBYTE COMP_0004 1 100 0 255 ECU_ADDRESS 0xFFFF3CA3 /begin FUNCTION_LIST /end FUNCTION_LIST /end MEASUREMENT
/begin MEASUREMENT vEPWBPN_C#29_R#1 "4K EEPROM Page writing buffer N" UBYTE COMP_0004 1 100 0 255 ECU_ADDRESS 0xFFFF3CA4 /begin FUNCTION_LIST /end FUNCTION_LIST /end MEASUREMENT
/begin MEASUREMENT vEPWBPN_C#30_R#1 "4K EEPROM Page writing buffer N" UBYTE COMP_0004 1 100 0 255 ECU_ADDRESS 0xFFFF3CA5 /begin FUNCTION_LIST /end FUNCTION_LIST /end MEASUREMENT
/begin MEASUREMENT vEPWBPN_C#31_R#1 "4K EEPROM Page writing buffer N" UBYTE COMP_0004 1 100 0 255 ECU_ADDRESS 0xFFFF3CA6 /begin FUNCTION_LIST /end FUNCTION_LIST /end MEASUREMENT
/begin MEASUREMENT vEPWBPN_C#32_R#1 "4K EEPROM Page writing buffer N" UBYTE COMP_0004 1 100 0 255 ECU_ADDRESS 0xFFFF3CA7 /begin FUNCTION_LIST /end FUNCTION_LIST /end MEASUREMENT
/begin MEASUREMENT vEPWBW0 "EEPROM writing buffer 0" UBYTE COMP_0004 1 100 0 255 ECU_ADDRESS 0xFFFF3CA8 /begin FUNCTION_LIST /end FUNCTION_LIST /end MEASUREMENT
/begin MEASUREMENT vEPWBW1 "EEPROM writing buffer 1" UBYTE COMP_0004 1 100 0 255 ECU_ADDRESS 0xFFFF3CA9 /begin FUNCTION_LIST /end FUNCTION_LIST /end MEASUREMENT
/begin MEASUREMENT vEPWBW2 "EEPROM writing buffer 2" UBYTE COMP_0004 1 100 0 255 ECU_ADDRESS 0xFFFF3CAA /begin FUNCTION_LIST /end FUNCTION_LIST /end MEASUREMENT
/begin MEASUREMENT vEPWBW3 "EEPROM writing buffer 3" UBYTE COMP_0004 1 100 0 255 ECU_ADDRESS 0xFFFF3CAB /begin FUNCTION_LIST /end FUNCTION_LIST /end MEASUREMENT
/begin MEASUREMENT vEPWBW4 "EEPROM writing buffer 4" UBYTE COMP_0004 1 100 0 255 ECU_ADDRESS 0xFFFF3CAC /begin FUNCTION_LIST /end FUNCTION_LIST /end MEASUREMENT
/begin MEASUREMENT vEPWBW5 "EEPROM writing buffer 5" UBYTE COMP_0004 1 100 0 255 ECU_ADDRESS 0xFFFF3CAD /begin FUNCTION_LIST /end FUNCTION_LIST /end MEASUREMENT
/begin MEASUREMENT vEPWBW6 "EEPROM writing buffer 6" UBYTE COMP_0004 1 100 0 255 ECU_ADDRESS 0xFFFF3CAE /begin FUNCTION_LIST /end FUNCTION_LIST /end MEASUREMENT
/begin MEASUREMENT vEPWBW7 "EEPROM writing buffer 7" UBYTE COMP_0004 1 100 0 255 ECU_ADDRESS 0xFFFF3CAF /begin FUNCTION_LIST /end FUNCTION_LIST /end MEASUREMENT
/begin MEASUREMENT vEPWBWN "EEPROM writing buffer" UBYTE COMP_0004 1 100 0 255 ECU_ADDRESS 0xFFFF3CB0 /begin FUNCTION_LIST /end FUNCTION_LIST /end MEASUREMENT
/begin MEASUREMENT vEPWCNT2 "4K EEPROM Page writing counter 2" UBYTE COMP_0068 1 100 0 255 ECU_ADDRESS 0xFFFF3CB1 /begin FUNCTION_LIST /end FUNCTION_LIST /end MEASUREMENT
/begin MEASUREMENT vEPWCNT7 "4K EEPROM Page writing counter 7" UBYTE COMP_0068 1 100 0 255 ECU_ADDRESS 0xFFFF3CB2 /begin FUNCTION_LIST /end FUNCTION_LIST /end MEASUREMENT
/begin MEASUREMENT vEPWCNTN "4K EEPROM Page writing counter N" UBYTE COMP_0068 1 100 0 255 ECU_ADDRESS 0xFFFF3CB3 /begin FUNCTION_LIST /end FUNCTION_LIST /end MEASUREMENT
/begin MEASUREMENT vEPWRTLEN "The reference position of the initial value table of the ECUReset command" UBYTE COMP_0068 1 100 0 255 ECU_ADDRESS 0xFFFF3CB4 /begin FUNCTION_LIST /end FUNCTION_LIST /end MEASUREMENT
/begin MEASUREMENT vEPWSIZE "EEP- The number of ROM writing bytes" UBYTE COMP_0068 1 100 0 255 ECU_ADDRESS 0xFFFF2B5E /begin FUNCTION_LIST /end FUNCTION_LIST /end MEASUREMENT
/begin MEASUREMENT vERAVEI "At the time of following, the amount of average deviation" UBYTE COMP_0256 1 100 -64 63.5 ECU_ADDRESS 0xFFFFA308 /begin FUNCTION_LIST /end FUNCTION_LIST /end MEASUREMENT
/begin MEASUREMENT vERAVEI_R#1 "At the time of following, the amount of average deviation" UBYTE COMP_0256 1 100 -64 63.5 ECU_ADDRESS 0xFFFFA308 /begin FUNCTION_LIST /end FUNCTION_LIST /end MEASUREMENT
/begin MEASUREMENT vERAVEI_R#2 "At the time of following, the amount of average deviation" UBYTE COMP_0256 1 100 -64 63.5 ECU_ADDRESS 0xFFFFA309 /begin FUNCTION_LIST /end FUNCTION_LIST /end MEASUREMENT
/begin MEASUREMENT vERBMXI "At the time of the actual angle following delay retard, a maximum deviation" UBYTE COMP_0256 1 100 -64 63.5 ECU_ADDRESS 0xFFFFA30A /begin FUNCTION_LIST /end FUNCTION_LIST /end MEASUREMENT
/begin MEASUREMENT vERBMXI_R#1 "At the time of the actual angle following delay retard, a maximum deviation" UBYTE COMP_0256 1 100 -64 63.5 ECU_ADDRESS 0xFFFFA30A /begin FUNCTION_LIST /end FUNCTION_LIST /end MEASUREMENT
/begin MEASUREMENT vERBMXI_R#2 "At the time of the actual angle following delay retard, a maximum deviation" UBYTE COMP_0256 1 100 -64 63.5 ECU_ADDRESS 0xFFFFA30B /begin FUNCTION_LIST /end FUNCTION_LIST /end MEASUREMENT
/begin MEASUREMENT vERFMXI "At the time of the actual angle following delay advance, a maximum deviation" UBYTE COMP_0256 1 100 -64 63.5 ECU_ADDRESS 0xFFFFA30C /begin FUNCTION_LIST /end FUNCTION_LIST /end MEASUREMENT
/begin MEASUREMENT vERFMXI_R#1 "At the time of the actual angle following delay advance, a maximum deviation" UBYTE COMP_0256 1 100 -64 63.5 ECU_ADDRESS 0xFFFFA30C /begin FUNCTION_LIST /end FUNCTION_LIST /end MEASUREMENT
/begin MEASUREMENT vERFMXI_R#2 "At the time of the actual angle following delay advance, a maximum deviation" UBYTE COMP_0256 1 100 -64 63.5 ECU_ADDRESS 0xFFFFA30D /begin FUNCTION_LIST /end FUNCTION_LIST /end MEASUREMENT
/begin MEASUREMENT vERMAXI "At the time of following, the amount of maximum deviation" UBYTE COMP_0256 1 100 -64 63.5 ECU_ADDRESS 0xFFFFA30E /begin FUNCTION_LIST /end FUNCTION_LIST /end MEASUREMENT
/begin MEASUREMENT vERMAXI_R#1 "At the time of following, the amount of maximum deviation" UBYTE COMP_0256 1 100 -64 63.5 ECU_ADDRESS 0xFFFFA30E /begin FUNCTION_LIST /end FUNCTION_LIST /end MEASUREMENT
/begin MEASUREMENT vERMAXI_R#2 "At the time of following, the amount of maximum deviation" UBYTE COMP_0256 1 100 -64 63.5 ECU_ADDRESS 0xFFFFA30F /begin FUNCTION_LIST /end FUNCTION_LIST /end MEASUREMENT
/begin MEASUREMENT vERMINI "At the time of following, the amount of minimum deviation" UBYTE COMP_0256 1 100 -64 63.5 ECU_ADDRESS 0xFFFFA310 /begin FUNCTION_LIST /end FUNCTION_LIST /end MEASUREMENT
/begin MEASUREMENT vERMINI_R#1 "At the time of following, the amount of minimum deviation" UBYTE COMP_0256 1 100 -64 63.5 ECU_ADDRESS 0xFFFFA310 /begin FUNCTION_LIST /end FUNCTION_LIST /end MEASUREMENT
/begin MEASUREMENT vERMINI_R#2 "At the time of following, the amount of minimum deviation" UBYTE COMP_0256 1 100 -64 63.5 ECU_ADDRESS 0xFFFFA311 /begin FUNCTION_LIST /end FUNCTION_LIST /end MEASUREMENT
/begin MEASUREMENT vERRJOKEf "VTC drive diagnosis normality judgement flag" UBYTE COMP_0004 1 100 0 255 ECU_ADDRESS 0xFFFF2B61 /begin FUNCTION_LIST /end FUNCTION_LIST /end MEASUREMENT
/begin MEASUREMENT vERRJOKIf "VTC drive diagnosis normality judgement flag" UBYTE COMP_0004 1 100 0 255 ECU_ADDRESS 0xFFFF2B63 /begin FUNCTION_LIST /end FUNCTION_LIST /end MEASUREMENT
/begin MEASUREMENT vERRJOKf "VTC drive diagnosis normality judgement flag" UBYTE COMP_0004 1 100 0 255 ECU_ADDRESS 0xFFFF2B62 /begin FUNCTION_LIST /end FUNCTION_LIST /end MEASUREMENT
/begin MEASUREMENT vERRLRNE "VTC operation angle deviation quantity integral value learning value" ULONG COMP_0064_S 1 100 -10737418.24 10737418.235 ECU_ADDRESS 0xFFFFA314 /begin FUNCTION_LIST /end FUNCTION_LIST /end MEASUREMENT
/begin MEASUREMENT vERRLRNE_R#1 "VTC operation angle deviation quantity integral value learning value" ULONG COMP_0064_S 1 100 -10737418.24 10737418.235 ECU_ADDRESS 0xFFFFA314 /begin FUNCTION_LIST /end FUNCTION_LIST /end MEASUREMENT
/begin MEASUREMENT vERRLRNE_R#2 "VTC operation angle deviation quantity integral value learning value" ULONG COMP_0064_S 1 100 -10737418.24 10737418.235 ECU_ADDRESS 0xFFFFA318 /begin FUNCTION_LIST /end FUNCTION_LIST /end MEASUREMENT
/begin MEASUREMENT vERRLRNEZ "VTC operation angle deviation quantity integral value learning value (last time, renewal value)" ULONG COMP_0064_S 1 100 -10737418.24 10737418.235 ECU_ADDRESS 0xFFFFA31C /begin FUNCTION_LIST /end FUNCTION_LIST /end MEASUREMENT
/begin MEASUREMENT vERRLRNEZ_R#1 "VTC operation angle deviation quantity integral value learning value (last time, renewal value)" ULONG COMP_0064_S 1 100 -10737418.24 10737418.235 ECU_ADDRESS 0xFFFFA31C /begin FUNCTION_LIST /end FUNCTION_LIST /end MEASUREMENT
/begin MEASUREMENT vERRLRNEZ_R#2 "VTC operation angle deviation quantity integral value learning value (last time, renewal value)" ULONG COMP_0064_S 1 100 -10737418.24 10737418.235 ECU_ADDRESS 0xFFFFA320 /begin FUNCTION_LIST /end FUNCTION_LIST /end MEASUREMENT
/begin MEASUREMENT vERRLRNIZ "VTC operation angle deviation quantity integral value learning value (last time, renewal value)" ULONG COMP_0064_S 1 100 -10737418.24 10737418.235 ECU_ADDRESS 0xFFFFA32C /begin FUNCTION_LIST /end FUNCTION_LIST /end MEASUREMENT
/begin MEASUREMENT vERRLRNIZ_R#1 "VTC operation angle deviation quantity integral value learning value (last time, renewal value)" ULONG COMP_0064_S 1 100 -10737418.24 10737418.235 ECU_ADDRESS 0xFFFFA32C /begin FUNCTION_LIST /end FUNCTION_LIST /end MEASUREMENT
/begin MEASUREMENT vERRLRNIZ_R#2 "VTC operation angle deviation quantity integral value learning value (last time, renewal value)" ULONG COMP_0064_S 1 100 -10737418.24 10737418.235 ECU_ADDRESS 0xFFFFA330 /begin FUNCTION_LIST /end FUNCTION_LIST /end MEASUREMENT
/begin MEASUREMENT vERRORE "The amount of operation corner deviation" UBYTE COMP_0256 1 100 -64 63.5 ECU_ADDRESS 0xFFFF12F6 /begin FUNCTION_LIST /end FUNCTION_LIST /end MEASUREMENT
/begin MEASUREMENT vERRORE_R#1 "The amount of operation corner deviation" UBYTE COMP_0256 1 100 -64 63.5 ECU_ADDRESS 0xFFFF12F6 /begin FUNCTION_LIST /end FUNCTION_LIST /end MEASUREMENT
/begin MEASUREMENT vERRORE_R#2 "The amount of operation corner deviation" UBYTE COMP_0256 1 100 -64 63.5 ECU_ADDRESS 0xFFFF12F7 /begin FUNCTION_LIST /end FUNCTION_LIST /end MEASUREMENT
/begin MEASUREMENT vERROREf "The judgement flag whose VTC drive diagnosis is unusual" UBYTE COMP_0004 1 100 0 255 ECU_ADDRESS 0xFFFF12F8 /begin FUNCTION_LIST /end FUNCTION_LIST /end MEASUREMENT
/begin MEASUREMENT vERRORI "The amount of operation corner deviation" UBYTE COMP_0256 1 100 -64 63.5 ECU_ADDRESS 0xFFFF12FA /begin FUNCTION_LIST /end FUNCTION_LIST /end MEASUREMENT
/begin MEASUREMENT vERRORI_R#1 "The amount of operation corner deviation" UBYTE COMP_0256 1 100 -64 63.5 ECU_ADDRESS 0xFFFF12FA /begin FUNCTION_LIST /end FUNCTION_LIST /end MEASUREMENT
/begin MEASUREMENT vERRORI_R#2 "The amount of operation corner deviation" UBYTE COMP_0256 1 100 -64 63.5 ECU_ADDRESS 0xFFFF12FB /begin FUNCTION_LIST /end FUNCTION_LIST /end MEASUREMENT
/begin MEASUREMENT vERRORIf "The judgement flag whose VTC drive diagnosis is unusual" UBYTE COMP_0004 1 100 0 255 ECU_ADDRESS 0xFFFF12FC /begin FUNCTION_LIST /end FUNCTION_LIST /end MEASUREMENT
/begin MEASUREMENT vERRORf "The judgement flag whose VTC drive diagnosis is unusual" UBYTE COMP_0004 1 100 0 255 ECU_ADDRESS 0xFFFF12F9 /begin FUNCTION_LIST /end FUNCTION_LIST /end MEASUREMENT
/begin MEASUREMENT vERRSE2Mf "#<=HNRPM<=VTLNEH# condition judgement" UBYTE COMP_0004 1 100 0 255 ECU_ADDRESS 0xFFFF12FD /begin FUNCTION_LIST /end FUNCTION_LIST /end MEASUREMENT
/begin MEASUREMENT vERRSI2Mf "#<=HNRPM<=VTLNEH# condition judgement" UBYTE COMP_0004 1 100 0 255 ECU_ADDRESS 0xFFFF12FE /begin FUNCTION_LIST /end FUNCTION_LIST /end MEASUREMENT
/begin MEASUREMENT vERRSME2 "VTC operation angle deviation quantity integral value" ULONG COMP_0064_S 1 100 -10737418.24 10737418.235 ECU_ADDRESS 0xFFFF1300 /begin FUNCTION_LIST /end FUNCTION_LIST /end MEASUREMENT
/begin MEASUREMENT vERRSME2_R#1 "VTC operation angle deviation quantity integral value" ULONG COMP_0064_S 1 100 -10737418.24 10737418.235 ECU_ADDRESS 0xFFFF1300 /begin FUNCTION_LIST /end FUNCTION_LIST /end MEASUREMENT
/begin MEASUREMENT vERRSME2_R#2 "VTC operation angle deviation quantity integral value" ULONG COMP_0064_S 1 100 -10737418.24 10737418.235 ECU_ADDRESS 0xFFFF1304 /begin FUNCTION_LIST /end FUNCTION_LIST /end MEASUREMENT
/begin MEASUREMENT vERRSME2M "VTC operation angle deviation quantity integral value memory value" ULONG COMP_0064_S 1 100 -10737418.24 10737418.235 ECU_ADDRESS 0xFFFF1308 /begin FUNCTION_LIST /end FUNCTION_LIST /end MEASUREMENT
/begin MEASUREMENT vERRSME2M_R#1 "VTC operation angle deviation quantity integral value memory value" ULONG COMP_0064_S 1 100 -10737418.24 10737418.235 ECU_ADDRESS 0xFFFF1308 /begin FUNCTION_LIST /end FUNCTION_LIST /end MEASUREMENT
/begin MEASUREMENT vERRSME2M_R#2 "VTC operation angle deviation quantity integral value memory value" ULONG COMP_0064_S 1 100 -10737418.24 10737418.235 ECU_ADDRESS 0xFFFF130C /begin FUNCTION_LIST /end FUNCTION_LIST /end MEASUREMENT
/begin MEASUREMENT vERRSME2Z "VTC operation angle deviation quantity integral value (last time, renewal value)" ULONG COMP_0064_S 1 100 -10737418.24 10737418.235 ECU_ADDRESS 0xFFFF1310 /begin FUNCTION_LIST /end FUNCTION_LIST /end MEASUREMENT
/begin MEASUREMENT vERRSME2Z_R#1 "VTC operation angle deviation quantity integral value (last time, renewal value)" ULONG COMP_0064_S 1 100 -10737418.24 10737418.235 ECU_ADDRESS 0xFFFF1310 /begin FUNCTION_LIST /end FUNCTION_LIST /end MEASUREMENT
/begin MEASUREMENT vERRSME2Z_R#2 "VTC operation angle deviation quantity integral value (last time, renewal value)" ULONG COMP_0064_S 1 100 -10737418.24 10737418.235 ECU_ADDRESS 0xFFFF1314 /begin FUNCTION_LIST /end FUNCTION_LIST /end MEASUREMENT
/begin MEASUREMENT vERRSMI2 "VTC operation angle deviation quantity integral value" ULONG COMP_0064_S 1 100 -10737418.24 10737418.235 ECU_ADDRESS 0xFFFF1318 /begin FUNCTION_LIST /end FUNCTION_LIST /end MEASUREMENT
/begin MEASUREMENT vERRSMI2_R#1 "VTC operation angle deviation quantity integral value" ULONG COMP_0064_S 1 100 -10737418.24 10737418.235 ECU_ADDRESS 0xFFFF1318 /begin FUNCTION_LIST /end FUNCTION_LIST /end MEASUREMENT
/begin MEASUREMENT vERRSMI2_R#2 "VTC operation angle deviation quantity integral value" ULONG COMP_0064_S 1 100 -10737418.24 10737418.235 ECU_ADDRESS 0xFFFF131C /begin FUNCTION_LIST /end FUNCTION_LIST /end MEASUREMENT
/begin MEASUREMENT vERRSMI2M "VTC operation angle deviation quantity integral value memory value" ULONG COMP_0064_S 1 100 -10737418.24 10737418.235 ECU_ADDRESS 0xFFFF1320 /begin FUNCTION_LIST /end FUNCTION_LIST /end MEASUREMENT
/begin MEASUREMENT vERRSMI2M_R#1 "VTC operation angle deviation quantity integral value memory value" ULONG COMP_0064_S 1 100 -10737418.24 10737418.235 ECU_ADDRESS 0xFFFF1320 /begin FUNCTION_LIST /end FUNCTION_LIST /end MEASUREMENT
/begin MEASUREMENT vERRSMI2M_R#2 "VTC operation angle deviation quantity integral value memory value" ULONG COMP_0064_S 1 100 -10737418.24 10737418.235 ECU_ADDRESS 0xFFFF1324 /begin FUNCTION_LIST /end FUNCTION_LIST /end MEASUREMENT
/begin MEASUREMENT vERRSMI2Z "VTC operation angle deviation quantity integral value (last time, renewal value)" ULONG COMP_0064_S 1 100 -10737418.24 10737418.235 ECU_ADDRESS 0xFFFF1328 /begin FUNCTION_LIST /end FUNCTION_LIST /end MEASUREMENT
/begin MEASUREMENT vERRSMI2Z_R#1 "VTC operation angle deviation quantity integral value (last time, renewal value)" ULONG COMP_0064_S 1 100 -10737418.24 10737418.235 ECU_ADDRESS 0xFFFF1328 /begin FUNCTION_LIST /end FUNCTION_LIST /end MEASUREMENT
/begin MEASUREMENT vERRSMI2Z_R#2 "VTC operation angle deviation quantity integral value (last time, renewal value)" ULONG COMP_0064_S 1 100 -10737418.24 10737418.235 ECU_ADDRESS 0xFFFF132C /begin FUNCTION_LIST /end FUNCTION_LIST /end MEASUREMENT
/begin MEASUREMENT vESTADR "A running condition data store waits, address pointer" UBYTE COMP_0068 1 100 0 255 ECU_ADDRESS 0xFFFFA334 /begin FUNCTION_LIST /end FUNCTION_LIST /end MEASUREMENT
/begin MEASUREMENT vESTDT1 "Running condition data memory 1" UBYTE COMP_0068 1 100 0 255 ECU_ADDRESS 0xFFFFA335 /begin FUNCTION_LIST /end FUNCTION_LIST /end MEASUREMENT
/begin MEASUREMENT vESTDT1_R#1 "Running condition data memory 1" UBYTE COMP_0068 1 100 0 255 ECU_ADDRESS 0xFFFFA335 /begin FUNCTION_LIST /end FUNCTION_LIST /end MEASUREMENT
/begin MEASUREMENT vESTDT1_R#2 "Running condition data memory 1" UBYTE COMP_0068 1 100 0 255 ECU_ADDRESS 0xFFFFA336 /begin FUNCTION_LIST /end FUNCTION_LIST /end MEASUREMENT
/begin MEASUREMENT vESTDT1_R#3 "Running condition data memory 1" UBYTE COMP_0068 1 100 0 255 ECU_ADDRESS 0xFFFFA337 /begin FUNCTION_LIST /end FUNCTION_LIST /end MEASUREMENT
/begin MEASUREMENT vESTDT1_R#4 "Running condition data memory 1" UBYTE COMP_0068 1 100 0 255 ECU_ADDRESS 0xFFFFA338 /begin FUNCTION_LIST /end FUNCTION_LIST /end MEASUREMENT
/begin MEASUREMENT vESTDT1_R#5 "Running condition data memory 1" UBYTE COMP_0068 1 100 0 255 ECU_ADDRESS 0xFFFFA339 /begin FUNCTION_LIST /end FUNCTION_LIST /end MEASUREMENT
/begin MEASUREMENT vESTDT1_R#6 "Running condition data memory 1" UBYTE COMP_0068 1 100 0 255 ECU_ADDRESS 0xFFFFA33A /begin FUNCTION_LIST /end FUNCTION_LIST /end MEASUREMENT
/begin MEASUREMENT vESTDT1_R#7 "Running condition data memory 1" UBYTE COMP_0068 1 100 0 255 ECU_ADDRESS 0xFFFFA33B /begin FUNCTION_LIST /end FUNCTION_LIST /end MEASUREMENT
/begin MEASUREMENT vESTDT1_R#8 "Running condition data memory 1" UBYTE COMP_0068 1 100 0 255 ECU_ADDRESS 0xFFFFA33C /begin FUNCTION_LIST /end FUNCTION_LIST /end MEASUREMENT
/begin MEASUREMENT vESTDT1_R#9 "Running condition data memory 1" UBYTE COMP_0068 1 100 0 255 ECU_ADDRESS 0xFFFFA33D /begin FUNCTION_LIST /end FUNCTION_LIST /end MEASUREMENT
/begin MEASUREMENT vESTDT1_R#10 "Running condition data memory 1" UBYTE COMP_0068 1 100 0 255 ECU_ADDRESS 0xFFFFA33E /begin FUNCTION_LIST /end FUNCTION_LIST /end MEASUREMENT
/begin MEASUREMENT vESTDT1_R#11 "Running condition data memory 1" UBYTE COMP_0068 1 100 0 255 ECU_ADDRESS 0xFFFFA33F /begin FUNCTION_LIST /end FUNCTION_LIST /end MEASUREMENT
/begin MEASUREMENT vESTDT1_R#12 "Running condition data memory 1" UBYTE COMP_0068 1 100 0 255 ECU_ADDRESS 0xFFFFA340 /begin FUNCTION_LIST /end FUNCTION_LIST /end MEASUREMENT
/begin MEASUREMENT vESTDT1_R#13 "Running condition data memory 1" UBYTE COMP_0068 1 100 0 255 ECU_ADDRESS 0xFFFFA341 /begin FUNCTION_LIST /end FUNCTION_LIST /end MEASUREMENT
/begin MEASUREMENT vESTDT1_R#14 "Running condition data memory 1" UBYTE COMP_0068 1 100 0 255 ECU_ADDRESS 0xFFFFA342 /begin FUNCTION_LIST /end FUNCTION_LIST /end MEASUREMENT
/begin MEASUREMENT vESTDT1_R#15 "Running condition data memory 1" UBYTE COMP_0068 1 100 0 255 ECU_ADDRESS 0xFFFFA343 /begin FUNCTION_LIST /end FUNCTION_LIST /end MEASUREMENT
/begin MEASUREMENT vESTDT1_R#16 "Running condition data memory 1" UBYTE COMP_0068 1 100 0 255 ECU_ADDRESS 0xFFFFA344 /begin FUNCTION_LIST /end FUNCTION_LIST /end MEASUREMENT
/begin MEASUREMENT vESTDT1_R#17 "Running condition data memory 1" UBYTE COMP_0068 1 100 0 255 ECU_ADDRESS 0xFFFFA345 /begin FUNCTION_LIST /end FUNCTION_LIST /end MEASUREMENT
/begin MEASUREMENT vESTDT1_R#18 "Running condition data memory 1" UBYTE COMP_0068 1 100 0 255 ECU_ADDRESS 0xFFFFA346 /begin FUNCTION_LIST /end FUNCTION_LIST /end MEASUREMENT
/begin MEASUREMENT vESTDT1_R#19 "Running condition data memory 1" UBYTE COMP_0068 1 100 0 255 ECU_ADDRESS 0xFFFFA347 /begin FUNCTION_LIST /end FUNCTION_LIST /end MEASUREMENT
/begin MEASUREMENT vESTDT1_R#20 "Running condition data memory 1" UBYTE COMP_0068 1 100 0 255 ECU_ADDRESS 0xFFFFA348 /begin FUNCTION_LIST /end FUNCTION_LIST /end MEASUREMENT
/begin MEASUREMENT vESTDT2 "Running condition data memory 2" UBYTE COMP_0068 1 100 0 255 ECU_ADDRESS 0xFFFFA349 /begin FUNCTION_LIST /end FUNCTION_LIST /end MEASUREMENT
/begin MEASUREMENT vESTDT2_R#1 "Running condition data memory 2" UBYTE COMP_0068 1 100 0 255 ECU_ADDRESS 0xFFFFA349 /begin FUNCTION_LIST /end FUNCTION_LIST /end MEASUREMENT
/begin MEASUREMENT vESTDT2_R#2 "Running condition data memory 2" UBYTE COMP_0068 1 100 0 255 ECU_ADDRESS 0xFFFFA34A /begin FUNCTION_LIST /end FUNCTION_LIST /end MEASUREMENT
/begin MEASUREMENT vESTDT2_R#3 "Running condition data memory 2" UBYTE COMP_0068 1 100 0 255 ECU_ADDRESS 0xFFFFA34B /begin FUNCTION_LIST /end FUNCTION_LIST /end MEASUREMENT
/begin MEASUREMENT vESTDT2_R#4 "Running condition data memory 2" UBYTE COMP_0068 1 100 0 255 ECU_ADDRESS 0xFFFFA34C /begin FUNCTION_LIST /end FUNCTION_LIST /end MEASUREMENT
/begin MEASUREMENT vESTDT2_R#5 "Running condition data memory 2" UBYTE COMP_0068 1 100 0 255 ECU_ADDRESS 0xFFFFA34D /begin FUNCTION_LIST /end FUNCTION_LIST /end MEASUREMENT
/begin MEASUREMENT vESTDT2_R#6 "Running condition data memory 2" UBYTE COMP_0068 1 100 0 255 ECU_ADDRESS 0xFFFFA34E /begin FUNCTION_LIST /end FUNCTION_LIST /end MEASUREMENT
/begin MEASUREMENT vESTDT2_R#7 "Running condition data memory 2" UBYTE COMP_0068 1 100 0 255 ECU_ADDRESS 0xFFFFA34F /begin FUNCTION_LIST /end FUNCTION_LIST /end MEASUREMENT
/begin MEASUREMENT vESTDT2_R#8 "Running condition data memory 2" UBYTE COMP_0068 1 100 0 255 ECU_ADDRESS 0xFFFFA350 /begin FUNCTION_LIST /end FUNCTION_LIST /end MEASUREMENT
/begin MEASUREMENT vESTDT2_R#9 "Running condition data memory 2" UBYTE COMP_0068 1 100 0 255 ECU_ADDRESS 0xFFFFA351 /begin FUNCTION_LIST /end FUNCTION_LIST /end MEASUREMENT
/begin MEASUREMENT vESTDT2_R#10 "Running condition data memory 2" UBYTE COMP_0068 1 100 0 255 ECU_ADDRESS 0xFFFFA352 /begin FUNCTION_LIST /end FUNCTION_LIST /end MEASUREMENT
/begin MEASUREMENT vESTDT2_R#11 "Running condition data memory 2" UBYTE COMP_0068 1 100 0 255 ECU_ADDRESS 0xFFFFA353 /begin FUNCTION_LIST /end FUNCTION_LIST /end MEASUREMENT
/begin MEASUREMENT vESTDT2_R#12 "Running condition data memory 2" UBYTE COMP_0068 1 100 0 255 ECU_ADDRESS 0xFFFFA354 /begin FUNCTION_LIST /end FUNCTION_LIST /end MEASUREMENT
/begin MEASUREMENT vESTDT2_R#13 "Running condition data memory 2" UBYTE COMP_0068 1 100 0 255 ECU_ADDRESS 0xFFFFA355 /begin FUNCTION_LIST /end FUNCTION_LIST /end MEASUREMENT
/begin MEASUREMENT vESTDT2_R#14 "Running condition data memory 2" UBYTE COMP_0068 1 100 0 255 ECU_ADDRESS 0xFFFFA356 /begin FUNCTION_LIST /end FUNCTION_LIST /end MEASUREMENT
/begin MEASUREMENT vESTDT2_R#15 "Running condition data memory 2" UBYTE COMP_0068 1 100 0 255 ECU_ADDRESS 0xFFFFA357 /begin FUNCTION_LIST /end FUNCTION_LIST /end MEASUREMENT
/begin MEASUREMENT vESTDT2_R#16 "Running condition data memory 2" UBYTE COMP_0068 1 100 0 255 ECU_ADDRESS 0xFFFFA358 /begin FUNCTION_LIST /end FUNCTION_LIST /end MEASUREMENT
/begin MEASUREMENT vESTDT2_R#17 "Running condition data memory 2" UBYTE COMP_0068 1 100 0 255 ECU_ADDRESS 0xFFFFA359 /begin FUNCTION_LIST /end FUNCTION_LIST /end MEASUREMENT
/begin MEASUREMENT vESTDT2_R#18 "Running condition data memory 2" UBYTE COMP_0068 1 100 0 255 ECU_ADDRESS 0xFFFFA35A /begin FUNCTION_LIST /end FUNCTION_LIST /end MEASUREMENT
/begin MEASUREMENT vESTDT2_R#19 "Running condition data memory 2" UBYTE COMP_0068 1 100 0 255 ECU_ADDRESS 0xFFFFA35B /begin FUNCTION_LIST /end FUNCTION_LIST /end MEASUREMENT
/begin MEASUREMENT vESTDT2_R#20 "Running condition data memory 2" UBYTE COMP_0068 1 100 0 255 ECU_ADDRESS 0xFFFFA35C /begin FUNCTION_LIST /end FUNCTION_LIST /end MEASUREMENT
/begin MEASUREMENT vESTDT3 "Running condition data memory 3" UBYTE COMP_0068 1 100 0 255 ECU_ADDRESS 0xFFFFA35D /begin FUNCTION_LIST /end FUNCTION_LIST /end MEASUREMENT
/begin MEASUREMENT vESTDT3_R#1 "Running condition data memory 3" UBYTE COMP_0068 1 100 0 255 ECU_ADDRESS 0xFFFFA35D /begin FUNCTION_LIST /end FUNCTION_LIST /end MEASUREMENT
/begin MEASUREMENT vESTDT3_R#2 "Running condition data memory 3" UBYTE COMP_0068 1 100 0 255 ECU_ADDRESS 0xFFFFA35E /begin FUNCTION_LIST /end FUNCTION_LIST /end MEASUREMENT
/begin MEASUREMENT vESTDT3_R#3 "Running condition data memory 3" UBYTE COMP_0068 1 100 0 255 ECU_ADDRESS 0xFFFFA35F /begin FUNCTION_LIST /end FUNCTION_LIST /end MEASUREMENT
/begin MEASUREMENT vESTDT3_R#4 "Running condition data memory 3" UBYTE COMP_0068 1 100 0 255 ECU_ADDRESS 0xFFFFA360 /begin FUNCTION_LIST /end FUNCTION_LIST /end MEASUREMENT
/begin MEASUREMENT vESTDT3_R#5 "Running condition data memory 3" UBYTE COMP_0068 1 100 0 255 ECU_ADDRESS 0xFFFFA361 /begin FUNCTION_LIST /end FUNCTION_LIST /end MEASUREMENT
/begin MEASUREMENT vESTDT3_R#6 "Running condition data memory 3" UBYTE COMP_0068 1 100 0 255 ECU_ADDRESS 0xFFFFA362 /begin FUNCTION_LIST /end FUNCTION_LIST /end MEASUREMENT
/begin MEASUREMENT vESTDT3_R#7 "Running condition data memory 3" UBYTE COMP_0068 1 100 0 255 ECU_ADDRESS 0xFFFFA363 /begin FUNCTION_LIST /end FUNCTION_LIST /end MEASUREMENT
/begin MEASUREMENT vESTDT3_R#8 "Running condition data memory 3" UBYTE COMP_0068 1 100 0 255 ECU_ADDRESS 0xFFFFA364 /begin FUNCTION_LIST /end FUNCTION_LIST /end MEASUREMENT
/begin MEASUREMENT vESTDT3_R#9 "Running condition data memory 3" UBYTE COMP_0068 1 100 0 255 ECU_ADDRESS 0xFFFFA365 /begin FUNCTION_LIST /end FUNCTION_LIST /end MEASUREMENT
/begin MEASUREMENT vESTDT3_R#10 "Running condition data memory 3" UBYTE COMP_0068 1 100 0 255 ECU_ADDRESS 0xFFFFA366 /begin FUNCTION_LIST /end FUNCTION_LIST /end MEASUREMENT
/begin MEASUREMENT vESTDT3_R#11 "Running condition data memory 3" UBYTE COMP_0068 1 100 0 255 ECU_ADDRESS 0xFFFFA367 /begin FUNCTION_LIST /end FUNCTION_LIST /end MEASUREMENT
/begin MEASUREMENT vESTDT3_R#12 "Running condition data memory 3" UBYTE COMP_0068 1 100 0 255 ECU_ADDRESS 0xFFFFA368 /begin FUNCTION_LIST /end FUNCTION_LIST /end MEASUREMENT
/begin MEASUREMENT vESTDT3_R#13 "Running condition data memory 3" UBYTE COMP_0068 1 100 0 255 ECU_ADDRESS 0xFFFFA369 /begin FUNCTION_LIST /end FUNCTION_LIST /end MEASUREMENT
/begin MEASUREMENT vESTDT3_R#14 "Running condition data memory 3" UBYTE COMP_0068 1 100 0 255 ECU_ADDRESS 0xFFFFA36A /begin FUNCTION_LIST /end FUNCTION_LIST /end MEASUREMENT
/begin MEASUREMENT vESTDT3_R#15 "Running condition data memory 3" UBYTE COMP_0068 1 100 0 255 ECU_ADDRESS 0xFFFFA36B /begin FUNCTION_LIST /end FUNCTION_LIST /end MEASUREMENT
/begin MEASUREMENT vESTDT3_R#16 "Running condition data memory 3" UBYTE COMP_0068 1 100 0 255 ECU_ADDRESS 0xFFFFA36C /begin FUNCTION_LIST /end FUNCTION_LIST /end MEASUREMENT
/begin MEASUREMENT vESTDT3_R#17 "Running condition data memory 3" UBYTE COMP_0068 1 100 0 255 ECU_ADDRESS 0xFFFFA36D /begin FUNCTION_LIST /end FUNCTION_LIST /end MEASUREMENT
/begin MEASUREMENT vESTDT3_R#18 "Running condition data memory 3" UBYTE COMP_0068 1 100 0 255 ECU_ADDRESS 0xFFFFA36E /begin FUNCTION_LIST /end FUNCTION_LIST /end MEASUREMENT
/begin MEASUREMENT vESTDT3_R#19 "Running condition data memory 3" UBYTE COMP_0068 1 100 0 255 ECU_ADDRESS 0xFFFFA36F /begin FUNCTION_LIST /end FUNCTION_LIST /end MEASUREMENT
/begin MEASUREMENT vESTDT3_R#20 "Running condition data memory 3" UBYTE COMP_0068 1 100 0 255 ECU_ADDRESS 0xFFFFA370 /begin FUNCTION_LIST /end FUNCTION_LIST /end MEASUREMENT
/begin MEASUREMENT vESTDT4 "Running condition data memory 4" UBYTE COMP_0068 1 100 0 255 ECU_ADDRESS 0xFFFFA371 /begin FUNCTION_LIST /end FUNCTION_LIST /end MEASUREMENT
/begin MEASUREMENT vESTDT4_R#1 "Running condition data memory 4" UBYTE COMP_0068 1 100 0 255 ECU_ADDRESS 0xFFFFA371 /begin FUNCTION_LIST /end FUNCTION_LIST /end MEASUREMENT
/begin MEASUREMENT vESTDT4_R#2 "Running condition data memory 4" UBYTE COMP_0068 1 100 0 255 ECU_ADDRESS 0xFFFFA372 /begin FUNCTION_LIST /end FUNCTION_LIST /end MEASUREMENT
/begin MEASUREMENT vESTDT4_R#3 "Running condition data memory 4" UBYTE COMP_0068 1 100 0 255 ECU_ADDRESS 0xFFFFA373 /begin FUNCTION_LIST /end FUNCTION_LIST /end MEASUREMENT
/begin MEASUREMENT vESTDT4_R#4 "Running condition data memory 4" UBYTE COMP_0068 1 100 0 255 ECU_ADDRESS 0xFFFFA374 /begin FUNCTION_LIST /end FUNCTION_LIST /end MEASUREMENT
/begin MEASUREMENT vESTDT4_R#5 "Running condition data memory 4" UBYTE COMP_0068 1 100 0 255 ECU_ADDRESS 0xFFFFA375 /begin FUNCTION_LIST /end FUNCTION_LIST /end MEASUREMENT
/begin MEASUREMENT vESTDT4_R#6 "Running condition data memory 4" UBYTE COMP_0068 1 100 0 255 ECU_ADDRESS 0xFFFFA376 /begin FUNCTION_LIST /end FUNCTION_LIST /end MEASUREMENT
/begin MEASUREMENT vESTDT4_R#7 "Running condition data memory 4" UBYTE COMP_0068 1 100 0 255 ECU_ADDRESS 0xFFFFA377 /begin FUNCTION_LIST /end FUNCTION_LIST /end MEASUREMENT
/begin MEASUREMENT vESTDT4_R#8 "Running condition data memory 4" UBYTE COMP_0068 1 100 0 255 ECU_ADDRESS 0xFFFFA378 /begin FUNCTION_LIST /end FUNCTION_LIST /end MEASUREMENT
/begin MEASUREMENT vESTDT4_R#9 "Running condition data memory 4" UBYTE COMP_0068 1 100 0 255 ECU_ADDRESS 0xFFFFA379 /begin FUNCTION_LIST /end FUNCTION_LIST /end MEASUREMENT
/begin MEASUREMENT vESTDT4_R#10 "Running condition data memory 4" UBYTE COMP_0068 1 100 0 255 ECU_ADDRESS 0xFFFFA37A /begin FUNCTION_LIST /end FUNCTION_LIST /end MEASUREMENT
/begin MEASUREMENT vESTDT4_R#11 "Running condition data memory 4" UBYTE COMP_0068 1 100 0 255 ECU_ADDRESS 0xFFFFA37B /begin FUNCTION_LIST /end FUNCTION_LIST /end MEASUREMENT
/begin MEASUREMENT vESTDT4_R#12 "Running condition data memory 4" UBYTE COMP_0068 1 100 0 255 ECU_ADDRESS 0xFFFFA37C /begin FUNCTION_LIST /end FUNCTION_LIST /end MEASUREMENT
/begin MEASUREMENT vESTDT4_R#13 "Running condition data memory 4" UBYTE COMP_0068 1 100 0 255 ECU_ADDRESS 0xFFFFA37D /begin FUNCTION_LIST /end FUNCTION_LIST /end MEASUREMENT
/begin MEASUREMENT vESTDT4_R#14 "Running condition data memory 4" UBYTE COMP_0068 1 100 0 255 ECU_ADDRESS 0xFFFFA37E /begin FUNCTION_LIST /end FUNCTION_LIST /end MEASUREMENT
/begin MEASUREMENT vESTDT4_R#15 "Running condition data memory 4" UBYTE COMP_0068 1 100 0 255 ECU_ADDRESS 0xFFFFA37F /begin FUNCTION_LIST /end FUNCTION_LIST /end MEASUREMENT
/begin MEASUREMENT vESTDT4_R#16 "Running condition data memory 4" UBYTE COMP_0068 1 100 0 255 ECU_ADDRESS 0xFFFFA380 /begin FUNCTION_LIST /end FUNCTION_LIST /end MEASUREMENT
/begin MEASUREMENT vESTDT4_R#17 "Running condition data memory 4" UBYTE COMP_0068 1 100 0 255 ECU_ADDRESS 0xFFFFA381 /begin FUNCTION_LIST /end FUNCTION_LIST /end MEASUREMENT
/begin MEASUREMENT vESTDT4_R#18 "Running condition data memory 4" UBYTE COMP_0068 1 100 0 255 ECU_ADDRESS 0xFFFFA382 /begin FUNCTION_LIST /end FUNCTION_LIST /end MEASUREMENT
/begin MEASUREMENT vESTDT4_R#19 "Running condition data memory 4" UBYTE COMP_0068 1 100 0 255 ECU_ADDRESS 0xFFFFA383 /begin FUNCTION_LIST /end FUNCTION_LIST /end MEASUREMENT
/begin MEASUREMENT vESTDT4_R#20 "Running condition data memory 4" UBYTE COMP_0068 1 100 0 255 ECU_ADDRESS 0xFFFFA384 /begin FUNCTION_LIST /end FUNCTION_LIST /end MEASUREMENT
/begin MEASUREMENT vESTDT5 "Running condition data memory 5" UBYTE COMP_0068 1 100 0 255 ECU_ADDRESS 0xFFFFA385 /begin FUNCTION_LIST /end FUNCTION_LIST /end MEASUREMENT
/begin MEASUREMENT vESTDT5_R#1 "Running condition data memory 5" UBYTE COMP_0068 1 100 0 255 ECU_ADDRESS 0xFFFFA385 /begin FUNCTION_LIST /end FUNCTION_LIST /end MEASUREMENT
/begin MEASUREMENT vESTDT5_R#2 "Running condition data memory 5" UBYTE COMP_0068 1 100 0 255 ECU_ADDRESS 0xFFFFA386 /begin FUNCTION_LIST /end FUNCTION_LIST /end MEASUREMENT
/begin MEASUREMENT vESTDT5_R#3 "Running condition data memory 5" UBYTE COMP_0068 1 100 0 255 ECU_ADDRESS 0xFFFFA387 /begin FUNCTION_LIST /end FUNCTION_LIST /end MEASUREMENT
/begin MEASUREMENT vESTDT5_R#4 "Running condition data memory 5" UBYTE COMP_0068 1 100 0 255 ECU_ADDRESS 0xFFFFA388 /begin FUNCTION_LIST /end FUNCTION_LIST /end MEASUREMENT
/begin MEASUREMENT vESTDT5_R#5 "Running condition data memory 5" UBYTE COMP_0068 1 100 0 255 ECU_ADDRESS 0xFFFFA389 /begin FUNCTION_LIST /end FUNCTION_LIST /end MEASUREMENT
/begin MEASUREMENT vESTDT5_R#6 "Running condition data memory 5" UBYTE COMP_0068 1 100 0 255 ECU_ADDRESS 0xFFFFA38A /begin FUNCTION_LIST /end FUNCTION_LIST /end MEASUREMENT
/begin MEASUREMENT vESTDT5_R#7 "Running condition data memory 5" UBYTE COMP_0068 1 100 0 255 ECU_ADDRESS 0xFFFFA38B /begin FUNCTION_LIST /end FUNCTION_LIST /end MEASUREMENT
/begin MEASUREMENT vESTDT5_R#8 "Running condition data memory 5" UBYTE COMP_0068 1 100 0 255 ECU_ADDRESS 0xFFFFA38C /begin FUNCTION_LIST /end FUNCTION_LIST /end MEASUREMENT
/begin MEASUREMENT vESTDT5_R#9 "Running condition data memory 5" UBYTE COMP_0068 1 100 0 255 ECU_ADDRESS 0xFFFFA38D /begin FUNCTION_LIST /end FUNCTION_LIST /end MEASUREMENT
/begin MEASUREMENT vESTDT5_R#10 "Running condition data memory 5" UBYTE COMP_0068 1 100 0 255 ECU_ADDRESS 0xFFFFA38E /begin FUNCTION_LIST /end FUNCTION_LIST /end MEASUREMENT
/begin MEASUREMENT vESTDT5_R#11 "Running condition data memory 5" UBYTE COMP_0068 1 100 0 255 ECU_ADDRESS 0xFFFFA38F /begin FUNCTION_LIST /end FUNCTION_LIST /end MEASUREMENT
/begin MEASUREMENT vESTDT5_R#12 "Running condition data memory 5" UBYTE COMP_0068 1 100 0 255 ECU_ADDRESS 0xFFFFA390 /begin FUNCTION_LIST /end FUNCTION_LIST /end MEASUREMENT
/begin MEASUREMENT vESTDT5_R#13 "Running condition data memory 5" UBYTE COMP_0068 1 100 0 255 ECU_ADDRESS 0xFFFFA391 /begin FUNCTION_LIST /end FUNCTION_LIST /end MEASUREMENT
/begin MEASUREMENT vESTDT5_R#14 "Running condition data memory 5" UBYTE COMP_0068 1 100 0 255 ECU_ADDRESS 0xFFFFA392 /begin FUNCTION_LIST /end FUNCTION_LIST /end MEASUREMENT
/begin MEASUREMENT vESTDT5_R#15 "Running condition data memory 5" UBYTE COMP_0068 1 100 0 255 ECU_ADDRESS 0xFFFFA393 /begin FUNCTION_LIST /end FUNCTION_LIST /end MEASUREMENT
/begin MEASUREMENT vESTDT5_R#16 "Running condition data memory 5" UBYTE COMP_0068 1 100 0 255 ECU_ADDRESS 0xFFFFA394 /begin FUNCTION_LIST /end FUNCTION_LIST /end MEASUREMENT
/begin MEASUREMENT vESTDT5_R#17 "Running condition data memory 5" UBYTE COMP_0068 1 100 0 255 ECU_ADDRESS 0xFFFFA395 /begin FUNCTION_LIST /end FUNCTION_LIST /end MEASUREMENT
/begin MEASUREMENT vESTDT5_R#18 "Running condition data memory 5" UBYTE COMP_0068 1 100 0 255 ECU_ADDRESS 0xFFFFA396 /begin FUNCTION_LIST /end FUNCTION_LIST /end MEASUREMENT
/begin MEASUREMENT vESTDT5_R#19 "Running condition data memory 5" UBYTE COMP_0068 1 100 0 255 ECU_ADDRESS 0xFFFFA397 /begin FUNCTION_LIST /end FUNCTION_LIST /end MEASUREMENT
/begin MEASUREMENT vESTDT5_R#20 "Running condition data memory 5" UBYTE COMP_0068 1 100 0 255 ECU_ADDRESS 0xFFFFA398 /begin FUNCTION_LIST /end FUNCTION_LIST /end MEASUREMENT
/begin MEASUREMENT vESTOIL "Estimated oil temperature" ULONG COMP_0590_S 1 100 -50 205.999807631557 ECU_ADDRESS 0xFFFF2B64 /begin FUNCTION_LIST /end FUNCTION_LIST /end MEASUREMENT
/begin MEASUREMENT vESTOILZ "Estimated oil temperature (before 100mS)" ULONG COMP_0590_S 1 100 -50 205.999807631557 ECU_ADDRESS 0xFFFF2B68 /begin FUNCTION_LIST /end FUNCTION_LIST /end MEASUREMENT
/begin MEASUREMENT vETAMXBNC "State of the CAN frame that carries close brake switch information" UBYTE COMP_0068 1 100 0 255 ECU_ADDRESS 0xFFFF3CB7 /begin FUNCTION_LIST /end FUNCTION_LIST /end MEASUREMENT
/begin MEASUREMENT vETAMXGCU "LPG ECU status for CAN" UBYTE COMP_0068 1 100 0 255 ECU_ADDRESS 0xFFFF3CBA /begin FUNCTION_LIST /end FUNCTION_LIST /end MEASUREMENT
/begin MEASUREMENT vETAMXRVR "State of the CAN frame that carries reverse gear information" UBYTE COMP_0068 1 100 0 255 ECU_ADDRESS 0xFFFF3CBC /begin FUNCTION_LIST /end FUNCTION_LIST /end MEASUREMENT
/begin MEASUREMENT vETAMXTDB "Instrument Panet ECU status for CAN" UBYTE COMP_0068 1 100 0 255 ECU_ADDRESS 0xFFFF3CBE /begin FUNCTION_LIST /end FUNCTION_LIST /end MEASUREMENT
/begin MEASUREMENT vETAMXVS "State of the CAN frame that carries the vehicle speed information" UBYTE COMP_0068 1 100 0 255 ECU_ADDRESS 0xFFFF3CBF /begin FUNCTION_LIST /end FUNCTION_LIST /end MEASUREMENT
/begin MEASUREMENT vETIME3 "Leak-down time measuring timer" UWORD COMP_0008 1 100 0 6553500 ECU_ADDRESS 0xFFFF2B6E /begin FUNCTION_LIST /end FUNCTION_LIST /end MEASUREMENT
/begin MEASUREMENT vETPCDC "After the purge cut /V close, timer" UBYTE COMP_0008 1 100 0 25500 ECU_ADDRESS 0xFFFF2B70 /begin FUNCTION_LIST /end FUNCTION_LIST /end MEASUREMENT
/begin MEASUREMENT vETQTCS "The amount of target engine torque requirement" SBYTE COMP_0067_S 1 100 -234 531 ECU_ADDRESS 0xFFFF3CC1 /begin FUNCTION_LIST /end FUNCTION_LIST /end MEASUREMENT
/begin MEASUREMENT vETQTS1 "After the operation permission judgement, the amount of target engine torque requirement" SWORD COMP_0228 1 100 -3276.8 3276.7 ECU_ADDRESS 0xFFFF1330 /begin FUNCTION_LIST /end FUNCTION_LIST /end MEASUREMENT
/begin MEASUREMENT vETQTSR "The amount of target engine torque requirement" SWORD COMP_0228 1 100 -3276.8 3276.7 ECU_ADDRESS 0xFFFF2B72 /begin FUNCTION_LIST /end FUNCTION_LIST /end MEASUREMENT
/begin MEASUREMENT vETQTSRF "The amount of TCS/VDC unusual time target engine torque requirement" SWORD COMP_0228 1 100 -3276.8 3276.7 ECU_ADDRESS 0xFFFF2B74 /begin FUNCTION_LIST /end FUNCTION_LIST /end MEASUREMENT
/begin MEASUREMENT vETSMSG0T "ETSMSG0 reception interval counter" UBYTE COMP_0014 1 100 0 2550 ECU_ADDRESS 0xFFFF4937 /begin FUNCTION_LIST /end FUNCTION_LIST /end MEASUREMENT
/begin MEASUREMENT vEVALPH "ALPHA weighted average value for the purge control" UWORD COMP_0031 1 100 0 255.99609375 ECU_ADDRESS 0xFFFF1332 /begin FUNCTION_LIST /end FUNCTION_LIST /end MEASUREMENT
/begin MEASUREMENT vEVALPH_R#1 "ALPHA weighted average value for the purge control" UWORD COMP_0031 1 100 0 255.99609375 ECU_ADDRESS 0xFFFF1332 /begin FUNCTION_LIST /end FUNCTION_LIST /end MEASUREMENT
/begin MEASUREMENT vEVALPH_R#2 "ALPHA weighted average value for the purge control" UWORD COMP_0031 1 100 0 255.99609375 ECU_ADDRESS 0xFFFF1334 /begin FUNCTION_LIST /end FUNCTION_LIST /end MEASUREMENT
/begin MEASUREMENT vEVALPH1 "ALPHA weighted average value (There is no purge.)" UWORD COMP_0031 1 100 0 255.99609375 ECU_ADDRESS 0xFFFF1336 /begin FUNCTION_LIST /end FUNCTION_LIST /end MEASUREMENT
/begin MEASUREMENT vEVALPH1_R#1 "ALPHA weighted average value (There is no purge.)" UWORD COMP_0031 1 100 0 255.99609375 ECU_ADDRESS 0xFFFF1336 /begin FUNCTION_LIST /end FUNCTION_LIST /end MEASUREMENT
/begin MEASUREMENT vEVALPH1_R#2 "ALPHA weighted average value (There is no purge.)" UWORD COMP_0031 1 100 0 255.99609375 ECU_ADDRESS 0xFFFF1338 /begin FUNCTION_LIST /end FUNCTION_LIST /end MEASUREMENT
/begin MEASUREMENT vEVALPJ "Heat resisting purge judgement condition ALPHA" UWORD COMP_0031 1 100 0 255.99609375 ECU_ADDRESS 0xFFFF133A /begin FUNCTION_LIST /end FUNCTION_LIST /end MEASUREMENT
/begin MEASUREMENT vEVAPCNT "Duty output timing counter" UBYTE COMP_0016 1 100 0 255 ECU_ADDRESS 0xFFFF1FBD /begin FUNCTION_LIST /end FUNCTION_LIST /end MEASUREMENT
/begin MEASUREMENT vEVAPLO "EVAP Off output time" UWORD COMP_0189 1 100 0 209712 ECU_ADDRESS 0xFFFF2B76 /begin FUNCTION_LIST /end FUNCTION_LIST /end MEASUREMENT
/begin MEASUREMENT vEVDLYCNT "Purge control valve delayed counter" ULONG COMP_0068 1 100 0 4294967295 ECU_ADDRESS 0xFFFF1FC0 /begin FUNCTION_LIST /end FUNCTION_LIST /end MEASUREMENT
/begin MEASUREMENT vEVKPMN "Drain-cut diagnosis DUTY value difference pressure coefficient operation minimum value" UBYTE COMP_0047 1 100 0 127.5 ECU_ADDRESS 0xFFFFA39E /begin FUNCTION_LIST /end FUNCTION_LIST /end MEASUREMENT
/begin MEASUREMENT vEVLKMI2 "When a function is diagnosed, line pressure change quantity minimum value" UWORD COMP_0050 1 100 0 5119.921875 ECU_ADDRESS 0xFFFF2B78 /begin FUNCTION_LIST /end FUNCTION_LIST /end MEASUREMENT
/begin MEASUREMENT vEVLKMN "In the leak-down, line pressure change minimum value" UWORD COMP_0050 1 100 0 5119.921875 ECU_ADDRESS 0xFFFF2B7A /begin FUNCTION_LIST /end FUNCTION_LIST /end MEASUREMENT
/begin MEASUREMENT vEVLKMN1 "Line pressure change minimum value for the 0.02 slosh judgement" UWORD COMP_0050 1 100 0 5119.921875 ECU_ADDRESS 0xFFFF2B7C /begin FUNCTION_LIST /end FUNCTION_LIST /end MEASUREMENT
/begin MEASUREMENT vEVLKMN2 "In the first leak-down inside, line pressure change minimum value" UWORD COMP_0050 1 100 0 5119.921875 ECU_ADDRESS 0xFFFF2B7E /begin FUNCTION_LIST /end FUNCTION_LIST /end MEASUREMENT
/begin MEASUREMENT vEVLKMNX "In the second leak-down inside, line pressure change minimum value" UWORD COMP_0050 1 100 0 5119.921875 ECU_ADDRESS 0xFFFF2B80 /begin FUNCTION_LIST /end FUNCTION_LIST /end MEASUREMENT
/begin MEASUREMENT vEVLNOL "Line pressure (one second ago) in the leak-down" UWORD COMP_0050 1 100 0 5119.921875 ECU_ADDRESS 0xFFFF2B82 /begin FUNCTION_LIST /end FUNCTION_LIST /end MEASUREMENT
/begin MEASUREMENT vEVLNOL_R#1 "Line pressure (one second ago) in the leak-down" UWORD COMP_0050 1 100 0 5119.921875 ECU_ADDRESS 0xFFFF2B82 /begin FUNCTION_LIST /end FUNCTION_LIST /end MEASUREMENT
/begin MEASUREMENT vEVLNOL_R#2 "Line pressure (one second ago) in the leak-down" UWORD COMP_0050 1 100 0 5119.921875 ECU_ADDRESS 0xFFFF2B84 /begin FUNCTION_LIST /end FUNCTION_LIST /end MEASUREMENT
/begin MEASUREMENT vEVLNOL_R#3 "Line pressure (one second ago) in the leak-down" UWORD COMP_0050 1 100 0 5119.921875 ECU_ADDRESS 0xFFFF2B86 /begin FUNCTION_LIST /end FUNCTION_LIST /end MEASUREMENT
/begin MEASUREMENT vEVLNOL_R#4 "Line pressure (one second ago) in the leak-down" UWORD COMP_0050 1 100 0 5119.921875 ECU_ADDRESS 0xFFFF2B88 /begin FUNCTION_LIST /end FUNCTION_LIST /end MEASUREMENT
/begin MEASUREMENT vEVLNOL_R#5 "Line pressure (one second ago) in the leak-down" UWORD COMP_0050 1 100 0 5119.921875 ECU_ADDRESS 0xFFFF2B8A /begin FUNCTION_LIST /end FUNCTION_LIST /end MEASUREMENT
/begin MEASUREMENT vEVLNOL14 "Line pressure (before 1sec) for the 0.02 slosh judgement" ULONG COMP_0592_S 1 100 0 1310720.93921892 ECU_ADDRESS 0xFFFF2B8C /begin FUNCTION_LIST /end FUNCTION_LIST /end MEASUREMENT
/begin MEASUREMENT vEVLNOL14_R#1 "Line pressure (before 1sec) for the 0.02 slosh judgement" ULONG COMP_0592_S 1 100 0 1310720.93921892 ECU_ADDRESS 0xFFFF2B8C /begin FUNCTION_LIST /end FUNCTION_LIST /end MEASUREMENT
/begin MEASUREMENT vEVLNOL14_R#2 "Line pressure (before 1sec) for the 0.02 slosh judgement" ULONG COMP_0592_S 1 100 0 1310720.93921892 ECU_ADDRESS 0xFFFF2B90 /begin FUNCTION_LIST /end FUNCTION_LIST /end MEASUREMENT
/begin MEASUREMENT vEVLNOL14_R#3 "Line pressure (before 1sec) for the 0.02 slosh judgement" ULONG COMP_0592_S 1 100 0 1310720.93921892 ECU_ADDRESS 0xFFFF2B94 /begin FUNCTION_LIST /end FUNCTION_LIST /end MEASUREMENT
/begin MEASUREMENT vEVLNOL14_R#4 "Line pressure (before 1sec) for the 0.02 slosh judgement" ULONG COMP_0592_S 1 100 0 1310720.93921892 ECU_ADDRESS 0xFFFF2B98 /begin FUNCTION_LIST /end FUNCTION_LIST /end MEASUREMENT
/begin MEASUREMENT vEVLNOL14_R#5 "Line pressure (before 1sec) for the 0.02 slosh judgement" ULONG COMP_0592_S 1 100 0 1310720.93921892 ECU_ADDRESS 0xFFFF2B9C /begin FUNCTION_LIST /end FUNCTION_LIST /end MEASUREMENT
/begin MEASUREMENT vEVLNOL14_R#6 "Line pressure (before 1sec) for the 0.02 slosh judgement" ULONG COMP_0592_S 1 100 0 1310720.93921892 ECU_ADDRESS 0xFFFF2BA0 /begin FUNCTION_LIST /end FUNCTION_LIST /end MEASUREMENT
/begin MEASUREMENT vEVLNOL14_R#7 "Line pressure (before 1sec) for the 0.02 slosh judgement" ULONG COMP_0592_S 1 100 0 1310720.93921892 ECU_ADDRESS 0xFFFF2BA4 /begin FUNCTION_LIST /end FUNCTION_LIST /end MEASUREMENT
/begin MEASUREMENT vEVLNOL14_R#8 "Line pressure (before 1sec) for the 0.02 slosh judgement" ULONG COMP_0592_S 1 100 0 1310720.93921892 ECU_ADDRESS 0xFFFF2BA8 /begin FUNCTION_LIST /end FUNCTION_LIST /end MEASUREMENT
/begin MEASUREMENT vEVLNOL14_R#9 "Line pressure (before 1sec) for the 0.02 slosh judgement" ULONG COMP_0592_S 1 100 0 1310720.93921892 ECU_ADDRESS 0xFFFF2BAC /begin FUNCTION_LIST /end FUNCTION_LIST /end MEASUREMENT
/begin MEASUREMENT vEVLNOL14_R#10 "Line pressure (before 1sec) for the 0.02 slosh judgement" ULONG COMP_0592_S 1 100 0 1310720.93921892 ECU_ADDRESS 0xFFFF2BB0 /begin FUNCTION_LIST /end FUNCTION_LIST /end MEASUREMENT
/begin MEASUREMENT vEVLNOL2 "The line pressure (two seconds ago) of the first leak-down inside" UWORD COMP_0050 1 100 0 5119.921875 ECU_ADDRESS 0xFFFF2BB4 /begin FUNCTION_LIST /end FUNCTION_LIST /end MEASUREMENT
/begin MEASUREMENT vEVLNOL2_R#1 "The line pressure (two seconds ago) of the first leak-down inside" UWORD COMP_0050 1 100 0 5119.921875 ECU_ADDRESS 0xFFFF2BB4 /begin FUNCTION_LIST /end FUNCTION_LIST /end MEASUREMENT
/begin MEASUREMENT vEVLNOL2_R#2 "The line pressure (two seconds ago) of the first leak-down inside" UWORD COMP_0050 1 100 0 5119.921875 ECU_ADDRESS 0xFFFF2BB6 /begin FUNCTION_LIST /end FUNCTION_LIST /end MEASUREMENT
/begin MEASUREMENT vEVLNOL2_R#3 "The line pressure (two seconds ago) of the first leak-down inside" UWORD COMP_0050 1 100 0 5119.921875 ECU_ADDRESS 0xFFFF2BB8 /begin FUNCTION_LIST /end FUNCTION_LIST /end MEASUREMENT
/begin MEASUREMENT vEVLNOL2_R#4 "The line pressure (two seconds ago) of the first leak-down inside" UWORD COMP_0050 1 100 0 5119.921875 ECU_ADDRESS 0xFFFF2BBA /begin FUNCTION_LIST /end FUNCTION_LIST /end MEASUREMENT
/begin MEASUREMENT vEVLNOL2_R#5 "The line pressure (two seconds ago) of the first leak-down inside" UWORD COMP_0050 1 100 0 5119.921875 ECU_ADDRESS 0xFFFF2BBC /begin FUNCTION_LIST /end FUNCTION_LIST /end MEASUREMENT
/begin MEASUREMENT vEVLNOL2_R#6 "The line pressure (two seconds ago) of the first leak-down inside" UWORD COMP_0050 1 100 0 5119.921875 ECU_ADDRESS 0xFFFF2BBE /begin FUNCTION_LIST /end FUNCTION_LIST /end MEASUREMENT
/begin MEASUREMENT vEVLNOL2_R#7 "The line pressure (two seconds ago) of the first leak-down inside" UWORD COMP_0050 1 100 0 5119.921875 ECU_ADDRESS 0xFFFF2BC0 /begin FUNCTION_LIST /end FUNCTION_LIST /end MEASUREMENT
/begin MEASUREMENT vEVLNOL2_R#8 "The line pressure (two seconds ago) of the first leak-down inside" UWORD COMP_0050 1 100 0 5119.921875 ECU_ADDRESS 0xFFFF2BC2 /begin FUNCTION_LIST /end FUNCTION_LIST /end MEASUREMENT
/begin MEASUREMENT vEVLNOL2_R#9 "The line pressure (two seconds ago) of the first leak-down inside" UWORD COMP_0050 1 100 0 5119.921875 ECU_ADDRESS 0xFFFF2BC4 /begin FUNCTION_LIST /end FUNCTION_LIST /end MEASUREMENT
/begin MEASUREMENT vEVLNOL2_R#10 "The line pressure (two seconds ago) of the first leak-down inside" UWORD COMP_0050 1 100 0 5119.921875 ECU_ADDRESS 0xFFFF2BC6 /begin FUNCTION_LIST /end FUNCTION_LIST /end MEASUREMENT
/begin MEASUREMENT vEVLNOL2_R#11 "The line pressure (two seconds ago) of the first leak-down inside" UWORD COMP_0050 1 100 0 5119.921875 ECU_ADDRESS 0xFFFF2BC8 /begin FUNCTION_LIST /end FUNCTION_LIST /end MEASUREMENT
/begin MEASUREMENT vEVLNOL2_R#12 "The line pressure (two seconds ago) of the first leak-down inside" UWORD COMP_0050 1 100 0 5119.921875 ECU_ADDRESS 0xFFFF2BCA /begin FUNCTION_LIST /end FUNCTION_LIST /end MEASUREMENT
/begin MEASUREMENT vEVLNOL2_R#13 "The line pressure (two seconds ago) of the first leak-down inside" UWORD COMP_0050 1 100 0 5119.921875 ECU_ADDRESS 0xFFFF2BCC /begin FUNCTION_LIST /end FUNCTION_LIST /end MEASUREMENT
/begin MEASUREMENT vEVLNOL2_R#14 "The line pressure (two seconds ago) of the first leak-down inside" UWORD COMP_0050 1 100 0 5119.921875 ECU_ADDRESS 0xFFFF2BCE /begin FUNCTION_LIST /end FUNCTION_LIST /end MEASUREMENT
/begin MEASUREMENT vEVLNOL2_R#15 "The line pressure (two seconds ago) of the first leak-down inside" UWORD COMP_0050 1 100 0 5119.921875 ECU_ADDRESS 0xFFFF2BD0 /begin FUNCTION_LIST /end FUNCTION_LIST /end MEASUREMENT
/begin MEASUREMENT vEVLNOL2_R#16 "The line pressure (two seconds ago) of the first leak-down inside" UWORD COMP_0050 1 100 0 5119.921875 ECU_ADDRESS 0xFFFF2BD2 /begin FUNCTION_LIST /end FUNCTION_LIST /end MEASUREMENT
/begin MEASUREMENT vEVLNOL2_R#17 "The line pressure (two seconds ago) of the first leak-down inside" UWORD COMP_0050 1 100 0 5119.921875 ECU_ADDRESS 0xFFFF2BD4 /begin FUNCTION_LIST /end FUNCTION_LIST /end MEASUREMENT
/begin MEASUREMENT vEVLNOL2_R#18 "The line pressure (two seconds ago) of the first leak-down inside" UWORD COMP_0050 1 100 0 5119.921875 ECU_ADDRESS 0xFFFF2BD6 /begin FUNCTION_LIST /end FUNCTION_LIST /end MEASUREMENT
/begin MEASUREMENT vEVLNOL2_R#19 "The line pressure (two seconds ago) of the first leak-down inside" UWORD COMP_0050 1 100 0 5119.921875 ECU_ADDRESS 0xFFFF2BD8 /begin FUNCTION_LIST /end FUNCTION_LIST /end MEASUREMENT
/begin MEASUREMENT vEVLNOL2_R#20 "The line pressure (two seconds ago) of the first leak-down inside" UWORD COMP_0050 1 100 0 5119.921875 ECU_ADDRESS 0xFFFF2BDA /begin FUNCTION_LIST /end FUNCTION_LIST /end MEASUREMENT
/begin MEASUREMENT vEVLNOLX "The line pressure (10 seconds ago) of the 2nd leak-down inside" UWORD COMP_0050 1 100 0 5119.921875 ECU_ADDRESS 0xFFFF2BDC /begin FUNCTION_LIST /end FUNCTION_LIST /end MEASUREMENT
/begin MEASUREMENT vEVLNOLX_R#1 "The line pressure (10 seconds ago) of the 2nd leak-down inside" UWORD COMP_0050 1 100 0 5119.921875 ECU_ADDRESS 0xFFFF2BDC /begin FUNCTION_LIST /end FUNCTION_LIST /end MEASUREMENT
/begin MEASUREMENT vEVLNOLX_R#2 "The line pressure (10 seconds ago) of the 2nd leak-down inside" UWORD COMP_0050 1 100 0 5119.921875 ECU_ADDRESS 0xFFFF2BDE /begin FUNCTION_LIST /end FUNCTION_LIST /end MEASUREMENT
/begin MEASUREMENT vEVLNOLX_R#3 "The line pressure (10 seconds ago) of the 2nd leak-down inside" UWORD COMP_0050 1 100 0 5119.921875 ECU_ADDRESS 0xFFFF2BE0 /begin FUNCTION_LIST /end FUNCTION_LIST /end MEASUREMENT
/begin MEASUREMENT vEVLNOLX_R#4 "The line pressure (10 seconds ago) of the 2nd leak-down inside" UWORD COMP_0050 1 100 0 5119.921875 ECU_ADDRESS 0xFFFF2BE2 /begin FUNCTION_LIST /end FUNCTION_LIST /end MEASUREMENT
/begin MEASUREMENT vEVLNOLX_R#5 "The line pressure (10 seconds ago) of the 2nd leak-down inside" UWORD COMP_0050 1 100 0 5119.921875 ECU_ADDRESS 0xFFFF2BE4 /begin FUNCTION_LIST /end FUNCTION_LIST /end MEASUREMENT
/begin MEASUREMENT vEVLNOLX_R#6 "The line pressure (10 seconds ago) of the 2nd leak-down inside" UWORD COMP_0050 1 100 0 5119.921875 ECU_ADDRESS 0xFFFF2BE6 /begin FUNCTION_LIST /end FUNCTION_LIST /end MEASUREMENT
/begin MEASUREMENT vEVLNOLX_R#7 "The line pressure (10 seconds ago) of the 2nd leak-down inside" UWORD COMP_0050 1 100 0 5119.921875 ECU_ADDRESS 0xFFFF2BE8 /begin FUNCTION_LIST /end FUNCTION_LIST /end MEASUREMENT
/begin MEASUREMENT vEVLNOLX_R#8 "The line pressure (10 seconds ago) of the 2nd leak-down inside" UWORD COMP_0050 1 100 0 5119.921875 ECU_ADDRESS 0xFFFF2BEA /begin FUNCTION_LIST /end FUNCTION_LIST /end MEASUREMENT
/begin MEASUREMENT vEVLNOLX_R#9 "The line pressure (10 seconds ago) of the 2nd leak-down inside" UWORD COMP_0050 1 100 0 5119.921875 ECU_ADDRESS 0xFFFF2BEC /begin FUNCTION_LIST /end FUNCTION_LIST /end MEASUREMENT
/begin MEASUREMENT vEVLNOLX_R#10 "The line pressure (10 seconds ago) of the 2nd leak-down inside" UWORD COMP_0050 1 100 0 5119.921875 ECU_ADDRESS 0xFFFF2BEE /begin FUNCTION_LIST /end FUNCTION_LIST /end MEASUREMENT
/begin MEASUREMENT vEVLNOLX_R#11 "The line pressure (10 seconds ago) of the 2nd leak-down inside" UWORD COMP_0050 1 100 0 5119.921875 ECU_ADDRESS 0xFFFF2BF0 /begin FUNCTION_LIST /end FUNCTION_LIST /end MEASUREMENT
/begin MEASUREMENT vEVLNOLX_R#12 "The line pressure (10 seconds ago) of the 2nd leak-down inside" UWORD COMP_0050 1 100 0 5119.921875 ECU_ADDRESS 0xFFFF2BF2 /begin FUNCTION_LIST /end FUNCTION_LIST /end MEASUREMENT
/begin MEASUREMENT vEVLNOLX_R#13 "The line pressure (10 seconds ago) of the 2nd leak-down inside" UWORD COMP_0050 1 100 0 5119.921875 ECU_ADDRESS 0xFFFF2BF4 /begin FUNCTION_LIST /end FUNCTION_LIST /end MEASUREMENT
/begin MEASUREMENT vEVLNOLX_R#14 "The line pressure (10 seconds ago) of the 2nd leak-down inside" UWORD COMP_0050 1 100 0 5119.921875 ECU_ADDRESS 0xFFFF2BF6 /begin FUNCTION_LIST /end FUNCTION_LIST /end MEASUREMENT
/begin MEASUREMENT vEVLNOLX_R#15 "The line pressure (10 seconds ago) of the 2nd leak-down inside" UWORD COMP_0050 1 100 0 5119.921875 ECU_ADDRESS 0xFFFF2BF8 /begin FUNCTION_LIST /end FUNCTION_LIST /end MEASUREMENT
/begin MEASUREMENT vEVLNOLX_R#16 "The line pressure (10 seconds ago) of the 2nd leak-down inside" UWORD COMP_0050 1 100 0 5119.921875 ECU_ADDRESS 0xFFFF2BFA /begin FUNCTION_LIST /end FUNCTION_LIST /end MEASUREMENT
/begin MEASUREMENT vEVLNOLX_R#17 "The line pressure (10 seconds ago) of the 2nd leak-down inside" UWORD COMP_0050 1 100 0 5119.921875 ECU_ADDRESS 0xFFFF2BFC /begin FUNCTION_LIST /end FUNCTION_LIST /end MEASUREMENT
/begin MEASUREMENT vEVLNOLX_R#18 "The line pressure (10 seconds ago) of the 2nd leak-down inside" UWORD COMP_0050 1 100 0 5119.921875 ECU_ADDRESS 0xFFFF2BFE /begin FUNCTION_LIST /end FUNCTION_LIST /end MEASUREMENT
/begin MEASUREMENT vEVLNOLX_R#19 "The line pressure (10 seconds ago) of the 2nd leak-down inside" UWORD COMP_0050 1 100 0 5119.921875 ECU_ADDRESS 0xFFFF2C00 /begin FUNCTION_LIST /end FUNCTION_LIST /end MEASUREMENT
/begin MEASUREMENT vEVLNOLX_R#20 "The line pressure (10 seconds ago) of the 2nd leak-down inside" UWORD COMP_0050 1 100 0 5119.921875 ECU_ADDRESS 0xFFFF2C02 /begin FUNCTION_LIST /end FUNCTION_LIST /end MEASUREMENT
/begin MEASUREMENT vEVLNOLX_R#21 "The line pressure (10 seconds ago) of the 2nd leak-down inside" UWORD COMP_0050 1 100 0 5119.921875 ECU_ADDRESS 0xFFFF2C04 /begin FUNCTION_LIST /end FUNCTION_LIST /end MEASUREMENT
/begin MEASUREMENT vEVLNOLX_R#22 "The line pressure (10 seconds ago) of the 2nd leak-down inside" UWORD COMP_0050 1 100 0 5119.921875 ECU_ADDRESS 0xFFFF2C06 /begin FUNCTION_LIST /end FUNCTION_LIST /end MEASUREMENT
/begin MEASUREMENT vEVLNOLX_R#23 "The line pressure (10 seconds ago) of the 2nd leak-down inside" UWORD COMP_0050 1 100 0 5119.921875 ECU_ADDRESS 0xFFFF2C08 /begin FUNCTION_LIST /end FUNCTION_LIST /end MEASUREMENT
/begin MEASUREMENT vEVLNOLX_R#24 "The line pressure (10 seconds ago) of the 2nd leak-down inside" UWORD COMP_0050 1 100 0 5119.921875 ECU_ADDRESS 0xFFFF2C0A /begin FUNCTION_LIST /end FUNCTION_LIST /end MEASUREMENT
/begin MEASUREMENT vEVLNOLX_R#25 "The line pressure (10 seconds ago) of the 2nd leak-down inside" UWORD COMP_0050 1 100 0 5119.921875 ECU_ADDRESS 0xFFFF2C0C /begin FUNCTION_LIST /end FUNCTION_LIST /end MEASUREMENT
/begin MEASUREMENT vEVLNOLX_R#26 "The line pressure (10 seconds ago) of the 2nd leak-down inside" UWORD COMP_0050 1 100 0 5119.921875 ECU_ADDRESS 0xFFFF2C0E /begin FUNCTION_LIST /end FUNCTION_LIST /end MEASUREMENT
/begin MEASUREMENT vEVLNOLX_R#27 "The line pressure (10 seconds ago) of the 2nd leak-down inside" UWORD COMP_0050 1 100 0 5119.921875 ECU_ADDRESS 0xFFFF2C10 /begin FUNCTION_LIST /end FUNCTION_LIST /end MEASUREMENT
/begin MEASUREMENT vEVLNOLX_R#28 "The line pressure (10 seconds ago) of the 2nd leak-down inside" UWORD COMP_0050 1 100 0 5119.921875 ECU_ADDRESS 0xFFFF2C12 /begin FUNCTION_LIST /end FUNCTION_LIST /end MEASUREMENT
/begin MEASUREMENT vEVLNOLX_R#29 "The line pressure (10 seconds ago) of the 2nd leak-down inside" UWORD COMP_0050 1 100 0 5119.921875 ECU_ADDRESS 0xFFFF2C14 /begin FUNCTION_LIST /end FUNCTION_LIST /end MEASUREMENT
/begin MEASUREMENT vEVLNOLX_R#30 "The line pressure (10 seconds ago) of the 2nd leak-down inside" UWORD COMP_0050 1 100 0 5119.921875 ECU_ADDRESS 0xFFFF2C16 /begin FUNCTION_LIST /end FUNCTION_LIST /end MEASUREMENT
/begin MEASUREMENT vEVLNOLX_R#31 "The line pressure (10 seconds ago) of the 2nd leak-down inside" UWORD COMP_0050 1 100 0 5119.921875 ECU_ADDRESS 0xFFFF2C18 /begin FUNCTION_LIST /end FUNCTION_LIST /end MEASUREMENT
/begin MEASUREMENT vEVLNOLX_R#32 "The line pressure (10 seconds ago) of the 2nd leak-down inside" UWORD COMP_0050 1 100 0 5119.921875 ECU_ADDRESS 0xFFFF2C1A /begin FUNCTION_LIST /end FUNCTION_LIST /end MEASUREMENT
/begin MEASUREMENT vEVLNOLX_R#33 "The line pressure (10 seconds ago) of the 2nd leak-down inside" UWORD COMP_0050 1 100 0 5119.921875 ECU_ADDRESS 0xFFFF2C1C /begin FUNCTION_LIST /end FUNCTION_LIST /end MEASUREMENT
/begin MEASUREMENT vEVLNOLX_R#34 "The line pressure (10 seconds ago) of the 2nd leak-down inside" UWORD COMP_0050 1 100 0 5119.921875 ECU_ADDRESS 0xFFFF2C1E /begin FUNCTION_LIST /end FUNCTION_LIST /end MEASUREMENT
/begin MEASUREMENT vEVLNOLX_R#35 "The line pressure (10 seconds ago) of the 2nd leak-down inside" UWORD COMP_0050 1 100 0 5119.921875 ECU_ADDRESS 0xFFFF2C20 /begin FUNCTION_LIST /end FUNCTION_LIST /end MEASUREMENT
/begin MEASUREMENT vEVLNOLX_R#36 "The line pressure (10 seconds ago) of the 2nd leak-down inside" UWORD COMP_0050 1 100 0 5119.921875 ECU_ADDRESS 0xFFFF2C22 /begin FUNCTION_LIST /end FUNCTION_LIST /end MEASUREMENT
/begin MEASUREMENT vEVLNOLX_R#37 "The line pressure (10 seconds ago) of the 2nd leak-down inside" UWORD COMP_0050 1 100 0 5119.921875 ECU_ADDRESS 0xFFFF2C24 /begin FUNCTION_LIST /end FUNCTION_LIST /end MEASUREMENT
/begin MEASUREMENT vEVLNOLX_R#38 "The line pressure (10 seconds ago) of the 2nd leak-down inside" UWORD COMP_0050 1 100 0 5119.921875 ECU_ADDRESS 0xFFFF2C26 /begin FUNCTION_LIST /end FUNCTION_LIST /end MEASUREMENT
/begin MEASUREMENT vEVLNOLX_R#39 "The line pressure (10 seconds ago) of the 2nd leak-down inside" UWORD COMP_0050 1 100 0 5119.921875 ECU_ADDRESS 0xFFFF2C28 /begin FUNCTION_LIST /end FUNCTION_LIST /end MEASUREMENT
/begin MEASUREMENT vEVLNOLX_R#40 "The line pressure (10 seconds ago) of the 2nd leak-down inside" UWORD COMP_0050 1 100 0 5119.921875 ECU_ADDRESS 0xFFFF2C2A /begin FUNCTION_LIST /end FUNCTION_LIST /end MEASUREMENT
/begin MEASUREMENT vEVLNOLX_R#41 "The line pressure (10 seconds ago) of the 2nd leak-down inside" UWORD COMP_0050 1 100 0 5119.921875 ECU_ADDRESS 0xFFFF2C2C /begin FUNCTION_LIST /end FUNCTION_LIST /end MEASUREMENT
/begin MEASUREMENT vEVLNOLX_R#42 "The line pressure (10 seconds ago) of the 2nd leak-down inside" UWORD COMP_0050 1 100 0 5119.921875 ECU_ADDRESS 0xFFFF2C2E /begin FUNCTION_LIST /end FUNCTION_LIST /end MEASUREMENT
/begin MEASUREMENT vEVLNOLX_R#43 "The line pressure (10 seconds ago) of the 2nd leak-down inside" UWORD COMP_0050 1 100 0 5119.921875 ECU_ADDRESS 0xFFFF2C30 /begin FUNCTION_LIST /end FUNCTION_LIST /end MEASUREMENT
/begin MEASUREMENT vEVLNOLX_R#44 "The line pressure (10 seconds ago) of the 2nd leak-down inside" UWORD COMP_0050 1 100 0 5119.921875 ECU_ADDRESS 0xFFFF2C32 /begin FUNCTION_LIST /end FUNCTION_LIST /end MEASUREMENT
/begin MEASUREMENT vEVLNOLX_R#45 "The line pressure (10 seconds ago) of the 2nd leak-down inside" UWORD COMP_0050 1 100 0 5119.921875 ECU_ADDRESS 0xFFFF2C34 /begin FUNCTION_LIST /end FUNCTION_LIST /end MEASUREMENT
/begin MEASUREMENT vEVLNOLX_R#46 "The line pressure (10 seconds ago) of the 2nd leak-down inside" UWORD COMP_0050 1 100 0 5119.921875 ECU_ADDRESS 0xFFFF2C36 /begin FUNCTION_LIST /end FUNCTION_LIST /end MEASUREMENT
/begin MEASUREMENT vEVLNOLX_R#47 "The line pressure (10 seconds ago) of the 2nd leak-down inside" UWORD COMP_0050 1 100 0 5119.921875 ECU_ADDRESS 0xFFFF2C38 /begin FUNCTION_LIST /end FUNCTION_LIST /end MEASUREMENT
/begin MEASUREMENT vEVLNOLX_R#48 "The line pressure (10 seconds ago) of the 2nd leak-down inside" UWORD COMP_0050 1 100 0 5119.921875 ECU_ADDRESS 0xFFFF2C3A /begin FUNCTION_LIST /end FUNCTION_LIST /end MEASUREMENT
/begin MEASUREMENT vEVLNOLX_R#49 "The line pressure (10 seconds ago) of the 2nd leak-down inside" UWORD COMP_0050 1 100 0 5119.921875 ECU_ADDRESS 0xFFFF2C3C /begin FUNCTION_LIST /end FUNCTION_LIST /end MEASUREMENT
/begin MEASUREMENT vEVLNOLX_R#50 "The line pressure (10 seconds ago) of the 2nd leak-down inside" UWORD COMP_0050 1 100 0 5119.921875 ECU_ADDRESS 0xFFFF2C3E /begin FUNCTION_LIST /end FUNCTION_LIST /end MEASUREMENT
/begin MEASUREMENT vEVLNOLX_R#51 "The line pressure (10 seconds ago) of the 2nd leak-down inside" UWORD COMP_0050 1 100 0 5119.921875 ECU_ADDRESS 0xFFFF2C40 /begin FUNCTION_LIST /end FUNCTION_LIST /end MEASUREMENT
/begin MEASUREMENT vEVLNOLX_R#52 "The line pressure (10 seconds ago) of the 2nd leak-down inside" UWORD COMP_0050 1 100 0 5119.921875 ECU_ADDRESS 0xFFFF2C42 /begin FUNCTION_LIST /end FUNCTION_LIST /end MEASUREMENT
/begin MEASUREMENT vEVLNOLX_R#53 "The line pressure (10 seconds ago) of the 2nd leak-down inside" UWORD COMP_0050 1 100 0 5119.921875 ECU_ADDRESS 0xFFFF2C44 /begin FUNCTION_LIST /end FUNCTION_LIST /end MEASUREMENT
/begin MEASUREMENT vEVLNOLX_R#54 "The line pressure (10 seconds ago) of the 2nd leak-down inside" UWORD COMP_0050 1 100 0 5119.921875 ECU_ADDRESS 0xFFFF2C46 /begin FUNCTION_LIST /end FUNCTION_LIST /end MEASUREMENT
/begin MEASUREMENT vEVLNOLX_R#55 "The line pressure (10 seconds ago) of the 2nd leak-down inside" UWORD COMP_0050 1 100 0 5119.921875 ECU_ADDRESS 0xFFFF2C48 /begin FUNCTION_LIST /end FUNCTION_LIST /end MEASUREMENT
/begin MEASUREMENT vEVLNOLX_R#56 "The line pressure (10 seconds ago) of the 2nd leak-down inside" UWORD COMP_0050 1 100 0 5119.921875 ECU_ADDRESS 0xFFFF2C4A /begin FUNCTION_LIST /end FUNCTION_LIST /end MEASUREMENT
/begin MEASUREMENT vEVLNOLX_R#57 "The line pressure (10 seconds ago) of the 2nd leak-down inside" UWORD COMP_0050 1 100 0 5119.921875 ECU_ADDRESS 0xFFFF2C4C /begin FUNCTION_LIST /end FUNCTION_LIST /end MEASUREMENT
/begin MEASUREMENT vEVLNOLX_R#58 "The line pressure (10 seconds ago) of the 2nd leak-down inside" UWORD COMP_0050 1 100 0 5119.921875 ECU_ADDRESS 0xFFFF2C4E /begin FUNCTION_LIST /end FUNCTION_LIST /end MEASUREMENT
/begin MEASUREMENT vEVLNOLX_R#59 "The line pressure (10 seconds ago) of the 2nd leak-down inside" UWORD COMP_0050 1 100 0 5119.921875 ECU_ADDRESS 0xFFFF2C50 /begin FUNCTION_LIST /end FUNCTION_LIST /end MEASUREMENT
/begin MEASUREMENT vEVLNOLX_R#60 "The line pressure (10 seconds ago) of the 2nd leak-down inside" UWORD COMP_0050 1 100 0 5119.921875 ECU_ADDRESS 0xFFFF2C52 /begin FUNCTION_LIST /end FUNCTION_LIST /end MEASUREMENT
/begin MEASUREMENT vEVLNOLX_R#61 "The line pressure (10 seconds ago) of the 2nd leak-down inside" UWORD COMP_0050 1 100 0 5119.921875 ECU_ADDRESS 0xFFFF2C54 /begin FUNCTION_LIST /end FUNCTION_LIST /end MEASUREMENT
/begin MEASUREMENT vEVLNOLX_R#62 "The line pressure (10 seconds ago) of the 2nd leak-down inside" UWORD COMP_0050 1 100 0 5119.921875 ECU_ADDRESS 0xFFFF2C56 /begin FUNCTION_LIST /end FUNCTION_LIST /end MEASUREMENT
/begin MEASUREMENT vEVLNOLX_R#63 "The line pressure (10 seconds ago) of the 2nd leak-down inside" UWORD COMP_0050 1 100 0 5119.921875 ECU_ADDRESS 0xFFFF2C58 /begin FUNCTION_LIST /end FUNCTION_LIST /end MEASUREMENT
/begin MEASUREMENT vEVLNOLX_R#64 "The line pressure (10 seconds ago) of the 2nd leak-down inside" UWORD COMP_0050 1 100 0 5119.921875 ECU_ADDRESS 0xFFFF2C5A /begin FUNCTION_LIST /end FUNCTION_LIST /end MEASUREMENT
/begin MEASUREMENT vEVLNOLX_R#65 "The line pressure (10 seconds ago) of the 2nd leak-down inside" UWORD COMP_0050 1 100 0 5119.921875 ECU_ADDRESS 0xFFFF2C5C /begin FUNCTION_LIST /end FUNCTION_LIST /end MEASUREMENT
/begin MEASUREMENT vEVLNOLX_R#66 "The line pressure (10 seconds ago) of the 2nd leak-down inside" UWORD COMP_0050 1 100 0 5119.921875 ECU_ADDRESS 0xFFFF2C5E /begin FUNCTION_LIST /end FUNCTION_LIST /end MEASUREMENT
/begin MEASUREMENT vEVLNOLX_R#67 "The line pressure (10 seconds ago) of the 2nd leak-down inside" UWORD COMP_0050 1 100 0 5119.921875 ECU_ADDRESS 0xFFFF2C60 /begin FUNCTION_LIST /end FUNCTION_LIST /end MEASUREMENT
/begin MEASUREMENT vEVLNOLX_R#68 "The line pressure (10 seconds ago) of the 2nd leak-down inside" UWORD COMP_0050 1 100 0 5119.921875 ECU_ADDRESS 0xFFFF2C62 /begin FUNCTION_LIST /end FUNCTION_LIST /end MEASUREMENT
/begin MEASUREMENT vEVLNOLX_R#69 "The line pressure (10 seconds ago) of the 2nd leak-down inside" UWORD COMP_0050 1 100 0 5119.921875 ECU_ADDRESS 0xFFFF2C64 /begin FUNCTION_LIST /end FUNCTION_LIST /end MEASUREMENT
/begin MEASUREMENT vEVLNOLX_R#70 "The line pressure (10 seconds ago) of the 2nd leak-down inside" UWORD COMP_0050 1 100 0 5119.921875 ECU_ADDRESS 0xFFFF2C66 /begin FUNCTION_LIST /end FUNCTION_LIST /end MEASUREMENT
/begin MEASUREMENT vEVLNOLX_R#71 "The line pressure (10 seconds ago) of the 2nd leak-down inside" UWORD COMP_0050 1 100 0 5119.921875 ECU_ADDRESS 0xFFFF2C68 /begin FUNCTION_LIST /end FUNCTION_LIST /end MEASUREMENT
/begin MEASUREMENT vEVLNOLX_R#72 "The line pressure (10 seconds ago) of the 2nd leak-down inside" UWORD COMP_0050 1 100 0 5119.921875 ECU_ADDRESS 0xFFFF2C6A /begin FUNCTION_LIST /end FUNCTION_LIST /end MEASUREMENT
/begin MEASUREMENT vEVLNOLX_R#73 "The line pressure (10 seconds ago) of the 2nd leak-down inside" UWORD COMP_0050 1 100 0 5119.921875 ECU_ADDRESS 0xFFFF2C6C /begin FUNCTION_LIST /end FUNCTION_LIST /end MEASUREMENT
/begin MEASUREMENT vEVLNOLX_R#74 "The line pressure (10 seconds ago) of the 2nd leak-down inside" UWORD COMP_0050 1 100 0 5119.921875 ECU_ADDRESS 0xFFFF2C6E /begin FUNCTION_LIST /end FUNCTION_LIST /end MEASUREMENT
/begin MEASUREMENT vEVLNOLX_R#75 "The line pressure (10 seconds ago) of the 2nd leak-down inside" UWORD COMP_0050 1 100 0 5119.921875 ECU_ADDRESS 0xFFFF2C70 /begin FUNCTION_LIST /end FUNCTION_LIST /end MEASUREMENT
/begin MEASUREMENT vEVLNOLX_R#76 "The line pressure (10 seconds ago) of the 2nd leak-down inside" UWORD COMP_0050 1 100 0 5119.921875 ECU_ADDRESS 0xFFFF2C72 /begin FUNCTION_LIST /end FUNCTION_LIST /end MEASUREMENT
/begin MEASUREMENT vEVLNOLX_R#77 "The line pressure (10 seconds ago) of the 2nd leak-down inside" UWORD COMP_0050 1 100 0 5119.921875 ECU_ADDRESS 0xFFFF2C74 /begin FUNCTION_LIST /end FUNCTION_LIST /end MEASUREMENT
/begin MEASUREMENT vEVLNOLX_R#78 "The line pressure (10 seconds ago) of the 2nd leak-down inside" UWORD COMP_0050 1 100 0 5119.921875 ECU_ADDRESS 0xFFFF2C76 /begin FUNCTION_LIST /end FUNCTION_LIST /end MEASUREMENT
/begin MEASUREMENT vEVLNOLX_R#79 "The line pressure (10 seconds ago) of the 2nd leak-down inside" UWORD COMP_0050 1 100 0 5119.921875 ECU_ADDRESS 0xFFFF2C78 /begin FUNCTION_LIST /end FUNCTION_LIST /end MEASUREMENT
/begin MEASUREMENT vEVLNOLX_R#80 "The line pressure (10 seconds ago) of the 2nd leak-down inside" UWORD COMP_0050 1 100 0 5119.921875 ECU_ADDRESS 0xFFFF2C7A /begin FUNCTION_LIST /end FUNCTION_LIST /end MEASUREMENT
/begin MEASUREMENT vEVLNOLX_R#81 "The line pressure (10 seconds ago) of the 2nd leak-down inside" UWORD COMP_0050 1 100 0 5119.921875 ECU_ADDRESS 0xFFFF2C7C /begin FUNCTION_LIST /end FUNCTION_LIST /end MEASUREMENT
/begin MEASUREMENT vEVLNOLX_R#82 "The line pressure (10 seconds ago) of the 2nd leak-down inside" UWORD COMP_0050 1 100 0 5119.921875 ECU_ADDRESS 0xFFFF2C7E /begin FUNCTION_LIST /end FUNCTION_LIST /end MEASUREMENT
/begin MEASUREMENT vEVLNOLX_R#83 "The line pressure (10 seconds ago) of the 2nd leak-down inside" UWORD COMP_0050 1 100 0 5119.921875 ECU_ADDRESS 0xFFFF2C80 /begin FUNCTION_LIST /end FUNCTION_LIST /end MEASUREMENT
/begin MEASUREMENT vEVLNOLX_R#84 "The line pressure (10 seconds ago) of the 2nd leak-down inside" UWORD COMP_0050 1 100 0 5119.921875 ECU_ADDRESS 0xFFFF2C82 /begin FUNCTION_LIST /end FUNCTION_LIST /end MEASUREMENT
/begin MEASUREMENT vEVLNOLX_R#85 "The line pressure (10 seconds ago) of the 2nd leak-down inside" UWORD COMP_0050 1 100 0 5119.921875 ECU_ADDRESS 0xFFFF2C84 /begin FUNCTION_LIST /end FUNCTION_LIST /end MEASUREMENT
/begin MEASUREMENT vEVLNOLX_R#86 "The line pressure (10 seconds ago) of the 2nd leak-down inside" UWORD COMP_0050 1 100 0 5119.921875 ECU_ADDRESS 0xFFFF2C86 /begin FUNCTION_LIST /end FUNCTION_LIST /end MEASUREMENT
/begin MEASUREMENT vEVLNOLX_R#87 "The line pressure (10 seconds ago) of the 2nd leak-down inside" UWORD COMP_0050 1 100 0 5119.921875 ECU_ADDRESS 0xFFFF2C88 /begin FUNCTION_LIST /end FUNCTION_LIST /end MEASUREMENT
/begin MEASUREMENT vEVLNOLX_R#88 "The line pressure (10 seconds ago) of the 2nd leak-down inside" UWORD COMP_0050 1 100 0 5119.921875 ECU_ADDRESS 0xFFFF2C8A /begin FUNCTION_LIST /end FUNCTION_LIST /end MEASUREMENT
/begin MEASUREMENT vEVLNOLX_R#89 "The line pressure (10 seconds ago) of the 2nd leak-down inside" UWORD COMP_0050 1 100 0 5119.921875 ECU_ADDRESS 0xFFFF2C8C /begin FUNCTION_LIST /end FUNCTION_LIST /end MEASUREMENT
/begin MEASUREMENT vEVLNOLX_R#90 "The line pressure (10 seconds ago) of the 2nd leak-down inside" UWORD COMP_0050 1 100 0 5119.921875 ECU_ADDRESS 0xFFFF2C8E /begin FUNCTION_LIST /end FUNCTION_LIST /end MEASUREMENT
/begin MEASUREMENT vEVLNOLX_R#91 "The line pressure (10 seconds ago) of the 2nd leak-down inside" UWORD COMP_0050 1 100 0 5119.921875 ECU_ADDRESS 0xFFFF2C90 /begin FUNCTION_LIST /end FUNCTION_LIST /end MEASUREMENT
/begin MEASUREMENT vEVLNOLX_R#92 "The line pressure (10 seconds ago) of the 2nd leak-down inside" UWORD COMP_0050 1 100 0 5119.921875 ECU_ADDRESS 0xFFFF2C92 /begin FUNCTION_LIST /end FUNCTION_LIST /end MEASUREMENT
/begin MEASUREMENT vEVLNOLX_R#93 "The line pressure (10 seconds ago) of the 2nd leak-down inside" UWORD COMP_0050 1 100 0 5119.921875 ECU_ADDRESS 0xFFFF2C94 /begin FUNCTION_LIST /end FUNCTION_LIST /end MEASUREMENT
/begin MEASUREMENT vEVLNOLX_R#94 "The line pressure (10 seconds ago) of the 2nd leak-down inside" UWORD COMP_0050 1 100 0 5119.921875 ECU_ADDRESS 0xFFFF2C96 /begin FUNCTION_LIST /end FUNCTION_LIST /end MEASUREMENT
/begin MEASUREMENT vEVLNOLX_R#95 "The line pressure (10 seconds ago) of the 2nd leak-down inside" UWORD COMP_0050 1 100 0 5119.921875 ECU_ADDRESS 0xFFFF2C98 /begin FUNCTION_LIST /end FUNCTION_LIST /end MEASUREMENT
/begin MEASUREMENT vEVLNOLX_R#96 "The line pressure (10 seconds ago) of the 2nd leak-down inside" UWORD COMP_0050 1 100 0 5119.921875 ECU_ADDRESS 0xFFFF2C9A /begin FUNCTION_LIST /end FUNCTION_LIST /end MEASUREMENT
/begin MEASUREMENT vEVLNOLX_R#97 "The line pressure (10 seconds ago) of the 2nd leak-down inside" UWORD COMP_0050 1 100 0 5119.921875 ECU_ADDRESS 0xFFFF2C9C /begin FUNCTION_LIST /end FUNCTION_LIST /end MEASUREMENT
/begin MEASUREMENT vEVLNOLX_R#98 "The line pressure (10 seconds ago) of the 2nd leak-down inside" UWORD COMP_0050 1 100 0 5119.921875 ECU_ADDRESS 0xFFFF2C9E /begin FUNCTION_LIST /end FUNCTION_LIST /end MEASUREMENT
/begin MEASUREMENT vEVLNOLX_R#99 "The line pressure (10 seconds ago) of the 2nd leak-down inside" UWORD COMP_0050 1 100 0 5119.921875 ECU_ADDRESS 0xFFFF2CA0 /begin FUNCTION_LIST /end FUNCTION_LIST /end MEASUREMENT
/begin MEASUREMENT vEVLNOLX_R#100 "The line pressure (10 seconds ago) of the 2nd leak-down inside" UWORD COMP_0050 1 100 0 5119.921875 ECU_ADDRESS 0xFFFF2CA2 /begin FUNCTION_LIST /end FUNCTION_LIST /end MEASUREMENT
/begin MEASUREMENT vEVLNZ2 "The line pressure (two seconds ago) that a function is diagnosed" UWORD COMP_0050 1 100 0 5119.921875 ECU_ADDRESS 0xFFFF2CA4 /begin FUNCTION_LIST /end FUNCTION_LIST /end MEASUREMENT
/begin MEASUREMENT vEVLNZ2_R#1 "The line pressure (two seconds ago) that a function is diagnosed" UWORD COMP_0050 1 100 0 5119.921875 ECU_ADDRESS 0xFFFF2CA4 /begin FUNCTION_LIST /end FUNCTION_LIST /end MEASUREMENT
/begin MEASUREMENT vEVLNZ2_R#2 "The line pressure (two seconds ago) that a function is diagnosed" UWORD COMP_0050 1 100 0 5119.921875 ECU_ADDRESS 0xFFFF2CA6 /begin FUNCTION_LIST /end FUNCTION_LIST /end MEASUREMENT
/begin MEASUREMENT vEVLNZ2_R#3 "The line pressure (two seconds ago) that a function is diagnosed" UWORD COMP_0050 1 100 0 5119.921875 ECU_ADDRESS 0xFFFF2CA8 /begin FUNCTION_LIST /end FUNCTION_LIST /end MEASUREMENT
/begin MEASUREMENT vEVLNZ2_R#4 "The line pressure (two seconds ago) that a function is diagnosed" UWORD COMP_0050 1 100 0 5119.921875 ECU_ADDRESS 0xFFFF2CAA /begin FUNCTION_LIST /end FUNCTION_LIST /end MEASUREMENT
/begin MEASUREMENT vEVLNZ2_R#5 "The line pressure (two seconds ago) that a function is diagnosed" UWORD COMP_0050 1 100 0 5119.921875 ECU_ADDRESS 0xFFFF2CAC /begin FUNCTION_LIST /end FUNCTION_LIST /end MEASUREMENT
/begin MEASUREMENT vEVLNZ2_R#6 "The line pressure (two seconds ago) that a function is diagnosed" UWORD COMP_0050 1 100 0 5119.921875 ECU_ADDRESS 0xFFFF2CAE /begin FUNCTION_LIST /end FUNCTION_LIST /end MEASUREMENT
/begin MEASUREMENT vEVLNZ2_R#7 "The line pressure (two seconds ago) that a function is diagnosed" UWORD COMP_0050 1 100 0 5119.921875 ECU_ADDRESS 0xFFFF2CB0 /begin FUNCTION_LIST /end FUNCTION_LIST /end MEASUREMENT
/begin MEASUREMENT vEVLNZ2_R#8 "The line pressure (two seconds ago) that a function is diagnosed" UWORD COMP_0050 1 100 0 5119.921875 ECU_ADDRESS 0xFFFF2CB2 /begin FUNCTION_LIST /end FUNCTION_LIST /end MEASUREMENT
/begin MEASUREMENT vEVLNZ2_R#9 "The line pressure (two seconds ago) that a function is diagnosed" UWORD COMP_0050 1 100 0 5119.921875 ECU_ADDRESS 0xFFFF2CB4 /begin FUNCTION_LIST /end FUNCTION_LIST /end MEASUREMENT
/begin MEASUREMENT vEVLNZ2_R#10 "The line pressure (two seconds ago) that a function is diagnosed" UWORD COMP_0050 1 100 0 5119.921875 ECU_ADDRESS 0xFFFF2CB6 /begin FUNCTION_LIST /end FUNCTION_LIST /end MEASUREMENT
/begin MEASUREMENT vEVLNZ2_R#11 "The line pressure (two seconds ago) that a function is diagnosed" UWORD COMP_0050 1 100 0 5119.921875 ECU_ADDRESS 0xFFFF2CB8 /begin FUNCTION_LIST /end FUNCTION_LIST /end MEASUREMENT
/begin MEASUREMENT vEVLNZ2_R#12 "The line pressure (two seconds ago) that a function is diagnosed" UWORD COMP_0050 1 100 0 5119.921875 ECU_ADDRESS 0xFFFF2CBA /begin FUNCTION_LIST /end FUNCTION_LIST /end MEASUREMENT
/begin MEASUREMENT vEVLNZ2_R#13 "The line pressure (two seconds ago) that a function is diagnosed" UWORD COMP_0050 1 100 0 5119.921875 ECU_ADDRESS 0xFFFF2CBC /begin FUNCTION_LIST /end FUNCTION_LIST /end MEASUREMENT
/begin MEASUREMENT vEVLNZ2_R#14 "The line pressure (two seconds ago) that a function is diagnosed" UWORD COMP_0050 1 100 0 5119.921875 ECU_ADDRESS 0xFFFF2CBE /begin FUNCTION_LIST /end FUNCTION_LIST /end MEASUREMENT
/begin MEASUREMENT vEVLNZ2_R#15 "The line pressure (two seconds ago) that a function is diagnosed" UWORD COMP_0050 1 100 0 5119.921875 ECU_ADDRESS 0xFFFF2CC0 /begin FUNCTION_LIST /end FUNCTION_LIST /end MEASUREMENT
/begin MEASUREMENT vEVLNZ2_R#16 "The line pressure (two seconds ago) that a function is diagnosed" UWORD COMP_0050 1 100 0 5119.921875 ECU_ADDRESS 0xFFFF2CC2 /begin FUNCTION_LIST /end FUNCTION_LIST /end MEASUREMENT
/begin MEASUREMENT vEVLNZ2_R#17 "The line pressure (two seconds ago) that a function is diagnosed" UWORD COMP_0050 1 100 0 5119.921875 ECU_ADDRESS 0xFFFF2CC4 /begin FUNCTION_LIST /end FUNCTION_LIST /end MEASUREMENT
/begin MEASUREMENT vEVLNZ2_R#18 "The line pressure (two seconds ago) that a function is diagnosed" UWORD COMP_0050 1 100 0 5119.921875 ECU_ADDRESS 0xFFFF2CC6 /begin FUNCTION_LIST /end FUNCTION_LIST /end MEASUREMENT
/begin MEASUREMENT vEVLNZ2_R#19 "The line pressure (two seconds ago) that a function is diagnosed" UWORD COMP_0050 1 100 0 5119.921875 ECU_ADDRESS 0xFFFF2CC8 /begin FUNCTION_LIST /end FUNCTION_LIST /end MEASUREMENT
/begin MEASUREMENT vEVLNZ2_R#20 "The line pressure (two seconds ago) that a function is diagnosed" UWORD COMP_0050 1 100 0 5119.921875 ECU_ADDRESS 0xFFFF2CCA /begin FUNCTION_LIST /end FUNCTION_LIST /end MEASUREMENT
/begin MEASUREMENT vEVMNS2 "The stage 2 switchover rest, at least, line pressure" UWORD COMP_0050 1 100 0 5119.921875 ECU_ADDRESS 0xFFFF133E /begin FUNCTION_LIST /end FUNCTION_LIST /end MEASUREMENT
/begin MEASUREMENT vEVMNS3 "At the time of the pull-down, minimum tank pressure" UBYTE COMP_0054 1 100 0 5100 ECU_ADDRESS 0xFFFF2CCC /begin FUNCTION_LIST /end FUNCTION_LIST /end MEASUREMENT
/begin MEASUREMENT vEVMON4f "Rich timer monitor flag" UBYTE COMP_0004 1 100 0 255 ECU_ADDRESS 0xFFFF1340 /begin FUNCTION_LIST /end FUNCTION_LIST /end MEASUREMENT
/begin MEASUREMENT vEVP100MC "The value of the 1 S front of EVPRES" UBYTE COMP_0054 1 100 0 5100 ECU_ADDRESS 0xFFFF1341 /begin FUNCTION_LIST /end FUNCTION_LIST /end MEASUREMENT
/begin MEASUREMENT vEVP100MP "EVPRES of the 1 s front" UBYTE COMP_0054 1 100 0 5100 ECU_ADDRESS 0xFFFF1342 /begin FUNCTION_LIST /end FUNCTION_LIST /end MEASUREMENT
/begin MEASUREMENT vEVP2 "Drain-cut /V diagnosis reference pressure" UBYTE COMP_0054 1 100 0 5100 ECU_ADDRESS 0xFFFF2CCD /begin FUNCTION_LIST /end FUNCTION_LIST /end MEASUREMENT
/begin MEASUREMENT vEVP3 "Close diagnosis reference pressure" UBYTE COMP_0054 1 100 0 5100 ECU_ADDRESS 0xFFFF2CCE /begin FUNCTION_LIST /end FUNCTION_LIST /end MEASUREMENT
/begin MEASUREMENT vEVP3DY "EVP3 monitor delay" UBYTE COMP_0008 1 100 0 25500 ECU_ADDRESS 0xFFFF2CCF /begin FUNCTION_LIST /end FUNCTION_LIST /end MEASUREMENT
/begin MEASUREMENT vEVP4 "Reference pressure for the function diagnosis (3)" UBYTE COMP_0054 1 100 0 5100 ECU_ADDRESS 0xFFFF2CD0 /begin FUNCTION_LIST /end FUNCTION_LIST /end MEASUREMENT
/begin MEASUREMENT vEVP4DYA "EVP4 monitor delay" UBYTE COMP_0049 1 100 0 255 ECU_ADDRESS 0xFFFF2CD1 /begin FUNCTION_LIST /end FUNCTION_LIST /end MEASUREMENT
/begin MEASUREMENT vEVPFT "Heat resisting purge magnification upper limit value" UBYTE COMP_0158 1 100 0 15.9375 ECU_ADDRESS 0xFFFF1343 /begin FUNCTION_LIST /end FUNCTION_LIST /end MEASUREMENT
/begin MEASUREMENT vEVPIMR "An evapo system diagnosis completion flag for for 2TRIP-ization" UBYTE COMP_0004 1 100 0 255 ECU_ADDRESS 0xFFFFA3A4 /begin FUNCTION_LIST /end FUNCTION_LIST /end MEASUREMENT
/begin MEASUREMENT vEVPO2 "O2 heater on integration time" UBYTE COMP_0013 1 100 0 255 ECU_ADDRESS 0xFFFF2CD5 /begin FUNCTION_LIST /end FUNCTION_LIST /end MEASUREMENT
/begin MEASUREMENT vEVPO2_R#1 "O2 heater on integration time" UBYTE COMP_0013 1 100 0 255 ECU_ADDRESS 0xFFFF2CD5 /begin FUNCTION_LIST /end FUNCTION_LIST /end MEASUREMENT
/begin MEASUREMENT vEVPO2_R#2 "O2 heater on integration time" UBYTE COMP_0013 1 100 0 255 ECU_ADDRESS 0xFFFF2CD6 /begin FUNCTION_LIST /end FUNCTION_LIST /end MEASUREMENT
/begin MEASUREMENT vEVPOUTM "Purge output pulse width" UWORD COMP_0004 1 100 0 65535 ECU_ADDRESS 0xFFFF1344 /begin FUNCTION_LIST /end FUNCTION_LIST /end MEASUREMENT
/begin MEASUREMENT vEVPOVF "For the purge output pulse width overflow evacuation" UBYTE COMP_0004 1 100 0 255 ECU_ADDRESS 0xFFFF1346 /begin FUNCTION_LIST /end FUNCTION_LIST /end MEASUREMENT
/begin MEASUREMENT vEVPRES2 "PEVAP weighted average value 2" UWORD COMP_0050 1 100 0 5119.921875 ECU_ADDRESS 0xFFFF8998 /begin FUNCTION_LIST /end FUNCTION_LIST /end MEASUREMENT
/begin MEASUREMENT vEVPRS024 "Line pressure for the 0.02 slosh judgement" ULONG COMP_0592_S 1 100 0 1310720.93921892 ECU_ADDRESS 0xFFFF2CD8 /begin FUNCTION_LIST /end FUNCTION_LIST /end MEASUREMENT
/begin MEASUREMENT vEVPRTO "Purge ratio" UWORD COMP_0032 1 100 0 255.99609375 ECU_ADDRESS 0xFFFF1348 /begin FUNCTION_LIST /end FUNCTION_LIST /end MEASUREMENT
/begin MEASUREMENT vEVPSBF "Basis DUTY value OLD" UBYTE COMP_0047 1 100 0 127.5 ECU_ADDRESS 0xFFFF2CDC /begin FUNCTION_LIST /end FUNCTION_LIST /end MEASUREMENT
/begin MEASUREMENT vEVPSMX "Purge valve open-degree EVPS maximum value" UBYTE COMP_0047 1 100 0 127.5 ECU_ADDRESS 0xFFFF134B /begin FUNCTION_LIST /end FUNCTION_LIST /end MEASUREMENT
/begin MEASUREMENT vEVPSR1 "After alpha limiter expansion is diagnosed, rich side idle purge region" UBYTE COMP_0027 1 100 0 255 ECU_ADDRESS 0xFFFF134C /begin FUNCTION_LIST /end FUNCTION_LIST /end MEASUREMENT
/begin MEASUREMENT vEVPSR2 "After alpha limiter expansion is diagnosed, rich side idle purge region 2" UBYTE COMP_0027 1 100 0 255 ECU_ADDRESS 0xFFFF134D /begin FUNCTION_LIST /end FUNCTION_LIST /end MEASUREMENT
/begin MEASUREMENT vEVPSST "Usually, purge target duty map value" UBYTE COMP_0047 1 100 0 127.5 ECU_ADDRESS 0xFFFF134E /begin FUNCTION_LIST /end FUNCTION_LIST /end MEASUREMENT
/begin MEASUREMENT vEVPSTS "Evapo related diagnosis status flag" UBYTE COMP_0004 1 100 0 255 ECU_ADDRESS 0xFFFF2CDD /begin FUNCTION_LIST /end FUNCTION_LIST /end MEASUREMENT
/begin MEASUREMENT vEVPTRM "Realtime purge magnification" UBYTE COMP_0163 1 100 0 15.9375 ECU_ADDRESS 0xFFFF134F /begin FUNCTION_LIST /end FUNCTION_LIST /end MEASUREMENT
/begin MEASUREMENT vEVTCCHKf "Electromagnetism VTC check signal" UBYTE COMP_0004 1 100 0 255 ECU_ADDRESS 0xFFFF475A /begin FUNCTION_LIST /end FUNCTION_LIST /end MEASUREMENT
/begin MEASUREMENT vEWCRASH "vCRASHMEM EEP-ROM Write Triger FLAG" UBYTE COMP_0068 1 100 0 255 ECU_ADDRESS 0xFFFF4060 /begin FUNCTION_LIST /end FUNCTION_LIST /end MEASUREMENT
/begin MEASUREMENT vEWCRASH2 "vCRASHMEM EEP-ROM Write Triger FLAG" UBYTE COMP_0068 1 100 0 255 ECU_ADDRESS 0xFFFF4061 /begin FUNCTION_LIST /end FUNCTION_LIST /end MEASUREMENT
/begin MEASUREMENT vEWCRASHC "vCRASHMEM EEP-ROM Write Triger FLAG" UBYTE COMP_0068 1 100 0 255 ECU_ADDRESS 0xFFFF4062 /begin FUNCTION_LIST /end FUNCTION_LIST /end MEASUREMENT
/begin MEASUREMENT vEWDAT_M "EEPROM writing value" UWORD COMP_0004 1 100 0 65535 ECU_ADDRESS 0xFFFF2CE0 /begin FUNCTION_LIST /end FUNCTION_LIST /end MEASUREMENT
/begin MEASUREMENT vFACFLG "Factory flag" UWORD COMP_0068 1 100 0 65535 ECU_ADDRESS 0xFFFFB5F2 /begin FUNCTION_LIST /end FUNCTION_LIST /end MEASUREMENT
/begin MEASUREMENT vFADDBTIMf "Dizzer addition start time set flag" UBYTE COMP_0004 1 100 0 255 ECU_ADDRESS 0xFFFF1359 /begin FUNCTION_LIST /end FUNCTION_LIST /end MEASUREMENT
/begin MEASUREMENT vFAFAVNG1f "A former A./F sensor middle electric potential trouble NG the first time judgement distinction" UBYTE COMP_0004 1 100 0 255 ECU_ADDRESS 0xFFFFA3A6 /begin FUNCTION_LIST /end FUNCTION_LIST /end MEASUREMENT
/begin MEASUREMENT vFAFAVNG2f "A former A./F sensor middle electric potential trouble NG the second time judgement distinction" UBYTE COMP_0004 1 100 0 255 ECU_ADDRESS 0xFFFFA3A7 /begin FUNCTION_LIST /end FUNCTION_LIST /end MEASUREMENT
/begin MEASUREMENT vFAFAVOKf "A former A./F sensor middle electric potential trouble OK judgement distinction" UBYTE COMP_0004 1 100 0 255 ECU_ADDRESS 0xFFFFA3A8 /begin FUNCTION_LIST /end FUNCTION_LIST /end MEASUREMENT
/begin MEASUREMENT vFAFHCNf "A/F heater diagnosis judgement trip judgement distinction" UBYTE COMP_0004 1 100 0 255 ECU_ADDRESS 0xFFFF2CEF /begin FUNCTION_LIST /end FUNCTION_LIST /end MEASUREMENT
/begin MEASUREMENT vFAFHFALf "A/F sensor heater-control fail mode flag" UBYTE COMP_0004 1 100 0 255 ECU_ADDRESS 0xFFFF1EB0 /begin FUNCTION_LIST /end FUNCTION_LIST /end MEASUREMENT
/begin MEASUREMENT vFAFHMAXf "A/F sensor heater parameter backup condition distinction" UBYTE COMP_0004 1 100 0 255 ECU_ADDRESS 0xFFFF2CF0 /begin FUNCTION_LIST /end FUNCTION_LIST /end MEASUREMENT
/begin MEASUREMENT vFAFHMINf "A/F sensor heater parameter backup condition distinction" UBYTE COMP_0004 1 100 0 255 ECU_ADDRESS 0xFFFF2CF1 /begin FUNCTION_LIST /end FUNCTION_LIST /end MEASUREMENT
/begin MEASUREMENT vFAFHMLOKf "A/F heater diagnosis normality completion distinction" UBYTE COMP_0004 1 100 0 255 ECU_ADDRESS 0xFFFF2CF2 /begin FUNCTION_LIST /end FUNCTION_LIST /end MEASUREMENT
/begin MEASUREMENT vFAFHNG1f "Heater diagnosis 1st trip NG detection" UBYTE COMP_0004 1 100 0 255 ECU_ADDRESS 0xFFFFA3A9 /begin FUNCTION_LIST /end FUNCTION_LIST /end MEASUREMENT
/begin MEASUREMENT vFAFHNG2f "Heater diagnosis 2nd trip NG detection" UBYTE COMP_0004 1 100 0 255 ECU_ADDRESS 0xFFFFA3AA /begin FUNCTION_LIST /end FUNCTION_LIST /end MEASUREMENT
/begin MEASUREMENT vFAFHOK2f "Heater diagnosis OK detection" UBYTE COMP_0004 1 100 0 255 ECU_ADDRESS 0xFFFFA3AB /begin FUNCTION_LIST /end FUNCTION_LIST /end MEASUREMENT
/begin MEASUREMENT vFAFHZNG1f "A former A./F sensor response deterioration diagnosis NG the first time judgement distinction" UBYTE COMP_0004 1 100 0 255 ECU_ADDRESS 0xFFFFA3AC /begin FUNCTION_LIST /end FUNCTION_LIST /end MEASUREMENT
/begin MEASUREMENT vFAFHZNG2f "A former A./F sensor response deterioration diagnosis NG the second time judgement distinction" UBYTE COMP_0004 1 100 0 255 ECU_ADDRESS 0xFFFFA3AD /begin FUNCTION_LIST /end FUNCTION_LIST /end MEASUREMENT
/begin MEASUREMENT vFAFHZOKf "A former A./F sensor response deterioration diagnosis OK judgement distinction" UBYTE COMP_0004 1 100 0 255 ECU_ADDRESS 0xFFFFA3AE /begin FUNCTION_LIST /end FUNCTION_LIST /end MEASUREMENT
/begin MEASUREMENT vFAFLNG1f "A./F sensor shift diagnosis lean-shift NG the first time judgement distinction" UBYTE COMP_0004 1 100 0 255 ECU_ADDRESS 0xFFFFA3AF /begin FUNCTION_LIST /end FUNCTION_LIST /end MEASUREMENT
/begin MEASUREMENT vFAFLNG2f "A./F sensor shift diagnosis lean-shift NG the second time judgement distinction" UBYTE COMP_0004 1 100 0 255 ECU_ADDRESS 0xFFFFA3B0 /begin FUNCTION_LIST /end FUNCTION_LIST /end MEASUREMENT
/begin MEASUREMENT vFAFLOKf "A./F sensor shift diagnosis lean-shift OK judgement distinction" UBYTE COMP_0004 1 100 0 255 ECU_ADDRESS 0xFFFFA3B1 /begin FUNCTION_LIST /end FUNCTION_LIST /end MEASUREMENT
/begin MEASUREMENT vFAFLROKf "Rich lean response deterioration diagnosis OK judgement flag" UBYTE COMP_0004 1 100 0 255 ECU_ADDRESS 0xFFFFA3B2 /begin FUNCTION_LIST /end FUNCTION_LIST /end MEASUREMENT
/begin MEASUREMENT vFAFMLOKf "A/F sensor diagnosis OK completion distinction" UBYTE COMP_0004 1 100 0 255 ECU_ADDRESS 0xFFFF2CF3 /begin FUNCTION_LIST /end FUNCTION_LIST /end MEASUREMENT
/begin MEASUREMENT vFAFOK2f "A/F sensor diagnosis completion judgement flag" UBYTE COMP_0004 1 100 0 255 ECU_ADDRESS 0xFFFFA3B3 /begin FUNCTION_LIST /end FUNCTION_LIST /end MEASUREMENT
/begin MEASUREMENT vFAFONG1f "A/F sensor breakage diagnosis 1st trip NG detection flag" UBYTE COMP_0004 1 100 0 255 ECU_ADDRESS 0xFFFFA3B4 /begin FUNCTION_LIST /end FUNCTION_LIST /end MEASUREMENT
/begin MEASUREMENT vFAFONG2f "A/F sensor breakage diagnosis 2st trip NG detection flag" UBYTE COMP_0004 1 100 0 255 ECU_ADDRESS 0xFFFFA3B5 /begin FUNCTION_LIST /end FUNCTION_LIST /end MEASUREMENT
/begin MEASUREMENT vFAFRLOKf "Lean rich response deterioration diagnosis OK judgement flag" UBYTE COMP_0004 1 100 0 255 ECU_ADDRESS 0xFFFFA3B6 /begin FUNCTION_LIST /end FUNCTION_LIST /end MEASUREMENT
/begin MEASUREMENT vFAFRNG1f "A./F sensor shift diagnosis rich-shift NG the first time judgement distinction" UBYTE COMP_0004 1 100 0 255 ECU_ADDRESS 0xFFFFA3B7 /begin FUNCTION_LIST /end FUNCTION_LIST /end MEASUREMENT
/begin MEASUREMENT vFAFRNG2f "A./F sensor shift diagnosis rich-shift NG the second time judgement distinction" UBYTE COMP_0004 1 100 0 255 ECU_ADDRESS 0xFFFFA3B8 /begin FUNCTION_LIST /end FUNCTION_LIST /end MEASUREMENT
/begin MEASUREMENT vFAFROKf "A./F sensor shift diagnosis rich-shift OK judgement distinction" UBYTE COMP_0004 1 100 0 255 ECU_ADDRESS 0xFFFFA3B9 /begin FUNCTION_LIST /end FUNCTION_LIST /end MEASUREMENT
/begin MEASUREMENT vFAFRVNG1f "Lean rich response deterioration diagnosis 1st TRIP NG flag" UBYTE COMP_0004 1 100 0 255 ECU_ADDRESS 0xFFFFA3BA /begin FUNCTION_LIST /end FUNCTION_LIST /end MEASUREMENT
/begin MEASUREMENT vFAFRVNG2f "Lean rich response deterioration diagnosis 2nd TRIP NG flag" UBYTE COMP_0004 1 100 0 255 ECU_ADDRESS 0xFFFFA3BB /begin FUNCTION_LIST /end FUNCTION_LIST /end MEASUREMENT
/begin MEASUREMENT vFAFSACTf "A/F sensor activated judgement flag" UBYTE COMP_0004 1 100 0 255 ECU_ADDRESS 0xFFFF899A /begin FUNCTION_LIST /end FUNCTION_LIST /end MEASUREMENT
/begin MEASUREMENT vFBANG "F/B control compensation value angle conversion value" UWORD COMP_0069_S 1 100 -8192 8191.75 ECU_ADDRESS 0xFFFF135E /begin FUNCTION_LIST /end FUNCTION_LIST /end MEASUREMENT
/begin MEASUREMENT vFBKS "Pull-down F/B coefficient" UBYTE COMP_0044 1 100 0 1.9921875 ECU_ADDRESS 0xFFFF2CF6 /begin FUNCTION_LIST /end FUNCTION_LIST /end MEASUREMENT
/begin MEASUREMENT vFBPSNGEf "The flag whose VTC reference angle position is unusual" UBYTE COMP_0004 1 100 0 255 ECU_ADDRESS 0xFFFF1360 /begin FUNCTION_LIST /end FUNCTION_LIST /end MEASUREMENT
/begin MEASUREMENT vFBPSNGIf "The flag whose VTC reference angle position is unusual" UBYTE COMP_0004 1 100 0 255 ECU_ADDRESS 0xFFFF1361 /begin FUNCTION_LIST /end FUNCTION_LIST /end MEASUREMENT
/begin MEASUREMENT vFBSLTDBUf "Base learning convergent experience excuse flag" UBYTE COMP_0004 1 100 0 255 ECU_ADDRESS 0xFFFFA3BC /begin FUNCTION_LIST /end FUNCTION_LIST /end MEASUREMENT
/begin MEASUREMENT vFBSLTDMf "Base learning convergent judgement previous value" UBYTE COMP_0004 1 100 0 255 ECU_ADDRESS 0xFFFF2CFA /begin FUNCTION_LIST /end FUNCTION_LIST /end MEASUREMENT
/begin MEASUREMENT vFCAFHZF2f "Delta-A/F minimum value computed start condition time judgement flag" UBYTE COMP_0004 1 100 0 255 ECU_ADDRESS 0xFFFF1363 /begin FUNCTION_LIST /end FUNCTION_LIST /end MEASUREMENT
/begin MEASUREMENT vFCAFHZFf "A F/C time progress judgement for the former A/F sensor response deterioration/middle electric potential diagnosis" UBYTE COMP_0004 1 100 0 255 ECU_ADDRESS 0xFFFF1364 /begin FUNCTION_LIST /end FUNCTION_LIST /end MEASUREMENT
/begin MEASUREMENT vFCAFHZf "A F/C formation delay time progress judgement for the former A/F sensor response deterioration/middle electric potential diagnosis" UBYTE COMP_0004 1 100 0 255 ECU_ADDRESS 0xFFFF1362 /begin FUNCTION_LIST /end FUNCTION_LIST /end MEASUREMENT
/begin MEASUREMENT vFCAT1IMR "Catalyst diagnosis bank1 diagnosis trip judgement completion flag" UBYTE COMP_0004 1 100 0 255 ECU_ADDRESS 0xFFFF2D0A /begin FUNCTION_LIST /end FUNCTION_LIST /end MEASUREMENT
/begin MEASUREMENT vFCAT2IMR "Catalyst diagnosis bank2 diagnosis trip judgement completion flag" UBYTE COMP_0004 1 100 0 255 ECU_ADDRESS 0xFFFF2D0B /begin FUNCTION_LIST /end FUNCTION_LIST /end MEASUREMENT
/begin MEASUREMENT vFCATDf "Monitor flag" UBYTE COMP_0004 1 100 0 255 ECU_ADDRESS 0xFFFF2D0E /begin FUNCTION_LIST /end FUNCTION_LIST /end MEASUREMENT
/begin MEASUREMENT vFCCUPDf "The rest O2/S F/C condition judgement distinction" UBYTE COMP_0004 1 100 0 255 ECU_ADDRESS 0xFFFF2D1F /begin FUNCTION_LIST /end FUNCTION_LIST /end MEASUREMENT
/begin MEASUREMENT vFCDT1 "Half-cylinder F/C delay" UBYTE COMP_0014 1 100 0 2550 ECU_ADDRESS 0xFFFF1366 /begin FUNCTION_LIST /end FUNCTION_LIST /end MEASUREMENT
/begin MEASUREMENT vFCDT2 "All the cylinder F/C delays" UBYTE COMP_0014 1 100 0 2550 ECU_ADDRESS 0xFFFF1367 /begin FUNCTION_LIST /end FUNCTION_LIST /end MEASUREMENT
/begin MEASUREMENT vFCGEAR "Gear position" UBYTE COMP_0068 1 100 0 255 ECU_ADDRESS 0xFFFF2D23 /begin FUNCTION_LIST /end FUNCTION_LIST /end MEASUREMENT
/begin MEASUREMENT vFCNSDLYIf "Retard side response time measuring delay start condition formation flag" UBYTE COMP_0004 1 100 0 255 ECU_ADDRESS 0xFFFF1369 /begin FUNCTION_LIST /end FUNCTION_LIST /end MEASUREMENT
/begin MEASUREMENT vFCUT "Usually, control of a fuel cut" UBYTE COMP_0068 1 100 0 255 ECU_ADDRESS 0xFFFF101F /begin FUNCTION_LIST /end FUNCTION_LIST /end MEASUREMENT
/begin MEASUREMENT vFCUTAL "After the recover judgement, CHOSn or INJSETn first operation flag (every cylinder)" UBYTE COMP_0068 1 100 0 255 ECU_ADDRESS 0xFFFF136C /begin FUNCTION_LIST /end FUNCTION_LIST /end MEASUREMENT
/begin MEASUREMENT vFCUTHF "After the recover judgement, CHOSn or INJSETn first operation flag (every cylinder)" UBYTE COMP_0068 1 100 0 255 ECU_ADDRESS 0xFFFF136D /begin FUNCTION_LIST /end FUNCTION_LIST /end MEASUREMENT
/begin MEASUREMENT vFCUTRCVf "AFSHOS renewal permission flag" UBYTE COMP_0004 1 100 0 255 ECU_ADDRESS 0xFFFF2D30 /begin FUNCTION_LIST /end FUNCTION_LIST /end MEASUREMENT
/begin MEASUREMENT vFCVSP1 "A fuel cut rush vehicle speed for the rich spike" UBYTE COMP_0007 1 100 0 510 ECU_ADDRESS 0xFFFF136E /begin FUNCTION_LIST /end FUNCTION_LIST /end MEASUREMENT
/begin MEASUREMENT vFCYLER "Cylinder distinction error judgement flag" UBYTE COMP_0092 1 100 0 255 ECU_ADDRESS 0xFFFF136F /begin FUNCTION_LIST /end FUNCTION_LIST /end MEASUREMENT
/begin MEASUREMENT vFDADST "FFD reading and writing address" UBYTE COMP_0004 1 100 0 255 ECU_ADDRESS 0xFFFF2D32 /begin FUNCTION_LIST /end FUNCTION_LIST /end MEASUREMENT
/begin MEASUREMENT vFDITHERf "Dizzer control permission flag" UBYTE COMP_0004 1 100 0 255 ECU_ADDRESS 0xFFFF1372 /begin FUNCTION_LIST /end FUNCTION_LIST /end MEASUREMENT
/begin MEASUREMENT vFDMNUM "The number of FFD reading and writing" UBYTE COMP_0004 1 100 0 255 ECU_ADDRESS 0xFFFF2D3A /begin FUNCTION_LIST /end FUNCTION_LIST /end MEASUREMENT
/begin MEASUREMENT vFDOSO1f "A former O2/s deterioration judgement (1) condition" UBYTE COMP_0004 1 100 0 255 ECU_ADDRESS 0xFFFFA3BE /begin FUNCTION_LIST /end FUNCTION_LIST /end MEASUREMENT
/begin MEASUREMENT vFDOSO2f "A former O2/s deterioration judgement (2) condition" UBYTE COMP_0004 1 100 0 255 ECU_ADDRESS 0xFFFFA3BF /begin FUNCTION_LIST /end FUNCTION_LIST /end MEASUREMENT
/begin MEASUREMENT vFDOSO3f "A former O2/s deterioration judgement (3) condition" UBYTE COMP_0004 1 100 0 255 ECU_ADDRESS 0xFFFFA3C0 /begin FUNCTION_LIST /end FUNCTION_LIST /end MEASUREMENT
/begin MEASUREMENT vFDRDDT "FFD reading data" UWORD COMP_0004 1 100 0 65535 ECU_ADDRESS 0xFFFF2D3C /begin FUNCTION_LIST /end FUNCTION_LIST /end MEASUREMENT
/begin MEASUREMENT vFDRQBF "FFDREQ buffer" UBYTE COMP_0004 1 100 0 255 ECU_ADDRESS 0xFFFF2D40 /begin FUNCTION_LIST /end FUNCTION_LIST /end MEASUREMENT
/begin MEASUREMENT vFDRTRGEf "A polarity judgement flag for the hysteresis DUTY ratio computation" UBYTE COMP_0004 1 100 0 255 ECU_ADDRESS 0xFFFF1373 /begin FUNCTION_LIST /end FUNCTION_LIST /end MEASUREMENT
/begin MEASUREMENT vFDRTRGIf "A polarity judgement flag for the hysteresis DUTY ratio computation" UBYTE COMP_0004 1 100 0 255 ECU_ADDRESS 0xFFFF1374 /begin FUNCTION_LIST /end FUNCTION_LIST /end MEASUREMENT
/begin MEASUREMENT vFDRWC2 "FFD reading and writing counter" UBYTE COMP_0016 1 100 0 255 ECU_ADDRESS 0xFFFF2D43 /begin FUNCTION_LIST /end FUNCTION_LIST /end MEASUREMENT
/begin MEASUREMENT vFDRWCNT_M "FFD writing counter" UBYTE COMP_0016 1 100 0 255 ECU_ADDRESS 0xFFFF2D44 /begin FUNCTION_LIST /end FUNCTION_LIST /end MEASUREMENT
/begin MEASUREMENT vFDRWCT "FFD reading and writing counter" UBYTE COMP_0016 1 100 0 255 ECU_ADDRESS 0xFFFF2D45 /begin FUNCTION_LIST /end FUNCTION_LIST /end MEASUREMENT
/begin MEASUREMENT vFDSFDOMf "A former O2/s deterioration judgement permission condition memory" UBYTE COMP_0004 1 100 0 255 ECU_ADDRESS 0xFFFF1376 /begin FUNCTION_LIST /end FUNCTION_LIST /end MEASUREMENT
/begin MEASUREMENT vFDSFDOf "A former O2/s deterioration judgement permission condition" UBYTE COMP_0004 1 100 0 255 ECU_ADDRESS 0xFFFF1375 /begin FUNCTION_LIST /end FUNCTION_LIST /end MEASUREMENT
/begin MEASUREMENT vFDSFOHf "A former O2/s reversion judgement (1) condition (upside)" UBYTE COMP_0004 1 100 0 255 ECU_ADDRESS 0xFFFF1377 /begin FUNCTION_LIST /end FUNCTION_LIST /end MEASUREMENT
/begin MEASUREMENT vFDSFOLf "A former O2/s reversion judgement (1) condition (bottom side)" UBYTE COMP_0004 1 100 0 255 ECU_ADDRESS 0xFFFF1378 /begin FUNCTION_LIST /end FUNCTION_LIST /end MEASUREMENT
/begin MEASUREMENT vFDTBTIMIf "Retard side waste time measuring flag" UBYTE COMP_0004 1 100 0 255 ECU_ADDRESS 0xFFFF1379 /begin FUNCTION_LIST /end FUNCTION_LIST /end MEASUREMENT
/begin MEASUREMENT vFDTFTIMIf "Advance side waste time measuring flag" UBYTE COMP_0004 1 100 0 255 ECU_ADDRESS 0xFFFF137A /begin FUNCTION_LIST /end FUNCTION_LIST /end MEASUREMENT
/begin MEASUREMENT vFDWOFS "FFD reading and writing address" UBYTE COMP_0004 1 100 0 255 ECU_ADDRESS 0xFFFF2D46 /begin FUNCTION_LIST /end FUNCTION_LIST /end MEASUREMENT
/begin MEASUREMENT vFEEVPCf "Purge check requirement edge judgement" UBYTE COMP_0004 1 100 0 255 ECU_ADDRESS 0xFFFF137C /begin FUNCTION_LIST /end FUNCTION_LIST /end MEASUREMENT
/begin MEASUREMENT vFEGCLIMR "EGR close diagnosis trip judgement completion flag" UBYTE COMP_0004 1 100 0 255 ECU_ADDRESS 0xFFFF2D47 /begin FUNCTION_LIST /end FUNCTION_LIST /end MEASUREMENT
/begin MEASUREMENT vFEGOPIMR "EGR open diagnosis trip judgement completion flag" UBYTE COMP_0004 1 100 0 255 ECU_ADDRESS 0xFFFF2D48 /begin FUNCTION_LIST /end FUNCTION_LIST /end MEASUREMENT
/begin MEASUREMENT vFEMDNO "After the start, diagnosis number of times" UBYTE COMP_0068 1 100 0 255 ECU_ADDRESS 0xFFFF2D49 /begin FUNCTION_LIST /end FUNCTION_LIST /end MEASUREMENT
/begin MEASUREMENT vFEVPIMR "An evapo system diagnosis completion flag for for 2TRIP-ization" UBYTE COMP_0004 1 100 0 255 ECU_ADDRESS 0xFFFF2D4B /begin FUNCTION_LIST /end FUNCTION_LIST /end MEASUREMENT
/begin MEASUREMENT vFEVPOK "A CCM OK judgement flag related to the evapo" UBYTE COMP_0004 1 100 0 255 ECU_ADDRESS 0xFFFF2D4C /begin FUNCTION_LIST /end FUNCTION_LIST /end MEASUREMENT
/begin MEASUREMENT vFEVPOK2 "A CCM OK judgement flag 2 related to the evapo" UBYTE COMP_0004 1 100 0 255 ECU_ADDRESS 0xFFFF2D4D /begin FUNCTION_LIST /end FUNCTION_LIST /end MEASUREMENT
/begin MEASUREMENT vFFBSTD "F.F. data buffer intake manifold absolute pressure (for DiagOnCAN)" UWORD COMP_0491_S 1 100 0 65535 ECU_ADDRESS 0xFFFF3CC6 /begin FUNCTION_LIST /end FUNCTION_LIST /end MEASUREMENT
/begin MEASUREMENT vFFDA1 "At the time of the DTCMN renewal, ALPHA" UBYTE COMP_0027 1 100 0 255 ECU_ADDRESS 0xFFFFA3DA /begin FUNCTION_LIST /end FUNCTION_LIST /end MEASUREMENT
/begin MEASUREMENT vFFDA1_R#1 "At the time of the DTCMN renewal, ALPHA" UBYTE COMP_0027 1 100 0 255 ECU_ADDRESS 0xFFFFA3DA /begin FUNCTION_LIST /end FUNCTION_LIST /end MEASUREMENT
/begin MEASUREMENT vFFDA1_R#2 "At the time of the DTCMN renewal, ALPHA" UBYTE COMP_0027 1 100 0 255 ECU_ADDRESS 0xFFFFA3DB /begin FUNCTION_LIST /end FUNCTION_LIST /end MEASUREMENT
/begin MEASUREMENT vFFDK1 "At the time of the DTCMN renewal, KBLRC" UBYTE COMP_0027 1 100 0 255 ECU_ADDRESS 0xFFFFA3DC /begin FUNCTION_LIST /end FUNCTION_LIST /end MEASUREMENT
/begin MEASUREMENT vFFDK1_R#1 "At the time of the DTCMN renewal, KBLRC" UBYTE COMP_0027 1 100 0 255 ECU_ADDRESS 0xFFFFA3DC /begin FUNCTION_LIST /end FUNCTION_LIST /end MEASUREMENT
/begin MEASUREMENT vFFDK1_R#2 "At the time of the DTCMN renewal, KBLRC" UBYTE COMP_0027 1 100 0 255 ECU_ADDRESS 0xFFFFA3DD /begin FUNCTION_LIST /end FUNCTION_LIST /end MEASUREMENT
/begin MEASUREMENT vFFDRD "Usually, prohibition of FFD permission /" UBYTE COMP_0004 1 100 0 255 ECU_ADDRESS 0xFFFF2D53 /begin FUNCTION_LIST /end FUNCTION_LIST /end MEASUREMENT
/begin MEASUREMENT vFFDSTP "It waits for reverse side FFD writing." UBYTE COMP_0014 1 100 0 2550 ECU_ADDRESS 0xFFFF2D54 /begin FUNCTION_LIST /end FUNCTION_LIST /end MEASUREMENT
/begin MEASUREMENT vFFDTF "At the time of the DTCMN renewal, TFBYAC" UBYTE COMP_0095 1 100 0 398.4375 ECU_ADDRESS 0xFFFFA3DE /begin FUNCTION_LIST /end FUNCTION_LIST /end MEASUREMENT
/begin MEASUREMENT vFFDTF_R#1 "At the time of the DTCMN renewal, TFBYAC" UBYTE COMP_0095 1 100 0 398.4375 ECU_ADDRESS 0xFFFFA3DE /begin FUNCTION_LIST /end FUNCTION_LIST /end MEASUREMENT
/begin MEASUREMENT vFFDTF_R#2 "At the time of the DTCMN renewal, TFBYAC" UBYTE COMP_0095 1 100 0 398.4375 ECU_ADDRESS 0xFFFFA3DF /begin FUNCTION_LIST /end FUNCTION_LIST /end MEASUREMENT
/begin MEASUREMENT vFG2MN "Fuel level gauge voltage minimum value" UWORD COMP_0050 1 100 0 5119.921875 ECU_ADDRESS 0xFFFFA418 /begin FUNCTION_LIST /end FUNCTION_LIST /end MEASUREMENT
/begin MEASUREMENT vFG2MX "Fuel level gauge voltage maximum value" UWORD COMP_0050 1 100 0 5119.921875 ECU_ADDRESS 0xFFFFA41A /begin FUNCTION_LIST /end FUNCTION_LIST /end MEASUREMENT
/begin MEASUREMENT vFG2SUB1 "EMPTY dead-zone outside FG2SUB minimum value" UWORD COMP_0050 1 100 0 5119.921875 ECU_ADDRESS 0xFFFFA41C /begin FUNCTION_LIST /end FUNCTION_LIST /end MEASUREMENT
/begin MEASUREMENT vFG2SUB2 "EMPTY dead-zone FG2SUB minimum value" UWORD COMP_0050 1 100 0 5119.921875 ECU_ADDRESS 0xFFFFA41E /begin FUNCTION_LIST /end FUNCTION_LIST /end MEASUREMENT
/begin MEASUREMENT vFGAGE1 "Fuel level gauge weighted average value 1" UWORD COMP_0050 1 100 0 5119.921875 ECU_ADDRESS 0xFFFF3CCA /begin FUNCTION_LIST /end FUNCTION_LIST /end MEASUREMENT
/begin MEASUREMENT vFGAGE2 "Fuel level gauge weighted average value 2" UWORD COMP_0050 1 100 0 5119.921875 ECU_ADDRESS 0xFFFF493A /begin FUNCTION_LIST /end FUNCTION_LIST /end MEASUREMENT
/begin MEASUREMENT vFGCAN "Fuel level gauge CAN receiving value" UWORD COMP_0068 1 100 0 65535 ECU_ADDRESS 0xFFFF3CCC /begin FUNCTION_LIST /end FUNCTION_LIST /end MEASUREMENT
/begin MEASUREMENT vFGNCUT "Fuel level gauge unusual value cut value" UWORD COMP_0050 1 100 0 5119.921875 ECU_ADDRESS 0xFFFF3CCE /begin FUNCTION_LIST /end FUNCTION_LIST /end MEASUREMENT
/begin MEASUREMENT vFGNST "A reference fuel level gauge voltage for the lubrication judgement" UWORD COMP_0050 1 100 0 5119.921875 ECU_ADDRESS 0xFFFF2D60 /begin FUNCTION_LIST /end FUNCTION_LIST /end MEASUREMENT
/begin MEASUREMENT vFHINJEXZ "A homogeneous injection executive cylinder in front of 1REF" UBYTE COMP_0004 1 100 0 255 ECU_ADDRESS 0xFFFF1FD0 /begin FUNCTION_LIST /end FUNCTION_LIST /end MEASUREMENT
/begin MEASUREMENT vFHTICHG "Homogeneous pulse change permission judgement" UBYTE COMP_0068 1 100 0 255 ECU_ADDRESS 0xFFFF1FD1 /begin FUNCTION_LIST /end FUNCTION_LIST /end MEASUREMENT
/begin MEASUREMENT vFHTMPf "After a KMR release, judgement flag" UBYTE COMP_0004 1 100 0 255 ECU_ADDRESS 0xFFFF138A /begin FUNCTION_LIST /end FUNCTION_LIST /end MEASUREMENT
/begin MEASUREMENT vFHTWRKf "A work flag for fFHTMP" UBYTE COMP_0004 1 100 0 255 ECU_ADDRESS 0xFFFF138B /begin FUNCTION_LIST /end FUNCTION_LIST /end MEASUREMENT
/begin MEASUREMENT vFILDMP "A stable occasion signal" UWORD COMP_0165 1 100 0 511.9921875 ECU_ADDRESS 0xFFFF138C /begin FUNCTION_LIST /end FUNCTION_LIST /end MEASUREMENT
/begin MEASUREMENT vFIMRDYBFf "A DOS control catalyst diagnosis completion flag buffer by the region" UBYTE COMP_0004 1 100 0 255 ECU_ADDRESS 0xFFFF2D69 /begin FUNCTION_LIST /end FUNCTION_LIST /end MEASUREMENT
/begin MEASUREMENT vFIRSTSLf "Slice level setup judgement" UBYTE COMP_0004 1 100 0 255 ECU_ADDRESS 0xFFFF1FD2 /begin FUNCTION_LIST /end FUNCTION_LIST /end MEASUREMENT
/begin MEASUREMENT vFKEISLf "During O2 sensor periodic measuring" UBYTE COMP_0004 1 100 0 255 ECU_ADDRESS 0xFFFF37E6 /begin FUNCTION_LIST /end FUNCTION_LIST /end MEASUREMENT
/begin MEASUREMENT vFKEISOf "O2 sensor periodic measuring timing" UBYTE COMP_0004 1 100 0 255 ECU_ADDRESS 0xFFFF37E7 /begin FUNCTION_LIST /end FUNCTION_LIST /end MEASUREMENT
/begin MEASUREMENT vFLASEED "A seed for FLASH memory writing" ULONG COMP_0068 1 100 0 4294967295 ECU_ADDRESS 0xFFFFB5F8 /begin FUNCTION_LIST /end FUNCTION_LIST /end MEASUREMENT
/begin MEASUREMENT vFLASHRAM "VIN flash write data" UBYTE COMP_0068 1 100 0 255 ECU_ADDRESS 0xFFFF3CDA /begin FUNCTION_LIST /end FUNCTION_LIST /end MEASUREMENT
/begin MEASUREMENT vFLASHRAM_R#1 "VIN flash write data" UBYTE COMP_0068 1 100 0 255 ECU_ADDRESS 0xFFFF3CDA /begin FUNCTION_LIST /end FUNCTION_LIST /end MEASUREMENT
/begin MEASUREMENT vFLASHRAM_R#2 "VIN flash write data" UBYTE COMP_0068 1 100 0 255 ECU_ADDRESS 0xFFFF3CDB /begin FUNCTION_LIST /end FUNCTION_LIST /end MEASUREMENT
/begin MEASUREMENT vFLASHRAM_R#3 "VIN flash write data" UBYTE COMP_0068 1 100 0 255 ECU_ADDRESS 0xFFFF3CDC /begin FUNCTION_LIST /end FUNCTION_LIST /end MEASUREMENT
/begin MEASUREMENT vFLASHRAM_R#4 "VIN flash write data" UBYTE COMP_0068 1 100 0 255 ECU_ADDRESS 0xFFFF3CDD /begin FUNCTION_LIST /end FUNCTION_LIST /end MEASUREMENT
/begin MEASUREMENT vFLASHRAM_R#5 "VIN flash write data" UBYTE COMP_0068 1 100 0 255 ECU_ADDRESS 0xFFFF3CDE /begin FUNCTION_LIST /end FUNCTION_LIST /end MEASUREMENT
/begin MEASUREMENT vFLASHRAM_R#6 "VIN flash write data" UBYTE COMP_0068 1 100 0 255 ECU_ADDRESS 0xFFFF3CDF /begin FUNCTION_LIST /end FUNCTION_LIST /end MEASUREMENT
/begin MEASUREMENT vFLASHRAM_R#7 "VIN flash write data" UBYTE COMP_0068 1 100 0 255 ECU_ADDRESS 0xFFFF3CE0 /begin FUNCTION_LIST /end FUNCTION_LIST /end MEASUREMENT
/begin MEASUREMENT vFLASHRAM_R#8 "VIN flash write data" UBYTE COMP_0068 1 100 0 255 ECU_ADDRESS 0xFFFF3CE1 /begin FUNCTION_LIST /end FUNCTION_LIST /end MEASUREMENT
/begin MEASUREMENT vFLASHRAM_R#9 "VIN flash write data" UBYTE COMP_0068 1 100 0 255 ECU_ADDRESS 0xFFFF3CE2 /begin FUNCTION_LIST /end FUNCTION_LIST /end MEASUREMENT
/begin MEASUREMENT vFLASHRAM_R#10 "VIN flash write data" UBYTE COMP_0068 1 100 0 255 ECU_ADDRESS 0xFFFF3CE3 /begin FUNCTION_LIST /end FUNCTION_LIST /end MEASUREMENT
/begin MEASUREMENT vFLASHRAM_R#11 "VIN flash write data" UBYTE COMP_0068 1 100 0 255 ECU_ADDRESS 0xFFFF3CE4 /begin FUNCTION_LIST /end FUNCTION_LIST /end MEASUREMENT
/begin MEASUREMENT vFLASHRAM_R#12 "VIN flash write data" UBYTE COMP_0068 1 100 0 255 ECU_ADDRESS 0xFFFF3CE5 /begin FUNCTION_LIST /end FUNCTION_LIST /end MEASUREMENT
/begin MEASUREMENT vFLASHRAM_R#13 "VIN flash write data" UBYTE COMP_0068 1 100 0 255 ECU_ADDRESS 0xFFFF3CE6 /begin FUNCTION_LIST /end FUNCTION_LIST /end MEASUREMENT
/begin MEASUREMENT vFLASHRAM_R#14 "VIN flash write data" UBYTE COMP_0068 1 100 0 255 ECU_ADDRESS 0xFFFF3CE7 /begin FUNCTION_LIST /end FUNCTION_LIST /end MEASUREMENT
/begin MEASUREMENT vFLASHRAM_R#15 "VIN flash write data" UBYTE COMP_0068 1 100 0 255 ECU_ADDRESS 0xFFFF3CE8 /begin FUNCTION_LIST /end FUNCTION_LIST /end MEASUREMENT
/begin MEASUREMENT vFLASHRAM_R#16 "VIN flash write data" UBYTE COMP_0068 1 100 0 255 ECU_ADDRESS 0xFFFF3CE9 /begin FUNCTION_LIST /end FUNCTION_LIST /end MEASUREMENT
/begin MEASUREMENT vFLASHRAM_R#17 "VIN flash write data" UBYTE COMP_0068 1 100 0 255 ECU_ADDRESS 0xFFFF3CEA /begin FUNCTION_LIST /end FUNCTION_LIST /end MEASUREMENT
/begin MEASUREMENT vFLASHRAM_R#18 "VIN flash write data" UBYTE COMP_0068 1 100 0 255 ECU_ADDRESS 0xFFFF3CEB /begin FUNCTION_LIST /end FUNCTION_LIST /end MEASUREMENT
/begin MEASUREMENT vFLASHRAM_R#19 "VIN flash write data" UBYTE COMP_0068 1 100 0 255 ECU_ADDRESS 0xFFFF3CEC /begin FUNCTION_LIST /end FUNCTION_LIST /end MEASUREMENT
/begin MEASUREMENT vFLASHRAM_R#20 "VIN flash write data" UBYTE COMP_0068 1 100 0 255 ECU_ADDRESS 0xFFFF3CED /begin FUNCTION_LIST /end FUNCTION_LIST /end MEASUREMENT
/begin MEASUREMENT vFLASHRAM_R#21 "VIN flash write data" UBYTE COMP_0068 1 100 0 255 ECU_ADDRESS 0xFFFF3CEE /begin FUNCTION_LIST /end FUNCTION_LIST /end MEASUREMENT
/begin MEASUREMENT vFLASHRAM_R#22 "VIN flash write data" UBYTE COMP_0068 1 100 0 255 ECU_ADDRESS 0xFFFF3CEF /begin FUNCTION_LIST /end FUNCTION_LIST /end MEASUREMENT
/begin MEASUREMENT vFLASHRAM_R#23 "VIN flash write data" UBYTE COMP_0068 1 100 0 255 ECU_ADDRESS 0xFFFF3CF0 /begin FUNCTION_LIST /end FUNCTION_LIST /end MEASUREMENT
/begin MEASUREMENT vFLASHRAM_R#24 "VIN flash write data" UBYTE COMP_0068 1 100 0 255 ECU_ADDRESS 0xFFFF3CF1 /begin FUNCTION_LIST /end FUNCTION_LIST /end MEASUREMENT
/begin MEASUREMENT vFLASHRAM_R#25 "VIN flash write data" UBYTE COMP_0068 1 100 0 255 ECU_ADDRESS 0xFFFF3CF2 /begin FUNCTION_LIST /end FUNCTION_LIST /end MEASUREMENT
/begin MEASUREMENT vFLASHRAM_R#26 "VIN flash write data" UBYTE COMP_0068 1 100 0 255 ECU_ADDRESS 0xFFFF3CF3 /begin FUNCTION_LIST /end FUNCTION_LIST /end MEASUREMENT
/begin MEASUREMENT vFLASHRAM_R#27 "VIN flash write data" UBYTE COMP_0068 1 100 0 255 ECU_ADDRESS 0xFFFF3CF4 /begin FUNCTION_LIST /end FUNCTION_LIST /end MEASUREMENT
/begin MEASUREMENT vFLASHRAM_R#28 "VIN flash write data" UBYTE COMP_0068 1 100 0 255 ECU_ADDRESS 0xFFFF3CF5 /begin FUNCTION_LIST /end FUNCTION_LIST /end MEASUREMENT
/begin MEASUREMENT vFLASHRAM_R#29 "VIN flash write data" UBYTE COMP_0068 1 100 0 255 ECU_ADDRESS 0xFFFF3CF6 /begin FUNCTION_LIST /end FUNCTION_LIST /end MEASUREMENT
/begin MEASUREMENT vFLASHRAM_R#30 "VIN flash write data" UBYTE COMP_0068 1 100 0 255 ECU_ADDRESS 0xFFFF3CF7 /begin FUNCTION_LIST /end FUNCTION_LIST /end MEASUREMENT
/begin MEASUREMENT vFLASHRAM_R#31 "VIN flash write data" UBYTE COMP_0068 1 100 0 255 ECU_ADDRESS 0xFFFF3CF8 /begin FUNCTION_LIST /end FUNCTION_LIST /end MEASUREMENT
/begin MEASUREMENT vFLASHRAM_R#32 "VIN flash write data" UBYTE COMP_0068 1 100 0 255 ECU_ADDRESS 0xFFFF3CF9 /begin FUNCTION_LIST /end FUNCTION_LIST /end MEASUREMENT
/begin MEASUREMENT vFLASHRAM_R#33 "VIN flash write data" UBYTE COMP_0068 1 100 0 255 ECU_ADDRESS 0xFFFF3CFA /begin FUNCTION_LIST /end FUNCTION_LIST /end MEASUREMENT
/begin MEASUREMENT vFLASHRAM_R#34 "VIN flash write data" UBYTE COMP_0068 1 100 0 255 ECU_ADDRESS 0xFFFF3CFB /begin FUNCTION_LIST /end FUNCTION_LIST /end MEASUREMENT
/begin MEASUREMENT vFLASHRAM_R#35 "VIN flash write data" UBYTE COMP_0068 1 100 0 255 ECU_ADDRESS 0xFFFF3CFC /begin FUNCTION_LIST /end FUNCTION_LIST /end MEASUREMENT
/begin MEASUREMENT vFLASHRAM_R#36 "VIN flash write data" UBYTE COMP_0068 1 100 0 255 ECU_ADDRESS 0xFFFF3CFD /begin FUNCTION_LIST /end FUNCTION_LIST /end MEASUREMENT
/begin MEASUREMENT vFLASHRAM_R#37 "VIN flash write data" UBYTE COMP_0068 1 100 0 255 ECU_ADDRESS 0xFFFF3CFE /begin FUNCTION_LIST /end FUNCTION_LIST /end MEASUREMENT
/begin MEASUREMENT vFLASHRAM_R#38 "VIN flash write data" UBYTE COMP_0068 1 100 0 255 ECU_ADDRESS 0xFFFF3CFF /begin FUNCTION_LIST /end FUNCTION_LIST /end MEASUREMENT
/begin MEASUREMENT vFLASHRAM_R#39 "VIN flash write data" UBYTE COMP_0068 1 100 0 255 ECU_ADDRESS 0xFFFF3D00 /begin FUNCTION_LIST /end FUNCTION_LIST /end MEASUREMENT
/begin MEASUREMENT vFLASHRAM_R#40 "VIN flash write data" UBYTE COMP_0068 1 100 0 255 ECU_ADDRESS 0xFFFF3D01 /begin FUNCTION_LIST /end FUNCTION_LIST /end MEASUREMENT
/begin MEASUREMENT vFLASHRAM_R#41 "VIN flash write data" UBYTE COMP_0068 1 100 0 255 ECU_ADDRESS 0xFFFF3D02 /begin FUNCTION_LIST /end FUNCTION_LIST /end MEASUREMENT
/begin MEASUREMENT vFLASHRAM_R#42 "VIN flash write data" UBYTE COMP_0068 1 100 0 255 ECU_ADDRESS 0xFFFF3D03 /begin FUNCTION_LIST /end FUNCTION_LIST /end MEASUREMENT
/begin MEASUREMENT vFLASHRAM_R#43 "VIN flash write data" UBYTE COMP_0068 1 100 0 255 ECU_ADDRESS 0xFFFF3D04 /begin FUNCTION_LIST /end FUNCTION_LIST /end MEASUREMENT
/begin MEASUREMENT vFLASHRAM_R#44 "VIN flash write data" UBYTE COMP_0068 1 100 0 255 ECU_ADDRESS 0xFFFF3D05 /begin FUNCTION_LIST /end FUNCTION_LIST /end MEASUREMENT
/begin MEASUREMENT vFLASHRAM_R#45 "VIN flash write data" UBYTE COMP_0068 1 100 0 255 ECU_ADDRESS 0xFFFF3D06 /begin FUNCTION_LIST /end FUNCTION_LIST /end MEASUREMENT
/begin MEASUREMENT vFLASHRAM_R#46 "VIN flash write data" UBYTE COMP_0068 1 100 0 255 ECU_ADDRESS 0xFFFF3D07 /begin FUNCTION_LIST /end FUNCTION_LIST /end MEASUREMENT
/begin MEASUREMENT vFLASHRAM_R#47 "VIN flash write data" UBYTE COMP_0068 1 100 0 255 ECU_ADDRESS 0xFFFF3D08 /begin FUNCTION_LIST /end FUNCTION_LIST /end MEASUREMENT
/begin MEASUREMENT vFLASHRAM_R#48 "VIN flash write data" UBYTE COMP_0068 1 100 0 255 ECU_ADDRESS 0xFFFF3D09 /begin FUNCTION_LIST /end FUNCTION_LIST /end MEASUREMENT
/begin MEASUREMENT vFLASHRAM_R#49 "VIN flash write data" UBYTE COMP_0068 1 100 0 255 ECU_ADDRESS 0xFFFF3D0A /begin FUNCTION_LIST /end FUNCTION_LIST /end MEASUREMENT
/begin MEASUREMENT vFLASHRAM_R#50 "VIN flash write data" UBYTE COMP_0068 1 100 0 255 ECU_ADDRESS 0xFFFF3D0B /begin FUNCTION_LIST /end FUNCTION_LIST /end MEASUREMENT
/begin MEASUREMENT vFLASHRAM_R#51 "VIN flash write data" UBYTE COMP_0068 1 100 0 255 ECU_ADDRESS 0xFFFF3D0C /begin FUNCTION_LIST /end FUNCTION_LIST /end MEASUREMENT
/begin MEASUREMENT vFLASHRAM_R#52 "VIN flash write data" UBYTE COMP_0068 1 100 0 255 ECU_ADDRESS 0xFFFF3D0D /begin FUNCTION_LIST /end FUNCTION_LIST /end MEASUREMENT
/begin MEASUREMENT vFLASHRAM_R#53 "VIN flash write data" UBYTE COMP_0068 1 100 0 255 ECU_ADDRESS 0xFFFF3D0E /begin FUNCTION_LIST /end FUNCTION_LIST /end MEASUREMENT
/begin MEASUREMENT vFLASHRAM_R#54 "VIN flash write data" UBYTE COMP_0068 1 100 0 255 ECU_ADDRESS 0xFFFF3D0F /begin FUNCTION_LIST /end FUNCTION_LIST /end MEASUREMENT
/begin MEASUREMENT vFLASHRAM_R#55 "VIN flash write data" UBYTE COMP_0068 1 100 0 255 ECU_ADDRESS 0xFFFF3D10 /begin FUNCTION_LIST /end FUNCTION_LIST /end MEASUREMENT
/begin MEASUREMENT vFLASHRAM_R#56 "VIN flash write data" UBYTE COMP_0068 1 100 0 255 ECU_ADDRESS 0xFFFF3D11 /begin FUNCTION_LIST /end FUNCTION_LIST /end MEASUREMENT
/begin MEASUREMENT vFLASHRAM_R#57 "VIN flash write data" UBYTE COMP_0068 1 100 0 255 ECU_ADDRESS 0xFFFF3D12 /begin FUNCTION_LIST /end FUNCTION_LIST /end MEASUREMENT
/begin MEASUREMENT vFLASHRAM_R#58 "VIN flash write data" UBYTE COMP_0068 1 100 0 255 ECU_ADDRESS 0xFFFF3D13 /begin FUNCTION_LIST /end FUNCTION_LIST /end MEASUREMENT
/begin MEASUREMENT vFLASHRAM_R#59 "VIN flash write data" UBYTE COMP_0068 1 100 0 255 ECU_ADDRESS 0xFFFF3D14 /begin FUNCTION_LIST /end FUNCTION_LIST /end MEASUREMENT
/begin MEASUREMENT vFLASHRAM_R#60 "VIN flash write data" UBYTE COMP_0068 1 100 0 255 ECU_ADDRESS 0xFFFF3D15 /begin FUNCTION_LIST /end FUNCTION_LIST /end MEASUREMENT
/begin MEASUREMENT vFLASHRAM_R#61 "VIN flash write data" UBYTE COMP_0068 1 100 0 255 ECU_ADDRESS 0xFFFF3D16 /begin FUNCTION_LIST /end FUNCTION_LIST /end MEASUREMENT
/begin MEASUREMENT vFLASHRAM_R#62 "VIN flash write data" UBYTE COMP_0068 1 100 0 255 ECU_ADDRESS 0xFFFF3D17 /begin FUNCTION_LIST /end FUNCTION_LIST /end MEASUREMENT
/begin MEASUREMENT vFLASHRAM_R#63 "VIN flash write data" UBYTE COMP_0068 1 100 0 255 ECU_ADDRESS 0xFFFF3D18 /begin FUNCTION_LIST /end FUNCTION_LIST /end MEASUREMENT
/begin MEASUREMENT vFLASHRAM_R#64 "VIN flash write data" UBYTE COMP_0068 1 100 0 255 ECU_ADDRESS 0xFFFF3D19 /begin FUNCTION_LIST /end FUNCTION_LIST /end MEASUREMENT
/begin MEASUREMENT vFLASHRAM_R#65 "VIN flash write data" UBYTE COMP_0068 1 100 0 255 ECU_ADDRESS 0xFFFF3D1A /begin FUNCTION_LIST /end FUNCTION_LIST /end MEASUREMENT
/begin MEASUREMENT vFLASHRAM_R#66 "VIN flash write data" UBYTE COMP_0068 1 100 0 255 ECU_ADDRESS 0xFFFF3D1B /begin FUNCTION_LIST /end FUNCTION_LIST /end MEASUREMENT
/begin MEASUREMENT vFLASHRAM_R#67 "VIN flash write data" UBYTE COMP_0068 1 100 0 255 ECU_ADDRESS 0xFFFF3D1C /begin FUNCTION_LIST /end FUNCTION_LIST /end MEASUREMENT
/begin MEASUREMENT vFLASHRAM_R#68 "VIN flash write data" UBYTE COMP_0068 1 100 0 255 ECU_ADDRESS 0xFFFF3D1D /begin FUNCTION_LIST /end FUNCTION_LIST /end MEASUREMENT
/begin MEASUREMENT vFLASHRAM_R#69 "VIN flash write data" UBYTE COMP_0068 1 100 0 255 ECU_ADDRESS 0xFFFF3D1E /begin FUNCTION_LIST /end FUNCTION_LIST /end MEASUREMENT
/begin MEASUREMENT vFLASHRAM_R#70 "VIN flash write data" UBYTE COMP_0068 1 100 0 255 ECU_ADDRESS 0xFFFF3D1F /begin FUNCTION_LIST /end FUNCTION_LIST /end MEASUREMENT
/begin MEASUREMENT vFLASHRAM_R#71 "VIN flash write data" UBYTE COMP_0068 1 100 0 255 ECU_ADDRESS 0xFFFF3D20 /begin FUNCTION_LIST /end FUNCTION_LIST /end MEASUREMENT
/begin MEASUREMENT vFLASHRAM_R#72 "VIN flash write data" UBYTE COMP_0068 1 100 0 255 ECU_ADDRESS 0xFFFF3D21 /begin FUNCTION_LIST /end FUNCTION_LIST /end MEASUREMENT
/begin MEASUREMENT vFLASHRAM_R#73 "VIN flash write data" UBYTE COMP_0068 1 100 0 255 ECU_ADDRESS 0xFFFF3D22 /begin FUNCTION_LIST /end FUNCTION_LIST /end MEASUREMENT
/begin MEASUREMENT vFLASHRAM_R#74 "VIN flash write data" UBYTE COMP_0068 1 100 0 255 ECU_ADDRESS 0xFFFF3D23 /begin FUNCTION_LIST /end FUNCTION_LIST /end MEASUREMENT
/begin MEASUREMENT vFLASHRAM_R#75 "VIN flash write data" UBYTE COMP_0068 1 100 0 255 ECU_ADDRESS 0xFFFF3D24 /begin FUNCTION_LIST /end FUNCTION_LIST /end MEASUREMENT
/begin MEASUREMENT vFLASHRAM_R#76 "VIN flash write data" UBYTE COMP_0068 1 100 0 255 ECU_ADDRESS 0xFFFF3D25 /begin FUNCTION_LIST /end FUNCTION_LIST /end MEASUREMENT
/begin MEASUREMENT vFLASHRAM_R#77 "VIN flash write data" UBYTE COMP_0068 1 100 0 255 ECU_ADDRESS 0xFFFF3D26 /begin FUNCTION_LIST /end FUNCTION_LIST /end MEASUREMENT
/begin MEASUREMENT vFLASHRAM_R#78 "VIN flash write data" UBYTE COMP_0068 1 100 0 255 ECU_ADDRESS 0xFFFF3D27 /begin FUNCTION_LIST /end FUNCTION_LIST /end MEASUREMENT
/begin MEASUREMENT vFLASHRAM_R#79 "VIN flash write data" UBYTE COMP_0068 1 100 0 255 ECU_ADDRESS 0xFFFF3D28 /begin FUNCTION_LIST /end FUNCTION_LIST /end MEASUREMENT
/begin MEASUREMENT vFLASHRAM_R#80 "VIN flash write data" UBYTE COMP_0068 1 100 0 255 ECU_ADDRESS 0xFFFF3D29 /begin FUNCTION_LIST /end FUNCTION_LIST /end MEASUREMENT
/begin MEASUREMENT vFLASHRAM_R#81 "VIN flash write data" UBYTE COMP_0068 1 100 0 255 ECU_ADDRESS 0xFFFF3D2A /begin FUNCTION_LIST /end FUNCTION_LIST /end MEASUREMENT
/begin MEASUREMENT vFLASHRAM_R#82 "VIN flash write data" UBYTE COMP_0068 1 100 0 255 ECU_ADDRESS 0xFFFF3D2B /begin FUNCTION_LIST /end FUNCTION_LIST /end MEASUREMENT
/begin MEASUREMENT vFLASHRAM_R#83 "VIN flash write data" UBYTE COMP_0068 1 100 0 255 ECU_ADDRESS 0xFFFF3D2C /begin FUNCTION_LIST /end FUNCTION_LIST /end MEASUREMENT
/begin MEASUREMENT vFLASHRAM_R#84 "VIN flash write data" UBYTE COMP_0068 1 100 0 255 ECU_ADDRESS 0xFFFF3D2D /begin FUNCTION_LIST /end FUNCTION_LIST /end MEASUREMENT
/begin MEASUREMENT vFLASHRAM_R#85 "VIN flash write data" UBYTE COMP_0068 1 100 0 255 ECU_ADDRESS 0xFFFF3D2E /begin FUNCTION_LIST /end FUNCTION_LIST /end MEASUREMENT
/begin MEASUREMENT vFLASHRAM_R#86 "VIN flash write data" UBYTE COMP_0068 1 100 0 255 ECU_ADDRESS 0xFFFF3D2F /begin FUNCTION_LIST /end FUNCTION_LIST /end MEASUREMENT
/begin MEASUREMENT vFLASHRAM_R#87 "VIN flash write data" UBYTE COMP_0068 1 100 0 255 ECU_ADDRESS 0xFFFF3D30 /begin FUNCTION_LIST /end FUNCTION_LIST /end MEASUREMENT
/begin MEASUREMENT vFLASHRAM_R#88 "VIN flash write data" UBYTE COMP_0068 1 100 0 255 ECU_ADDRESS 0xFFFF3D31 /begin FUNCTION_LIST /end FUNCTION_LIST /end MEASUREMENT
/begin MEASUREMENT vFLASHRAM_R#89 "VIN flash write data" UBYTE COMP_0068 1 100 0 255 ECU_ADDRESS 0xFFFF3D32 /begin FUNCTION_LIST /end FUNCTION_LIST /end MEASUREMENT
/begin MEASUREMENT vFLASHRAM_R#90 "VIN flash write data" UBYTE COMP_0068 1 100 0 255 ECU_ADDRESS 0xFFFF3D33 /begin FUNCTION_LIST /end FUNCTION_LIST /end MEASUREMENT
/begin MEASUREMENT vFLASHRAM_R#91 "VIN flash write data" UBYTE COMP_0068 1 100 0 255 ECU_ADDRESS 0xFFFF3D34 /begin FUNCTION_LIST /end FUNCTION_LIST /end MEASUREMENT
/begin MEASUREMENT vFLASHRAM_R#92 "VIN flash write data" UBYTE COMP_0068 1 100 0 255 ECU_ADDRESS 0xFFFF3D35 /begin FUNCTION_LIST /end FUNCTION_LIST /end MEASUREMENT
/begin MEASUREMENT vFLASHRAM_R#93 "VIN flash write data" UBYTE COMP_0068 1 100 0 255 ECU_ADDRESS 0xFFFF3D36 /begin FUNCTION_LIST /end FUNCTION_LIST /end MEASUREMENT
/begin MEASUREMENT vFLASHRAM_R#94 "VIN flash write data" UBYTE COMP_0068 1 100 0 255 ECU_ADDRESS 0xFFFF3D37 /begin FUNCTION_LIST /end FUNCTION_LIST /end MEASUREMENT
/begin MEASUREMENT vFLASHRAM_R#95 "VIN flash write data" UBYTE COMP_0068 1 100 0 255 ECU_ADDRESS 0xFFFF3D38 /begin FUNCTION_LIST /end FUNCTION_LIST /end MEASUREMENT
/begin MEASUREMENT vFLASHRAM_R#96 "VIN flash write data" UBYTE COMP_0068 1 100 0 255 ECU_ADDRESS 0xFFFF3D39 /begin FUNCTION_LIST /end FUNCTION_LIST /end MEASUREMENT
/begin MEASUREMENT vFLASHRAM_R#97 "VIN flash write data" UBYTE COMP_0068 1 100 0 255 ECU_ADDRESS 0xFFFF3D3A /begin FUNCTION_LIST /end FUNCTION_LIST /end MEASUREMENT
/begin MEASUREMENT vFLASHRAM_R#98 "VIN flash write data" UBYTE COMP_0068 1 100 0 255 ECU_ADDRESS 0xFFFF3D3B /begin FUNCTION_LIST /end FUNCTION_LIST /end MEASUREMENT
/begin MEASUREMENT vFLASHRAM_R#99 "VIN flash write data" UBYTE COMP_0068 1 100 0 255 ECU_ADDRESS 0xFFFF3D3C /begin FUNCTION_LIST /end FUNCTION_LIST /end MEASUREMENT
/begin MEASUREMENT vFLASHRAM_R#100 "VIN flash write data" UBYTE COMP_0068 1 100 0 255 ECU_ADDRESS 0xFFFF3D3D /begin FUNCTION_LIST /end FUNCTION_LIST /end MEASUREMENT
/begin MEASUREMENT vFLASHRAM_R#101 "VIN flash write data" UBYTE COMP_0068 1 100 0 255 ECU_ADDRESS 0xFFFF3D3E /begin FUNCTION_LIST /end FUNCTION_LIST /end MEASUREMENT
/begin MEASUREMENT vFLASHRAM_R#102 "VIN flash write data" UBYTE COMP_0068 1 100 0 255 ECU_ADDRESS 0xFFFF3D3F /begin FUNCTION_LIST /end FUNCTION_LIST /end MEASUREMENT
/begin MEASUREMENT vFLASHRAM_R#103 "VIN flash write data" UBYTE COMP_0068 1 100 0 255 ECU_ADDRESS 0xFFFF3D40 /begin FUNCTION_LIST /end FUNCTION_LIST /end MEASUREMENT
/begin MEASUREMENT vFLASHRAM_R#104 "VIN flash write data" UBYTE COMP_0068 1 100 0 255 ECU_ADDRESS 0xFFFF3D41 /begin FUNCTION_LIST /end FUNCTION_LIST /end MEASUREMENT
/begin MEASUREMENT vFLASHRAM_R#105 "VIN flash write data" UBYTE COMP_0068 1 100 0 255 ECU_ADDRESS 0xFFFF3D42 /begin FUNCTION_LIST /end FUNCTION_LIST /end MEASUREMENT
/begin MEASUREMENT vFLASHRAM_R#106 "VIN flash write data" UBYTE COMP_0068 1 100 0 255 ECU_ADDRESS 0xFFFF3D43 /begin FUNCTION_LIST /end FUNCTION_LIST /end MEASUREMENT
/begin MEASUREMENT vFLASHRAM_R#107 "VIN flash write data" UBYTE COMP_0068 1 100 0 255 ECU_ADDRESS 0xFFFF3D44 /begin FUNCTION_LIST /end FUNCTION_LIST /end MEASUREMENT
/begin MEASUREMENT vFLASHRAM_R#108 "VIN flash write data" UBYTE COMP_0068 1 100 0 255 ECU_ADDRESS 0xFFFF3D45 /begin FUNCTION_LIST /end FUNCTION_LIST /end MEASUREMENT
/begin MEASUREMENT vFLASHRAM_R#109 "VIN flash write data" UBYTE COMP_0068 1 100 0 255 ECU_ADDRESS 0xFFFF3D46 /begin FUNCTION_LIST /end FUNCTION_LIST /end MEASUREMENT
/begin MEASUREMENT vFLASHRAM_R#110 "VIN flash write data" UBYTE COMP_0068 1 100 0 255 ECU_ADDRESS 0xFFFF3D47 /begin FUNCTION_LIST /end FUNCTION_LIST /end MEASUREMENT
/begin MEASUREMENT vFLASHRAM_R#111 "VIN flash write data" UBYTE COMP_0068 1 100 0 255 ECU_ADDRESS 0xFFFF3D48 /begin FUNCTION_LIST /end FUNCTION_LIST /end MEASUREMENT
/begin MEASUREMENT vFLASHRAM_R#112 "VIN flash write data" UBYTE COMP_0068 1 100 0 255 ECU_ADDRESS 0xFFFF3D49 /begin FUNCTION_LIST /end FUNCTION_LIST /end MEASUREMENT
/begin MEASUREMENT vFLASHRAM_R#113 "VIN flash write data" UBYTE COMP_0068 1 100 0 255 ECU_ADDRESS 0xFFFF3D4A /begin FUNCTION_LIST /end FUNCTION_LIST /end MEASUREMENT
/begin MEASUREMENT vFLASHRAM_R#114 "VIN flash write data" UBYTE COMP_0068 1 100 0 255 ECU_ADDRESS 0xFFFF3D4B /begin FUNCTION_LIST /end FUNCTION_LIST /end MEASUREMENT
/begin MEASUREMENT vFLASHRAM_R#115 "VIN flash write data" UBYTE COMP_0068 1 100 0 255 ECU_ADDRESS 0xFFFF3D4C /begin FUNCTION_LIST /end FUNCTION_LIST /end MEASUREMENT
/begin MEASUREMENT vFLASHRAM_R#116 "VIN flash write data" UBYTE COMP_0068 1 100 0 255 ECU_ADDRESS 0xFFFF3D4D /begin FUNCTION_LIST /end FUNCTION_LIST /end MEASUREMENT
/begin MEASUREMENT vFLASHRAM_R#117 "VIN flash write data" UBYTE COMP_0068 1 100 0 255 ECU_ADDRESS 0xFFFF3D4E /begin FUNCTION_LIST /end FUNCTION_LIST /end MEASUREMENT
/begin MEASUREMENT vFLASHRAM_R#118 "VIN flash write data" UBYTE COMP_0068 1 100 0 255 ECU_ADDRESS 0xFFFF3D4F /begin FUNCTION_LIST /end FUNCTION_LIST /end MEASUREMENT
/begin MEASUREMENT vFLASHRAM_R#119 "VIN flash write data" UBYTE COMP_0068 1 100 0 255 ECU_ADDRESS 0xFFFF3D50 /begin FUNCTION_LIST /end FUNCTION_LIST /end MEASUREMENT
/begin MEASUREMENT vFLASHRAM_R#120 "VIN flash write data" UBYTE COMP_0068 1 100 0 255 ECU_ADDRESS 0xFFFF3D51 /begin FUNCTION_LIST /end FUNCTION_LIST /end MEASUREMENT
/begin MEASUREMENT vFLASHRAM_R#121 "VIN flash write data" UBYTE COMP_0068 1 100 0 255 ECU_ADDRESS 0xFFFF3D52 /begin FUNCTION_LIST /end FUNCTION_LIST /end MEASUREMENT
/begin MEASUREMENT vFLASHRAM_R#122 "VIN flash write data" UBYTE COMP_0068 1 100 0 255 ECU_ADDRESS 0xFFFF3D53 /begin FUNCTION_LIST /end FUNCTION_LIST /end MEASUREMENT
/begin MEASUREMENT vFLASHRAM_R#123 "VIN flash write data" UBYTE COMP_0068 1 100 0 255 ECU_ADDRESS 0xFFFF3D54 /begin FUNCTION_LIST /end FUNCTION_LIST /end MEASUREMENT
/begin MEASUREMENT vFLASHRAM_R#124 "VIN flash write data" UBYTE COMP_0068 1 100 0 255 ECU_ADDRESS 0xFFFF3D55 /begin FUNCTION_LIST /end FUNCTION_LIST /end MEASUREMENT
/begin MEASUREMENT vFLASHRAM_R#125 "VIN flash write data" UBYTE COMP_0068 1 100 0 255 ECU_ADDRESS 0xFFFF3D56 /begin FUNCTION_LIST /end FUNCTION_LIST /end MEASUREMENT
/begin MEASUREMENT vFLASHRAM_R#126 "VIN flash write data" UBYTE COMP_0068 1 100 0 255 ECU_ADDRESS 0xFFFF3D57 /begin FUNCTION_LIST /end FUNCTION_LIST /end MEASUREMENT
/begin MEASUREMENT vFLASHRAM_R#127 "VIN flash write data" UBYTE COMP_0068 1 100 0 255 ECU_ADDRESS 0xFFFF3D58 /begin FUNCTION_LIST /end FUNCTION_LIST /end MEASUREMENT
/begin COMPU_METHOD COMP_0068 "1-" RAT_FUNC "%8.2" "-" COEFFS 0 1 0 0 0 1 /end COMPU_METHOD
/begin COMPU_METHOD COMP_0004 "1Å|" RAT_FUNC "%8.2" "Å|" COEFFS 0 1 0 0 0 1 /end COMPU_METHOD
/begin COMPU_METHOD COMP_0023 "5mV" RAT_FUNC "%8.2" "mV" COEFFS 0 1 0 0 0 5 /end COMPU_METHOD
/begin COMPU_METHOD COMP_0001 "1/8ms" RAT_FUNC "%8.2" "ms" COEFFS 0 1 0 0 0 0.125 /end COMPU_METHOD
/begin COMPU_METHOD COMP_0002 "0.35deg" RAT_FUNC "%8.2" "deg" COEFFS 0 1 0 0 0 0.35 /end COMPU_METHOD
/begin COMPU_METHOD COMP_0003 "1Åé" RAT_FUNC "%8.2" "Åé" COEFFS 0 1 0 0 0 1 /end COMPU_METHOD
/begin COMPU_METHOD COMP_0014 "10ms" RAT_FUNC "%8.2" "ms" COEFFS 0 1 0 0 0 10 /end COMPU_METHOD
/begin COMPU_METHOD COMP_0008 "100ms" RAT_FUNC "%8.2" "ms" COEFFS 0 1 0 0 0 100 /end COMPU_METHOD
/begin COMPU_METHOD COMP_0013 "1s" RAT_FUNC "%8.2" "s" COEFFS 0 1 0 0 0 1 /end COMPU_METHOD
/begin COMPU_METHOD COMP_0047 "0.5%" RAT_FUNC "%8.2" "%" COEFFS 0 1 0 0 0 0.5 /end COMPU_METHOD
/begin COMPU_METHOD COMP_0163 "1/16%" RAT_FUNC "%8.3" "%" COEFFS 0 1 0 0 0 0.0625 /end COMPU_METHOD
/begin COMPU_METHOD COMP_0007 "2km/h" RAT_FUNC "%8.2" "km/h" COEFFS 0 1 0 0 0 2 /end COMPU_METHOD
/begin COMPU_METHOD COMP_0027 "1%" RAT_FUNC "%8.2" "%" COEFFS 0 1 0 0 0 1 /end COMPU_METHOD
/begin COMPU_METHOD COMP_0049 "1sec" RAT_FUNC "%8.2" "sec" COEFFS 0 1 0 0 0 1 /end COMPU_METHOD
/begin COMPU_METHOD COMP_0032 "1/256Å|" RAT_FUNC "%8.4" "Å|" COEFFS 0 1 0 0 0 0.00390625 /end COMPU_METHOD
/begin COMPU_METHOD COMP_0030 "1âÒ" RAT_FUNC "%8.2" "âÒ" COEFFS 0 1 0 0 0 1 /end COMPU_METHOD
/begin COMPU_METHOD COMP_0031 "1/256%" RAT_FUNC "%8.4" "%" COEFFS 0 1 0 0 0 0.00390625 /end COMPU_METHOD
/begin COMPU_METHOD COMP_0053_S "deg/150msdeg/150m" RAT_FUNC "%8.2" "deg/150m" COEFFS 0 1 0 0 0 0.35 /end COMPU_METHOD
/begin COMPU_METHOD COMP_0005 "0.11deg" RAT_FUNC "%8.2" "deg" COEFFS 0 1 0 0 0 0.11 /end COMPU_METHOD
/begin COMPU_METHOD COMP_0362_S "0.125%" RAT_FUNC "%8.2" "%" COEFFS 0 1 0 0 0 0.125 /end COMPU_METHOD
/begin COMPU_METHOD COMP_0183 "20ms" RAT_FUNC "%8.2" "ms" COEFFS 0 1 0 0 0 20 /end COMPU_METHOD
/begin COMPU_METHOD COMP_0044 "1/128Å|" RAT_FUNC "%8.4" "Å|" COEFFS 0 1 0 0 0 0.0078125 /end COMPU_METHOD
/begin COMPU_METHOD COMP_0370_S "20/256mV/100ms" RAT_FUNC "%8.3" "mV/100ms" COEFFS 0 1 0 0 0 0.078125 /end COMPU_METHOD
/begin COMPU_METHOD COMP_0016 "1count" RAT_FUNC "%8.2" "count" COEFFS 0 1 0 0 0 1 /end COMPU_METHOD
/begin COMPU_METHOD COMP_0054 "20mV" RAT_FUNC "%8.2" "mV" COEFFS 0 1 0 0 0 20 /end COMPU_METHOD
/begin COMPU_METHOD COMP_0050 "5/64mV" RAT_FUNC "%8.3" "mV" COEFFS 0 1 0 0 0 0.078125 /end COMPU_METHOD
/begin COMPU_METHOD COMP_0035 "X-50Åé" RAT_FUNC "%8.2" "Åé" COEFFS 0 1 50 0 0 1 /end COMPU_METHOD
/begin COMPU_METHOD COMP_0228 "0.1Nm" RAT_FUNC "%8.2" "Nm" COEFFS 0 1 0 0 0 0.1 /end COMPU_METHOD
/begin COMPU_METHOD COMP_0095 "400/256%" RAT_FUNC "%8.2" "%" COEFFS 0 1 0 0 0 1.5625 /end COMPU_METHOD
/begin COMPU_METHOD COMP_0410 "100/256/256%" RAT_FUNC "%8.4" "%" COEFFS 0 1 0 0 0 0.00152588 /end COMPU_METHOD
/begin COMPU_METHOD COMP_0456 "1/(256Å~128)-" RAT_FUNC "%8.6" "-" COEFFS 0 1 0 0 0 0.0000305176 /end COMPU_METHOD
/begin COMPU_METHOD COMP_0256 "64/128degCA" RAT_FUNC "%8.2" "degCA" COEFFS 0 1 64 0 0 0.5 /end COMPU_METHOD
/begin COMPU_METHOD COMP_0073 "3.2us" RAT_FUNC "%8.2" "us" COEFFS 0 1 0 0 0 3.2 /end COMPU_METHOD
/begin COMPU_METHOD COMP_0025 "0.5step" RAT_FUNC "%8.2" "step" COEFFS 0 1 0 0 0 0.5 /end COMPU_METHOD
/begin COMPU_METHOD COMP_0229 "2km/h" RAT_FUNC "%8.2" "km/h" COEFFS 0 1 256 0 0 2 /end COMPU_METHOD
/begin COMPU_METHOD COMP_0092 "1bit" RAT_FUNC "%8.2" "bit" COEFFS 0 1 0 0 0 1 /end COMPU_METHOD
/begin COMPU_METHOD COMP_0491_S "1mbar" RAT_FUNC "%8.2" "mbar" COEFFS 0 1 0 0 0 1 /end COMPU_METHOD
/begin COMPU_METHOD COMP_0378 "100/255%" RAT_FUNC "%8.2" "%" COEFFS 0 1 0 0 0 0.392156863 /end COMPU_METHOD
/begin COMPU_METHOD COMP_0140 "0.5STEP" RAT_FUNC "%8.2" "STEP" COEFFS 0 1 0 0 0 0.5 /end COMPU_METHOD
/begin COMPU_METHOD COMP_0264 "1Å|" RAT_FUNC "%8.2" "Å|" COEFFS 0 1 0 0 0 1 /end COMPU_METHOD
/begin COMPU_METHOD COMP_0118 "40mV" RAT_FUNC "%8.2" "mV" COEFFS 0 1 0 0 0 40 /end COMPU_METHOD
/begin COMPU_METHOD COMP_0189 "3.2É S" RAT_FUNC "%8.2" "É S" COEFFS 0 1 0 0 0 3.2 /end COMPU_METHOD
/begin COMPU_METHOD COMP_0062_S "AA" RAT_FUNC "%8.2" "A" COEFFS 0 1 0 0 0 1 /end COMPU_METHOD
/begin COMPU_METHOD COMP_0385 "1.608km" RAT_FUNC "%8.2" "km" COEFFS 0 1 0 0 0 1.608 /end COMPU_METHOD
/begin COMPU_METHOD COMP_0390 "10deg" RAT_FUNC "%8.2" "deg" COEFFS 0 1 0 0 0 10 /end COMPU_METHOD
/begin COMPU_METHOD COMP_0399 "4Åé" RAT_FUNC "%8.2" "Åé" COEFFS 0 1 512 0 0 4 /end COMPU_METHOD
/begin COMPU_METHOD COMP_0583_S "%/80ms%/80ms" RAT_FUNC "%8.2" "%/80ms" COEFFS 0 1 0 0 0 0.125 /end COMPU_METHOD
/begin COMPU_METHOD COMP_0584_S "deg/100nsdeg/100n" RAT_FUNC "%8.2" "deg/100n" COEFFS 0 1 0 0 0 0.35 /end COMPU_METHOD
/begin COMPU_METHOD COMP_0153 "X-128%" RAT_FUNC "%8.2" "%" COEFFS 0 1 128 0 0 1 /end COMPU_METHOD
/begin COMPU_METHOD COMP_0026_S "degdeg" RAT_FUNC "%8.2" "deg" COEFFS 0 1 0 0 0 0.1 /end COMPU_METHOD
/begin COMPU_METHOD COMP_0585_S "mVmV" RAT_FUNC "%8.3" "mV" COEFFS 0 1 2560 0 0 0.078125 /end COMPU_METHOD
/begin COMPU_METHOD COMP_0403 "1Åé/10s" RAT_FUNC "%8.2" "Åé/10s" COEFFS 0 1 0 0 0 1 /end COMPU_METHOD
/begin COMPU_METHOD COMP_0050_S "Åé/mEGRTM1[sec]Åé/mEGRT" RAT_FUNC "%8.2" "Åé/mEGRT" COEFFS 0 1 0 0 0 1 /end COMPU_METHOD
/begin COMPU_METHOD COMP_0345 "0.0032cm**2" RAT_FUNC "%8.4" "cm**2" COEFFS 0 1 0 0 0 0.0032 /end COMPU_METHOD
/begin COMPU_METHOD COMP_0411 "1step" RAT_FUNC "%8.2" "step" COEFFS 0 1 0 0 0 1 /end COMPU_METHOD
/begin COMPU_METHOD COMP_0588_S "ROMÉAÉhÉåÉXROMÉAÉh" RAT_FUNC "%8.2" "ROMÉAÉh" COEFFS 0 1 0 0 0 1 /end COMPU_METHOD
/begin COMPU_METHOD COMP_0413 "0.5step" RAT_FUNC "%8.2" "step" COEFFS 0 1 0 0 0 0.5 /end COMPU_METHOD
/begin COMPU_METHOD COMP_0139 "1êßå‰é¸ä˙" RAT_FUNC "%8.2" "êßå‰é¸ä˙" COEFFS 0 1 0 0 0 1 /end COMPU_METHOD
/begin COMPU_METHOD COMP_0414 "1NO" RAT_FUNC "%8.2" "NO" COEFFS 0 1 0 0 0 1 /end COMPU_METHOD
/begin COMPU_METHOD COMP_0064_S "degCAsdegCAs" RAT_FUNC "%8.4" "degCAs" COEFFS 0 1 10737418.24 0 0 0.005 /end COMPU_METHOD
/begin COMPU_METHOD COMP_0590_S "ÅéÅé" RAT_FUNC "%8.6" "Åé" COEFFS 0 1 50 0 0 0.0000000596046 /end COMPU_METHOD
/begin COMPU_METHOD COMP_0067_S "NmNm" RAT_FUNC "%8.2" "Nm" COEFFS 0 1 -150 0 0 3 /end COMPU_METHOD
/begin COMPU_METHOD COMP_0592_S "mVmV" RAT_FUNC "%8.5" "mV" COEFFS 0 1 0 0 0 0.000305176 /end COMPU_METHOD
/begin COMPU_METHOD COMP_0158 "1/16Å|" RAT_FUNC "%8.3" "Å|" COEFFS 0 1 0 0 0 0.0625 /end COMPU_METHOD
/begin COMPU_METHOD COMP_0069_S "degdeg" RAT_FUNC "%8.2" "deg" COEFFS 0 1 8192 0 0 0.25 /end COMPU_METHOD
/begin COMPU_METHOD COMP_0165 "1/128rpm" RAT_FUNC "%8.4" "rpm" COEFFS 0 1 0 0 0 0.0078125 /end COMPU_METHOD
/end MODULE
/end PROJECT
