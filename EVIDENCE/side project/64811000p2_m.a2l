ASAP2_VERSION 1 3_BETA
/begin PROJECT TK_X91_EUR_VC ""
/begin HEADER "" /* key HEADER ++ "comment" Ç… Par.scomment */ PROJECT_NO TK_X91_EUR_VC /* key PROJECT_NO ++ project number Ç… car_eng_desti_lot */ VERSION "7V4YHZEB2" /* key VERSION ++ version number Ç… mProgver */ /end HEADER
/begin MODULE DIM ""
/begin MOD_COMMON "" DEPOSIT ABSOLUTE BYTE_ORDER MSB_FIRST /* ﬁ≤ƒµ∞¿ﬁ∞Ç™ÿÃﬂ⁄∞ΩÇ≥ÇÍÇÈ */ /end MOD_COMMON
/begin FUNCTION R105.2.tra_sdfta_1_1_2 "Dependability of Automatic Transmission / Engine Exchanges" /end FUNCTION
/begin FUNCTION R106.1.epw_altxx_1_1_0 "Alternator intersystem outputs" /end FUNCTION
/begin FUNCTION R106.2.epw_mxalt_1_1_0 "Alternator Maximum Allowed Power" /end FUNCTION
/begin FUNCTION R106.3.epw_palmx_1_1_0 "USM Fast Frame Acquisition" /end FUNCTION
/begin FUNCTION R106.4.epw_paltx_1_1_0 "Alternator power choice" /end FUNCTION
/begin FUNCTION R106.5.epw_ptcxx_1_1_0 "PTC LOAD MANAGEMENT" /end FUNCTION
/begin FUNCTION R106.6.epw_slope_1_1_0 "Alternator power slope" /end FUNCTION
/begin FUNCTION R106.7.epw_tqalt_1_1_0 "Alternator torque load characteristic" /end FUNCTION
/begin FUNCTION R107.1.iss_ariss_1_0_4 "Idle speed setpoint arbitration" /end FUNCTION
/begin FUNCTION R107.2.iss_atiss_1_0_2 "Automatic transmission idle speed setpoint" /end FUNCTION
/begin FUNCTION R107.3.iss_eliss_1_0_4 "Electric consumers idle speed setpoint" /end FUNCTION
/begin FUNCTION R107.4.iss_mciss_1_0_2 "Mechanical consumers idle speed setpoint" /end FUNCTION
/begin FUNCTION R108.1.dls_gbrat_vmm_1_1_5 "GearBox Ratio Elaboration" /end FUNCTION
/begin FUNCTION R201.1.stp_mngtx_1_2_2 "Arrets moteur et Air bag Crash " /end FUNCTION
/begin FUNCTION R202.1.acx_acprs_1_2_3 "Acquisition Pression" /end FUNCTION
/begin FUNCTION R202.2.acx_mdfan_1_2_2 "Formattage GMV" /end FUNCTION
/begin FUNCTION R203.1.crk_mngtx_1_2_1 "Cranking management" /end FUNCTION
/begin FUNCTION R203.2.crk_restx_1_0_8 "Restart Strategy" /end FUNCTION
/begin FUNCTION R204.1.CanComm_1_9_2 "CAN Communication" /end FUNCTION
/begin FUNCTION R205.1.ADAC_spec_1_1_0 "ADAC" /end FUNCTION
/begin FUNCTION R206.1.Reprog_controller_1_0_1 "Reprog - Management" /end FUNCTION
/begin FUNCTION R206.2.ECU_Repro_1_0_3 "Reprog - Serial data transmission ecu reprogramming" /end FUNCTION
/begin FUNCTION R206.3.ECU_Repro_service_1_0_1 "Reprog - Serial data transmission eprom services" /end FUNCTION
/begin FUNCTION R206.4.ECU_Repro_R-N_specificity_1_0_1 "Reprog - Serial data transmission R/N specificity" /end FUNCTION
/begin FUNCTION R206.5.ECU_Repro_flash_1_0_1 "Reprog - Serial data transmission Implementation" /end FUNCTION
/begin FUNCTION R208.1.SWTCH_1_1_7 "Switches control" /end FUNCTION
/begin CHARACTERISTIC mACISSDRV "Air conditioning idle speed setpoint calibration under drive mode of the automatic transmission" VALUE 0x00008F98 REC_UWORD_C 0 COMP_0337_S 0 65535 DISPLAY_IDENTIFIER Cxx_agb_ac_min_is_n /begin FUNCTION_LIST R107.4.iss_mciss_1_0_2 /end FUNCTION_LIST /end CHARACTERISTIC
/begin CHARACTERISTIC mACISSNUT "Air conditioning idle speed setpoint calibration under neutral mode of the AT (or manual gearbox)" VALUE 0x00008F9A REC_UWORD_C 0 COMP_0337_S 0 65535 DISPLAY_IDENTIFIER Cxx_pn_ac_min_is_n /begin FUNCTION_LIST R107.4.iss_mciss_1_0_2 /end FUNCTION_LIST /end CHARACTERISTIC
/begin CHARACTERISTIC mAGBCTRNG "Failure counter threshold. It authorize N successive failures before downgraded mode activation." VALUE 0x00008243 REC_UBYTE_C 0 COMP_0068 0 255 DISPLAY_IDENTIFIER Cxx_agb_ctr_max_thd /begin FUNCTION_LIST R105.2.tra_sdfta_1_1_2 /end FUNCTION_LIST /end CHARACTERISTIC
/begin CHARACTERISTIC mAGBINTDL "Time after we reset the integrator after a shift." VALUE 0x00008245 REC_UBYTE_C 0 COMP_0013 0 255 DISPLAY_IDENTIFIER Cxx_agb_int_rst_t /begin FUNCTION_LIST R105.2.tra_sdfta_1_1_2 /end FUNCTION_LIST /end CHARACTERISTIC
/begin CHARACTERISTIC mAGBISSC "Idle speed setpoint under request of the AT" VALUE 0x00008FF0 REC_UWORD_C 0 COMP_0337_S 0 65535 DISPLAY_IDENTIFIER Cxx_agb_min_is_n /begin FUNCTION_LIST R107.2.iss_atiss_1_0_2 /end FUNCTION_LIST /end CHARACTERISTIC
/begin CHARACTERISTIC mAGBISSNK "Invalid value of the idle speed setpoint required by the Automatic Transmission" VALUE 0x00008FF2 REC_UWORD_C 0 COMP_0443 0 65535 DISPLAY_IDENTIFIER Cxx_agb_is_acel_req_nok /begin FUNCTION_LIST R107.2.iss_atiss_1_0_2 /end FUNCTION_LIST /end CHARACTERISTIC
/begin CHARACTERISTIC mAGBMXTRQ "Max value which can be set in CAN message list for torque" VALUE 0x00008FF4 REC_UWORD_C 0 COMP_0345_S -400 1647.96875 DISPLAY_IDENTIFIER Cxx_agb_max_tqe /begin FUNCTION_LIST R105.2.tra_sdfta_1_1_2 /end FUNCTION_LIST /end CHARACTERISTIC
/begin CHARACTERISTIC mAGBNGTRQ "torque limitation applied when a wrong gear request occurs" VALUE 0x00008FF6 REC_UWORD_C 0 COMP_0345_S -400 1647.96875 DISPLAY_IDENTIFIER Cxx_dft_agb_tq_sp_lim /begin FUNCTION_LIST R105.2.tra_sdfta_1_1_2 /end FUNCTION_LIST /end CHARACTERISTIC
/begin CHARACTERISTIC mAGBNOKTQ "Raw CAN invalid value for AGB torque" VALUE 0x00008FF8 REC_UWORD_C 0 COMP_0068 0 65535 DISPLAY_IDENTIFIER Cxx_mux_agb_tqe_nok_raw /begin FUNCTION_LIST R105.2.tra_sdfta_1_1_2 /end FUNCTION_LIST /end CHARACTERISTIC
/begin CHARACTERISTIC mAGBSIPDL "Maximum time allowed for a gear shift" VALUE 0x00008248 REC_UBYTE_C 0 COMP_0013 0 255 DISPLAY_IDENTIFIER Cxx_max_gear_cge_dly /begin FUNCTION_LIST R105.2.tra_sdfta_1_1_2 /end FUNCTION_LIST /end CHARACTERISTIC
/begin CHARACTERISTIC mAGBSLPOS "Positive torque slew rate calibration    in case of protocol error" VALUE 0x00008FFC REC_UWORD_C 0 COMP_0347_S 0 327675 DISPLAY_IDENTIFIER Cxx_agb_slwr_pos /begin FUNCTION_LIST R105.2.tra_sdfta_1_1_2 /end FUNCTION_LIST /end CHARACTERISTIC
/begin CHARACTERISTIC mAGBUPTHD "Upper threshold of torque integrator detecting irregular shifts" VALUE 0x00009000 REC_UWORD_C 0 COMP_0348_S 0 6553.5 DISPLAY_IDENTIFIER Cxx_i_agb_driv_tq_thd /begin FUNCTION_LIST R105.2.tra_sdfta_1_1_2 /end FUNCTION_LIST /end CHARACTERISTIC
/begin CHARACTERISTIC mAPDFLT "Default alternator power value used in case of failure detection." VALUE 0x0000827B REC_UBYTE_C 0 COMP_0360_S 0 10200 DISPLAY_IDENTIFIER Cxx_alt_pow_dft /begin FUNCTION_LIST R106.3.epw_palmx_1_1_0 /end FUNCTION_LIST /end CHARACTERISTIC
/begin CHARACTERISTIC mAPFILDEC "Filtering factor used to detect an decreasing alternator power value" VALUE 0x0000901C REC_UWORD_C 0 COMP_0361_S 0 65.535 DISPLAY_IDENTIFIER Cxx_alt_pow_trs_fil_dec /begin FUNCTION_LIST R106.7.epw_tqalt_1_1_0 /end FUNCTION_LIST /end CHARACTERISTIC
/begin CHARACTERISTIC mAPFILDSB "Value when the 1st filter is disabled" VALUE 0x0000901E REC_UWORD_C 0 COMP_0361_S 0 65.535 DISPLAY_IDENTIFIER Cxx_alt_pow_dsb_fil_fac /begin FUNCTION_LIST R106.7.epw_tqalt_1_1_0 /end FUNCTION_LIST /end CHARACTERISTIC
/begin CHARACTERISTIC mAPFILINC "Filtering factor used to detect an increasing alternator power value" VALUE 0x00009020 REC_UWORD_C 0 COMP_0361_S 0 65.535 DISPLAY_IDENTIFIER Cxx_alt_pow_trs_fil_inc /begin FUNCTION_LIST R106.7.epw_tqalt_1_1_0 /end FUNCTION_LIST /end CHARACTERISTIC
/begin CHARACTERISTIC mAPMXDEC "Decreasing slope for the maximum power allowed to the alternator" VALUE 0x00009030 REC_UWORD_C 0 COMP_0363_S -655350 0 DISPLAY_IDENTIFIER Cxx_alt_max_pow_dec /begin FUNCTION_LIST R106.2.epw_mxalt_1_1_0 /end FUNCTION_LIST /end CHARACTERISTIC
/begin CHARACTERISTIC mAPMXINC "Increasing slope for the maximum power allowed to the alternator" VALUE 0x00009032 REC_UWORD_C 0 COMP_0364_S 0 655350 DISPLAY_IDENTIFIER Cxx_alt_max_pow_inc /begin FUNCTION_LIST R106.2.epw_mxalt_1_1_0 /end FUNCTION_LIST /end CHARACTERISTIC
/begin CHARACTERISTIC mAPNEH "Engine speed value above which alternator power is used" VALUE 0x00009034 REC_UWORD_C 0 COMP_0337_S 0 65535 DISPLAY_IDENTIFIER Cxx_alt_pow_h_n /begin FUNCTION_LIST R106.3.epw_palmx_1_1_0 /end FUNCTION_LIST /end CHARACTERISTIC
/begin CHARACTERISTIC mAPNEL "Engine speed value below which alternator power is set to a default value" VALUE 0x00009036 REC_UWORD_C 0 COMP_0337_S 0 65535 DISPLAY_IDENTIFIER Cxx_alt_pow_l_n /begin FUNCTION_LIST R106.3.epw_palmx_1_1_0 /end FUNCTION_LIST /end CHARACTERISTIC
/begin CHARACTERISTIC mAPOFSRSB "Value to send on CAN during detected failure of accelerator pedal safety case N" VALUE 0x0000903C REC_UWORD_C 0 COMP_0362_S 0 8191.875 /begin FUNCTION_LIST R204.1.CanComm_1_9_2 /end FUNCTION_LIST /end CHARACTERISTIC
/begin CHARACTERISTIC mAPSLPDLY "Alternator power ramp on initialisation" VALUE 0x00008282 REC_UBYTE_C 0 COMP_0183 0 5100 DISPLAY_IDENTIFIER Cxx_alt_slop_dly /begin FUNCTION_LIST R106.7.epw_tqalt_1_1_0 /end FUNCTION_LIST /end CHARACTERISTIC
/begin CHARACTERISTIC mAPSTART "Alternator power value used during cranking" VALUE 0x00008285 REC_UBYTE_C 0 COMP_0360_S 0 10200 DISPLAY_IDENTIFIER Cxx_alt_pow_sta /begin FUNCTION_LIST R106.3.epw_palmx_1_1_0 /end FUNCTION_LIST /end CHARACTERISTIC
/begin CHARACTERISTIC mAPTRSTH "Transcient detection power threshold" VALUE 0x00009074 REC_UWORD_C 0 COMP_0365_S 0 655350 DISPLAY_IDENTIFIER Cxx_alt_pow_trs_dif_thd /begin FUNCTION_LIST R106.7.epw_tqalt_1_1_0 /end FUNCTION_LIST /end CHARACTERISTIC
/begin CHARACTERISTIC mBATCDRLV "Minimum battery voltage to enable the cruise control and speed limiter option detection" VALUE 0x000082AD REC_UBYTE_C 0 COMP_0033 0 20400 DISPLAY_IDENTIFIER batcdrlv /begin FUNCTION_LIST R208.1.SWTCH_1_1_7 /end FUNCTION_LIST /end CHARACTERISTIC
/begin CHARACTERISTIC mCRSHLVL1 "Expected value of 2nd byte of received airbag crash frame for crash level 1" VALUE 0x00008369 REC_UBYTE_C 0 COMP_0068 0 255 DISPLAY_IDENTIFIER Cxx_eng_stop_req_airb2_lvl1 /begin FUNCTION_LIST R201.1.stp_mngtx_1_2_2 /end FUNCTION_LIST /end CHARACTERISTIC
/begin CHARACTERISTIC mCRSHLVL2 "Expected value of 2nd byte of received airbag crash frame for crash level 2" VALUE 0x0000836A REC_UBYTE_C 0 COMP_0068 0 255 DISPLAY_IDENTIFIER Cxx_eng_stop_req_airb2_lvl2 /begin FUNCTION_LIST R201.1.stp_mngtx_1_2_2 /end FUNCTION_LIST /end CHARACTERISTIC
/begin CHARACTERISTIC mCSACBDLY "Maxixmum duration of the SET+ press before blocked switch detection" VALUE 0x0000836E REC_UBYTE_C 0 COMP_0380_S 0 51 DISPLAY_IDENTIFIER Cxx_cru_sl_acel_blk_dly /begin FUNCTION_LIST R208.1.SWTCH_1_1_7 /end FUNCTION_LIST /end CHARACTERISTIC
/begin CHARACTERISTIC mCSACMNTH "Minimum dec threshold to detect an accel switch press" VALUE 0x000090C6 REC_UWORD_C 0 COMP_0023 0 327675 DISPLAY_IDENTIFIER Cxx_cru_sl_acel_min_thd /begin FUNCTION_LIST R208.1.SWTCH_1_1_7 /end FUNCTION_LIST /end CHARACTERISTIC
/begin CHARACTERISTIC mCSACMXTH "Maximum dec threshold to detect an accel switch press" VALUE 0x000090C8 REC_UWORD_C 0 COMP_0023 0 327675 DISPLAY_IDENTIFIER Cxx_cru_sl_acel_max_thd /begin FUNCTION_LIST R208.1.SWTCH_1_1_7 /end FUNCTION_LIST /end CHARACTERISTIC
/begin CHARACTERISTIC mCSDCMNTH "Minimum dec threshold to detect a decel switch press" VALUE 0x000090CA REC_UWORD_C 0 COMP_0023 0 327675 DISPLAY_IDENTIFIER Cxx_cru_sl_decl_min_thd /begin FUNCTION_LIST R208.1.SWTCH_1_1_7 /end FUNCTION_LIST /end CHARACTERISTIC
/begin CHARACTERISTIC mCSDCMXTH "Maximum dec threshold to detect a decel switch press" VALUE 0x000090CC REC_UWORD_C 0 COMP_0023 0 327675 DISPLAY_IDENTIFIER Cxx_cru_sl_decl_max_thd /begin FUNCTION_LIST R208.1.SWTCH_1_1_7 /end FUNCTION_LIST /end CHARACTERISTIC
/begin CHARACTERISTIC mCSDEBDLY "Maxixmum duration of the SET- press before blocked switch detection" VALUE 0x00008371 REC_UBYTE_C 0 COMP_0380_S 0 51 DISPLAY_IDENTIFIER Cxx_cru_sl_decl_blk_dly /begin FUNCTION_LIST R208.1.SWTCH_1_1_7 /end FUNCTION_LIST /end CHARACTERISTIC
/begin CHARACTERISTIC mCSOPMNTH "Minimum dec threshold to detect not-connected steering wheel switch" VALUE 0x000090CE REC_UWORD_C 0 COMP_0023 0 327675 DISPLAY_IDENTIFIER Cxx_cru_sl_open_min_thd /begin FUNCTION_LIST R208.1.SWTCH_1_1_7 /end FUNCTION_LIST /end CHARACTERISTIC
/begin CHARACTERISTIC mCSRLMNTH "Minimum dec threshold to detect non-pressed steering wheel switch" VALUE 0x000090D0 REC_UWORD_C 0 COMP_0023 0 327675 DISPLAY_IDENTIFIER Cxx_cru_sl_rls_min_thd /begin FUNCTION_LIST R208.1.SWTCH_1_1_7 /end FUNCTION_LIST /end CHARACTERISTIC
/begin CHARACTERISTIC mCSRLMXTH "Maximum dec threshold to detect non-pressed steering wheel switch" VALUE 0x000090D2 REC_UWORD_C 0 COMP_0023 0 327675 DISPLAY_IDENTIFIER Cxx_cru_sl_rls_max_thd /begin FUNCTION_LIST R208.1.SWTCH_1_1_7 /end FUNCTION_LIST /end CHARACTERISTIC
/begin CHARACTERISTIC mCSRSBDLY "Maxixmum duration of the RESUME press before blocked switch detection" VALUE 0x00008386 REC_UBYTE_C 0 COMP_0380_S 0 51 DISPLAY_IDENTIFIER Cxx_cru_sl_resu_blk_dly /begin FUNCTION_LIST R208.1.SWTCH_1_1_7 /end FUNCTION_LIST /end CHARACTERISTIC
/begin CHARACTERISTIC mCSRSMNTH "Minimum dec threshold to detect a resume switch press" VALUE 0x000090D4 REC_UWORD_C 0 COMP_0023 0 327675 DISPLAY_IDENTIFIER Cxx_cru_sl_resu_min_thd /begin FUNCTION_LIST R208.1.SWTCH_1_1_7 /end FUNCTION_LIST /end CHARACTERISTIC
/begin CHARACTERISTIC mCSRSMXTH "Maximum dec threshold to detect a resume switch press" VALUE 0x000090D6 REC_UWORD_C 0 COMP_0023 0 327675 DISPLAY_IDENTIFIER Cxx_cru_sl_resu_max_thd /begin FUNCTION_LIST R208.1.SWTCH_1_1_7 /end FUNCTION_LIST /end CHARACTERISTIC
/begin CHARACTERISTIC mCSSPMXTH "Maximum dec threshold to detect a suspend switch press" VALUE 0x000090D8 REC_UWORD_C 0 COMP_0023 0 327675 DISPLAY_IDENTIFIER Cxx_cru_sl_susp_max_thd /begin FUNCTION_LIST R208.1.SWTCH_1_1_7 /end FUNCTION_LIST /end CHARACTERISTIC
/begin CHARACTERISTIC mCSSUBDLY "Maxixmum duration of the SUSPEND press before blocked switch detection" VALUE 0x00008387 REC_UBYTE_C 0 COMP_0380_S 0 51 DISPLAY_IDENTIFIER Cxx_cru_sl_susp_blk_dly /begin FUNCTION_LIST R208.1.SWTCH_1_1_7 /end FUNCTION_LIST /end CHARACTERISTIC
/begin CHARACTERISTIC mDECABABS "abs absent counter decrement value" VALUE 0x000083FA REC_UBYTE_C 0 COMP_0068 0 255 DISPLAY_IDENTIFIER Cxx_abs_vld_abst_frm_dec /begin FUNCTION_LIST R204.1.CanComm_1_9_2 /end FUNCTION_LIST /end CHARACTERISTIC
/begin CHARACTERISTIC mDECABACC "acc absent counter decrement value" VALUE 0x000083FB REC_UBYTE_C 0 COMP_0068 0 255 DISPLAY_IDENTIFIER Cxx_acc_vld_abst_frm_dec /begin FUNCTION_LIST R204.1.CanComm_1_9_2 /end FUNCTION_LIST /end CHARACTERISTIC
/begin CHARACTERISTIC mDECABBVA "automatic gearbox absent counter decrement value" VALUE 0x000083FC REC_UBYTE_C 0 COMP_0068 0 255 DISPLAY_IDENTIFIER Cxx_agb_vld_abst_frm_dec /begin FUNCTION_LIST R204.1.CanComm_1_9_2 /end FUNCTION_LIST /end CHARACTERISTIC
/begin CHARACTERISTIC mDECABCLM "Climate Control Unit decrementation value for validated absent CAN failure counter" VALUE 0x000083FD REC_UBYTE_C 0 COMP_0068 0 255 DISPLAY_IDENTIFIER Cxx_ac_vld_abst_frm_dec /begin FUNCTION_LIST R204.1.CanComm_1_9_2 /end FUNCTION_LIST /end CHARACTERISTIC
/begin CHARACTERISTIC mDECABCLU "Cluster Control Unit decrementation value for validated absent CAN failure counter" VALUE 0x000083FE REC_UBYTE_C 0 COMP_0068 0 255 DISPLAY_IDENTIFIER decabtdb /begin FUNCTION_LIST R204.1.CanComm_1_9_2 /end FUNCTION_LIST /end CHARACTERISTIC
/begin CHARACTERISTIC mDECABDDC "DDCM Control Unit : decrementation value for    validated absent CAN failure counter" VALUE 0x000083FF REC_UBYTE_C 0 COMP_0068 0 255 DISPLAY_IDENTIFIER Cxx_ddcm_vld_abst_frm_dec /begin FUNCTION_LIST R204.1.CanComm_1_9_2 /end FUNCTION_LIST /end CHARACTERISTIC
/begin CHARACTERISTIC mDECABSWA "Steering Wheel Angle Control Unit decrementation value for validated absent CAN failure counter" VALUE 0x00008401 REC_UBYTE_C 0 COMP_0068 0 255 DISPLAY_IDENTIFIER Cxx_swa_vld_abst_frm_dec /begin FUNCTION_LIST R204.1.CanComm_1_9_2 /end FUNCTION_LIST /end CHARACTERISTIC
/begin CHARACTERISTIC mDECABUCH "uch absent counter decrement value" VALUE 0x00008403 REC_UBYTE_C 0 COMP_0068 0 255 DISPLAY_IDENTIFIER decabuch /begin FUNCTION_LIST R204.1.CanComm_1_9_2 /end FUNCTION_LIST /end CHARACTERISTIC
/begin CHARACTERISTIC mDECABUPC "Decrement of the C_Absent (UPC) volatile counter" VALUE 0x00008404 REC_UBYTE_C 0 COMP_0068 0 255 DISPLAY_IDENTIFIER decabupc /begin FUNCTION_LIST R204.1.CanComm_1_9_2 /end FUNCTION_LIST /end CHARACTERISTIC
/begin CHARACTERISTIC mDECM "memorized counter decrement value" VALUE 0x0000840B REC_UBYTE_C 0 COMP_0068 0 255 DISPLAY_IDENTIFIER decm /begin FUNCTION_LIST R204.1.CanComm_1_9_2 /end FUNCTION_LIST /end CHARACTERISTIC
/begin CHARACTERISTIC mDECMUTE "module mute counter decrement value" VALUE 0x0000840C REC_UBYTE_C 0 COMP_0068 0 255 DISPLAY_IDENTIFIER decmute /begin FUNCTION_LIST R204.1.CanComm_1_9_2 /end FUNCTION_LIST /end CHARACTERISTIC
/begin CHARACTERISTIC mDECSAC "Type of decrease slope for the air conditioning idle speed setpoint (1=Low 2=Med 3=Fast)" VALUE 0x0000840F REC_UBYTE_C 0 COMP_0068 0 255 DISPLAY_IDENTIFIER Cxx_dec_slop_ac_sp /begin FUNCTION_LIST R107.1.iss_ariss_1_0_4 /end FUNCTION_LIST /end CHARACTERISTIC
/begin CHARACTERISTIC mDECSAGB "Type of decrease slope for the AGB idle speed setpoint (1=Low 2=Med 3=Fast)" VALUE 0x00008410 REC_UBYTE_C 0 COMP_0068 0 255 DISPLAY_IDENTIFIER Cxx_dec_slop_agb_sp /begin FUNCTION_LIST R107.1.iss_ariss_1_0_4 /end FUNCTION_LIST /end CHARACTERISTIC
/begin CHARACTERISTIC mDECSBRK "Type of decrease slope for Brake Off at D range idle speed setpoint" VALUE 0x00008411 REC_UBYTE_C 0 COMP_0068 0 255 /begin FUNCTION_LIST R107.1.iss_ariss_1_0_4 /end FUNCTION_LIST /end CHARACTERISTIC
/begin CHARACTERISTIC mDECSDIAG "Type of decrease slope for the after sale idle speed setpoint (1=Low 2=Med 3=Fast)" VALUE 0x00008412 REC_UBYTE_C 0 COMP_0068 0 255 DISPLAY_IDENTIFIER Cxx_dec_slop_diag_sp /begin FUNCTION_LIST R107.1.iss_ariss_1_0_4 /end FUNCTION_LIST /end CHARACTERISTIC
/begin CHARACTERISTIC mDECSFS "Type of decrease slope for Failures idle speed setpoint" VALUE 0x00008413 REC_UBYTE_C 0 COMP_0068 0 255 /begin FUNCTION_LIST R107.1.iss_ariss_1_0_4 /end FUNCTION_LIST /end CHARACTERISTIC
/begin CHARACTERISTIC mDECSHEAT "Type of decrease slope for Engine Start at very hot condition idle speed setpoint" VALUE 0x00008414 REC_UBYTE_C 0 COMP_0068 0 255 /begin FUNCTION_LIST R107.1.iss_ariss_1_0_4 /end FUNCTION_LIST /end CHARACTERISTIC
/begin CHARACTERISTIC mDECSHOMO "Type of decrease slope for DIG homogeneous combustion mode idle speed setpoint" VALUE 0x00008415 REC_UBYTE_C 0 COMP_0068 0 255 /begin FUNCTION_LIST R107.1.iss_ariss_1_0_4 /end FUNCTION_LIST /end CHARACTERISTIC
/begin CHARACTERISTIC mDECSPFT "Type of decrease slope for the particle filter idle speed setpoint (1=Low 2=Med 3=Fast)" VALUE 0x00008416 REC_UBYTE_C 0 COMP_0068 0 255 DISPLAY_IDENTIFIER Cxx_dec_slop_pft_sp /begin FUNCTION_LIST R107.1.iss_ariss_1_0_4 /end FUNCTION_LIST /end CHARACTERISTIC
/begin CHARACTERISTIC mDECSPIGR "Type of decrease slope for Hot water and air temperature idle speed setpoint" VALUE 0x00008417 REC_UBYTE_C 0 COMP_0068 0 255 /begin FUNCTION_LIST R107.1.iss_ariss_1_0_4 /end FUNCTION_LIST /end CHARACTERISTIC
/begin CHARACTERISTIC mDECSPSFL "Type of decrease slope for Power-steering oil pressure sensor fail-safe idle speed setpoint" VALUE 0x00008418 REC_UBYTE_C 0 COMP_0068 0 255 /begin FUNCTION_LIST R107.1.iss_ariss_1_0_4 /end FUNCTION_LIST /end CHARACTERISTIC
/begin CHARACTERISTIC mDECSPTC "Type of decrease slope for the PTC idle speed setpoint (1=Low 2=Med 3=Fast)" VALUE 0x00008419 REC_UBYTE_C 0 COMP_0068 0 255 DISPLAY_IDENTIFIER Cxx_dec_slop_ptc_sp /begin FUNCTION_LIST R107.1.iss_ariss_1_0_4 /end FUNCTION_LIST /end CHARACTERISTIC
/begin CHARACTERISTIC mDECSPWST "Type of decrease slope for the power steering idle speed setpoint (1=Low 2=Med 3=Fast)" VALUE 0x0000841A REC_UBYTE_C 0 COMP_0068 0 255 DISPLAY_IDENTIFIER Cxx_dec_slop_pwst_sp /begin FUNCTION_LIST R107.1.iss_ariss_1_0_4 /end FUNCTION_LIST /end CHARACTERISTIC
/begin CHARACTERISTIC mDECSRUN "Type of decrease slope for the running vehicle idle speed setpoint (1=Low 2=Med 3=Fast)" VALUE 0x0000841B REC_UBYTE_C 0 COMP_0068 0 255 DISPLAY_IDENTIFIER Cxx_dec_slop_run_vh_sp /begin FUNCTION_LIST R107.1.iss_ariss_1_0_4 /end FUNCTION_LIST /end CHARACTERISTIC
/begin CHARACTERISTIC mDECSTHPL "Type of increase slope for the thermoplunger idle speed setpoint (1=Low 2=Med 3=Fast)" VALUE 0x0000841C REC_UBYTE_C 0 COMP_0068 0 255 DISPLAY_IDENTIFIER Cxx_dec_slop_thpl_sp /begin FUNCTION_LIST R107.1.iss_ariss_1_0_4 /end FUNCTION_LIST /end CHARACTERISTIC
/begin CHARACTERISTIC mDECSTW "Type of decrease slope for the coolant temperature idle speed setpoint (1=Low 2=Med 3=Fast)" VALUE 0x0000841D REC_UBYTE_C 0 COMP_0068 0 255 DISPLAY_IDENTIFIER Cxx_dec_slop_tco_sp /begin FUNCTION_LIST R107.1.iss_ariss_1_0_4 /end FUNCTION_LIST /end CHARACTERISTIC
/begin CHARACTERISTIC mDECSWIND "Type of decrease slope for the electrical windshield idle speed setpoint (1=Low 2=Med 3=Fast)" VALUE 0x0000841E REC_UBYTE_C 0 COMP_0068 0 255 DISPLAY_IDENTIFIER Cxx_dec_slop_el_wind_sp /begin FUNCTION_LIST R107.1.iss_ariss_1_0_4 /end FUNCTION_LIST /end CHARACTERISTIC
/begin CHARACTERISTIC mDECTHRES "memorized mux failure counter decrement threshold" VALUE 0x0000841F REC_UBYTE_C 0 COMP_0068 0 255 DISPLAY_IDENTIFIER decthres /begin FUNCTION_LIST R204.1.CanComm_1_9_2 /end FUNCTION_LIST /end CHARACTERISTIC
/begin CHARACTERISTIC mDGMAXISS "Maximum after-sale idle speed setpoint authorized" VALUE 0x000090F2 REC_UWORD_C 0 COMP_0337_S 0 65535 DISPLAY_IDENTIFIER Cxx_diag_max_is_n /begin FUNCTION_LIST R107.1.iss_ariss_1_0_4 /end FUNCTION_LIST /end CHARACTERISTIC
/begin CHARACTERISTIC mDGMINISS "Minimum after-sale idle speed setpoin" VALUE 0x000090F4 REC_UWORD_C 0 COMP_0337_S 0 65535 DISPLAY_IDENTIFIER Cxx_diag_min_is_n /begin FUNCTION_LIST R107.1.iss_ariss_1_0_4 /end FUNCTION_LIST /end CHARACTERISTIC
/begin CHARACTERISTIC mELWNDISS "Electric windshield idle speed setpoint calibration" VALUE 0x0000916E REC_UWORD_C 0 COMP_0337_S 0 65535 DISPLAY_IDENTIFIER Cxx_el_wind_min_is_n /begin FUNCTION_LIST R107.3.iss_eliss_1_0_4 /end FUNCTION_LIST /end CHARACTERISTIC
/begin CHARACTERISTIC mESPNETH "Engine speed upper condition in engine speed condition bloc" VALUE 0x00009180 REC_UWORD_C 0 COMP_0337_S 0 65535 DISPLAY_IDENTIFIER Cxx_ptc_cut_n_n_up_thd /begin FUNCTION_LIST R106.5.epw_ptcxx_1_1_0 /end FUNCTION_LIST /end CHARACTERISTIC
/begin CHARACTERISTIC mESPNETL "Water temperature breakpoints tabula used in limitationEngine speed lower condition in engine speed condition bloctake off and autonomous system" VALUE 0x00009182 REC_UWORD_C 0 COMP_0337_S 0 65535 DISPLAY_IDENTIFIER Cxx_ptc_cut_n_n_l_thd /begin FUNCTION_LIST R106.5.epw_ptcxx_1_1_0 /end FUNCTION_LIST /end CHARACTERISTIC
/begin CHARACTERISTIC mFASTDECS "Value of the fast decrease slope" VALUE 0x00009192 REC_UWORD_C 0 COMP_0406_S -65535 0 DISPLAY_IDENTIFIER Cxx_fast_dec_slop /begin FUNCTION_LIST R107.1.iss_ariss_1_0_4 /end FUNCTION_LIST /end CHARACTERISTIC
/begin CHARACTERISTIC mFASTINCS "Value of the fast increase slope" VALUE 0x00009194 REC_UWORD_C 0 COMP_0407_S 0 65535 DISPLAY_IDENTIFIER Cxx_fast_inc_slop /begin FUNCTION_LIST R107.1.iss_ariss_1_0_4 /end FUNCTION_LIST /end CHARACTERISTIC
/begin CHARACTERISTIC mFREONGIN "Air conditioning pressure sensor gain value" VALUE 0x0000862F REC_UBYTE_C 0 COMP_0410_S 0 0.19921875 DISPLAY_IDENTIFIER freongin /begin FUNCTION_LIST R202.1.acx_acprs_1_2_3 /end FUNCTION_LIST /end CHARACTERISTIC
/begin CHARACTERISTIC mFREONOFS "AC pressure sensor offset value" VALUE 0x000091BC REC_UWORD_C 0 COMP_0411_S 0 5.119921875 DISPLAY_IDENTIFIER freonofs /begin FUNCTION_LIST R202.1.acx_acprs_1_2_3 /end FUNCTION_LIST /end CHARACTERISTIC
/begin CHARACTERISTIC mGINELNEG "Gain used for the calculation of the electric balance protection counter" VALUE 0x00008667 REC_UBYTE_C 0 COMP_0412_S 0 1.00000035 DISPLAY_IDENTIFIER Cxx_el_csm_clc_neg_fac /begin FUNCTION_LIST R107.3.iss_eliss_1_0_4 /end FUNCTION_LIST /end CHARACTERISTIC
/begin CHARACTERISTIC mGINELPOS "Gain used for the calculation of the electric balance protection counter" VALUE 0x00008668 REC_UBYTE_C 0 COMP_0412_S 0 1.00000035 DISPLAY_IDENTIFIER Cxx_el_csm_clc_pos_fac /begin FUNCTION_LIST R107.3.iss_eliss_1_0_4 /end FUNCTION_LIST /end CHARACTERISTIC
/begin CHARACTERISTIC mGRRATMN1 "Minimum value for 1st gear ratio" VALUE 0x000091F4 REC_UWORD_C 0 COMP_0413_S -10 645.35 DISPLAY_IDENTIFIER Cxx_1_gear_min_vs_n_rat /begin FUNCTION_LIST R108.1.dls_gbrat_vmm_1_1_5 /end FUNCTION_LIST /end CHARACTERISTIC
/begin CHARACTERISTIC mGRRATMN2 "Minimum value for 2nd gear ratio" VALUE 0x000091F6 REC_UWORD_C 0 COMP_0413_S -10 645.35 DISPLAY_IDENTIFIER Cxx_2_gear_min_vs_n_rat /begin FUNCTION_LIST R108.1.dls_gbrat_vmm_1_1_5 /end FUNCTION_LIST /end CHARACTERISTIC
/begin CHARACTERISTIC mGRRATMN3 "Minimum value for 3rd gear ratio" VALUE 0x000091F8 REC_UWORD_C 0 COMP_0413_S -10 645.35 DISPLAY_IDENTIFIER Cxx_3_gear_min_vs_n_rat /begin FUNCTION_LIST R108.1.dls_gbrat_vmm_1_1_5 /end FUNCTION_LIST /end CHARACTERISTIC
/begin CHARACTERISTIC mGRRATMN4 "Minimum value for 4th gear ratio" VALUE 0x000091FA REC_UWORD_C 0 COMP_0413_S -10 645.35 DISPLAY_IDENTIFIER Cxx_4_gear_min_vs_n_rat /begin FUNCTION_LIST R108.1.dls_gbrat_vmm_1_1_5 /end FUNCTION_LIST /end CHARACTERISTIC
/begin CHARACTERISTIC mGRRATMN5 "Minimum value for 5th gear ratio" VALUE 0x000091FC REC_UWORD_C 0 COMP_0413_S -10 645.35 DISPLAY_IDENTIFIER Cxx_5_gear_min_vs_n_rat /begin FUNCTION_LIST R108.1.dls_gbrat_vmm_1_1_5 /end FUNCTION_LIST /end CHARACTERISTIC
/begin CHARACTERISTIC mGRRATMN6 "Minimum value for 6th gear ratio" VALUE 0x000091FE REC_UWORD_C 0 COMP_0413_S -10 645.35 DISPLAY_IDENTIFIER Cxx_6_gear_min_vs_n_rat /begin FUNCTION_LIST R108.1.dls_gbrat_vmm_1_1_5 /end FUNCTION_LIST /end CHARACTERISTIC
/begin CHARACTERISTIC mGRRATMX1 "Maximum value for 1st gear ratio" VALUE 0x00009200 REC_UWORD_C 0 COMP_0413_S -10 645.35 DISPLAY_IDENTIFIER Cxx_1_gear_max_vs_n_rat /begin FUNCTION_LIST R108.1.dls_gbrat_vmm_1_1_5 /end FUNCTION_LIST /end CHARACTERISTIC
/begin CHARACTERISTIC mGRRATMX2 "Maximum value for 2nd gear ratio" VALUE 0x00009202 REC_UWORD_C 0 COMP_0413_S -10 645.35 DISPLAY_IDENTIFIER Cxx_2_gear_max_vs_n_rat /begin FUNCTION_LIST R108.1.dls_gbrat_vmm_1_1_5 /end FUNCTION_LIST /end CHARACTERISTIC
/begin CHARACTERISTIC mGRRATMX3 "Maximum value for 3rd gear ratio" VALUE 0x00009204 REC_UWORD_C 0 COMP_0413_S -10 645.35 DISPLAY_IDENTIFIER Cxx_3_gear_max_vs_n_rat /begin FUNCTION_LIST R108.1.dls_gbrat_vmm_1_1_5 /end FUNCTION_LIST /end CHARACTERISTIC
/begin CHARACTERISTIC mGRRATMX4 "Maximum value for 4th gear ratio" VALUE 0x00009206 REC_UWORD_C 0 COMP_0413_S -10 645.35 DISPLAY_IDENTIFIER Cxx_4_gear_max_vs_n_rat /begin FUNCTION_LIST R108.1.dls_gbrat_vmm_1_1_5 /end FUNCTION_LIST /end CHARACTERISTIC
/begin CHARACTERISTIC mGRRATMX5 "Maximum value for 5th gear ratio" VALUE 0x00009208 REC_UWORD_C 0 COMP_0413_S -10 645.35 DISPLAY_IDENTIFIER Cxx_5_gear_max_vs_n_rat /begin FUNCTION_LIST R108.1.dls_gbrat_vmm_1_1_5 /end FUNCTION_LIST /end CHARACTERISTIC
/begin CHARACTERISTIC mGRRATMX6 "Maximum value for 6th gear ratio" VALUE 0x0000920A REC_UWORD_C 0 COMP_0413_S -10 645.35 DISPLAY_IDENTIFIER Cxx_6_gear_max_vs_n_rat /begin FUNCTION_LIST R108.1.dls_gbrat_vmm_1_1_5 /end FUNCTION_LIST /end CHARACTERISTIC
/begin CHARACTERISTIC mHLDNETH "Engine speed upper condition in high load condition bloc" VALUE 0x00009226 REC_UWORD_C 0 COMP_0337_S 0 65535 DISPLAY_IDENTIFIER Cxx_ptc_fl_n_up_thd /begin FUNCTION_LIST R106.5.epw_ptcxx_1_1_0 /end FUNCTION_LIST /end CHARACTERISTIC
/begin CHARACTERISTIC mHLDNETL "Engine speed lower condition in high load condition bloc" VALUE 0x00009228 REC_UWORD_C 0 COMP_0337_S 0 65535 DISPLAY_IDENTIFIER Cxx_ptc_fl_n_l_thd /begin FUNCTION_LIST R106.5.epw_ptcxx_1_1_0 /end FUNCTION_LIST /end CHARACTERISTIC
/begin CHARACTERISTIC mHLDVSPTH "Vehicule speed upper condition in high load condition bloc" VALUE 0x0000922A REC_UWORD_C 0 COMP_0375_S 0 655.35 DISPLAY_IDENTIFIER Cxx_ptc_fl_vs_up_thd /begin FUNCTION_LIST R106.5.epw_ptcxx_1_1_0 /end FUNCTION_LIST /end CHARACTERISTIC
/begin CHARACTERISTIC mHLDVSPTL "Vehicule speed lower condition in high load condition bloc" VALUE 0x0000922C REC_UWORD_C 0 COMP_0375_S 0 655.35 DISPLAY_IDENTIFIER Cxx_ptc_fl_vs_l_thd /begin FUNCTION_LIST R106.5.epw_ptcxx_1_1_0 /end FUNCTION_LIST /end CHARACTERISTIC
/begin CHARACTERISTIC mHYPRSGM0 "Security AC pressure hysteresis for fans activation when there is no ac presnce" VALUE 0x00009266 REC_UWORD_C 0 COMP_0420_S 0 6553.5 DISPLAY_IDENTIFIER hyprs0gmv /begin FUNCTION_LIST R202.2.acx_mdfan_1_2_2 /end FUNCTION_LIST /end CHARACTERISTIC
/begin CHARACTERISTIC mIDABR1 "BRAKE_CANHS_R_01 CAN frame identifier" VALUE 0x00009272 REC_UWORD_C 0 COMP_0068 0 65535 DISPLAY_IDENTIFIER Cxx_BRAKE_CANHS_R_01_id /begin FUNCTION_LIST R204.1.CanComm_1_9_2 /end FUNCTION_LIST /end CHARACTERISTIC
/begin CHARACTERISTIC mIDABS1 "BRAKE_CANHS_RNr_01 frame identifier" VALUE 0x00009274 REC_UWORD_C 0 COMP_0068 0 65535 DISPLAY_IDENTIFIER Cxx_BRAKE_CANHS_RNr_01_id /begin FUNCTION_LIST R204.1.CanComm_1_9_2 /end FUNCTION_LIST /end CHARACTERISTIC
/begin CHARACTERISTIC mIDABS2 "BRAKE_CANHS_RNr_02 frame identifier" VALUE 0x00009276 REC_UWORD_C 0 COMP_0068 0 65535 DISPLAY_IDENTIFIER Cxx_BRAKE_CANHS_RNr_02_id /begin FUNCTION_LIST R204.1.CanComm_1_9_2 /end FUNCTION_LIST /end CHARACTERISTIC
/begin CHARACTERISTIC mIDABS3 "BRAKE_CANHS_RNr_03 frame identifier" VALUE 0x00009278 REC_UWORD_C 0 COMP_0068 0 65535 DISPLAY_IDENTIFIER Cxx_BRAKE_CANHS_RNr_03_id /begin FUNCTION_LIST R204.1.CanComm_1_9_2 /end FUNCTION_LIST /end CHARACTERISTIC
/begin CHARACTERISTIC mIDABS4 "BRAKE_CANHS_RNr_04 frame identifier" VALUE 0x0000927A REC_UWORD_C 0 COMP_0068 0 65535 DISPLAY_IDENTIFIER Cxx_BRAKE_CANHS_RNr_04_id /begin FUNCTION_LIST R204.1.CanComm_1_9_2 /end FUNCTION_LIST /end CHARACTERISTIC
/begin CHARACTERISTIC mIDACC1 "ACC_CANHS_RNr_01 CAN frame identifier" VALUE 0x0000927C REC_UWORD_C 0 COMP_0068 0 65535 DISPLAY_IDENTIFIER Cxx_ACC_CANHS_RNr_01_id /begin FUNCTION_LIST R204.1.CanComm_1_9_2 /end FUNCTION_LIST /end CHARACTERISTIC
/begin CHARACTERISTIC mIDARB "AIRBAGCrash frame identifier" VALUE 0x00009280 REC_UWORD_C 0 COMP_0068 0 65535 DISPLAY_IDENTIFIER Cxx_AIRBAGCrash_id /begin FUNCTION_LIST R204.1.CanComm_1_9_2 /end FUNCTION_LIST /end CHARACTERISTIC
/begin CHARACTERISTIC mIDBVA1 "TORQUE_AT_CANHS_RNr_01 CAN frame identifier" VALUE 0x0000928A REC_UWORD_C 0 COMP_0068 0 65535 DISPLAY_IDENTIFIER Cxx_TORQUE_AT_CANHS_RNr_01_id /begin FUNCTION_LIST R204.1.CanComm_1_9_2 /end FUNCTION_LIST /end CHARACTERISTIC
/begin CHARACTERISTIC mIDBVA2 "TORQUE_AT_CANHS_RNr_02 CAN frame identifier" VALUE 0x0000928C REC_UWORD_C 0 COMP_0068 0 65535 DISPLAY_IDENTIFIER Cxx_TORQUE_AT_CANHS_RNr_02_id /begin FUNCTION_LIST R204.1.CanComm_1_9_2 /end FUNCTION_LIST /end CHARACTERISTIC
/begin CHARACTERISTIC mIDCLM1 "CLIM_CANHS_R_01 CAN frame identifier" VALUE 0x0000928E REC_UWORD_C 0 COMP_0068 0 65535 DISPLAY_IDENTIFIER Cxx_CLIM_CANHS_R_01_id /begin FUNCTION_LIST R204.1.CanComm_1_9_2 /end FUNCTION_LIST /end CHARACTERISTIC
/begin CHARACTERISTIC mIDCLU1 "CLUSTER_CANHS_RNr_01 CAN frame identifier" VALUE 0x00009290 REC_UWORD_C 0 COMP_0068 0 65535 DISPLAY_IDENTIFIER Cxx_CLUSTER_CANHS_RNr_01_id /begin FUNCTION_LIST R204.1.CanComm_1_9_2 /end FUNCTION_LIST /end CHARACTERISTIC
/begin CHARACTERISTIC mIDDDC1 "DDCM_CANLSFT_R_01 CAN frame identifier" VALUE 0x00009296 REC_UWORD_C 0 COMP_0068 0 65535 DISPLAY_IDENTIFIER Cxx_ECM_CANHS_RNr_01_id /begin FUNCTION_LIST R204.1.CanComm_1_9_2 /end FUNCTION_LIST /end CHARACTERISTIC
/begin CHARACTERISTIC mIDECM1 "ECM_CANHS_RNr_01" VALUE 0x00009298 REC_UWORD_C 0 COMP_0068 0 65535 /begin FUNCTION_LIST R204.1.CanComm_1_9_2 /end FUNCTION_LIST /end CHARACTERISTIC
/begin CHARACTERISTIC mIDECM2 "ECM_CANHS_RNr_02" VALUE 0x0000929A REC_UWORD_C 0 COMP_0068 0 65535 /begin FUNCTION_LIST R204.1.CanComm_1_9_2 /end FUNCTION_LIST /end CHARACTERISTIC
/begin CHARACTERISTIC mIDFRC1 "Force_ECM_CANHS_RNr_01 frame identifier" VALUE 0x000092AE REC_UWORD_C 0 COMP_0068 0 65535 /begin FUNCTION_LIST R204.1.CanComm_1_9_2 /end FUNCTION_LIST /end CHARACTERISTIC
/begin CHARACTERISTIC mIDMMI1 "MMI_ECM_CANHS_RNr_01" VALUE 0x000092B4 REC_UWORD_C 0 COMP_0068 0 65535 /begin FUNCTION_LIST R204.1.CanComm_1_9_2 /end FUNCTION_LIST /end CHARACTERISTIC
/begin CHARACTERISTIC mIDSWA1 "SWA_CANHS_RNr_01 CAN frame identifier" VALUE 0x000092B8 REC_UWORD_C 0 COMP_0068 0 65535 DISPLAY_IDENTIFIER Cxx_SWA_CANHS_RNr_01_id /begin FUNCTION_LIST R204.1.CanComm_1_9_2 /end FUNCTION_LIST /end CHARACTERISTIC
/begin CHARACTERISTIC mIDTQE1 "Torque_ECM_CANHS_RNr_01" VALUE 0x000092BA REC_UWORD_C 0 COMP_0068 0 65535 /begin FUNCTION_LIST R204.1.CanComm_1_9_2 /end FUNCTION_LIST /end CHARACTERISTIC
/begin CHARACTERISTIC mIDTQE2 "Torque_ECM_CANHS_RNr_02" VALUE 0x000092BC REC_UWORD_C 0 COMP_0068 0 65535 /begin FUNCTION_LIST R204.1.CanComm_1_9_2 /end FUNCTION_LIST /end CHARACTERISTIC
/begin CHARACTERISTIC mIDTQR1 "Torque_ECM_CANHS_R_01" VALUE 0x000092BE REC_UWORD_C 0 COMP_0068 0 65535 /begin FUNCTION_LIST R204.1.CanComm_1_9_2 /end FUNCTION_LIST /end CHARACTERISTIC
/begin CHARACTERISTIC mIDUCH1 "BCM_CANHS_RNr_01 CAN frame identifier" VALUE 0x000092CA REC_UWORD_C 0 COMP_0068 0 65535 DISPLAY_IDENTIFIER Cxx_BCM_CANHS_RNr_01_id /begin FUNCTION_LIST R204.1.CanComm_1_9_2 /end FUNCTION_LIST /end CHARACTERISTIC
/begin CHARACTERISTIC mIDUCH2 "BCM_CANHS_RNr_02 CAN frame identifier" VALUE 0x000092CC REC_UWORD_C 0 COMP_0068 0 65535 DISPLAY_IDENTIFIER Cxx_BCM_CANHS_RNr_02_id /begin FUNCTION_LIST R204.1.CanComm_1_9_2 /end FUNCTION_LIST /end CHARACTERISTIC
/begin CHARACTERISTIC mIDUCHV "BCM_VERLOG CAN frame identifier" VALUE 0x000092D2 REC_UWORD_C 0 COMP_0068 0 65535 DISPLAY_IDENTIFIER Cxx_BCM_VERLOG_id /begin FUNCTION_LIST R204.1.CanComm_1_9_2 /end FUNCTION_LIST /end CHARACTERISTIC
/begin CHARACTERISTIC mIDUPC1 "USM_CANHS_RNr_01 CAN frame identifier" VALUE 0x000092D6 REC_UWORD_C 0 COMP_0068 0 65535 DISPLAY_IDENTIFIER Cxx_USM_CANHS_RNr_01_id /begin FUNCTION_LIST R204.1.CanComm_1_9_2 /end FUNCTION_LIST /end CHARACTERISTIC
/begin CHARACTERISTIC mIDVRLG "ECM_VERLOG" VALUE 0x000092DC REC_UWORD_C 0 COMP_0068 0 65535 /begin FUNCTION_LIST R204.1.CanComm_1_9_2 /end FUNCTION_LIST /end CHARACTERISTIC
/begin CHARACTERISTIC mIGKSTALN "Engine speed threshold for resetting stall recognition" VALUE 0x000092E2 REC_UWORD_C 0 COMP_0337_S 0 65535 DISPLAY_IDENTIFIER Cxx_igk_stal_eng_n_thd /begin FUNCTION_LIST R203.2.crk_restx_1_0_8 /end FUNCTION_LIST /end CHARACTERISTIC
/begin CHARACTERISTIC mINCABABS "abs absent counter increment value" VALUE 0x0000870B REC_UBYTE_C 0 COMP_0068 0 255 DISPLAY_IDENTIFIER Cxx_abs_vld_abst_frm_inc /begin FUNCTION_LIST R204.1.CanComm_1_9_2 /end FUNCTION_LIST /end CHARACTERISTIC
/begin CHARACTERISTIC mINCABACC "acc absent counter increment value" VALUE 0x0000870C REC_UBYTE_C 0 COMP_0068 0 255 DISPLAY_IDENTIFIER Cxx_acc_vld_abst_frm_inc /begin FUNCTION_LIST R204.1.CanComm_1_9_2 /end FUNCTION_LIST /end CHARACTERISTIC
/begin CHARACTERISTIC mINCABBVA "automatic gearbox absent counter increment value" VALUE 0x0000870D REC_UBYTE_C 0 COMP_0068 0 255 DISPLAY_IDENTIFIER Cxx_agb_vld_abst_frm_inc /begin FUNCTION_LIST R204.1.CanComm_1_9_2 /end FUNCTION_LIST /end CHARACTERISTIC
/begin CHARACTERISTIC mINCABCLM "Climate Control Unit decrementation value for validated absent CAN failure counter" VALUE 0x0000870E REC_UBYTE_C 0 COMP_0068 0 255 DISPLAY_IDENTIFIER Cxx_ac_vld_abst_frm_inc /begin FUNCTION_LIST R204.1.CanComm_1_9_2 /end FUNCTION_LIST /end CHARACTERISTIC
/begin CHARACTERISTIC mINCABCLU "Cluster Control Unit incrementation value for validated absent CAN failure counter" VALUE 0x0000870F REC_UBYTE_C 0 COMP_0068 0 255 DISPLAY_IDENTIFIER incabtdb /begin FUNCTION_LIST R204.1.CanComm_1_9_2 /end FUNCTION_LIST /end CHARACTERISTIC
/begin CHARACTERISTIC mINCABDDC "DDCM Control Unit : incrementation value for    validated absent CAN failure counter" VALUE 0x00008710 REC_UBYTE_C 0 COMP_0068 0 255 DISPLAY_IDENTIFIER Cxx_ddcm_vld_abst_frm_inc /begin FUNCTION_LIST R204.1.CanComm_1_9_2 /end FUNCTION_LIST /end CHARACTERISTIC
/begin CHARACTERISTIC mINCABSWA "Steering Wheel Angle Control Unit incrementation value for validated absent CAN failure counter" VALUE 0x00008712 REC_UBYTE_C 0 COMP_0068 0 255 DISPLAY_IDENTIFIER Cxx_swa_vld_abst_frm_inc /begin FUNCTION_LIST R204.1.CanComm_1_9_2 /end FUNCTION_LIST /end CHARACTERISTIC
/begin CHARACTERISTIC mINCABUCH "uch absent counter increment value" VALUE 0x00008714 REC_UBYTE_C 0 COMP_0068 0 255 DISPLAY_IDENTIFIER incabuch /begin FUNCTION_LIST R204.1.CanComm_1_9_2 /end FUNCTION_LIST /end CHARACTERISTIC
/begin CHARACTERISTIC mINCABUPC "Increment of the C_Absent (UPC) volatile counter" VALUE 0x00008715 REC_UBYTE_C 0 COMP_0068 0 255 DISPLAY_IDENTIFIER incabupc /begin FUNCTION_LIST R204.1.CanComm_1_9_2 /end FUNCTION_LIST /end CHARACTERISTIC
/begin CHARACTERISTIC mINCMUTE "module mute counter increment value" VALUE 0x0000871C REC_UBYTE_C 0 COMP_0068 0 255 DISPLAY_IDENTIFIER incmute /begin FUNCTION_LIST R204.1.CanComm_1_9_2 /end FUNCTION_LIST /end CHARACTERISTIC
/begin CHARACTERISTIC mINCSAC "Type of increase slope for the air conditioning idle speed setpoint (1=Low 2=Med 3=Fast)" VALUE 0x0000871F REC_UBYTE_C 0 COMP_0068 0 255 DISPLAY_IDENTIFIER Cxx_inc_slop_ac_sp /begin FUNCTION_LIST R107.1.iss_ariss_1_0_4 /end FUNCTION_LIST /end CHARACTERISTIC
/begin CHARACTERISTIC mINCSAGB "Type of increase slope for the AGB idle speed setpoint (1=Low 2=Med 3=Fast)" VALUE 0x00008720 REC_UBYTE_C 0 COMP_0068 0 255 DISPLAY_IDENTIFIER Cxx_inc_slop_agb_sp /begin FUNCTION_LIST R107.1.iss_ariss_1_0_4 /end FUNCTION_LIST /end CHARACTERISTIC
/begin CHARACTERISTIC mINCSBRK "Type of increase slope for Brake Off at D range idle speed setpoint" VALUE 0x00008721 REC_UBYTE_C 0 COMP_0068 0 255 /begin FUNCTION_LIST R107.1.iss_ariss_1_0_4 /end FUNCTION_LIST /end CHARACTERISTIC
/begin CHARACTERISTIC mINCSDIAG "Type of increase slope for the after sale idle speed setpoint (1=Low 2=Med 3=Fast)" VALUE 0x00008722 REC_UBYTE_C 0 COMP_0068 0 255 DISPLAY_IDENTIFIER Cxx_inc_slop_diag_sp /begin FUNCTION_LIST R107.1.iss_ariss_1_0_4 /end FUNCTION_LIST /end CHARACTERISTIC
/begin CHARACTERISTIC mINCSFS "Type of increase slope for Failures idle speed setpoint" VALUE 0x00008723 REC_UBYTE_C 0 COMP_0068 0 255 /begin FUNCTION_LIST R107.1.iss_ariss_1_0_4 /end FUNCTION_LIST /end CHARACTERISTIC
/begin CHARACTERISTIC mINCSHEAT "Type of increase slope for Engine Start at very hot condition idle speed setpoint" VALUE 0x00008724 REC_UBYTE_C 0 COMP_0068 0 255 /begin FUNCTION_LIST R107.1.iss_ariss_1_0_4 /end FUNCTION_LIST /end CHARACTERISTIC
/begin CHARACTERISTIC mINCSHOMO "Type of increase slope for DIG homogeneous combustion mode idle speed setpoint" VALUE 0x00008725 REC_UBYTE_C 0 COMP_0068 0 255 /begin FUNCTION_LIST R107.1.iss_ariss_1_0_4 /end FUNCTION_LIST /end CHARACTERISTIC
/begin CHARACTERISTIC mINCSPFT "Type of increase slope for the particle filter idle speed setpoint (1=Low 2=Med 3=Fast)" VALUE 0x00008726 REC_UBYTE_C 0 COMP_0068 0 255 DISPLAY_IDENTIFIER Cxx_inc_slop_pft_sp /begin FUNCTION_LIST R107.1.iss_ariss_1_0_4 /end FUNCTION_LIST /end CHARACTERISTIC
/begin CHARACTERISTIC mINCSPIGR "Type of increase slope for Hot water and air temperature idle speed setpoint" VALUE 0x00008727 REC_UBYTE_C 0 COMP_0068 0 255 /begin FUNCTION_LIST R107.1.iss_ariss_1_0_4 /end FUNCTION_LIST /end CHARACTERISTIC
/begin CHARACTERISTIC mINCSPSFL "Type of increase slope for Power-steering oil pressure sensor fail-safe idle speed setpoint" VALUE 0x00008728 REC_UBYTE_C 0 COMP_0068 0 255 /begin FUNCTION_LIST R107.1.iss_ariss_1_0_4 /end FUNCTION_LIST /end CHARACTERISTIC
/begin CHARACTERISTIC mINCSPTC "Type of increase slope for the PTC idle speed setpoint (1=Low 2=Med 3=Fast)" VALUE 0x00008729 REC_UBYTE_C 0 COMP_0068 0 255 DISPLAY_IDENTIFIER Cxx_inc_slop_ptc_sp /begin FUNCTION_LIST R107.1.iss_ariss_1_0_4 /end FUNCTION_LIST /end CHARACTERISTIC
/begin CHARACTERISTIC mINCSPWST "Type of increase slope for the power steering idle speed setpoint (1=Low 2=Med 3=Fast)" VALUE 0x0000872A REC_UBYTE_C 0 COMP_0068 0 255 DISPLAY_IDENTIFIER Cxx_inc_slop_pwst_sp /begin FUNCTION_LIST R107.1.iss_ariss_1_0_4 /end FUNCTION_LIST /end CHARACTERISTIC
/begin CHARACTERISTIC mINCSRUN "Type of increase slope for the running vehicle idle speed setpoint (1=Low 2=Med 3=Fast)" VALUE 0x0000872B REC_UBYTE_C 0 COMP_0068 0 255 DISPLAY_IDENTIFIER Cxx_inc_slop_run_vh_sp /begin FUNCTION_LIST R107.1.iss_ariss_1_0_4 /end FUNCTION_LIST /end CHARACTERISTIC
/begin CHARACTERISTIC mINCSTHPL "Type of increase slope for the thermoplunger idle speed setpoint (1=Low 2=Med 3=Fast)" VALUE 0x0000872C REC_UBYTE_C 0 COMP_0068 0 255 DISPLAY_IDENTIFIER Cxx_inc_slop_thpl_sp /begin FUNCTION_LIST R107.1.iss_ariss_1_0_4 /end FUNCTION_LIST /end CHARACTERISTIC
/begin CHARACTERISTIC mINCSTW "Type of increase slope for the coolant temperature idle speed setpoint (1=Low 2=Med 3=Fast)" VALUE 0x0000872D REC_UBYTE_C 0 COMP_0068 0 255 DISPLAY_IDENTIFIER Cxx_inc_slop_tco_sp /begin FUNCTION_LIST R107.1.iss_ariss_1_0_4 /end FUNCTION_LIST /end CHARACTERISTIC
/begin CHARACTERISTIC mINCSWIND "Type of increase slope for the electrical windshield idle speed setpoint (1=Low 2=Med 3=Fast)" VALUE 0x0000872E REC_UBYTE_C 0 COMP_0068 0 255 DISPLAY_IDENTIFIER Cxx_inc_slop_el_wind_sp /begin FUNCTION_LIST R107.1.iss_ariss_1_0_4 /end FUNCTION_LIST /end CHARACTERISTIC
/begin CHARACTERISTIC mISSDEC "Idle speed setpoint decrementation" VALUE 0x0000930C REC_UWORD_C 0 COMP_0406_S -65535 0 DISPLAY_IDENTIFIER Cxx_n_sp_dec /begin FUNCTION_LIST R107.1.iss_ariss_1_0_4 /end FUNCTION_LIST /end CHARACTERISTIC
/begin CHARACTERISTIC mMAXISS "Maximum idle speed setpoint authorized" VALUE 0x0000939A REC_UWORD_C 0 COMP_0337_S 0 65535 DISPLAY_IDENTIFIER Cxx_is_n_sp_max /begin FUNCTION_LIST R107.1.iss_ariss_1_0_4 /end FUNCTION_LIST /end CHARACTERISTIC
/begin CHARACTERISTIC mMEDDECS "Value of the medium decrease slope" VALUE 0x000093A0 REC_UWORD_C 0 COMP_0406_S -65535 0 DISPLAY_IDENTIFIER Cxx_med_dec_slop /begin FUNCTION_LIST R107.1.iss_ariss_1_0_4 /end FUNCTION_LIST /end CHARACTERISTIC
/begin CHARACTERISTIC mMEDINCS "Value of the medium increase slope" VALUE 0x000093A2 REC_UWORD_C 0 COMP_0407_S 0 65535 DISPLAY_IDENTIFIER Cxx_med_inc_slop /begin FUNCTION_LIST R107.1.iss_ariss_1_0_4 /end FUNCTION_LIST /end CHARACTERISTIC
/begin CHARACTERISTIC mMINISS "Minimum idle speed setpoint authorized" VALUE 0x000093A8 REC_UWORD_C 0 COMP_0337_S 0 65535 DISPLAY_IDENTIFIER Cxx_is_n_sp_min /begin FUNCTION_LIST R107.1.iss_ariss_1_0_4 /end FUNCTION_LIST /end CHARACTERISTIC
/begin CHARACTERISTIC mMSWDLYS "Main switch press validation time" VALUE 0x00008873 REC_UBYTE_C 0 COMP_0105 0 25.5 DISPLAY_IDENTIFIER Cxx_cru_sl_swi_dly /begin FUNCTION_LIST R208.1.SWTCH_1_1_7 /end FUNCTION_LIST /end CHARACTERISTIC
/begin CHARACTERISTIC mNEUTVBRF "Electric balance protection voltage reference" VALUE 0x000093C8 REC_UWORD_C 0 COMP_0492 0 65535 DISPLAY_IDENTIFIER Cxx_el_csm_clc_neut_vb /begin FUNCTION_LIST R107.3.iss_eliss_1_0_4 /end FUNCTION_LIST /end CHARACTERISTIC
/begin CHARACTERISTIC mPFRZDLY "Timeout freeze condition, used in freeze condition bloc" VALUE 0x000089A6 REC_UBYTE_C 0 COMP_0013 0 255 DISPLAY_IDENTIFIER Cxx_ptc_frz_dly /begin FUNCTION_LIST R106.5.epw_ptcxx_1_1_0 /end FUNCTION_LIST /end CHARACTERISTIC
/begin CHARACTERISTIC mPPMNENA "Minimum power limitation used in power limitation" VALUE 0x000089AF REC_UBYTE_C 0 COMP_0439_S 0 5100 DISPLAY_IDENTIFIER Cxx_ptc_min_pow_ena_min /begin FUNCTION_LIST R106.5.epw_ptcxx_1_1_0 /end FUNCTION_LIST /end CHARACTERISTIC
/begin CHARACTERISTIC mPPMXEDEC "Decrement of power limitation, in power limitation bloc" VALUE 0x000089B0 REC_UBYTE_C 0 COMP_0440_S -1020 0 DISPLAY_IDENTIFIER Cxx_ptc_max_pow_ena_dec /begin FUNCTION_LIST R106.5.epw_ptcxx_1_1_0 /end FUNCTION_LIST /end CHARACTERISTIC
/begin CHARACTERISTIC mPPMXEINC "Increment of power limitation, in power limitation bloc" VALUE 0x000089B1 REC_UBYTE_C 0 COMP_0441_S 0 1020 DISPLAY_IDENTIFIER Cxx_ptc_max_pow_ena_inc /begin FUNCTION_LIST R106.5.epw_ptcxx_1_1_0 /end FUNCTION_LIST /end CHARACTERISTIC
/begin CHARACTERISTIC mPRSCLMHI "High threshold for AC pressure sensor failure detection" VALUE 0x00009440 REC_UWORD_C 0 COMP_0411_S 0 5.119921875 DISPLAY_IDENTIFIER prsclimhi /begin FUNCTION_LIST R202.1.acx_acprs_1_2_3 /end FUNCTION_LIST /end CHARACTERISTIC
/begin CHARACTERISTIC mPRSCLMLO "Low threshold for AC pressure sensor failure detection" VALUE 0x00009442 REC_UWORD_C 0 COMP_0411_S 0 5.119921875 DISPLAY_IDENTIFIER prsclimlo /begin FUNCTION_LIST R202.1.acx_acprs_1_2_3 /end FUNCTION_LIST /end CHARACTERISTIC
/begin CHARACTERISTIC mPRSLKDLY "Duration of air con pressure" VALUE 0x000089CC REC_UBYTE_C 0 COMP_0443_S 0 5.1 DISPLAY_IDENTIFIER Cxx_ac_prs_lk_stt_dly /begin FUNCTION_LIST R202.1.acx_acprs_1_2_3 /end FUNCTION_LIST /end CHARACTERISTIC
/begin CHARACTERISTIC mPTCISS "PTC idle speed setpoint calibration" VALUE 0x0000944A REC_UWORD_C 0 COMP_0337_S 0 65535 DISPLAY_IDENTIFIER Cxx_ptc_min_is_n /begin FUNCTION_LIST R107.3.iss_eliss_1_0_4 /end FUNCTION_LIST /end CHARACTERISTIC
/begin CHARACTERISTIC mPWSTISSD "Power steering idle speed setpoint calibration under drive mode of the automatic transmission" VALUE 0x0000944E REC_UWORD_C 0 COMP_0337_S 0 65535 DISPLAY_IDENTIFIER Cxx_agb_pwst_min_is_n /begin FUNCTION_LIST R107.4.iss_mciss_1_0_2 /end FUNCTION_LIST /end CHARACTERISTIC
/begin CHARACTERISTIC mPWSTISSN "Power steering idle speed setpoint calibration under neutral mode of the AT (or manual gearbox)" VALUE 0x00009450 REC_UWORD_C 0 COMP_0337_S 0 65535 DISPLAY_IDENTIFIER Cxx_pn_pwst_min_is_n /begin FUNCTION_LIST R107.4.iss_mciss_1_0_2 /end FUNCTION_LIST /end CHARACTERISTIC
/begin CHARACTERISTIC mRESTGA1 "Restart correction gain 1 (for KAS correction)" VALUE 0x00008A41 REC_UBYTE_C 0 COMP_0449_S 0 1.00000035 /begin FUNCTION_LIST R203.2.crk_restx_1_0_8 /end FUNCTION_LIST /end CHARACTERISTIC
/begin CHARACTERISTIC mRESTGA2 "Restart correction gain 2 (for TISTn correction)" VALUE 0x00008A42 REC_UBYTE_C 0 COMP_0449_S 0 1.00000035 /begin FUNCTION_LIST R203.2.crk_restx_1_0_8 /end FUNCTION_LIST /end CHARACTERISTIC
/begin CHARACTERISTIC mRESTTWH "High tco offset on the memorized tco to detect tco evolution since last engine start" VALUE 0x00008A45 REC_UBYTE_C 0 COMP_0450_S 0 159.375 DISPLAY_IDENTIFIER Cxx_rest_tco_up_ofs /begin FUNCTION_LIST R203.2.crk_restx_1_0_8 /end FUNCTION_LIST /end CHARACTERISTIC
/begin CHARACTERISTIC mRESTTWL "Low tco offset on the memorized tco to detect tco evolution since last engine start" VALUE 0x00008A46 REC_UBYTE_C 0 COMP_0450_S 0 159.375 DISPLAY_IDENTIFIER Cxx_rest_tco_l_ofs /begin FUNCTION_LIST R203.2.crk_restx_1_0_8 /end FUNCTION_LIST /end CHARACTERISTIC
/begin CHARACTERISTIC mRESTTWT "TCO value inhibiting the restart strategy" VALUE 0x00008A47 REC_UBYTE_C 0 COMP_0356 -40 119.375 DISPLAY_IDENTIFIER Cxx_stop_rest_tco_thd /begin FUNCTION_LIST R203.2.crk_restx_1_0_8 /end FUNCTION_LIST /end CHARACTERISTIC
/begin CHARACTERISTIC mRESTUCR "Successive restarts correction factor" VALUE 0x00008A48 REC_UBYTE_C 0 COMP_0068 0 255 DISPLAY_IDENTIFIER Cxx_rest_ufld_cor /begin FUNCTION_LIST R203.2.crk_restx_1_0_8 /end FUNCTION_LIST /end CHARACTERISTIC
/begin CHARACTERISTIC mRESTUCR1 "First start correction factor" VALUE 0x00008A49 REC_UBYTE_C 0 COMP_0068 0 255 DISPLAY_IDENTIFIER Cxx_rest1_ufld_cor /begin FUNCTION_LIST R203.2.crk_restx_1_0_8 /end FUNCTION_LIST /end CHARACTERISTIC
/begin CHARACTERISTIC mRESTUFLD "Unflooding counter value inhibiting the specific maintain of ECU power supply" VALUE 0x00008A4A REC_UBYTE_C 0 COMP_0068 0 255 DISPLAY_IDENTIFIER Cxx_stop_rest_ufld_thd /begin FUNCTION_LIST R203.2.crk_restx_1_0_8 /end FUNCTION_LIST /end CHARACTERISTIC
/begin CHARACTERISTIC mRGMNVSC "Minimum engine speed for use in cranking management strategy" VALUE 0x000094A6 REC_UWORD_C 0 COMP_0443 0 65535 DISPLAY_IDENTIFIER rgmnvsc /begin FUNCTION_LIST R203.1.crk_mngtx_1_2_1 /end FUNCTION_LIST /end CHARACTERISTIC
/begin CHARACTERISTIC mRHLDAPOH "pedal position upper condition in high load condition bloc" VALUE 0x000094A8 REC_UWORD_C 0 COMP_0451_S 0 81.91875 DISPLAY_IDENTIFIER Cxx_ptc_fl_pdl_up_thd /begin FUNCTION_LIST R106.5.epw_ptcxx_1_1_0 /end FUNCTION_LIST /end CHARACTERISTIC
/begin CHARACTERISTIC mRHLDAPOL "pedal position lower condition in high load condition bloc" VALUE 0x000094AA REC_UWORD_C 0 COMP_0451_S 0 81.91875 DISPLAY_IDENTIFIER Cxx_ptc_fl_pdl_l_thd /begin FUNCTION_LIST R106.5.epw_ptcxx_1_1_0 /end FUNCTION_LIST /end CHARACTERISTIC
/begin CHARACTERISTIC mRTOFAPOH "pedal position upper condition in take off condition bloc" VALUE 0x000094EE REC_UWORD_C 0 COMP_0451_S 0 81.91875 DISPLAY_IDENTIFIER Cxx_ptc_tkof_pdl_up_thd /begin FUNCTION_LIST R106.5.epw_ptcxx_1_1_0 /end FUNCTION_LIST /end CHARACTERISTIC
/begin CHARACTERISTIC mRUNUFLC1 "Number of tdc to count between two unflooding counter incrementations (validity during the beginning of running only)" VALUE 0x00008ADF REC_UBYTE_C 0 COMP_0461_S 0 255 DISPLAY_IDENTIFIER Cxx_run_ufld_ctr_inc1 /begin FUNCTION_LIST R203.2.crk_restx_1_0_8 /end FUNCTION_LIST /end CHARACTERISTIC
/begin CHARACTERISTIC mRUNUFLC2 "Number of tdc to count between two unflooding counter incrementations (valid only after a delay)" VALUE 0x00008AE0 REC_UBYTE_C 0 COMP_0461_S 0 255 DISPLAY_IDENTIFIER Cxx_run_ufld_ctr_inc2 /begin FUNCTION_LIST R203.2.crk_restx_1_0_8 /end FUNCTION_LIST /end CHARACTERISTIC
/begin CHARACTERISTIC mSAPMXMUX "Alternator maximum allowed power sent on the CAN at power supply of the injection ECU" VALUE 0x00008AE6 REC_UBYTE_C 0 COMP_0360_S 0 10200 DISPLAY_IDENTIFIER Cxx_mux_sta_alt_max_pow_ena /begin FUNCTION_LIST R106.1.epw_altxx_1_1_0 /end FUNCTION_LIST /end CHARACTERISTIC
/begin CHARACTERISTIC mSASLPMUX "Power slope sent to the USM at power supply of the injection ECU" VALUE 0x00008AE7 REC_UBYTE_C 0 COMP_0463_S 0 10200 DISPLAY_IDENTIFIER Cxx_mux_sta_alt_slop_req /begin FUNCTION_LIST R106.1.epw_altxx_1_1_0 /end FUNCTION_LIST /end CHARACTERISTIC
/begin CHARACTERISTIC mSLOWDECS "Value of the slow decrease slope" VALUE 0x00009508 REC_UWORD_C 0 COMP_0406_S -65535 0 DISPLAY_IDENTIFIER Cxx_slow_dec_slop /begin FUNCTION_LIST R107.1.iss_ariss_1_0_4 /end FUNCTION_LIST /end CHARACTERISTIC
/begin CHARACTERISTIC mSLOWINCS "Value of the slow increase slope" VALUE 0x0000950A REC_UWORD_C 0 COMP_0407_S 0 65535 DISPLAY_IDENTIFIER Cxx_slow_inc_slop /begin FUNCTION_LIST R107.1.iss_ariss_1_0_4 /end FUNCTION_LIST /end CHARACTERISTIC
/begin CHARACTERISTIC mSPRSGMV0 "Security AC pressure threshold for fans activation when there is no ac presence" VALUE 0x00009558 REC_UWORD_C 0 COMP_0420_S 0 6553.5 DISPLAY_IDENTIFIER sprs0gmv /begin FUNCTION_LIST R202.2.acx_mdfan_1_2_2 /end FUNCTION_LIST /end CHARACTERISTIC
/begin CHARACTERISTIC mSRGMNVSC "Minimum engine speed threshold used for engine state calculation" VALUE 0x0000955E REC_UWORD_C 0 COMP_0443 0 65535 DISPLAY_IDENTIFIER srgmnvsc /begin FUNCTION_LIST R203.1.crk_mngtx_1_2_1 /end FUNCTION_LIST /end CHARACTERISTIC
/begin CHARACTERISTIC mSSWBLKMX "CC/SL : maximum number of unexpected switch changes before blocked switch detection" VALUE 0x00008B28 REC_UBYTE_C 0 COMP_0068 0 255 DISPLAY_IDENTIFIER Cxx_cru_sl_whl_cmd_blk_ctr_max /begin FUNCTION_LIST R208.1.SWTCH_1_1_7 /end FUNCTION_LIST /end CHARACTERISTIC
/begin CHARACTERISTIC mSTAINJNO "Engine speed threshold for resetting starting injection" VALUE 0x00009560 REC_UWORD_C 0 COMP_0337_S 0 65535 DISPLAY_IDENTIFIER Cxx_out_inj_sta_n_thd /begin FUNCTION_LIST R203.2.crk_restx_1_0_8 /end FUNCTION_LIST /end CHARACTERISTIC
/begin CHARACTERISTIC mSTAPDEC "Alternator power min slew rate after start" VALUE 0x000081B4 REC_SBYTE_C 0 COMP_0467_S -1280 1270 DISPLAY_IDENTIFIER Cxx_sta_alt_dec /begin FUNCTION_LIST R106.7.epw_tqalt_1_1_0 /end FUNCTION_LIST /end CHARACTERISTIC
/begin CHARACTERISTIC mSTAPINC "Alternator power max slew rate after start" VALUE 0x000081B5 REC_SBYTE_C 0 COMP_0467_S -1280 1270 DISPLAY_IDENTIFIER Cxx_sta_alt_inc /begin FUNCTION_LIST R106.7.epw_tqalt_1_1_0 /end FUNCTION_LIST /end CHARACTERISTIC
/begin CHARACTERISTIC mSTAPMX "Maximum power allowed to the alternator at engine start" VALUE 0x00009562 REC_UWORD_C 0 COMP_0365_S 0 655350 DISPLAY_IDENTIFIER Cxx_sta_alt_max_pow_ena /begin FUNCTION_LIST R106.2.epw_mxalt_1_1_0 /end FUNCTION_LIST /end CHARACTERISTIC
/begin CHARACTERISTIC mSTLRFAC "Specific restart correction after engine stall" VALUE 0x00008B34 REC_UBYTE_C 0 COMP_0068 0 255 DISPLAY_IDENTIFIER Cxx_stal_rest_fac /begin FUNCTION_LIST R203.2.crk_restx_1_0_8 /end FUNCTION_LIST /end CHARACTERISTIC
/begin CHARACTERISTIC mSTOPBVR "Coherence checking of the robotized gearbox engine stop request" VALUE 0x00008B3B REC_UBYTE_C 0 COMP_0068 0 255 DISPLAY_IDENTIFIER stopbvr /begin FUNCTION_LIST R201.1.stp_mngtx_1_2_2 /end FUNCTION_LIST /end CHARACTERISTIC
/begin CHARACTERISTIC mSTOPSSG "Coherence checking of the SSG engine stop request" VALUE 0x00008B3C REC_UBYTE_C 0 COMP_0068 0 255 DISPLAY_IDENTIFIER Cxx_eng_stop_req_ssg /begin FUNCTION_LIST R201.1.stp_mngtx_1_2_2 /end FUNCTION_LIST /end CHARACTERISTIC
/begin CHARACTERISTIC mSTOPUCCA "Emergency Engine Stop" VALUE 0x00008B3D REC_UBYTE_C 0 COMP_0068 0 255 DISPLAY_IDENTIFIER stopucca /begin FUNCTION_LIST R201.1.stp_mngtx_1_2_2 /end FUNCTION_LIST /end CHARACTERISTIC
/begin CHARACTERISTIC mSTPUFLC "Time to count between two unflooding counter incrementations (when engine is not running)" VALUE 0x00008B44 REC_UBYTE_C 0 COMP_0380_S 0 51 DISPLAY_IDENTIFIER Cxx_stop_ufld_ctr_inc /begin FUNCTION_LIST R203.2.crk_restx_1_0_8 /end FUNCTION_LIST /end CHARACTERISTIC
/begin CHARACTERISTIC mTCVSNRT1 "First time constant of second order numeric filter of ratio V/N" VALUE 0x00008B9B REC_UBYTE_C 0 COMP_0344_S 0 2.55 DISPLAY_IDENTIFIER Cxx_vs_n_rat_fil_fac1 /begin FUNCTION_LIST R108.1.dls_gbrat_vmm_1_1_5 /end FUNCTION_LIST /end CHARACTERISTIC
/begin CHARACTERISTIC mTCVSNRT2 "Second time constant of second order numeric filter of ratio V/N" VALUE 0x00008B9C REC_UBYTE_C 0 COMP_0344_S 0 2.55 DISPLAY_IDENTIFIER Cxx_vs_n_rat_fil_fac2 /begin FUNCTION_LIST R108.1.dls_gbrat_vmm_1_1_5 /end FUNCTION_LIST /end CHARACTERISTIC
/begin CHARACTERISTIC mTHPLISS "Thermoplunger idle speed setpoint calibration" VALUE 0x00009592 REC_UWORD_C 0 COMP_0337_S 0 65535 DISPLAY_IDENTIFIER Cxx_thpl_min_is_n /begin FUNCTION_LIST R107.3.iss_eliss_1_0_4 /end FUNCTION_LIST /end CHARACTERISTIC
/begin CHARACTERISTIC mTMALTCUT "Inhibition delay of the calculation of the idle speed setpoint offset under alternator cut requests" VALUE 0x00008C0F REC_UBYTE_C 0 COMP_0377_S 0 30.6 DISPLAY_IDENTIFIER Cxx_el_csm_alt_cut_dly /begin FUNCTION_LIST R107.3.iss_eliss_1_0_4 /end FUNCTION_LIST /end CHARACTERISTIC
/begin CHARACTERISTIC mTMATDEM "Duration in stopped engine state before making a starter stop request" VALUE 0x00008C15 REC_UBYTE_C 0 COMP_0215 0 51 DISPLAY_IDENTIFIER tmatdem /begin FUNCTION_LIST R203.1.crk_mngtx_1_2_1 /end FUNCTION_LIST /end CHARACTERISTIC
/begin CHARACTERISTIC mTMATVSC "Min duration of the stopped engine state before the driven engine state in case of starter absence" VALUE 0x00008C1C REC_UBYTE_C 0 COMP_0165_S 0 2.55 DISPLAY_IDENTIFIER tmatvsc /begin FUNCTION_LIST R203.1.crk_mngtx_1_2_1 /end FUNCTION_LIST /end CHARACTERISTIC
/begin CHARACTERISTIC mTMCDRLVS "Filter time to enable the cruise control and speed limiter option detection" VALUE 0x00008C23 REC_UBYTE_C 0 COMP_0344_S 0 2.55 DISPLAY_IDENTIFIER tmcdrlv /begin FUNCTION_LIST R208.1.SWTCH_1_1_7 /end FUNCTION_LIST /end CHARACTERISTIC
/begin CHARACTERISTIC mTMCRASH "Delay after crash to avoid engine running" VALUE 0x000095AA REC_UWORD_C 0 COMP_0013 0 65535 DISPLAY_IDENTIFIER tmcrash /begin FUNCTION_LIST R201.1.stp_mngtx_1_2_2 /end FUNCTION_LIST /end CHARACTERISTIC
/begin CHARACTERISTIC mTMDEFVA "Specific time out before starter stop demand for the first engine cranking" VALUE 0x00008C2F REC_UBYTE_C 0 COMP_0215 0 51 DISPLAY_IDENTIFIER tmdefva /begin FUNCTION_LIST R203.1.crk_mngtx_1_2_1 /end FUNCTION_LIST /end CHARACTERISTIC
/begin CHARACTERISTIC mTMDIAMUX "surveilance delay value for data reception during init phase" VALUE 0x00008C30 REC_UBYTE_C 0 COMP_0008 0 25500 DISPLAY_IDENTIFIER Cxx_mux_diag_ena_dly /begin FUNCTION_LIST R204.1.CanComm_1_9_2 /end FUNCTION_LIST /end CHARACTERISTIC
/begin CHARACTERISTIC mTMENGSTA "Inhibition delay of the calculation of the idle speed setpoint offset after engine start" VALUE 0x00008C39 REC_UBYTE_C 0 COMP_0377_S 0 30.6 DISPLAY_IDENTIFIER Cxx_el_csm_clc_dly /begin FUNCTION_LIST R107.3.iss_eliss_1_0_4 /end FUNCTION_LIST /end CHARACTERISTIC
/begin CHARACTERISTIC mTMFAN "Fan initial delay time" VALUE 0x00008C45 REC_UBYTE_C 0 COMP_0366_S 0 5.1 DISPLAY_IDENTIFIER Cxx_mdf_min_dly /begin FUNCTION_LIST R202.2.acx_mdfan_1_2_2 /end FUNCTION_LIST /end CHARACTERISTIC
/begin CHARACTERISTIC mTMPWSTIS "Delay of retention of the idle speed setpoint requested by the power steering" VALUE 0x00008C77 REC_UBYTE_C 0 COMP_0471_S 0 10.0000035 DISPLAY_IDENTIFIER Cxx_pwst_is_acel_rtn_dly /begin FUNCTION_LIST R107.4.iss_mciss_1_0_2 /end FUNCTION_LIST /end CHARACTERISTIC
/begin CHARACTERISTIC mTMSRVABS "Brake Control Unit absence detection time out" VALUE 0x00008C90 REC_UBYTE_C 0 COMP_0014 0 2550 DISPLAY_IDENTIFIER tmsrvbra /begin FUNCTION_LIST R204.1.CanComm_1_9_2 /end FUNCTION_LIST /end CHARACTERISTIC
/begin CHARACTERISTIC mTMSRVACC "ACC Base reception supervisory delay value" VALUE 0x00008C91 REC_UBYTE_C 0 COMP_0014 0 2550 DISPLAY_IDENTIFIER Cxx_acc_abst_frm_dly /begin FUNCTION_LIST R204.1.CanComm_1_9_2 /end FUNCTION_LIST /end CHARACTERISTIC
/begin CHARACTERISTIC mTMSRVBVA "Automatic Gear Box Control Unit absence detection time out" VALUE 0x00008C94 REC_UBYTE_C 0 COMP_0014 0 2550 DISPLAY_IDENTIFIER tmsrvat /begin FUNCTION_LIST R204.1.CanComm_1_9_2 /end FUNCTION_LIST /end CHARACTERISTIC
/begin CHARACTERISTIC mTMSRVCLM "Climate Control Unit absence detection time out" VALUE 0x00008C95 REC_UBYTE_C 0 COMP_0014 0 2550 DISPLAY_IDENTIFIER Cxx_ac_abst_frm_dly /begin FUNCTION_LIST R204.1.CanComm_1_9_2 /end FUNCTION_LIST /end CHARACTERISTIC
/begin CHARACTERISTIC mTMSRVCLU "CLUSTER GeneralStatus reception supervisory delay value" VALUE 0x00008C96 REC_UBYTE_C 0 COMP_0014 0 2550 DISPLAY_IDENTIFIER tmsrvclu /begin FUNCTION_LIST R204.1.CanComm_1_9_2 /end FUNCTION_LIST /end CHARACTERISTIC
/begin CHARACTERISTIC mTMSRVDDC "DDCM Control Unit absence detection time-out" VALUE 0x00008C97 REC_UBYTE_C 0 COMP_0014 0 2550 DISPLAY_IDENTIFIER Cxx_ddcm_abst_frm_dly /begin FUNCTION_LIST R204.1.CanComm_1_9_2 /end FUNCTION_LIST /end CHARACTERISTIC
/begin CHARACTERISTIC mTMSRVINJ "Mute (transmission failure) detection time-out" VALUE 0x00008C99 REC_UBYTE_C 0 COMP_0014 0 2550 DISPLAY_IDENTIFIER Cxx_must_abst_frm_dly /begin FUNCTION_LIST R204.1.CanComm_1_9_2 /end FUNCTION_LIST /end CHARACTERISTIC
/begin CHARACTERISTIC mTMSRVSWA "Steering Wheel Angle Control Unit absence detection time out" VALUE 0x00008C9A REC_UBYTE_C 0 COMP_0014 0 2550 DISPLAY_IDENTIFIER Cxx_swa_abst_frm_dly /begin FUNCTION_LIST R204.1.CanComm_1_9_2 /end FUNCTION_LIST /end CHARACTERISTIC
/begin CHARACTERISTIC mTMSRVUCH "UCH_ver_INJ receptiuon supervisory delay value" VALUE 0x00008C9B REC_UBYTE_C 0 COMP_0014 0 2550 DISPLAY_IDENTIFIER tmsrvuch /begin FUNCTION_LIST R204.1.CanComm_1_9_2 /end FUNCTION_LIST /end CHARACTERISTIC
/begin CHARACTERISTIC mTMSRVUPC "UPC FastFrame reception supervisory delay value" VALUE 0x00008C9C REC_UBYTE_C 0 COMP_0014 0 2550 DISPLAY_IDENTIFIER tmsrvupc /begin FUNCTION_LIST R204.1.CanComm_1_9_2 /end FUNCTION_LIST /end CHARACTERISTIC
/begin CHARACTERISTIC mTMSTLDET "Filtering of the stall detection" VALUE 0x00008C9E REC_UBYTE_C 0 COMP_0165_S 0 2.55 DISPLAY_IDENTIFIER Cxx_wait_stal_dly /begin FUNCTION_LIST R203.1.crk_mngtx_1_2_1 /end FUNCTION_LIST /end CHARACTERISTIC
/begin CHARACTERISTIC mTOFGRTH "Physical gear ratio upper condition in take off condition bloc" VALUE 0x000095D4 REC_UWORD_C 0 COMP_0472_S 0 655.35 DISPLAY_IDENTIFIER Cxx_ptc_tkof_gear_up_thd /begin FUNCTION_LIST R106.5.epw_ptcxx_1_1_0 /end FUNCTION_LIST /end CHARACTERISTIC
/begin CHARACTERISTIC mTOFGRTL "Physical gear ratio lower condition in take off condition bloc" VALUE 0x000095D6 REC_UWORD_C 0 COMP_0472_S 0 655.35 DISPLAY_IDENTIFIER Cxx_ptc_tkof_gear_l_thd /begin FUNCTION_LIST R106.5.epw_ptcxx_1_1_0 /end FUNCTION_LIST /end CHARACTERISTIC
/begin CHARACTERISTIC mTOFNETH "Engine speed upper condition in take off condition bloc" VALUE 0x000095D8 REC_UWORD_C 0 COMP_0337_S 0 65535 DISPLAY_IDENTIFIER Cxx_ptc_tkof_n_up_thd /begin FUNCTION_LIST R106.5.epw_ptcxx_1_1_0 /end FUNCTION_LIST /end CHARACTERISTIC
/begin CHARACTERISTIC mTOFNETL "Engine speed lower condition in take off condition bloc" VALUE 0x000095DA REC_UWORD_C 0 COMP_0337_S 0 65535 DISPLAY_IDENTIFIER Cxx_ptc_tkof_n_l_thd /begin FUNCTION_LIST R106.5.epw_ptcxx_1_1_0 /end FUNCTION_LIST /end CHARACTERISTIC
/begin CHARACTERISTIC mTOFVSPTH "Vehicule speed upper condition in take off condition bloc" VALUE 0x000095DC REC_UWORD_C 0 COMP_0375_S 0 655.35 DISPLAY_IDENTIFIER Cxx_ptc_tkof_vs_up_thd /begin FUNCTION_LIST R106.5.epw_ptcxx_1_1_0 /end FUNCTION_LIST /end CHARACTERISTIC
/begin CHARACTERISTIC mTOFVSPTL "Vehicule speed lower condition in take off condition bloc" VALUE 0x000095DE REC_UWORD_C 0 COMP_0375_S 0 655.35 DISPLAY_IDENTIFIER Cxx_ptc_tkof_vs_l_thd /begin FUNCTION_LIST R106.5.epw_ptcxx_1_1_0 /end FUNCTION_LIST /end CHARACTERISTIC
/begin CHARACTERISTIC mTPAPBOUS "Steering wheel switch press validation time" VALUE 0x00008CC3 REC_UBYTE_C 0 COMP_0344_S 0 2.55 DISPLAY_IDENTIFIER tpapbout /begin FUNCTION_LIST R208.1.SWTCH_1_1_7 /end FUNCTION_LIST /end CHARACTERISTIC
/begin CHARACTERISTIC mTPAUGCOS "Minimum duration of a push button press for continuous increase of requested speed" VALUE 0x00008CC4 REC_UBYTE_C 0 COMP_0344_S 0 2.55 DISPLAY_IDENTIFIER tpaugcon /begin FUNCTION_LIST R208.1.SWTCH_1_1_7 /end FUNCTION_LIST /end CHARACTERISTIC
/begin CHARACTERISTIC mTPDIMCOS "Minimum duration of a push button press for continuous decrease of requested speed" VALUE 0x00008CCB REC_UBYTE_C 0 COMP_0344_S 0 2.55 DISPLAY_IDENTIFIER tpdimcon /begin FUNCTION_LIST R208.1.SWTCH_1_1_7 /end FUNCTION_LIST /end CHARACTERISTIC
/begin CHARACTERISTIC mTPSPALVS "Time between two requested speed increments or decrements when button is pressed continuously" VALUE 0x00008CDC REC_UBYTE_C 0 COMP_0105 0 25.5 DISPLAY_IDENTIFIER tpspalvi /begin FUNCTION_LIST R208.1.SWTCH_1_1_7 /end FUNCTION_LIST /end CHARACTERISTIC
/begin CHARACTERISTIC mUCEMUX1 "Mute (transmission failure detection) feature for Mux configuration detection (always present or optional)" VALUE 0x00008D84 REC_UBYTE_C 0 COMP_0068 0 255 DISPLAY_IDENTIFIER Cxx_mute_ecu_conf /begin FUNCTION_LIST R204.1.CanComm_1_9_2 /end FUNCTION_LIST /end CHARACTERISTIC
/begin CHARACTERISTIC mUCEMUX14 "Init value of data UCE14 for diag frame  mux network " VALUE 0x00008D86 REC_UBYTE_C 0 COMP_0068 0 255 DISPLAY_IDENTIFIER Cxx_swa_ecu_conf /begin FUNCTION_LIST R204.1.CanComm_1_9_2 /end FUNCTION_LIST /end CHARACTERISTIC
/begin CHARACTERISTIC mUCEMUX2 "Init value of data UCE2 for diag frame  mux network " VALUE 0x00008D87 REC_UBYTE_C 0 COMP_0068 0 255 DISPLAY_IDENTIFIER ucemux2 /begin FUNCTION_LIST R204.1.CanComm_1_9_2 /end FUNCTION_LIST /end CHARACTERISTIC
/begin CHARACTERISTIC mUCEMUX20 "Init value of data UCE20 for diag frame  mux network " VALUE 0x00008D88 REC_UBYTE_C 0 COMP_0068 0 255 DISPLAY_IDENTIFIER ucemux20 /begin FUNCTION_LIST R204.1.CanComm_1_9_2 /end FUNCTION_LIST /end CHARACTERISTIC
/begin CHARACTERISTIC mUCEMUX24 "DDCM Control Unit feature for Mux configuration detection" VALUE 0x00008D89 REC_UBYTE_C 0 COMP_0068 0 255 DISPLAY_IDENTIFIER Cxx_ddcm_ecu_conf /begin FUNCTION_LIST R204.1.CanComm_1_9_2 /end FUNCTION_LIST /end CHARACTERISTIC
/begin CHARACTERISTIC mUCEMUX3 "Init value of data UCE3 for diag frame  mux network " VALUE 0x00008D8A REC_UBYTE_C 0 COMP_0068 0 255 DISPLAY_IDENTIFIER ucemux3 /begin FUNCTION_LIST R204.1.CanComm_1_9_2 /end FUNCTION_LIST /end CHARACTERISTIC
/begin CHARACTERISTIC mUCEMUX4 "Init value of data UCE4 for diag frame  mux network " VALUE 0x00008D8B REC_UBYTE_C 0 COMP_0068 0 255 DISPLAY_IDENTIFIER ucemux4 /begin FUNCTION_LIST R204.1.CanComm_1_9_2 /end FUNCTION_LIST /end CHARACTERISTIC
/begin CHARACTERISTIC mUCEMUX7 "Init value of data UCE7 for diag frame  mux network " VALUE 0x00008D8C REC_UBYTE_C 0 COMP_0068 0 255 DISPLAY_IDENTIFIER Cxx_acc_ecu_conf /begin FUNCTION_LIST R204.1.CanComm_1_9_2 /end FUNCTION_LIST /end CHARACTERISTIC
/begin CHARACTERISTIC mUCEMUX8 "Init value of data UCE8 for diag frame  mux network " VALUE 0x00008D8D REC_UBYTE_C 0 COMP_0068 0 255 DISPLAY_IDENTIFIER ucemux8 /begin FUNCTION_LIST R204.1.CanComm_1_9_2 /end FUNCTION_LIST /end CHARACTERISTIC
/begin CHARACTERISTIC mUCEMUX9 "Init value of data UCE9 for diag frame  mux network " VALUE 0x00008D8E REC_UBYTE_C 0 COMP_0068 0 255 DISPLAY_IDENTIFIER ucemux9 /begin FUNCTION_LIST R204.1.CanComm_1_9_2 /end FUNCTION_LIST /end CHARACTERISTIC
/begin CHARACTERISTIC mURDDFTH "Value to declare detected failure of USM fast frame reception (Nbre de d? clarations upc absent avant d? tection panne)" VALUE 0x00008D92 REC_UBYTE_C 0 COMP_0068 0 255 DISPLAY_IDENTIFIER Cxx_dfth_abst_usm_fast_frm /begin FUNCTION_LIST R106.3.epw_palmx_1_1_0 /end FUNCTION_LIST /end CHARACTERISTIC
/begin CHARACTERISTIC mVALMAX "max value of memorized counters" VALUE 0x00008D96 REC_UBYTE_C 0 COMP_0068 0 255 DISPLAY_IDENTIFIER valmax /begin FUNCTION_LIST R204.1.CanComm_1_9_2 /end FUNCTION_LIST /end CHARACTERISTIC
/begin CHARACTERISTIC mVBFLASH "FLASH programming voltage lower limit value" VALUE 0x00008D9E REC_UBYTE_C 0 COMP_0033 0 20400 /begin FUNCTION_LIST R206.2.ECU_Repro_1_0_3 /end FUNCTION_LIST /end CHARACTERISTIC
/begin CHARACTERISTIC mVSNRATMN "Default value of V/Neng ratio if calculation of real value can't be done." VALUE 0x00009662 REC_UWORD_C 0 COMP_0413_S -10 645.35 DISPLAY_IDENTIFIER Cxx_dft_min_vs_n_rat /begin FUNCTION_LIST R108.1.dls_gbrat_vmm_1_1_5 /end FUNCTION_LIST /end CHARACTERISTIC
/begin CHARACTERISTIC mVSNRATMX "Max value of V/Neng ratio." VALUE 0x00009664 REC_UWORD_C 0 COMP_0413_S -10 645.35 DISPLAY_IDENTIFIER Cxx_dft_max_vs_n_rat /begin FUNCTION_LIST R108.1.dls_gbrat_vmm_1_1_5 /end FUNCTION_LIST /end CHARACTERISTIC
/begin CHARACTERISTIC mVSPABDLY "Invalid value duration to declare invalid vehicle speed" VALUE 0x00008E07 REC_UBYTE_C 0 COMP_0371_S 0 10.2 DISPLAY_IDENTIFIER Cxx_nok_vs_dly /begin FUNCTION_LIST R108.1.dls_gbrat_vmm_1_1_5 /end FUNCTION_LIST /end CHARACTERISTIC
/begin CHARACTERISTIC mWHLRAD "Wheel radius" VALUE 0x00008E94 REC_UBYTE_C 0 COMP_0479_S 0.2 0.455 DISPLAY_IDENTIFIER Cxx_whl_rad /begin FUNCTION_LIST R204.1.CanComm_1_9_2 /end FUNCTION_LIST /end CHARACTERISTIC
/begin CHARACTERISTIC mTBALTSLP "Table of interpolation for the calculation of the alternator slope in bench mode" CURVE 0x0000CE6A REC_UBYTE_C 0 COMP_0463_S 0 10200
 /begin AXIS_DESCR COM_AXIS NO_INPUT_QUANTITY COMP_0337_S 16 0 65535 AXIS_PTS_REF mTPNESLPA /end AXIS_DESCR
 DISPLAY_IDENTIFIER Ctp_n_alt_slop /begin FUNCTION_LIST R106.6.epw_slope_1_1_0 /end FUNCTION_LIST /end CHARACTERISTIC
/begin CHARACTERISTIC mTBFILFAP "filter factor for alternator power" CURVE 0x0000E72A REC_UWORD_C 0 COMP_0361_S 0 65.535
 /begin AXIS_DESCR COM_AXIS NO_INPUT_QUANTITY COMP_0337_S 16 0 65535 AXIS_PTS_REF mTPNEFILA /end AXIS_DESCR
 DISPLAY_IDENTIFIER Ctp_alt_pow_fil_fac /begin FUNCTION_LIST R106.7.epw_tqalt_1_1_0 /end FUNCTION_LIST /end CHARACTERISTIC
/begin CHARACTERISTIC mTMMYVSC "Timeout   function of the water temperature used for the engine state calculation" CURVE 0x0000D590 REC_UBYTE_C 0 COMP_0165_S 0 2.55
 /begin AXIS_DESCR FIX_AXIS NO_INPUT_QUANTITY COMP_0280_S 16 -40 110 FIX_AXIS_PAR_DIST 0 1 16 /end AXIS_DESCR
 DISPLAY_IDENTIFIER tmmyvsc /begin FUNCTION_LIST R203.1.crk_mngtx_1_2_1 /end FUNCTION_LIST /end CHARACTERISTIC
/begin CHARACTERISTIC mTMOUTO "Table of starter time out function of the water temperature" CURVE 0x0000D5A0 REC_UBYTE_C 0 COMP_0215 0 51
 /begin AXIS_DESCR FIX_AXIS NO_INPUT_QUANTITY COMP_0280_S 16 -40 110 FIX_AXIS_PAR_DIST 0 1 16 /end AXIS_DESCR
 DISPLAY_IDENTIFIER tmouto /begin FUNCTION_LIST R203.1.crk_mngtx_1_2_1 /end FUNCTION_LIST /end CHARACTERISTIC
/begin CHARACTERISTIC mTPAGBD "Idle speed setpoint which depends of the coolant temperature in 'Drive' position" CURVE 0x0000EB52 REC_UWORD_C 0 COMP_0337_S 0 65535
 /begin AXIS_DESCR FIX_AXIS NO_INPUT_QUANTITY COMP_0280_S 16 -40 110 FIX_AXIS_PAR_DIST 0 1 16 /end AXIS_DESCR
 DISPLAY_IDENTIFIER Ctp_agb_tco_min_is_n /begin FUNCTION_LIST R107.2.iss_atiss_1_0_2 /end FUNCTION_LIST /end CHARACTERISTIC
/begin CHARACTERISTIC mTPAGBDR "Idle speed setpoint which depends of the coolant temperature in case of drag reduction" CURVE 0x0000EB72 REC_UWORD_C 0 COMP_0337_S 0 65535
 /begin AXIS_DESCR FIX_AXIS NO_INPUT_QUANTITY COMP_0280_S 16 -40 110 FIX_AXIS_PAR_DIST 0 1 16 /end AXIS_DESCR
 DISPLAY_IDENTIFIER Ctp_drag_tco_min_is_n /begin FUNCTION_LIST R107.2.iss_atiss_1_0_2 /end FUNCTION_LIST /end CHARACTERISTIC
/begin CHARACTERISTIC mTPFOBISS "Idle speed table used to avoid critical engine speed    requested by AC" CURVE 0x0000EBC2 REC_UWORD_C 0 COMP_0337_S 0 65535
 /begin AXIS_DESCR COM_AXIS NO_INPUT_QUANTITY COMP_0498_S 16 0 3276750 AXIS_PTS_REF mTBFOBISS /end AXIS_DESCR
 DISPLAY_IDENTIFIER Ctp_ac_forb_is_n /begin FUNCTION_LIST R107.4.iss_mciss_1_0_2 /end FUNCTION_LIST /end CHARACTERISTIC
/begin CHARACTERISTIC mTPTWISS "Idle speed setpoint according to the engine coolant temperature" CURVE 0x0000EC72 REC_UWORD_C 0 COMP_0337_S 0 65535
 /begin AXIS_DESCR FIX_AXIS NO_INPUT_QUANTITY COMP_0280_S 16 -40 110 FIX_AXIS_PAR_DIST 0 1 16 /end AXIS_DESCR
 DISPLAY_IDENTIFIER Ctp_tco_min_is_n /begin FUNCTION_LIST R107.1.iss_ariss_1_0_4 /end FUNCTION_LIST /end CHARACTERISTIC
/begin CHARACTERISTIC mTRESCOR "Additive correction to the restart correction factor table dependant on the unflooding counter" CURVE 0x0000D808 REC_UBYTE_C 0 COMP_0068 0 255
 /begin AXIS_DESCR COM_AXIS NO_INPUT_QUANTITY COMP_0068 16 0 255 AXIS_PTS_REF mTRESCORB /end AXIS_DESCR
 DISPLAY_IDENTIFIER Ctd_ufld_rest_cor /begin FUNCTION_LIST R203.2.crk_restx_1_0_8 /end FUNCTION_LIST /end CHARACTERISTIC
/begin CHARACTERISTIC mTRESCORM "Additive correction to the restart correction factor to avoid a too powerfull injection correction" CURVE 0x0000D828 REC_UBYTE_C 0 COMP_0068 0 255
 /begin AXIS_DESCR FIX_AXIS NO_INPUT_QUANTITY COMP_0280_S 16 -40 110 FIX_AXIS_PAR_DIST 0 1 16 /end AXIS_DESCR
 DISPLAY_IDENTIFIER Ctd_tco_min_rest_cor /begin FUNCTION_LIST R203.2.crk_restx_1_0_8 /end FUNCTION_LIST /end CHARACTERISTIC
/begin CHARACTERISTIC mTRGMXVSC "Table of maximum engine speed threshold function of water temperature for engine state calculation" CURVE 0x0000EFC6 REC_UWORD_C 0 COMP_0443 0 65535
 /begin AXIS_DESCR FIX_AXIS NO_INPUT_QUANTITY COMP_0280_S 16 -40 110 FIX_AXIS_PAR_DIST 0 1 16 /end AXIS_DESCR
 DISPLAY_IDENTIFIER trgmxvsc /begin FUNCTION_LIST R203.1.crk_mngtx_1_2_1 /end FUNCTION_LIST /end CHARACTERISTIC
/begin CHARACTERISTIC mTRGMYVSC "Table of middle engine speed threshold function of water temperature for engine state calculation" CURVE 0x0000EFE6 REC_UWORD_C 0 COMP_0443 0 65535
 /begin AXIS_DESCR FIX_AXIS NO_INPUT_QUANTITY COMP_0280_S 16 -40 110 FIX_AXIS_PAR_DIST 0 1 16 /end AXIS_DESCR
 DISPLAY_IDENTIFIER trgmyvsc /begin FUNCTION_LIST R203.1.crk_mngtx_1_2_1 /end FUNCTION_LIST /end CHARACTERISTIC
/begin CHARACTERISTIC mTSTINJSD "Maximum time table of starting mode retention according to coolant temperature" CURVE 0x0000D902 REC_UBYTE_C 0 COMP_0008 0 25500
 /begin AXIS_DESCR COM_AXIS NO_INPUT_QUANTITY COMP_0356 16 -40 119.375 AXIS_PTS_REF mTSTINJSB /end AXIS_DESCR
 /begin FUNCTION_LIST R203.2.crk_restx_1_0_8 /end FUNCTION_LIST
/end CHARACTERISTIC
/begin CHARACTERISTIC mRTBTOFAP "Driver lower threshold depending of water temperature for take off conditions" CURVE 0x0000E43A REC_UWORD_C 0 COMP_0451_S 0 81.91875
 /begin AXIS_DESCR COM_AXIS NO_INPUT_QUANTITY COMP_0510_S 8 -40 119.99780435 AXIS_PTS_REF mTPTWLIMP /end AXIS_DESCR
 DISPLAY_IDENTIFIER Ctp_ptc_tco_tkof_l_thd /begin FUNCTION_LIST R106.5.epw_ptcxx_1_1_0 /end FUNCTION_LIST /end CHARACTERISTIC
/begin CHARACTERISTIC mTBALTPMN "Table of minimum alternator power allowed" CURVE 0x0000E61A REC_UWORD_C 0 COMP_0365_S 0 655350
 /begin AXIS_DESCR COM_AXIS NO_INPUT_QUANTITY COMP_0337_S 8 0 65535 AXIS_PTS_REF mTPNELIMA /end AXIS_DESCR
 DISPLAY_IDENTIFIER Ctp_n_alt_min_pow_ena /begin FUNCTION_LIST R106.2.epw_mxalt_1_1_0 /end FUNCTION_LIST /end CHARACTERISTIC
/begin CHARACTERISTIC mTBALTPMX "Table of maximum alternator power allowed" CURVE 0x0000E62A REC_UWORD_C 0 COMP_0365_S 0 655350
 /begin AXIS_DESCR COM_AXIS NO_INPUT_QUANTITY COMP_0337_S 8 0 65535 AXIS_PTS_REF mTPNELIMA /end AXIS_DESCR
 DISPLAY_IDENTIFIER Ctp_n_alt_max_pow_ena /begin FUNCTION_LIST R106.2.epw_mxalt_1_1_0 /end FUNCTION_LIST /end CHARACTERISTIC
/begin CHARACTERISTIC mTBPTCMX "Driver threshold depending of water temperature for power limitations" CURVE 0x0000E77A REC_UWORD_C 0 COMP_0512_S 0 5119.921875
 /begin AXIS_DESCR COM_AXIS NO_INPUT_QUANTITY COMP_0510_S 8 -40 119.99780435 AXIS_PTS_REF mTPTWLIMP /end AXIS_DESCR
 DISPLAY_IDENTIFIER Ctp_ptc_tco_max_pow_thd /begin FUNCTION_LIST R106.5.epw_ptcxx_1_1_0 /end FUNCTION_LIST /end CHARACTERISTIC
/begin CHARACTERISTIC mTBSTDLYA "Timer duration of alternator power limitations depending on water temperature" CURVE 0x0000E78A REC_UWORD_C 0 COMP_0014 0 655350
 /begin AXIS_DESCR COM_AXIS NO_INPUT_QUANTITY COMP_0500_S 8 -40 119.99754221 AXIS_PTS_REF mTPTWLIMA /end AXIS_DESCR
 DISPLAY_IDENTIFIER Ctp_tco_sta_alt_max_pow_ena_dly /begin FUNCTION_LIST R106.2.epw_mxalt_1_1_0 /end FUNCTION_LIST /end CHARACTERISTIC
/begin CHARACTERISTIC mTBSTDLYP "Time out threshold depending of water temperature for autonomous state" CURVE 0x0000E79A REC_UWORD_C 0 COMP_0355 0 255.99609375
 /begin AXIS_DESCR COM_AXIS NO_INPUT_QUANTITY COMP_0510_S 8 -40 119.99780435 AXIS_PTS_REF mTPTWLIMP /end AXIS_DESCR
 DISPLAY_IDENTIFIER Ctp_ptc_tco_aut_thd /begin FUNCTION_LIST R106.5.epw_ptcxx_1_1_0 /end FUNCTION_LIST /end CHARACTERISTIC
/begin CHARACTERISTIC mTDGEAR "Running vehicule index table based on the gear engaged" CURVE 0x0000E85A REC_UWORD_C 0 COMP_0443 0 65535
 /begin AXIS_DESCR FIX_AXIS NO_INPUT_QUANTITY COMP_0484_S 8 -1 6 FIX_AXIS_PAR_DIST 0 1 8 /end AXIS_DESCR
 DISPLAY_IDENTIFIER Ctd_gear_run_vh_min_is_n /begin FUNCTION_LIST R107.1.iss_ariss_1_0_4 /end FUNCTION_LIST /end CHARACTERISTIC
/begin CHARACTERISTIC mTPELISSO "Interpolation table used for the calculation of the electric balance protection idle setpoint offset" CURVE 0x0000EBB2 REC_UWORD_C 0 COMP_0337_S 0 65535
 /begin AXIS_DESCR COM_AXIS NO_INPUT_QUANTITY COMP_0063 8 0 255.99609375 AXIS_PTS_REF mTBELISSO /end AXIS_DESCR
 DISPLAY_IDENTIFIER Ctp_el_csm_n_sp_ofs /begin FUNCTION_LIST R107.3.iss_eliss_1_0_4 /end FUNCTION_LIST /end CHARACTERISTIC
/begin AXIS_PTS mTPNESLPA "1r/min" 0x0000EC52 NO_INPUT_QUANTITY REC_AXIS_UWORD 0 COMP_0337_S 16 0 65535 /end AXIS_PTS
/begin AXIS_PTS mTPNEFILA "1r/min" 0x0000EC22 NO_INPUT_QUANTITY REC_AXIS_UWORD 0 COMP_0337_S 16 0 65535 /end AXIS_PTS
/begin AXIS_PTS mTBFOBISS "50r/min" 0x0000E74A NO_INPUT_QUANTITY REC_AXIS_UWORD 0 COMP_0498_S 16 0 3276750 /end AXIS_PTS
/begin AXIS_PTS mTRESCORB "1-" 0x0000D818 NO_INPUT_QUANTITY REC_AXIS_UBYTE 0 COMP_0068 16 0 255 /end AXIS_PTS
/begin AXIS_PTS mTSTINJSB "0.625Åé" 0x0000D8F2 NO_INPUT_QUANTITY REC_AXIS_UBYTE 0 COMP_0356 16 -40 119.375 /end AXIS_PTS
/begin AXIS_PTS mTPTWLIMP "0.00244140625Åé" 0x0000ECA2 NO_INPUT_QUANTITY REC_AXIS_UWORD 0 COMP_0510_S 8 -40 119.99780435 /end AXIS_PTS
/begin AXIS_PTS mTPNELIMA "1r/min" 0x0000EC42 NO_INPUT_QUANTITY REC_AXIS_UWORD 0 COMP_0337_S 8 0 65535 /end AXIS_PTS
/begin AXIS_PTS mTPTWLIMA "0.625/256degC" 0x0000EC92 NO_INPUT_QUANTITY REC_AXIS_UWORD 0 COMP_0500_S 8 -40 119.99754221 /end AXIS_PTS
/begin AXIS_PTS mTBELISSO "1/256-" 0x0000E71A NO_INPUT_QUANTITY REC_AXIS_UWORD 0 COMP_0063 8 0 255.99609375 /end AXIS_PTS
/begin MEASUREMENT fACGMV1 "Fan1 activation request from ac" UBYTE COMP_0283 1 100 0 1 BIT_MASK 0x0020 ECU_ADDRESS 0xFFFF49D6 DISPLAY_IDENTIFIER Acgmv1
 /begin FUNCTION_LIST R202.2.acx_mdfan_1_2_2 R204.1.CanComm_1_9_2 R901.1.Diag_on_can_app_1_6_2 /end FUNCTION_LIST
/end MEASUREMENT
/begin MEASUREMENT fACGMV2 "Fan2 activation request from ac" UBYTE COMP_0283 1 100 0 1 BIT_MASK 0x0010 ECU_ADDRESS 0xFFFF49D6 DISPLAY_IDENTIFIER Acgmv2
 /begin FUNCTION_LIST R202.2.acx_mdfan_1_2_2 R204.1.CanComm_1_9_2 R901.1.Diag_on_can_app_1_6_2 /end FUNCTION_LIST
/end MEASUREMENT
/begin MEASUREMENT fACMNISRN "The idle speed value requested by the AC is currently unavailable" UBYTE COMP_0283 1 100 0 1 BIT_MASK 0x0008 ECU_ADDRESS 0xFFFF49D6 DISPLAY_IDENTIFIER Vbx_mux_ac_is_acel_req_navl /begin FUNCTION_LIST R107.4.iss_mciss_1_0_2 R204.1.CanComm_1_9_2 /end FUNCTION_LIST /end MEASUREMENT
/begin MEASUREMENT fAGBACLRQ "Idle speed setpoint acceleration by AT is requested" UBYTE COMP_0283 1 100 0 1 BIT_MASK 0x0001 ECU_ADDRESS 0xFFFF49D6 DISPLAY_IDENTIFIER Vbx_mux_agb_is_acel_req /begin FUNCTION_LIST R107.2.iss_atiss_1_0_2 R204.1.CanComm_1_9_2 /end FUNCTION_LIST /end MEASUREMENT
/begin MEASUREMENT fAGBGRDFT "Automatic Gearbox ratio engaged default" UBYTE COMP_0283 1 100 0 1 BIT_MASK 0x0080 ECU_ADDRESS 0xFFFF49D7 DISPLAY_IDENTIFIER Vbx_agb_gear_dft /begin FUNCTION_LIST R108.1.dls_gbrat_vmm_1_1_5 R204.1.CanComm_1_9_2 /end FUNCTION_LIST /end MEASUREMENT
/begin MEASUREMENT fALTPWMXN "Alternator mechanical power from CAN is not available" UBYTE COMP_0283 1 100 0 1 BIT_MASK 0x0010 ECU_ADDRESS 0xFFFF49D7 DISPLAY_IDENTIFIER Vbx_mux_alt_pow_navl /begin FUNCTION_LIST R106.3.epw_palmx_1_1_0 R204.1.CanComm_1_9_2 /end FUNCTION_LIST /end MEASUREMENT
/begin MEASUREMENT fASRINREG "ASRinRegulation" UBYTE COMP_0283 1 100 0 1 BIT_MASK 0x0001 ECU_ADDRESS 0xFFFF49D7 DISPLAY_IDENTIFIER Asrinreg
 /begin FUNCTION_LIST R204.1.CanComm_1_9_2 R208.4.STFLW_1_2_2 R208.10.dgn_ccadd_1_3_2 /end FUNCTION_LIST
/end MEASUREMENT
/begin MEASUREMENT fBPKSW "parking braking detected" UBYTE COMP_0283 1 100 0 1 BIT_MASK 0x0004 ECU_ADDRESS 0xFFFF49D8 DISPLAY_IDENTIFIER Vbx_cru_bpk
 /begin FUNCTION_LIST R204.1.CanComm_1_9_2 R208.4.STFLW_1_2_2 R208.8.DACAX_1_1_5 R208.10.dgn_ccadd_1_3_2 R901.1.Diag_on_can_app_1_6_2 /end FUNCTION_LIST
/end MEASUREMENT
/begin MEASUREMENT fBRKSWN "The brake status information is unavailable" UBYTE COMP_0283 1 100 0 1 BIT_MASK 0x0002 ECU_ADDRESS 0xFFFF49D8 DISPLAY_IDENTIFIER Vbx_cru_brk_navl
 /begin FUNCTION_LIST R204.1.CanComm_1_9_2 R208.8.DACAX_1_1_5 R208.9.SAFETYX_1_3_2 R208.10.dgn_ccadd_1_3_2 R901.1.Diag_on_can_app_1_6_2 /end FUNCTION_LIST
/end MEASUREMENT
/begin MEASUREMENT fCLUSW "State of the clutch pedal" UBYTE COMP_0283 1 100 0 1 BIT_MASK 0x0080 ECU_ADDRESS 0xFFFF49DA DISPLAY_IDENTIFIER Vbx_cru_clu
 /begin FUNCTION_LIST R204.1.CanComm_1_9_2 R208.3.GRBOX_1_2_2 R208.4.STFLW_1_2_2 R208.9.SAFETYX_1_3_2 R208.10.dgn_ccadd_1_3_2 R901.1.Diag_on_can_app_1_6_2 Rxxx.2.Integration_Diagnostic_cycle_1_1_1 /end FUNCTION_LIST
/end MEASUREMENT
/begin MEASUREMENT fCLUSWI "mitei" UBYTE COMP_0283 1 100 0 1 BIT_MASK 0x0040 ECU_ADDRESS 0xFFFF49DA
 /begin FUNCTION_LIST R204.1.CanComm_1_9_2 Rxxx.2.Integration_Diagnostic_cycle_1_1_1 /end FUNCTION_LIST
/end MEASUREMENT
/begin MEASUREMENT fCLUSWN "The clutch pedal status information is unavailable" UBYTE COMP_0283 1 100 0 1 BIT_MASK 0x0020 ECU_ADDRESS 0xFFFF49DA DISPLAY_IDENTIFIER Vbx_cru_clu_navl
 /begin FUNCTION_LIST R204.1.CanComm_1_9_2 R208.8.DACAX_1_1_5 R208.9.SAFETYX_1_3_2 R301.5.FuelCut_1_2_2 R901.1.Diag_on_can_app_1_6_2 /end FUNCTION_LIST
/end MEASUREMENT
/begin MEASUREMENT fCMDGMVB1 "Fan 1 activation request from AGB" UBYTE COMP_0283 1 100 0 1 BIT_MASK 0x0010 ECU_ADDRESS 0xFFFF49DA DISPLAY_IDENTIFIER Vbx_agb_mdf1_req
 /begin FUNCTION_LIST R202.2.acx_mdfan_1_2_2 R204.1.CanComm_1_9_2 R901.1.Diag_on_can_app_1_6_2 /end FUNCTION_LIST
/end MEASUREMENT
/begin MEASUREMENT fCMDGMVB2 "Fan 2 activation request from AGB" UBYTE COMP_0283 1 100 0 1 BIT_MASK 0x0008 ECU_ADDRESS 0xFFFF49DA DISPLAY_IDENTIFIER Vbx_agb_mdf2_req
 /begin FUNCTION_LIST R202.2.acx_mdfan_1_2_2 R204.1.CanComm_1_9_2 R901.1.Diag_on_can_app_1_6_2 /end FUNCTION_LIST
/end MEASUREMENT
/begin MEASUREMENT fETAMXBRK "The brake status information is absent" UBYTE COMP_0283 1 100 0 1 BIT_MASK 0x0010 ECU_ADDRESS 0xFFFF49DD DISPLAY_IDENTIFIER Vbx_cru_brk_abst
 /begin FUNCTION_LIST R204.1.CanComm_1_9_2 R208.8.DACAX_1_1_5 R208.9.SAFETYX_1_3_2 R208.10.dgn_ccadd_1_3_2 /end FUNCTION_LIST
/end MEASUREMENT
/begin MEASUREMENT fETAMXCLU "The clutch pedal status information is absent" UBYTE COMP_0283 1 100 0 1 BIT_MASK 0x0008 ECU_ADDRESS 0xFFFF49DD DISPLAY_IDENTIFIER Vbx_cru_clu_abst
 /begin FUNCTION_LIST R204.1.CanComm_1_9_2 R208.8.DACAX_1_1_5 R208.9.SAFETYX_1_3_2 /end FUNCTION_LIST
/end MEASUREMENT
/begin MEASUREMENT fETAMXNUT "The ECU which transmits the neutral position is confirmed absent" UBYTE COMP_0283 1 100 0 1 BIT_MASK 0x0004 ECU_ADDRESS 0xFFFF49DD DISPLAY_IDENTIFIER Vbx_mux_gear_neut_vld_abst /begin FUNCTION_LIST R204.1.CanComm_1_9_2 R208.3.GRBOX_1_2_2 /end FUNCTION_LIST /end MEASUREMENT
/begin MEASUREMENT fETAMXRVR "The ECU which transmits the reverse position is confirmed absent" UBYTE COMP_0283 1 100 0 1 BIT_MASK 0x0002 ECU_ADDRESS 0xFFFF49DD DISPLAY_IDENTIFIER Vbx_gear_rvr_vld_abst /begin FUNCTION_LIST R204.1.CanComm_1_9_2 R208.3.GRBOX_1_2_2 /end FUNCTION_LIST /end MEASUREMENT
/begin MEASUREMENT fETAMXVSP "The vehicle speed information is absent" UBYTE COMP_0283 1 100 0 1 BIT_MASK 0x0001 ECU_ADDRESS 0xFFFF49DD DISPLAY_IDENTIFIER Vbx_vs_abst /begin FUNCTION_LIST R204.1.CanComm_1_9_2 R208.2.VSINT_1_1_2 /end FUNCTION_LIST /end MEASUREMENT
/begin MEASUREMENT fEVRUPC1 "CAN frame received" UBYTE COMP_0283 1 100 0 1 BIT_MASK 0x0002 ECU_ADDRESS 0xFFFF49DE DISPLAY_IDENTIFIER Event_rcpt_USM_CANHS_RNr_01 /begin FUNCTION_LIST R106.3.epw_palmx_1_1_0 R204.1.CanComm_1_9_2 /end FUNCTION_LIST /end MEASUREMENT
/begin MEASUREMENT fGBDRAG "Boolean that indicates that Gearbox is in Drag Reduction phase" UBYTE COMP_0283 1 100 0 1 BIT_MASK 0x0008 ECU_ADDRESS 0xFFFF49DF DISPLAY_IDENTIFIER Vbx_drag_red_agb
 /begin FUNCTION_LIST R107.2.iss_atiss_1_0_2 R204.1.CanComm_1_9_2 R301.6.IscAirflow_1_4_5 /end FUNCTION_LIST
/end MEASUREMENT
/begin MEASUREMENT fGBGEARLH "The automatic gearbox transmits a limphome or invalid or unexpected gear value" UBYTE COMP_0283 1 100 0 1 BIT_MASK 0x0004 ECU_ADDRESS 0xFFFF49DF DISPLAY_IDENTIFIER Vbx_agb_gear_lih
 /begin FUNCTION_LIST R204.1.CanComm_1_9_2 R208.3.GRBOX_1_2_2 R301.23.ADV_calculation_1_1_2 R901.1.Diag_on_can_app_1_6_2 /end FUNCTION_LIST
/end MEASUREMENT
/begin MEASUREMENT fGBGEARNC "The automatic gearbox is not coupled to the engine" UBYTE COMP_0283 1 100 0 1 BIT_MASK 0x0002 ECU_ADDRESS 0xFFFF49DF DISPLAY_IDENTIFIER Vbx_agb_eng_gear_no_cple
 /begin FUNCTION_LIST R204.1.CanComm_1_9_2 R208.3.GRBOX_1_2_2 R901.1.Diag_on_can_app_1_6_2 /end FUNCTION_LIST
/end MEASUREMENT
/begin MEASUREMENT fGBGEARNT "The automatic gearbox is on neutral position" UBYTE COMP_0283 1 100 0 1 BIT_MASK 0x0001 ECU_ADDRESS 0xFFFF49DF DISPLAY_IDENTIFIER Vbx_agb_gear_neut
 /begin FUNCTION_LIST R204.1.CanComm_1_9_2 R208.3.GRBOX_1_2_2 R901.1.Diag_on_can_app_1_6_2 /end FUNCTION_LIST
/end MEASUREMENT
/begin MEASUREMENT fGBGEARRV "The automatic gearbox is on reverse position" UBYTE COMP_0283 1 100 0 1 BIT_MASK 0x0080 ECU_ADDRESS 0xFFFF49E0 DISPLAY_IDENTIFIER Vbx_agb_gear_rvr
 /begin FUNCTION_LIST R204.1.CanComm_1_9_2 R208.3.GRBOX_1_2_2 R901.1.Diag_on_can_app_1_6_2 /end FUNCTION_LIST
/end MEASUREMENT
/begin MEASUREMENT fGEARREV "In manual gearbox the reverse position is engaged" UBYTE COMP_0283 1 100 0 1 BIT_MASK 0x0040 ECU_ADDRESS 0xFFFF49E0 DISPLAY_IDENTIFIER Vbx_gear_rvr
 /begin FUNCTION_LIST R204.1.CanComm_1_9_2 R208.3.GRBOX_1_2_2 R901.1.Diag_on_can_app_1_6_2 /end FUNCTION_LIST
/end MEASUREMENT
/begin MEASUREMENT fIDUPPTC "PTC engine idle speed increase, input from the CAN    (CLIM_Base frame)." UBYTE COMP_0283 1 100 0 1 BIT_MASK 0x0010 ECU_ADDRESS 0xFFFF49E0 DISPLAY_IDENTIFIER Vbx_ptc_is_acel_req
 /begin FUNCTION_LIST R106.5.epw_ptcxx_1_1_0 R107.3.iss_eliss_1_0_4 R204.1.CanComm_1_9_2 /end FUNCTION_LIST
/end MEASUREMENT
/begin MEASUREMENT fMRGBMX "MIL AGB illumination gobal request status" UBYTE COMP_0283 1 100 0 1 BIT_MASK 0x0001 ECU_ADDRESS 0xFFFF49E1 DISPLAY_IDENTIFIER Vbx_mil_tcu_req /begin FUNCTION_LIST R204.1.CanComm_1_9_2 R902.2.DiagMiscell_1_3_5 /end FUNCTION_LIST /end MEASUREMENT
/begin MEASUREMENT fNEUTPSN "Gearbox is on the neutral position" UBYTE COMP_0283 1 100 0 1 BIT_MASK 0x0020 ECU_ADDRESS 0xFFFF49E2 DISPLAY_IDENTIFIER Vbx_mux_gear_neut_psn
 /begin FUNCTION_LIST R204.1.CanComm_1_9_2 R208.3.GRBOX_1_2_2 R901.1.Diag_on_can_app_1_6_2 /end FUNCTION_LIST
/end MEASUREMENT
/begin MEASUREMENT fRSTEPRM "ResetECU service applicative flag" UBYTE COMP_0283 1 100 0 1 BIT_MASK 0x0040 ECU_ADDRESS 0xFFFF49E3 DISPLAY_IDENTIFIER Event_diag_tool_ecu_rst
 /begin FUNCTION_LIST R106.3.epw_palmx_1_1_0 R107.3.iss_eliss_1_0_4 R202.1.acx_acprs_1_2_3 R203.1.crk_mngtx_1_2_1 R204.1.CanComm_1_9_2 R208.1.SWTCH_1_1_7 R208.9.SAFETYX_1_3_2 R901.1.Diag_on_can_app_1_6_2 /end FUNCTION_LIST
/end MEASUREMENT
/begin MEASUREMENT fSIPROG "AGB request intensive flag" UBYTE COMP_0283 1 100 0 1 BIT_MASK 0x0080 ECU_ADDRESS 0xFFFF49E4 DISPLAY_IDENTIFIER Vbx_agb_tq_req /begin FUNCTION_LIST R105.2.tra_sdfta_1_1_2 /end FUNCTION_LIST /end MEASUREMENT
/begin MEASUREMENT fVDCACT "VDC movement signal" UBYTE COMP_0283 1 100 0 1 BIT_MASK 0x0040 ECU_ADDRESS 0xFFFF49E5 DISPLAY_IDENTIFIER Aycinreg
 /begin FUNCTION_LIST R204.1.CanComm_1_9_2 R208.4.STFLW_1_2_2 R208.10.dgn_ccadd_1_3_2 /end FUNCTION_LIST
/end MEASUREMENT
/begin MEASUREMENT fVITESDSM "The displayed vehicle speed is in miles/h" UBYTE COMP_0283 1 100 0 1 BIT_MASK 0x0010 ECU_ADDRESS 0xFFFF49E5 DISPLAY_IDENTIFIER Vbx_dspl_vs_in_mph
 /begin FUNCTION_LIST R204.1.CanComm_1_9_2 R208.2.VSINT_1_1_2 R208.5.SETPT_1_1_0 R208.10.dgn_ccadd_1_3_2 R301.13.FFDforDiagOnCAN_1_1_3 R901.1.Diag_on_can_app_1_6_2 /end FUNCTION_LIST
/end MEASUREMENT
/begin MEASUREMENT fVITESDSN "Vehicle speed received on the CAN network not available" UBYTE COMP_0283 1 100 0 1 BIT_MASK 0x0008 ECU_ADDRESS 0xFFFF49E5 DISPLAY_IDENTIFIER Vbx_mux_dspl_vs_navl
 /begin FUNCTION_LIST R204.1.CanComm_1_9_2 R208.2.VSINT_1_1_2 R901.1.Diag_on_can_app_1_6_2 /end FUNCTION_LIST
/end MEASUREMENT
/begin MEASUREMENT fVITESMXN "Vehicle speed received on the CAN network not available" UBYTE COMP_0283 1 100 0 1 BIT_MASK 0x0004 ECU_ADDRESS 0xFFFF49E5 DISPLAY_IDENTIFIER Vbx_mux_vs_navl
 /begin FUNCTION_LIST R108.1.dls_gbrat_vmm_1_1_5 R204.1.CanComm_1_9_2 R208.2.VSINT_1_1_2 R901.1.Diag_on_can_app_1_6_2 /end FUNCTION_LIST
/end MEASUREMENT
/begin MEASUREMENT fWNDSHISR "Electric windshield idle speed setpoint acceleration request" UBYTE COMP_0283 1 100 0 1 BIT_MASK 0x0002 ECU_ADDRESS 0xFFFF49E5 DISPLAY_IDENTIFIER Vbx_el_wind_is_acel /begin FUNCTION_LIST R107.3.iss_eliss_1_0_4 R204.1.CanComm_1_9_2 /end FUNCTION_LIST /end MEASUREMENT
/begin MEASUREMENT fALERTOMX "Water temperature warning lamp illumination command" UBYTE COMP_0283 1 100 0 1 BIT_MASK 0x0002 ECU_ADDRESS 0xFFFF427F DISPLAY_IDENTIFIER Vbx_wal_tco_req /begin FUNCTION_LIST R204.1.CanComm_1_9_2 R902.2.DiagMiscell_1_3_5 /end FUNCTION_LIST /end MEASUREMENT
/begin MEASUREMENT fCCSLENA "Enable cruise control and speed limiter option detection" UBYTE COMP_0283 1 100 0 1 BIT_MASK 0x0010 ECU_ADDRESS 0xFFFF4288 DISPLAY_IDENTIFIER Vbx_cru_sl_lk_ena /begin FUNCTION_LIST R208.1.SWTCH_1_1_7 R301.27.PWST_detection_1_0_2 /end FUNCTION_LIST /end MEASUREMENT
/begin MEASUREMENT fCFAPMUX "Confirmed failure : USM fast frame reception" UBYTE COMP_0283 1 100 0 1 BIT_MASK 0x0020 ECU_ADDRESS 0xFFFF4289 DISPLAY_IDENTIFIER Vbx_cf_usm_alt_pow_nok /begin FUNCTION_LIST R106.3.epw_palmx_1_1_0 R902.1.SafetyDiagManager_1_3_6 /end FUNCTION_LIST /end MEASUREMENT
/begin MEASUREMENT fCFPRSOC "Air conditioning pressure sensor open circuit confirmed failure" UBYTE COMP_0283 1 100 0 1 BIT_MASK 0x0008 ECU_ADDRESS 0xFFFF428A DISPLAY_IDENTIFIER Sbx_cf_ac_prs_oc /begin FUNCTION_LIST R202.1.acx_acprs_1_2_3 R902.1.SafetyDiagManager_1_3_6 /end FUNCTION_LIST /end MEASUREMENT
/begin MEASUREMENT fCFPRSSC "Air conditioning pressure sensor short circuit confirmed failure" UBYTE COMP_0283 1 100 0 1 BIT_MASK 0x0004 ECU_ADDRESS 0xFFFF428A DISPLAY_IDENTIFIER Sbx_cf_ac_prs_sc /begin FUNCTION_LIST R202.1.acx_acprs_1_2_3 R902.1.SafetyDiagManager_1_3_6 /end FUNCTION_LIST /end MEASUREMENT
/begin MEASUREMENT fCFUPCRCV "Confirmed failure : invalide value of the alternator    power transmited by the USM" UBYTE COMP_0283 1 100 0 1 BIT_MASK 0x0002 ECU_ADDRESS 0xFFFF428A DISPLAY_IDENTIFIER Vbx_cf_usm_rcpt /begin FUNCTION_LIST R106.3.epw_palmx_1_1_0 R902.1.SafetyDiagManager_1_3_6 /end FUNCTION_LIST /end MEASUREMENT
/begin MEASUREMENT fCMDMDF1N "Low speed fan initial permission flag" UBYTE COMP_0283 1 100 0 1 BIT_MASK 0x0080 ECU_ADDRESS 0xFFFF428C /begin FUNCTION_LIST R202.2.acx_mdfan_1_2_2 R301.3.FanAftPwl_1_0_4 /end FUNCTION_LIST /end MEASUREMENT
/begin MEASUREMENT fCMDMDF1P "Low speed engine fan delayed command before PV control" UBYTE COMP_0283 1 100 0 1 BIT_MASK 0x0040 ECU_ADDRESS 0xFFFF428C /begin FUNCTION_LIST R202.2.acx_mdfan_1_2_2 R301.3.FanAftPwl_1_0_4 /end FUNCTION_LIST /end MEASUREMENT
/begin MEASUREMENT fCMDMDF2N "A high-speed fan initial permission flag" UBYTE COMP_0283 1 100 0 1 BIT_MASK 0x0020 ECU_ADDRESS 0xFFFF428C /begin FUNCTION_LIST R202.2.acx_mdfan_1_2_2 R301.3.FanAftPwl_1_0_4 /end FUNCTION_LIST /end MEASUREMENT
/begin MEASUREMENT fCMDMDF2P "High speed engine fan delayed command before PV control" UBYTE COMP_0283 1 100 0 1 BIT_MASK 0x0010 ECU_ADDRESS 0xFFFF428C /begin FUNCTION_LIST R202.2.acx_mdfan_1_2_2 R301.3.FanAftPwl_1_0_4 /end FUNCTION_LIST /end MEASUREMENT
/begin MEASUREMENT fCSACBLK "The SET+ button is blocked" UBYTE COMP_0283 1 100 0 1 BIT_MASK 0x0002 ECU_ADDRESS 0xFFFF428F DISPLAY_IDENTIFIER Vbx_cru_sl_acel_blk /begin FUNCTION_LIST R208.1.SWTCH_1_1_7 /end FUNCTION_LIST /end MEASUREMENT
/begin MEASUREMENT fCSDEBLK "The SET- button is blocked" UBYTE COMP_0283 1 100 0 1 BIT_MASK 0x0001 ECU_ADDRESS 0xFFFF428F DISPLAY_IDENTIFIER Vbx_cru_sl_decl_blk /begin FUNCTION_LIST R208.1.SWTCH_1_1_7 /end FUNCTION_LIST /end MEASUREMENT
/begin MEASUREMENT fCSRSBLK "The RESUME button is blocked" UBYTE COMP_0283 1 100 0 1 BIT_MASK 0x0040 ECU_ADDRESS 0xFFFF4290 DISPLAY_IDENTIFIER Vbx_cru_sl_resu_blk /begin FUNCTION_LIST R208.1.SWTCH_1_1_7 /end FUNCTION_LIST /end MEASUREMENT
/begin MEASUREMENT fCSSUBLK "The SUSPEND button is blocked" UBYTE COMP_0283 1 100 0 1 BIT_MASK 0x0020 ECU_ADDRESS 0xFFFF4290 DISPLAY_IDENTIFIER Vbx_cru_sl_susp_blk /begin FUNCTION_LIST R208.1.SWTCH_1_1_7 /end FUNCTION_LIST /end MEASUREMENT
/begin MEASUREMENT fDFALTP "Detected failure of alternator power information" UBYTE COMP_0283 1 100 0 1 BIT_MASK 0x0040 ECU_ADDRESS 0xFFFF4293 DISPLAY_IDENTIFIER Vbx_alt_pow_dft /begin FUNCTION_LIST R106.4.epw_paltx_1_1_0 R301.6.IscAirflow_1_4_5 /end FUNCTION_LIST /end MEASUREMENT
/begin MEASUREMENT fDFALTPUS "When active indicates that alternator power" UBYTE COMP_0283 1 100 0 1 BIT_MASK 0x0020 ECU_ADDRESS 0xFFFF4293 DISPLAY_IDENTIFIER Vbx_usm_alt_pow_dft /begin FUNCTION_LIST R106.3.epw_palmx_1_1_0 R106.4.epw_paltx_1_1_0 /end FUNCTION_LIST /end MEASUREMENT
/begin MEASUREMENT fDFCSCHR "Detected failure : Cruise Control Main Switch Coherence" UBYTE COMP_0283 1 100 0 1 BIT_MASK 0x0001 ECU_ADDRESS 0xFFFF4293 DISPLAY_IDENTIFIER Vbx_df_cru_sl_swi_chr
 /begin FUNCTION_LIST R208.1.SWTCH_1_1_7 R901.1.Diag_on_can_app_1_6_2 R902.1.SafetyDiagManager_1_3_6 /end FUNCTION_LIST
/end MEASUREMENT
/begin MEASUREMENT fDFCSOC "Detected failure : Cruise Control Steering Wheel Command Switch open circuit" UBYTE COMP_0283 1 100 0 1 BIT_MASK 0x0080 ECU_ADDRESS 0xFFFF4294 /begin FUNCTION_LIST R208.1.SWTCH_1_1_7 /end FUNCTION_LIST /end MEASUREMENT
/begin MEASUREMENT fDFUPCRCV "Detected failure : USM fast frame reception" UBYTE COMP_0283 1 100 0 1 BIT_MASK 0x0010 ECU_ADDRESS 0xFFFF4294 DISPLAY_IDENTIFIER Vbx_df_usm_rcpt /begin FUNCTION_LIST R106.3.epw_palmx_1_1_0 R902.1.SafetyDiagManager_1_3_6 /end FUNCTION_LIST /end MEASUREMENT
/begin MEASUREMENT fELCLCENA "Electric balance protection idle speed setpoint calculation enabled" UBYTE COMP_0283 1 100 0 1 BIT_MASK 0x0001 ECU_ADDRESS 0xFFFF429C DISPLAY_IDENTIFIER Vbx_el_csm_clc_ena /begin FUNCTION_LIST R107.3.iss_eliss_1_0_4 /end FUNCTION_LIST /end MEASUREMENT
/begin MEASUREMENT fEVCSAC "Event : the switch SET+ for cruise control and speed limiter has been pressed" UBYTE COMP_0283 1 100 0 1 BIT_MASK 0x0020 ECU_ADDRESS 0xFFFF42A4 DISPLAY_IDENTIFIER Event_cru_sl_acel /begin FUNCTION_LIST R208.1.SWTCH_1_1_7 R208.4.STFLW_1_2_2 R208.5.SETPT_1_1_0 /end FUNCTION_LIST /end MEASUREMENT
/begin MEASUREMENT fEVCSDE "Event : the switch SET- for cruise control and speed limiter has been pressed" UBYTE COMP_0283 1 100 0 1 BIT_MASK 0x0008 ECU_ADDRESS 0xFFFF42A4 DISPLAY_IDENTIFIER Event_cru_sl_decl /begin FUNCTION_LIST R208.1.SWTCH_1_1_7 R208.4.STFLW_1_2_2 R208.5.SETPT_1_1_0 /end FUNCTION_LIST /end MEASUREMENT
/begin MEASUREMENT fEVCSLA "Event : the switch SET+ for cruise control and speed limiter is held pressed" UBYTE COMP_0283 1 100 0 1 BIT_MASK 0x0004 ECU_ADDRESS 0xFFFF42A4 DISPLAY_IDENTIFIER Event_cru_sl_long_acel /begin FUNCTION_LIST R208.1.SWTCH_1_1_7 R208.5.SETPT_1_1_0 /end FUNCTION_LIST /end MEASUREMENT
/begin MEASUREMENT fEVCSLD "Event : the switch SET- for cruise control and speed limiter is held pressed" UBYTE COMP_0283 1 100 0 1 BIT_MASK 0x0002 ECU_ADDRESS 0xFFFF42A4 DISPLAY_IDENTIFIER Event_cru_sl_long_decl /begin FUNCTION_LIST R208.1.SWTCH_1_1_7 R208.5.SETPT_1_1_0 /end FUNCTION_LIST /end MEASUREMENT
/begin MEASUREMENT fEVCSRS "Event : the switch RESUME for cruise control and speed limiter has been pressed" UBYTE COMP_0283 1 100 0 1 BIT_MASK 0x0001 ECU_ADDRESS 0xFFFF42A4 DISPLAY_IDENTIFIER Event_cru_sl_resu /begin FUNCTION_LIST R208.1.SWTCH_1_1_7 R208.4.STFLW_1_2_2 /end FUNCTION_LIST /end MEASUREMENT
/begin MEASUREMENT fEVCSSU "Event : the switch SUSPEND for cruise control and speed limiter has been pressed" UBYTE COMP_0283 1 100 0 1 BIT_MASK 0x0040 ECU_ADDRESS 0xFFFF42A5 DISPLAY_IDENTIFIER Event_cru_sl_susp /begin FUNCTION_LIST R208.1.SWTCH_1_1_7 R208.4.STFLW_1_2_2 /end FUNCTION_LIST /end MEASUREMENT
/begin MEASUREMENT fINJOPEN "One (ore more) injector is open" UBYTE COMP_0283 1 100 0 1 BIT_MASK 0x0004 ECU_ADDRESS 0xFFFF42C9 DISPLAY_IDENTIFIER Vbx_inj_open /begin FUNCTION_LIST R203.2.crk_restx_1_0_8 /end FUNCTION_LIST /end MEASUREMENT
/begin MEASUREMENT fMGBGRDFT "Manual Gearbox ratio engaged default" UBYTE COMP_0283 1 100 0 1 BIT_MASK 0x0004 ECU_ADDRESS 0xFFFF42D4 DISPLAY_IDENTIFIER Vbx_mgb_gear_dft /begin FUNCTION_LIST R108.1.dls_gbrat_vmm_1_1_5 /end FUNCTION_LIST /end MEASUREMENT
/begin MEASUREMENT fNFPT1VSP "Opposite of Vbx_cf_vs" UBYTE COMP_0283 1 100 0 1 BIT_MASK 0x0004 ECU_ADDRESS 0xFFFF42D7 DISPLAY_IDENTIFIER Vbx_no_cf_vs /begin FUNCTION_LIST R108.1.dls_gbrat_vmm_1_1_5 /end FUNCTION_LIST /end MEASUREMENT
/begin MEASUREMENT fNMGBGRDT "Opposite of fMGBGRDFT" UBYTE COMP_0283 1 100 0 1 BIT_MASK 0x0008 ECU_ADDRESS 0xFFFF42D8 DISPLAY_IDENTIFIER Vbx_no_mgb_gear_dft /begin FUNCTION_LIST R108.1.dls_gbrat_vmm_1_1_5 /end FUNCTION_LIST /end MEASUREMENT
/begin MEASUREMENT fRESTPWS "Retention of the power supply for restart" UBYTE COMP_0283 1 100 0 1 BIT_MASK 0x0080 ECU_ADDRESS 0xFFFF42E9 DISPLAY_IDENTIFIER Vbx_rest_set_pws /begin FUNCTION_LIST R203.2.crk_restx_1_0_8 /end FUNCTION_LIST /end MEASUREMENT
/begin MEASUREMENT fRESTTWF "Failure coolant temperature for Restart" UBYTE COMP_0283 1 100 0 1 BIT_MASK 0x0040 ECU_ADDRESS 0xFFFF42E9 /begin FUNCTION_LIST R203.2.crk_restx_1_0_8 /end FUNCTION_LIST /end MEASUREMENT
/begin MEASUREMENT fRFNREQR "Low speed fan initial permission flag" UBYTE COMP_0283 1 100 0 1 BIT_MASK 0x0010 ECU_ADDRESS 0xFFFF42E9 /begin FUNCTION_LIST R202.2.acx_mdfan_1_2_2 /end FUNCTION_LIST /end MEASUREMENT
/begin MEASUREMENT fSTAINJST "Boolean for the starting mode." UBYTE COMP_0283 1 100 0 1 BIT_MASK 0x0020 ECU_ADDRESS 0xFFFF42F0 DISPLAY_IDENTIFIER Vbx_sta_inj_stt /begin FUNCTION_LIST R203.2.crk_restx_1_0_8 /end FUNCTION_LIST /end MEASUREMENT
/begin MEASUREMENT fSTALSWL "Boolean for no starting software lock engine stalling detection." UBYTE COMP_0283 1 100 0 1 BIT_MASK 0x0010 ECU_ADDRESS 0xFFFF42F0 DISPLAY_IDENTIFIER Vbx_swlk_stal /begin FUNCTION_LIST R203.2.crk_restx_1_0_8 /end FUNCTION_LIST /end MEASUREMENT
/begin MEASUREMENT fSTRSWBLK "One of the CC/SL steering wheel switches is inferred blocked" UBYTE COMP_0283 1 100 0 1 BIT_MASK 0x0001 ECU_ADDRESS 0xFFFF42F0 DISPLAY_IDENTIFIER Vbx_cru_sl_whl_cmd_blk /begin FUNCTION_LIST R208.1.SWTCH_1_1_7 /end FUNCTION_LIST /end MEASUREMENT
/begin MEASUREMENT fTWKEQU "Boolean indicates that TCO had not change a lot since the last engine start." UBYTE COMP_0283 1 100 0 1 BIT_MASK 0x0004 ECU_ADDRESS 0xFFFF42F6 DISPLAY_IDENTIFIER Vbx_equ_tco /begin FUNCTION_LIST R203.2.crk_restx_1_0_8 /end FUNCTION_LIST /end MEASUREMENT
/begin MEASUREMENT fEVRBVA1 "CAN frame received" UBYTE COMP_0283 1 100 0 1 BIT_MASK 0x0080 ECU_ADDRESS 0xFFFF430A DISPLAY_IDENTIFIER Event_agb_frm_atsip /begin FUNCTION_LIST R105.2.tra_sdfta_1_1_2 R204.1.CanComm_1_9_2 /end FUNCTION_LIST /end MEASUREMENT
/begin MEASUREMENT fEVRUCHV "CAN frame received" UBYTE COMP_0283 1 100 0 1 BIT_MASK 0x0040 ECU_ADDRESS 0xFFFF430A DISPLAY_IDENTIFIER Event_rcpt_BCM_VERLOG /begin FUNCTION_LIST R204.1.CanComm_1_9_2 /end FUNCTION_LIST /end MEASUREMENT
/begin MEASUREMENT fEVTVRLG "CAN frame received" UBYTE COMP_0283 1 100 0 1 BIT_MASK 0x0020 ECU_ADDRESS 0xFFFF430A DISPLAY_IDENTIFIER Event_emt_ECM_VERLOG /begin FUNCTION_LIST R204.1.CanComm_1_9_2 /end FUNCTION_LIST /end MEASUREMENT
/begin MEASUREMENT fABSINREG "ABS in regulation acquired on CAN" UBYTE COMP_0283 1 100 0 1 BIT_MASK 0x0020 ECU_ADDRESS 0xFFFF430D DISPLAY_IDENTIFIER Vbx_mux_abs_reg /begin FUNCTION_LIST R204.1.CanComm_1_9_2 /end FUNCTION_LIST /end MEASUREMENT
/begin MEASUREMENT fAGBISCLC "Enable switch for AGB subsystem calculation" UBYTE COMP_0283 1 100 0 1 BIT_MASK 0x0001 ECU_ADDRESS 0xFFFF430E /begin FUNCTION_LIST R107.2.iss_atiss_1_0_2 /end FUNCTION_LIST /end MEASUREMENT
/begin MEASUREMENT fAGBLKFL "The engine control has lost conninication with AT" UBYTE COMP_0283 1 100 0 1 BIT_MASK 0x0080 ECU_ADDRESS 0xFFFF430F DISPLAY_IDENTIFIER Vbx_agb_lk_fail /begin FUNCTION_LIST R105.2.tra_sdfta_1_1_2 /end FUNCTION_LIST /end MEASUREMENT
/begin MEASUREMENT fATTQSIP "Gear change in progress" UBYTE COMP_0283 1 100 0 1 BIT_MASK 0x0004 ECU_ADDRESS 0xFFFF4311 DISPLAY_IDENTIFIER Vbx_mux_gear_cge /begin FUNCTION_LIST R204.1.CanComm_1_9_2 /end FUNCTION_LIST /end MEASUREMENT
/begin MEASUREMENT fCRASHDCL "airbag crash detection flag to avtivate EEPROM" UBYTE COMP_0283 1 100 0 1 BIT_MASK 0x0040 ECU_ADDRESS 0xFFFF4317 /begin FUNCTION_LIST R201.1.stp_mngtx_1_2_2 /end FUNCTION_LIST /end MEASUREMENT
/begin MEASUREMENT fCRASHDCT "airbag crash detection flag" UBYTE COMP_0283 1 100 0 1 BIT_MASK 0x0020 ECU_ADDRESS 0xFFFF4317 /begin FUNCTION_LIST R201.1.stp_mngtx_1_2_2 /end FUNCTION_LIST /end MEASUREMENT
/begin MEASUREMENT fCRSHDET "Event: an airbag crash frame level 1 or 2 has been received" UBYTE COMP_0283 1 100 0 1 BIT_MASK 0x0010 ECU_ADDRESS 0xFFFF4317 DISPLAY_IDENTIFIER Event_crsh_det /begin FUNCTION_LIST R201.1.stp_mngtx_1_2_2 R208.10.dgn_ccadd_1_3_2 /end FUNCTION_LIST /end MEASUREMENT
/begin MEASUREMENT fCRSHLVL1 "An airbag crash frame level 1 has been received" UBYTE COMP_0283 1 100 0 1 BIT_MASK 0x0008 ECU_ADDRESS 0xFFFF4317 DISPLAY_IDENTIFIER Vbx_crsh_lvl1_det /begin FUNCTION_LIST R201.1.stp_mngtx_1_2_2 /end FUNCTION_LIST /end MEASUREMENT
/begin MEASUREMENT fCRSHLVL2 "An airbag crash frame level 2 has been received" UBYTE COMP_0283 1 100 0 1 BIT_MASK 0x0004 ECU_ADDRESS 0xFFFF4317 DISPLAY_IDENTIFIER Vbx_crsh_lvl2_det /begin FUNCTION_LIST R201.1.stp_mngtx_1_2_2 /end FUNCTION_LIST /end MEASUREMENT
/begin MEASUREMENT fDEFDEM "Start fault flag for the diagnostic function" UBYTE COMP_0283 1 100 0 1 BIT_MASK 0x0080 ECU_ADDRESS 0xFFFF4319 DISPLAY_IDENTIFIER Defdem /begin FUNCTION_LIST R203.1.crk_mngtx_1_2_1 R901.1.Diag_on_can_app_1_6_2 /end FUNCTION_LIST /end MEASUREMENT
/begin MEASUREMENT fDFAGBCLK "Agb clock error detected" UBYTE COMP_0283 1 100 0 1 BIT_MASK 0x0001 ECU_ADDRESS 0xFFFF4319 DISPLAY_IDENTIFIER Vbx_df_agb_clck /begin FUNCTION_LIST R105.2.tra_sdfta_1_1_2 R902.1.SafetyDiagManager_1_3_6 /end FUNCTION_LIST /end MEASUREMENT
/begin MEASUREMENT fDFAGBLNK "AGB link detected failure" UBYTE COMP_0283 1 100 0 1 BIT_MASK 0x0020 ECU_ADDRESS 0xFFFF431A DISPLAY_IDENTIFIER Vbx_df_agb_lk /begin FUNCTION_LIST R105.2.tra_sdfta_1_1_2 R902.1.SafetyDiagManager_1_3_6 /end FUNCTION_LIST /end MEASUREMENT
/begin MEASUREMENT fDFDVSP "Displayed vehicle speed received on the CAN network not available" UBYTE COMP_0283 1 100 0 1 BIT_MASK 0x0010 ECU_ADDRESS 0xFFFF431A /begin FUNCTION_LIST R204.1.CanComm_1_9_2 /end FUNCTION_LIST /end MEASUREMENT
/begin MEASUREMENT fDFPRSOC "Air conditioning pressure sensor open circuit detected failure" UBYTE COMP_0283 1 100 0 1 BIT_MASK 0x0004 ECU_ADDRESS 0xFFFF431A DISPLAY_IDENTIFIER Vbx_df_ac_prs_oc
 /begin FUNCTION_LIST R202.1.acx_acprs_1_2_3 R901.1.Diag_on_can_app_1_6_2 R902.1.SafetyDiagManager_1_3_6 /end FUNCTION_LIST
/end MEASUREMENT
/begin MEASUREMENT fDFPRSSC "Air conditioning pressure sensor short circuit detected failure" UBYTE COMP_0283 1 100 0 1 BIT_MASK 0x0002 ECU_ADDRESS 0xFFFF431A DISPLAY_IDENTIFIER Vbx_df_ac_prs_sc
 /begin FUNCTION_LIST R202.1.acx_acprs_1_2_3 R901.1.Diag_on_can_app_1_6_2 R902.1.SafetyDiagManager_1_3_6 /end FUNCTION_LIST
/end MEASUREMENT
/begin MEASUREMENT fDFVSP "Vehicle speed received on the CAN network not available" UBYTE COMP_0283 1 100 0 1 BIT_MASK 0x0001 ECU_ADDRESS 0xFFFF431A /begin FUNCTION_LIST R204.1.CanComm_1_9_2 /end FUNCTION_LIST /end MEASUREMENT
/begin MEASUREMENT fDGONBCM "BCM reception diagnostic indicator" UBYTE COMP_0283 1 100 0 1 BIT_MASK 0x0040 ECU_ADDRESS 0xFFFF431B DISPLAY_IDENTIFIER Vbx_mux_can_diag /begin FUNCTION_LIST R204.1.CanComm_1_9_2 /end FUNCTION_LIST /end MEASUREMENT
/begin MEASUREMENT fDIAGMXON "Mux diagnostic activation indicator for network (CAN bus) failure detection" UBYTE COMP_0283 1 100 0 1 BIT_MASK 0x0010 ECU_ADDRESS 0xFFFF431B DISPLAY_IDENTIFIER Vbx_can_diag_bus_fail /begin FUNCTION_LIST R204.1.CanComm_1_9_2 /end FUNCTION_LIST /end MEASUREMENT
/begin MEASUREMENT fDIAGONGR "Raw Mux diagnostic activation indicator" UBYTE COMP_0283 1 100 0 1 BIT_MASK 0x0008 ECU_ADDRESS 0xFFFF431B DISPLAY_IDENTIFIER Vbx_can_diag_raw /begin FUNCTION_LIST R204.1.CanComm_1_9_2 /end FUNCTION_LIST /end MEASUREMENT
/begin MEASUREMENT fENGSTDFT "Engine stop origin: other cases" UBYTE COMP_0283 1 100 0 1 BIT_MASK 0x0008 ECU_ADDRESS 0xFFFF431F DISPLAY_IDENTIFIER Vbx_eng_stop_srce_dft /begin FUNCTION_LIST R201.1.stp_mngtx_1_2_2 R204.1.CanComm_1_9_2 /end FUNCTION_LIST /end MEASUREMENT
/begin MEASUREMENT fENGSTDRV "Engine stop origin: normal driver request" UBYTE COMP_0283 1 100 0 1 BIT_MASK 0x0004 ECU_ADDRESS 0xFFFF431F DISPLAY_IDENTIFIER Vbx_eng_stop_srce_norm_driv /begin FUNCTION_LIST R201.1.stp_mngtx_1_2_2 R204.1.CanComm_1_9_2 /end FUNCTION_LIST /end MEASUREMENT
/begin MEASUREMENT fENGSTSEC "Engine stop origin: emergency request" UBYTE COMP_0283 1 100 0 1 BIT_MASK 0x0002 ECU_ADDRESS 0xFFFF431F DISPLAY_IDENTIFIER Vbx_eng_stop_srce_secu /begin FUNCTION_LIST R201.1.stp_mngtx_1_2_2 R204.1.CanComm_1_9_2 /end FUNCTION_LIST /end MEASUREMENT
/begin MEASUREMENT fENGSTSYS "Engine stop origin: normal system request" UBYTE COMP_0283 1 100 0 1 BIT_MASK 0x0001 ECU_ADDRESS 0xFFFF431F DISPLAY_IDENTIFIER Vbx_eng_stop_srce_norm_sys /begin FUNCTION_LIST R201.1.stp_mngtx_1_2_2 R204.1.CanComm_1_9_2 /end FUNCTION_LIST /end MEASUREMENT
/begin MEASUREMENT fEVRABR1 "CAN frame received" UBYTE COMP_0283 1 100 0 1 BIT_MASK 0x0010 ECU_ADDRESS 0xFFFF4322 DISPLAY_IDENTIFIER Event_rcpt_BRAKE_CANHS_R_01 /begin FUNCTION_LIST R204.1.CanComm_1_9_2 /end FUNCTION_LIST /end MEASUREMENT
/begin MEASUREMENT fEVRABS2 "CAN frame received" UBYTE COMP_0283 1 100 0 1 BIT_MASK 0x0008 ECU_ADDRESS 0xFFFF4322 DISPLAY_IDENTIFIER Event_rcpt_BRAKE_CANHS_RNr_02 /begin FUNCTION_LIST R204.1.CanComm_1_9_2 /end FUNCTION_LIST /end MEASUREMENT
/begin MEASUREMENT fEVRABS3 "received BRAKE_CANHS_RNr_03" UBYTE COMP_0283 1 100 0 1 BIT_MASK 0x0004 ECU_ADDRESS 0xFFFF4322 DISPLAY_IDENTIFIER Event_rcpt_BRAKE_CANHS_RNr_03 /begin FUNCTION_LIST R204.1.CanComm_1_9_2 /end FUNCTION_LIST /end MEASUREMENT
/begin MEASUREMENT fEVRABS4 "received BRAKE_CANHS_RNr_04" UBYTE COMP_0283 1 100 0 1 BIT_MASK 0x0002 ECU_ADDRESS 0xFFFF4322 DISPLAY_IDENTIFIER Event_rcpt_BRAKE_CANHS_RNr_04 /begin FUNCTION_LIST R204.1.CanComm_1_9_2 /end FUNCTION_LIST /end MEASUREMENT
/begin MEASUREMENT fEVRACC1 "Event : ACC_CANHS_RNr_01 CAN frame received" UBYTE COMP_0283 1 100 0 1 BIT_MASK 0x0001 ECU_ADDRESS 0xFFFF4322 DISPLAY_IDENTIFIER Event_rcpt_ACC_CANHS_RNr_01 /begin FUNCTION_LIST R204.1.CanComm_1_9_2 /end FUNCTION_LIST /end MEASUREMENT
/begin MEASUREMENT fEVRBVA2 "CAN frame received" UBYTE COMP_0283 1 100 0 1 BIT_MASK 0x0080 ECU_ADDRESS 0xFFFF4323 DISPLAY_IDENTIFIER Event_rcpt_TORQU_AT_CANHS_RNr_02 /begin FUNCTION_LIST R204.1.CanComm_1_9_2 /end FUNCTION_LIST /end MEASUREMENT
/begin MEASUREMENT fEVRCLM1 "CAN frame received" UBYTE COMP_0283 1 100 0 1 BIT_MASK 0x0040 ECU_ADDRESS 0xFFFF4323 DISPLAY_IDENTIFIER Event_rcpt_CLIM_CANHS_R_01 /begin FUNCTION_LIST R204.1.CanComm_1_9_2 /end FUNCTION_LIST /end MEASUREMENT
/begin MEASUREMENT fEVRCLU1 "CAN frame received" UBYTE COMP_0283 1 100 0 1 BIT_MASK 0x0020 ECU_ADDRESS 0xFFFF4323 DISPLAY_IDENTIFIER Event_rcpt_CLUSTER_CANHS_RNr_01 /begin FUNCTION_LIST R204.1.CanComm_1_9_2 /end FUNCTION_LIST /end MEASUREMENT
/begin MEASUREMENT fEVRDDC1 "DDCM_CANLSFT_R_01 CAN frame received" UBYTE COMP_0283 1 100 0 1 BIT_MASK 0x0010 ECU_ADDRESS 0xFFFF4323 DISPLAY_IDENTIFIER Event_rcpt_DDCM_CANLSFT_R_01 /begin FUNCTION_LIST R204.1.CanComm_1_9_2 /end FUNCTION_LIST /end MEASUREMENT
/begin MEASUREMENT fEVRSWA1 "CAN frame received" UBYTE COMP_0283 1 100 0 1 BIT_MASK 0x0004 ECU_ADDRESS 0xFFFF4323 DISPLAY_IDENTIFIER Event_rcpt_SWA_CANHS_RNr_01 /begin FUNCTION_LIST R204.1.CanComm_1_9_2 /end FUNCTION_LIST /end MEASUREMENT
/begin MEASUREMENT fEVRUCH1 "CAN frame received" UBYTE COMP_0283 1 100 0 1 BIT_MASK 0x0002 ECU_ADDRESS 0xFFFF4323 DISPLAY_IDENTIFIER Event_rcpt_BCM_CANHS_RNr_01 /begin FUNCTION_LIST R204.1.CanComm_1_9_2 /end FUNCTION_LIST /end MEASUREMENT
/begin MEASUREMENT fEVRUCH2 "CAN frame received" UBYTE COMP_0283 1 100 0 1 BIT_MASK 0x0001 ECU_ADDRESS 0xFFFF4323 DISPLAY_IDENTIFIER Event_rcpt_BCM_CANHS_RNr_02 /begin FUNCTION_LIST R204.1.CanComm_1_9_2 /end FUNCTION_LIST /end MEASUREMENT
/begin MEASUREMENT fEVTECM1 "CAN frame received" UBYTE COMP_0283 1 100 0 1 BIT_MASK 0x0010 ECU_ADDRESS 0xFFFF4324 DISPLAY_IDENTIFIER Event_emt_ECM_CANHS_RNr_01 /begin FUNCTION_LIST R204.1.CanComm_1_9_2 /end FUNCTION_LIST /end MEASUREMENT
/begin MEASUREMENT fEVTECM2 "CAN frame received" UBYTE COMP_0283 1 100 0 1 BIT_MASK 0x0008 ECU_ADDRESS 0xFFFF4324 DISPLAY_IDENTIFIER Event_emt_ECM_CANHS_RNr_02 /begin FUNCTION_LIST R204.1.CanComm_1_9_2 /end FUNCTION_LIST /end MEASUREMENT
/begin MEASUREMENT fEVTECR1 "Event : ECM_CANHS_R_01 CAN frame transmitted" UBYTE COMP_0283 1 100 0 1 BIT_MASK 0x0004 ECU_ADDRESS 0xFFFF4324 /begin FUNCTION_LIST R204.1.CanComm_1_9_2 /end FUNCTION_LIST /end MEASUREMENT
/begin MEASUREMENT fEVTFRC1 "Event : ECM_Event : Force_ECM_CANHS_RNr_01 CAN frame transmitted" UBYTE COMP_0283 1 100 0 1 BIT_MASK 0x0002 ECU_ADDRESS 0xFFFF4324 DISPLAY_IDENTIFIER Event_emt_Force_ECM_CANHS_RNr_01 /begin FUNCTION_LIST R204.1.CanComm_1_9_2 /end FUNCTION_LIST /end MEASUREMENT
/begin MEASUREMENT fEVTMMI1 "CAN frame received" UBYTE COMP_0283 1 100 0 1 BIT_MASK 0x0001 ECU_ADDRESS 0xFFFF4324 DISPLAY_IDENTIFIER Event_emt_MMI_ECM_CANHS_RNr_01 /begin FUNCTION_LIST R204.1.CanComm_1_9_2 /end FUNCTION_LIST /end MEASUREMENT
/begin MEASUREMENT fEVTPRC1 "Event : PRESETCCSL_CANHS_RNr_01 CAN frame transmitted" UBYTE COMP_0283 1 100 0 1 BIT_MASK 0x0080 ECU_ADDRESS 0xFFFF4325 /begin FUNCTION_LIST R204.1.CanComm_1_9_2 /end FUNCTION_LIST /end MEASUREMENT
/begin MEASUREMENT fEVTTQE1 "CAN frame received" UBYTE COMP_0283 1 100 0 1 BIT_MASK 0x0040 ECU_ADDRESS 0xFFFF4325 DISPLAY_IDENTIFIER Event_emt_TORQU_ECM_CANHS_RNr_01 /begin FUNCTION_LIST R204.1.CanComm_1_9_2 /end FUNCTION_LIST /end MEASUREMENT
/begin MEASUREMENT fEVTTQE2 "CAN frame received" UBYTE COMP_0283 1 100 0 1 BIT_MASK 0x0020 ECU_ADDRESS 0xFFFF4325 DISPLAY_IDENTIFIER Event_emt_TORQU_ECM_CANHS_RNr_02 /begin FUNCTION_LIST R204.1.CanComm_1_9_2 /end FUNCTION_LIST /end MEASUREMENT
/begin MEASUREMENT fEVTTQR1 "CAN frame received" UBYTE COMP_0283 1 100 0 1 BIT_MASK 0x0010 ECU_ADDRESS 0xFFFF4325 DISPLAY_IDENTIFIER Event_emt_TORQUE_ECM_CANHS_R_01 /begin FUNCTION_LIST R204.1.CanComm_1_9_2 /end FUNCTION_LIST /end MEASUREMENT
/begin MEASUREMENT fMAXAVTQN "Condition_to_send_unavailable_value_in_max_available_torque_CAN_signal_Flag" UBYTE COMP_0283 1 100 0 1 BIT_MASK 0x0002 ECU_ADDRESS 0xFFFF4330 DISPLAY_IDENTIFIER Vbx_max_avl_tqe_navl /begin FUNCTION_LIST R204.1.CanComm_1_9_2 R902.2.DiagMiscell_1_3_5 /end FUNCTION_LIST /end MEASUREMENT
/begin MEASUREMENT fMFGBMX "MIL AGB flashing request status" UBYTE COMP_0283 1 100 0 1 BIT_MASK 0x0010 ECU_ADDRESS 0xFFFF4332 DISPLAY_IDENTIFIER Vbx_mil_flsh_tcu_req /begin FUNCTION_LIST R204.1.CanComm_1_9_2 /end FUNCTION_LIST /end MEASUREMENT
/begin MEASUREMENT fMILEDEC "Mileage decode activation flag" UBYTE COMP_0283 1 100 0 1 BIT_MASK 0x0008 ECU_ADDRESS 0xFFFF4332 /begin FUNCTION_LIST R204.1.CanComm_1_9_2 /end FUNCTION_LIST /end MEASUREMENT
/begin MEASUREMENT fMINAVTQN "Condition_to_send_unavailable_value_in_min_available_torque_CAN_signal_Flag" UBYTE COMP_0283 1 100 0 1 BIT_MASK 0x0004 ECU_ADDRESS 0xFFFF4332 DISPLAY_IDENTIFIER Vbx_min_avl_tqe_navl /begin FUNCTION_LIST R204.1.CanComm_1_9_2 R902.2.DiagMiscell_1_3_5 /end FUNCTION_LIST /end MEASUREMENT
/begin MEASUREMENT fMINESSMX "Fuel low indication parameter" UBYTE COMP_0283 1 100 0 1 BIT_MASK 0x0002 ECU_ADDRESS 0xFFFF4332 /begin FUNCTION_LIST R204.1.CanComm_1_9_2 R901.1.Diag_on_can_app_1_6_2 /end FUNCTION_LIST /end MEASUREMENT
/begin MEASUREMENT fNOAGBTRN "Condition to send unavailable value in estimated torque CAN signal" UBYTE COMP_0283 1 100 0 1 BIT_MASK 0x0008 ECU_ADDRESS 0xFFFF4333 /begin FUNCTION_LIST R204.1.CanComm_1_9_2 R902.2.DiagMiscell_1_3_5 /end FUNCTION_LIST /end MEASUREMENT
/begin MEASUREMENT fPTCPOWN "Invalid value of PTC power" UBYTE COMP_0283 1 100 0 1 BIT_MASK 0x0010 ECU_ADDRESS 0xFFFF4334 DISPLAY_IDENTIFIER Vbx_ptc_pow_navl /begin FUNCTION_LIST R204.1.CanComm_1_9_2 /end FUNCTION_LIST /end MEASUREMENT
/begin MEASUREMENT fRALACC "Idle speed acceleration required by the air conditioning system" UBYTE COMP_0283 1 100 0 1 BIT_MASK 0x0001 ECU_ADDRESS 0xFFFF4334 DISPLAY_IDENTIFIER Vbx_ac_is_acel_req
 /begin FUNCTION_LIST R107.4.iss_mciss_1_0_2 R204.1.CanComm_1_9_2 R301.6.IscAirflow_1_4_5 /end FUNCTION_LIST
/end MEASUREMENT
/begin MEASUREMENT fRDGBMX "AGB readiness codes completion status" UBYTE COMP_0283 1 100 0 1 BIT_MASK 0x0080 ECU_ADDRESS 0xFFFF4335 DISPLAY_IDENTIFIER Vbx_tcu_rdn_full /begin FUNCTION_LIST R204.1.CanComm_1_9_2 /end FUNCTION_LIST /end MEASUREMENT
/begin MEASUREMENT fRSTFSDEM "Erasing authorization after an ECU reset firstdem request from the diagnosis tool" UBYTE COMP_0283 1 100 0 1 BIT_MASK 0x0020 ECU_ADDRESS 0xFFFF4337 DISPLAY_IDENTIFIER Event_diag_tool_ecu_rst_frst_sta /begin FUNCTION_LIST R203.1.crk_mngtx_1_2_1 R901.1.Diag_on_can_app_1_6_2 /end FUNCTION_LIST /end MEASUREMENT
/begin MEASUREMENT fSTLCK "Internal stall detected flag for cranking management strategy" UBYTE COMP_0283 1 100 0 1 BIT_MASK 0x0040 ECU_ADDRESS 0xFFFF433B DISPLAY_IDENTIFIER Vbx_eng_stal_crkm /begin FUNCTION_LIST R203.1.crk_mngtx_1_2_1 /end FUNCTION_LIST /end MEASUREMENT
/begin MEASUREMENT fSTLCKFIL "Stall detected flag filtered for cranking management strategy" UBYTE COMP_0283 1 100 0 1 BIT_MASK 0x0020 ECU_ADDRESS 0xFFFF433B DISPLAY_IDENTIFIER Vbx_eng_stal_crkm_fil /begin FUNCTION_LIST R203.1.crk_mngtx_1_2_1 /end FUNCTION_LIST /end MEASUREMENT
/begin MEASUREMENT fTMDIAGON "ECM reception diagnostic indicator" UBYTE COMP_0283 1 100 0 1 BIT_MASK 0x0010 ECU_ADDRESS 0xFFFF433D DISPLAY_IDENTIFIER Vbx_can_diag_ecm /begin FUNCTION_LIST R204.1.CanComm_1_9_2 /end FUNCTION_LIST /end MEASUREMENT
/begin MEASUREMENT fTQ12FRIN "Condition to send unavailable value in estimated torque CAN signal" UBYTE COMP_0283 1 100 0 1 BIT_MASK 0x0010 ECU_ADDRESS 0xFFFF433E /begin FUNCTION_LIST R204.1.CanComm_1_9_2 R902.2.DiagMiscell_1_3_5 /end FUNCTION_LIST /end MEASUREMENT
/begin MEASUREMENT fTQWOGBN "Condition to send unavailable value in estimated torque CAN signal" UBYTE COMP_0283 1 100 0 1 BIT_MASK 0x0008 ECU_ADDRESS 0xFFFF433E DISPLAY_IDENTIFIER Vbx_mux_arb_no_agb_tqe_navl /begin FUNCTION_LIST R204.1.CanComm_1_9_2 R902.2.DiagMiscell_1_3_5 /end FUNCTION_LIST /end MEASUREMENT
/begin MEASUREMENT fTRAACLN "Transverse acceleration default detection" UBYTE COMP_0283 1 100 0 1 BIT_MASK 0x0004 ECU_ADDRESS 0xFFFF433E DISPLAY_IDENTIFIER Vbx_tra_acel_in_dft /begin FUNCTION_LIST R204.1.CanComm_1_9_2 /end FUNCTION_LIST /end MEASUREMENT
/begin MEASUREMENT fTTEPDIFN "Condition to send unavailable value in estimated torque CAN signal" UBYTE COMP_0283 1 100 0 1 BIT_MASK 0x0080 ECU_ADDRESS 0xFFFF433F /begin FUNCTION_LIST R204.1.CanComm_1_9_2 R902.2.DiagMiscell_1_3_5 /end FUNCTION_LIST /end MEASUREMENT
/begin MEASUREMENT fVHDSTMXN "Total vehicle distance available" UBYTE COMP_0283 1 100 0 1 BIT_MASK 0x0040 ECU_ADDRESS 0xFFFF4341 DISPLAY_IDENTIFIER Vbx_mux_vh_dist_navl /begin FUNCTION_LIST R204.1.CanComm_1_9_2 /end FUNCTION_LIST /end MEASUREMENT
/begin MEASUREMENT fVHKEY "Key or Keyless Vehicle" UBYTE COMP_0283 1 100 0 1 BIT_MASK 0x0020 ECU_ADDRESS 0xFFFF4341 DISPLAY_IDENTIFIER Vhkey /begin FUNCTION_LIST R203.1.crk_mngtx_1_2_1 R204.1.CanComm_1_9_2 /end FUNCTION_LIST /end MEASUREMENT
/begin MEASUREMENT fWSPDRLRN "Rear left wheels speeds default detection" UBYTE COMP_0283 1 100 0 1 BIT_MASK 0x0002 ECU_ADDRESS 0xFFFF4341 /begin FUNCTION_LIST R204.1.CanComm_1_9_2 /end FUNCTION_LIST /end MEASUREMENT
/begin MEASUREMENT fWSPDRN "Rear wheels speeds default detection" UBYTE COMP_0283 1 100 0 1 BIT_MASK 0x0001 ECU_ADDRESS 0xFFFF4341 /begin FUNCTION_LIST R204.1.CanComm_1_9_2 /end FUNCTION_LIST /end MEASUREMENT
/begin MEASUREMENT fWSPDRRRN "Rear right wheels speeds default detection" UBYTE COMP_0283 1 100 0 1 BIT_MASK 0x0080 ECU_ADDRESS 0xFFFF4342 /begin FUNCTION_LIST R204.1.CanComm_1_9_2 /end FUNCTION_LIST /end MEASUREMENT
/begin MEASUREMENT fEVRARB "Event : AIRBAGCrash CAN frame received" UBYTE COMP_0283 1 100 0 1 BIT_MASK 0x0020 ECU_ADDRESS 0xFFFF4344 DISPLAY_IDENTIFIER Event_rcpt_AIRBAGCrash /begin FUNCTION_LIST R201.1.stp_mngtx_1_2_2 R204.1.CanComm_1_9_2 /end FUNCTION_LIST /end MEASUREMENT
/begin MEASUREMENT fACPRSNAV "Relative air conditioning pressure not available" UBYTE COMP_0283 1 100 0 1 BIT_MASK 0x0080 ECU_ADDRESS 0xFFFF435B DISPLAY_IDENTIFIER Vbx_ac_prs_navl /begin FUNCTION_LIST R202.1.acx_acprs_1_2_3 R204.1.CanComm_1_9_2 /end FUNCTION_LIST /end MEASUREMENT
/begin MEASUREMENT fAGBACK "AGB requirement Acknowledgement" UBYTE COMP_0283 1 100 0 1 BIT_MASK 0x0008 ECU_ADDRESS 0xFFFF435B DISPLAY_IDENTIFIER Vbx_mux_agb_ack /begin FUNCTION_LIST R105.2.tra_sdfta_1_1_2 R204.1.CanComm_1_9_2 /end FUNCTION_LIST /end MEASUREMENT
/begin MEASUREMENT fCFAP12 "Confirmed failure of accelerator pedal" UBYTE COMP_0283 1 100 0 1 BIT_MASK 0x0040 ECU_ADDRESS 0xFFFF435F DISPLAY_IDENTIFIER Vbx_cf_acel_pdl_tot
 /begin FUNCTION_LIST R204.1.CanComm_1_9_2 R902.1.SafetyDiagManager_1_3_6 R902.2.DiagMiscell_1_3_5 /end FUNCTION_LIST
/end MEASUREMENT
/begin MEASUREMENT fCFAPCHR "Confirmed failure of accelerator pedal consistency" UBYTE COMP_0283 1 100 0 1 BIT_MASK 0x0020 ECU_ADDRESS 0xFFFF435F DISPLAY_IDENTIFIER Vbx_cf_acel_pdl_chr
 /begin FUNCTION_LIST R204.1.CanComm_1_9_2 R902.1.SafetyDiagManager_1_3_6 R902.2.DiagMiscell_1_3_5 /end FUNCTION_LIST
/end MEASUREMENT
/begin MEASUREMENT fCFAPSC "Confirmed failure of pedal safety case" UBYTE COMP_0283 1 100 0 1 BIT_MASK 0x0010 ECU_ADDRESS 0xFFFF435F DISPLAY_IDENTIFIER Vbx_cf_acel_pdl_secu
 /begin FUNCTION_LIST R204.1.CanComm_1_9_2 R902.1.SafetyDiagManager_1_3_6 R902.2.DiagMiscell_1_3_5 /end FUNCTION_LIST
/end MEASUREMENT
/begin MEASUREMENT fCFAPSOC1 "Confirmed failure of accelerator pedal track 1 open circuit" UBYTE COMP_0283 1 100 0 1 BIT_MASK 0x0008 ECU_ADDRESS 0xFFFF435F DISPLAY_IDENTIFIER Vbx_cf_acel_pdl_oc_v1
 /begin FUNCTION_LIST R204.1.CanComm_1_9_2 R902.1.SafetyDiagManager_1_3_6 R902.2.DiagMiscell_1_3_5 /end FUNCTION_LIST
/end MEASUREMENT
/begin MEASUREMENT fCFAPSOC2 "Confirmed failure of accelerator pedal track 2 open circuit" UBYTE COMP_0283 1 100 0 1 BIT_MASK 0x0004 ECU_ADDRESS 0xFFFF435F DISPLAY_IDENTIFIER Vbx_cf_acel_pdl_oc_v2
 /begin FUNCTION_LIST R204.1.CanComm_1_9_2 R902.1.SafetyDiagManager_1_3_6 R902.2.DiagMiscell_1_3_5 /end FUNCTION_LIST
/end MEASUREMENT
/begin MEASUREMENT fCFAPSSC1 "Confirmed failure of accelerator pedal track 1 short circuit" UBYTE COMP_0283 1 100 0 1 BIT_MASK 0x0002 ECU_ADDRESS 0xFFFF435F DISPLAY_IDENTIFIER Vbx_cf_acel_pdl_sc_v1
 /begin FUNCTION_LIST R204.1.CanComm_1_9_2 R902.1.SafetyDiagManager_1_3_6 R902.2.DiagMiscell_1_3_5 /end FUNCTION_LIST
/end MEASUREMENT
/begin MEASUREMENT fCFAPSSC2 "Confirmed failure of accelerator pedal track 2 short circuit" UBYTE COMP_0283 1 100 0 1 BIT_MASK 0x0001 ECU_ADDRESS 0xFFFF435F DISPLAY_IDENTIFIER Vbx_cf_acel_pdl_sc_v2
 /begin FUNCTION_LIST R204.1.CanComm_1_9_2 R902.1.SafetyDiagManager_1_3_6 R902.2.DiagMiscell_1_3_5 /end FUNCTION_LIST
/end MEASUREMENT
/begin MEASUREMENT fCFAVCC1 "Confirmed failure of power supply 1 (accelerator pedal track 1)" UBYTE COMP_0283 1 100 0 1 BIT_MASK 0x0080 ECU_ADDRESS 0xFFFF4360 DISPLAY_IDENTIFIER Vbx_cf_pws_1
 /begin FUNCTION_LIST R204.1.CanComm_1_9_2 R902.1.SafetyDiagManager_1_3_6 R902.2.DiagMiscell_1_3_5 /end FUNCTION_LIST
/end MEASUREMENT
/begin MEASUREMENT fCFAVCC2 "Confirmed failure of power supply 2 (accelerator pedal track 2)" UBYTE COMP_0283 1 100 0 1 BIT_MASK 0x0040 ECU_ADDRESS 0xFFFF4360 DISPLAY_IDENTIFIER Vbx_cf_pws_2
 /begin FUNCTION_LIST R204.1.CanComm_1_9_2 R902.1.SafetyDiagManager_1_3_6 R902.2.DiagMiscell_1_3_5 /end FUNCTION_LIST
/end MEASUREMENT
/begin MEASUREMENT fCFCSCHR "Cruise Control Main Switch Coherence" UBYTE COMP_0283 1 100 0 1 BIT_MASK 0x0020 ECU_ADDRESS 0xFFFF4360 DISPLAY_IDENTIFIER Sbx_cf_cru_sl_swi_chr
 /begin FUNCTION_LIST R208.1.SWTCH_1_1_7 R208.8.DACAX_1_1_5 R208.10.dgn_ccadd_1_3_2 R902.1.SafetyDiagManager_1_3_6 /end FUNCTION_LIST
/end MEASUREMENT
/begin MEASUREMENT fCFCSNOK "CCSL steering wheel switches blocked button stored confirmed failure" UBYTE COMP_0283 1 100 0 1 BIT_MASK 0x0010 ECU_ADDRESS 0xFFFF4360 DISPLAY_IDENTIFIER Sbx_cf_cru_whl_cmd_nok
 /begin FUNCTION_LIST R208.1.SWTCH_1_1_7 R208.8.DACAX_1_1_5 R208.10.dgn_ccadd_1_3_2 R902.1.SafetyDiagManager_1_3_6 /end FUNCTION_LIST
/end MEASUREMENT
/begin MEASUREMENT fCFCSOCS "CCSL steering wheel switches open circuit stored confirmed failure" UBYTE COMP_0283 1 100 0 1 BIT_MASK 0x0008 ECU_ADDRESS 0xFFFF4360 DISPLAY_IDENTIFIER Sbx_cf_cru_whl_cmd_oc_scw
 /begin FUNCTION_LIST R208.1.SWTCH_1_1_7 R208.8.DACAX_1_1_5 R208.10.dgn_ccadd_1_3_2 R902.1.SafetyDiagManager_1_3_6 /end FUNCTION_LIST
/end MEASUREMENT
/begin MEASUREMENT fCFCSOOR "CCSL steering wheel switches invalid value stored confirmed failure" UBYTE COMP_0283 1 100 0 1 BIT_MASK 0x0004 ECU_ADDRESS 0xFFFF4360 DISPLAY_IDENTIFIER Sbx_cf_cru_whl_cmd_oor
 /begin FUNCTION_LIST R208.1.SWTCH_1_1_7 R208.8.DACAX_1_1_5 R208.10.dgn_ccadd_1_3_2 R902.1.SafetyDiagManager_1_3_6 /end FUNCTION_LIST
/end MEASUREMENT
/begin MEASUREMENT fCLIGVCMX "Cruise control and speed limiter warning (overspeed) sent on the CAN network" UBYTE COMP_0283 1 100 0 1 BIT_MASK 0x0001 ECU_ADDRESS 0xFFFF4360 DISPLAY_IDENTIFIER Cligvcmx
 /begin FUNCTION_LIST R204.1.CanComm_1_9_2 R208.4.STFLW_1_2_2 R208.5.SETPT_1_1_0 R208.7.OUTMX_1_1_3 /end FUNCTION_LIST
/end MEASUREMENT
/begin MEASUREMENT fCMDMDF1D "Low speed engine fan delayed command" UBYTE COMP_0283 1 100 0 1 BIT_MASK 0x0040 ECU_ADDRESS 0xFFFF4361 DISPLAY_IDENTIFIER Vbx_mdf1_cmd_dly
 /begin FUNCTION_LIST R202.2.acx_mdfan_1_2_2 R204.1.CanComm_1_9_2 R206.2.ECU_Repro_1_0_3 R301.3.FanAftPwl_1_0_4 R901.1.Diag_on_can_app_1_6_2 /end FUNCTION_LIST
/end MEASUREMENT
/begin MEASUREMENT fCMDMDF2D "High speed engine fan delayed command" UBYTE COMP_0283 1 100 0 1 BIT_MASK 0x0020 ECU_ADDRESS 0xFFFF4361 DISPLAY_IDENTIFIER Vbx_mdf2_cmd_dly
 /begin FUNCTION_LIST R202.2.acx_mdfan_1_2_2 R204.1.CanComm_1_9_2 R206.2.ECU_Repro_1_0_3 R301.3.FanAftPwl_1_0_4 R901.1.Diag_on_can_app_1_6_2 /end FUNCTION_LIST
/end MEASUREMENT
/begin MEASUREMENT fCUTOFBIN "Cut off condition, output of shut off and limitation conditions to the CAN" UBYTE COMP_0283 1 100 0 1 BIT_MASK 0x0001 ECU_ADDRESS 0xFFFF4361 DISPLAY_IDENTIFIER Vbx_ptc_cut /begin FUNCTION_LIST R106.5.epw_ptcxx_1_1_0 R204.1.CanComm_1_9_2 /end FUNCTION_LIST /end MEASUREMENT
/begin MEASUREMENT fDFAPMUX "Detected failure : invalid value of    the alternator power transmitted by the USM." UBYTE COMP_0283 1 100 0 1 BIT_MASK 0x0008 ECU_ADDRESS 0xFFFF4362 DISPLAY_IDENTIFIER Vbx_df_usm_alt_pow_nok
 /begin FUNCTION_LIST R106.3.epw_palmx_1_1_0 R204.1.CanComm_1_9_2 R902.1.SafetyDiagManager_1_3_6 /end FUNCTION_LIST
/end MEASUREMENT
/begin MEASUREMENT fDFCSNOK "CCSL Steering Wheel Command Switch blocked button detected failure" UBYTE COMP_0283 1 100 0 1 BIT_MASK 0x0001 ECU_ADDRESS 0xFFFF4362 DISPLAY_IDENTIFIER Vbx_df_cru_whl_cmd_nok
 /begin FUNCTION_LIST R208.1.SWTCH_1_1_7 R901.1.Diag_on_can_app_1_6_2 R902.1.SafetyDiagManager_1_3_6 /end FUNCTION_LIST
/end MEASUREMENT
/begin MEASUREMENT fDFCSOCS "CCSL Steering Wheel Command Switch open circuit detected failure" UBYTE COMP_0283 1 100 0 1 BIT_MASK 0x0080 ECU_ADDRESS 0xFFFF4363 DISPLAY_IDENTIFIER Vbx_df_cru_whl_cmd_oc_scw
 /begin FUNCTION_LIST R208.1.SWTCH_1_1_7 R901.1.Diag_on_can_app_1_6_2 R902.1.SafetyDiagManager_1_3_6 /end FUNCTION_LIST
/end MEASUREMENT
/begin MEASUREMENT fDFCSOOR "CCSL Steering Wheel Command Switch invalid value detected failure" UBYTE COMP_0283 1 100 0 1 BIT_MASK 0x0040 ECU_ADDRESS 0xFFFF4363 DISPLAY_IDENTIFIER Vbx_df_cru_whl_cmd_oor
 /begin FUNCTION_LIST R208.1.SWTCH_1_1_7 R901.1.Diag_on_can_app_1_6_2 R902.1.SafetyDiagManager_1_3_6 /end FUNCTION_LIST
/end MEASUREMENT
/begin MEASUREMENT fFRZOTBIN "Output of freeze condition, to the CAN" UBYTE COMP_0283 1 100 0 1 BIT_MASK 0x0004 ECU_ADDRESS 0xFFFF4365 DISPLAY_IDENTIFIER Vbx_ptc_frz /begin FUNCTION_LIST R106.5.epw_ptcxx_1_1_0 R204.1.CanComm_1_9_2 /end FUNCTION_LIST /end MEASUREMENT
/begin MEASUREMENT fFSLAM1 "Severity_1_lamp_control_Flag" UBYTE COMP_0283 1 100 0 1 BIT_MASK 0x0001 ECU_ADDRESS 0xFFFF4365 DISPLAY_IDENTIFIER Vbx_wal_1_req /begin FUNCTION_LIST R204.1.CanComm_1_9_2 R902.2.DiagMiscell_1_3_5 /end FUNCTION_LIST /end MEASUREMENT
/begin MEASUREMENT fFSLAM2 "Severity_2_lamp_control_Flag" UBYTE COMP_0283 1 100 0 1 BIT_MASK 0x0080 ECU_ADDRESS 0xFFFF4366 DISPLAY_IDENTIFIER Vbx_wal_2_req /begin FUNCTION_LIST R204.1.CanComm_1_9_2 R902.2.DiagMiscell_1_3_5 /end FUNCTION_LIST /end MEASUREMENT
/begin MEASUREMENT fGEARDFT "Gear engaged default identification" UBYTE COMP_0283 1 100 0 1 BIT_MASK 0x0040 ECU_ADDRESS 0xFFFF4366 DISPLAY_IDENTIFIER Vbx_gear_dft
 /begin FUNCTION_LIST R108.1.dls_gbrat_vmm_1_1_5 R208.3.GRBOX_1_2_2 R301.12.ClutchSwDiag_1_0_1 R901.1.Diag_on_can_app_1_6_2 /end FUNCTION_LIST
/end MEASUREMENT
/begin MEASUREMENT fTQ12ENGN "Condition to send unavailable value in estimated torque CAN signal" UBYTE COMP_0283 1 100 0 1 BIT_MASK 0x0004 ECU_ADDRESS 0xFFFF4369 DISPLAY_IDENTIFIER Vbx_esti_tqe_navl
 /begin FUNCTION_LIST R204.1.CanComm_1_9_2 R901.1.Diag_on_can_app_1_6_2 R902.2.DiagMiscell_1_3_5 /end FUNCTION_LIST
/end MEASUREMENT
/begin MEASUREMENT fVSABDLY "Vehicle speed received on the CAN network not present after a filtering time" UBYTE COMP_0283 1 100 0 1 BIT_MASK 0x0010 ECU_ADDRESS 0xFFFF436A
 /begin FUNCTION_LIST R204.1.CanComm_1_9_2 R208.2.VSINT_1_1_2 R208.8.DACAX_1_1_5 R208.10.dgn_ccadd_1_3_2 /end FUNCTION_LIST
/end MEASUREMENT
/begin MEASUREMENT fVSNKDLY "Vehicle speed received on the CAN network not available after a filtering time" UBYTE COMP_0283 1 100 0 1 BIT_MASK 0x0008 ECU_ADDRESS 0xFFFF436A DISPLAY_IDENTIFIER Vbx_mux_vs_navl_fil
 /begin FUNCTION_LIST R204.1.CanComm_1_9_2 R208.2.VSINT_1_1_2 R208.8.DACAX_1_1_5 R208.10.dgn_ccadd_1_3_2 /end FUNCTION_LIST
/end MEASUREMENT
/begin MEASUREMENT fALTCUT "Cut off condition of the alternator. This evolution is available for the variable voltage regulator" UBYTE COMP_0283 1 100 0 1 BIT_MASK 0x0008 ECU_ADDRESS 0xFFFF2465 DISPLAY_IDENTIFIER Vbx_alt_cut
 /begin FUNCTION_LIST R106.2.epw_mxalt_1_1_0 R106.5.epw_ptcxx_1_1_0 R107.3.iss_eliss_1_0_4 /end FUNCTION_LIST
/end MEASUREMENT
/begin MEASUREMENT fALTPWTRS "Alternator power transient detected boolean." UBYTE COMP_0283 1 100 0 1 BIT_MASK 0x0004 ECU_ADDRESS 0xFFFF2465 DISPLAY_IDENTIFIER Vbx_alt_pow_trs /begin FUNCTION_LIST R106.7.epw_tqalt_1_1_0 /end FUNCTION_LIST /end MEASUREMENT
/begin MEASUREMENT fFRZTEST "Freeze condition, output of freeze condition bloc" UBYTE COMP_0283 1 100 0 1 BIT_MASK 0x0040 ECU_ADDRESS 0xFFFF2482 DISPLAY_IDENTIFIER Vbx_ptc_frz_test /begin FUNCTION_LIST R106.5.epw_ptcxx_1_1_0 /end FUNCTION_LIST /end MEASUREMENT
/begin MEASUREMENT fPCUTEDLY "Engine status condition, output of delay time autonomus condition." UBYTE COMP_0283 1 100 0 1 BIT_MASK 0x0002 ECU_ADDRESS 0xFFFF2492 DISPLAY_IDENTIFIER Vbx_ptc_cut_eng_cdn /begin FUNCTION_LIST R106.5.epw_ptcxx_1_1_0 /end FUNCTION_LIST /end MEASUREMENT
/begin MEASUREMENT fPCUTHLD "high load condition, output high load condition bloc" UBYTE COMP_0283 1 100 0 1 BIT_MASK 0x0040 ECU_ADDRESS 0xFFFF2493 DISPLAY_IDENTIFIER Vbx_ptc_cut_fl_cdn /begin FUNCTION_LIST R106.5.epw_ptcxx_1_1_0 /end FUNCTION_LIST /end MEASUREMENT
/begin MEASUREMENT fPCUTHLD1 "high load condition n Åã 1" UBYTE COMP_0283 1 100 0 1 BIT_MASK 0x0020 ECU_ADDRESS 0xFFFF2493 DISPLAY_IDENTIFIER Vbx_ptc_cut_fl_cdn_1 /begin FUNCTION_LIST R106.5.epw_ptcxx_1_1_0 /end FUNCTION_LIST /end MEASUREMENT
/begin MEASUREMENT fPCUTHLD2 "high load condition n Åã 2" UBYTE COMP_0283 1 100 0 1 BIT_MASK 0x0010 ECU_ADDRESS 0xFFFF2493 DISPLAY_IDENTIFIER Vbx_ptc_cut_fl_cdn_2 /begin FUNCTION_LIST R106.5.epw_ptcxx_1_1_0 /end FUNCTION_LIST /end MEASUREMENT
/begin MEASUREMENT fPCUTHLD3 "high load condition n Åã 3" UBYTE COMP_0283 1 100 0 1 BIT_MASK 0x0008 ECU_ADDRESS 0xFFFF2493 DISPLAY_IDENTIFIER Vbx_ptc_cut_fl_cdn_3 /begin FUNCTION_LIST R106.5.epw_ptcxx_1_1_0 /end FUNCTION_LIST /end MEASUREMENT
/begin MEASUREMENT fPCUTRPM "Shut off engine speed condition, output of engine speed condition bloc" UBYTE COMP_0283 1 100 0 1 BIT_MASK 0x0004 ECU_ADDRESS 0xFFFF2493 DISPLAY_IDENTIFIER Vbx_ptc_cut_n_cdn /begin FUNCTION_LIST R106.5.epw_ptcxx_1_1_0 /end FUNCTION_LIST /end MEASUREMENT
/begin MEASUREMENT fPCUTTOF "Take off condition,output take off condition bloc" UBYTE COMP_0283 1 100 0 1 BIT_MASK 0x0002 ECU_ADDRESS 0xFFFF2493 DISPLAY_IDENTIFIER Vbx_ptc_cut_tkof_cdn /begin FUNCTION_LIST R106.5.epw_ptcxx_1_1_0 /end FUNCTION_LIST /end MEASUREMENT
/begin MEASUREMENT fPCUTTOF1 "Take off condition n Åã 1" UBYTE COMP_0283 1 100 0 1 BIT_MASK 0x0001 ECU_ADDRESS 0xFFFF2493 DISPLAY_IDENTIFIER Vbx_ptc_cut_tkof_cdn_1 /begin FUNCTION_LIST R106.5.epw_ptcxx_1_1_0 /end FUNCTION_LIST /end MEASUREMENT
/begin MEASUREMENT fPCUTTOF2 "Take off condition n Åã 2" UBYTE COMP_0283 1 100 0 1 BIT_MASK 0x0080 ECU_ADDRESS 0xFFFF2494 DISPLAY_IDENTIFIER Vbx_ptc_cut_tkof_cdn_2 /begin FUNCTION_LIST R106.5.epw_ptcxx_1_1_0 /end FUNCTION_LIST /end MEASUREMENT
/begin MEASUREMENT fPCUTTOF3 "Take off condition n Åã 3" UBYTE COMP_0283 1 100 0 1 BIT_MASK 0x0040 ECU_ADDRESS 0xFFFF2494 DISPLAY_IDENTIFIER Vbx_ptc_cut_tkof_cdn_3 /begin FUNCTION_LIST R106.5.epw_ptcxx_1_1_0 /end FUNCTION_LIST /end MEASUREMENT
/begin MEASUREMENT fPCUTTOF4 "Take off condition n Åã 4" UBYTE COMP_0283 1 100 0 1 BIT_MASK 0x0020 ECU_ADDRESS 0xFFFF2494 DISPLAY_IDENTIFIER Vbx_ptc_cut_tkof_cdn_4 /begin FUNCTION_LIST R106.5.epw_ptcxx_1_1_0 /end FUNCTION_LIST /end MEASUREMENT
/begin MEASUREMENT fACOUTR "Air conditioning relay control raw flag" UBYTE COMP_0283 1 100 0 1 BIT_MASK 0x0040 ECU_ADDRESS 0xFFFF24CA
 /begin FUNCTION_LIST R204.1.CanComm_1_9_2 R301.6.IscAirflow_1_4_5 R901.1.Diag_on_can_app_1_6_2 /end FUNCTION_LIST
/end MEASUREMENT
/begin MEASUREMENT fCNXSDL "Detect the Speed Distance Limiter option" UBYTE COMP_0283 1 100 0 1 BIT_MASK 0x0020 ECU_ADDRESS 0xFFFFB7DA DISPLAY_IDENTIFIER Vbx_sdl_lk_stt
 /begin FUNCTION_LIST R204.1.CanComm_1_9_2 R208.1.SWTCH_1_1_7 R208.7.OUTMX_1_1_3 R901.1.Diag_on_can_app_1_6_2 /end FUNCTION_LIST
/end MEASUREMENT
/begin MEASUREMENT fCNXUCE7 "ACC frame presence detection with security on configuration detection. Stored in EEPROM" UBYTE COMP_0283 1 100 0 1 BIT_MASK 0x0010 ECU_ADDRESS 0xFFFFB7DA DISPLAY_IDENTIFIER Cnxacc
 /begin FUNCTION_LIST R204.1.CanComm_1_9_2 R208.1.SWTCH_1_1_7 R208.4.STFLW_1_2_2 R208.7.OUTMX_1_1_3 R901.1.Diag_on_can_app_1_6_2 /end FUNCTION_LIST
/end MEASUREMENT
/begin MEASUREMENT fCNXUCE8 "conection status with ECU NO.8" UBYTE COMP_0283 1 100 0 1 BIT_MASK 0x0008 ECU_ADDRESS 0xFFFFB7DA DISPLAY_IDENTIFIER Cnxuce8
 /begin FUNCTION_LIST R202.1.acx_acprs_1_2_3 R204.1.CanComm_1_9_2 R901.1.Diag_on_can_app_1_6_2 /end FUNCTION_LIST
/end MEASUREMENT
/begin MEASUREMENT fCNXUCE9 "conection status with ECU NO.9" UBYTE COMP_0283 1 100 0 1 BIT_MASK 0x0004 ECU_ADDRESS 0xFFFFB7DA DISPLAY_IDENTIFIER Cnxuce9
 /begin FUNCTION_LIST R204.1.CanComm_1_9_2 R208.3.GRBOX_1_2_2 R208.6.SERVO_1_2_2 R208.8.DACAX_1_1_5 R208.9.SAFETYX_1_3_2 R301.6.IscAirflow_1_4_5 R901.1.Diag_on_can_app_1_6_2 /end FUNCTION_LIST
/end MEASUREMENT
/begin MEASUREMENT fFIRSTDEM "First starting flag" UBYTE COMP_0283 1 100 0 1 BIT_MASK 0x0002 ECU_ADDRESS 0xFFFFB7DA DISPLAY_IDENTIFIER Firstdem
 /begin FUNCTION_LIST R203.1.crk_mngtx_1_2_1 R208.1.SWTCH_1_1_7 R901.1.Diag_on_can_app_1_6_2 /end FUNCTION_LIST
/end MEASUREMENT
/begin MEASUREMENT fALTST "alternator load information available.    Stored in E2PROM." UBYTE COMP_0283 1 100 0 1 BIT_MASK 0x0080 ECU_ADDRESS 0xFFFFB7DC DISPLAY_IDENTIFIER Vbx_usm_alt_lk_stt /begin FUNCTION_LIST R106.3.epw_palmx_1_1_0 /end FUNCTION_LIST /end MEASUREMENT
/begin MEASUREMENT fCNXUCE14 "conection status with ECU NO.14" UBYTE COMP_0283 1 100 0 1 BIT_MASK 0x0020 ECU_ADDRESS 0xFFFFB7E5 DISPLAY_IDENTIFIER Vbx_swa_lk_stt /begin FUNCTION_LIST R204.1.CanComm_1_9_2 R901.1.Diag_on_can_app_1_6_2 /end FUNCTION_LIST /end MEASUREMENT
/begin MEASUREMENT fCNXUCE2 "conection status with ECU NO.2" UBYTE COMP_0283 1 100 0 1 BIT_MASK 0x0010 ECU_ADDRESS 0xFFFFB7E5 DISPLAY_IDENTIFIER Cnxuce2 /begin FUNCTION_LIST R204.1.CanComm_1_9_2 R901.1.Diag_on_can_app_1_6_2 /end FUNCTION_LIST /end MEASUREMENT
/begin MEASUREMENT fCNXUCE20 "Connection status with ECU20" UBYTE COMP_0283 1 100 0 1 BIT_MASK 0x0008 ECU_ADDRESS 0xFFFFB7E5 DISPLAY_IDENTIFIER Cnxuce20 /begin FUNCTION_LIST R204.1.CanComm_1_9_2 R901.1.Diag_on_can_app_1_6_2 /end FUNCTION_LIST /end MEASUREMENT
/begin MEASUREMENT fCNXUCE24 "Mux Network configuration detection" UBYTE COMP_0283 1 100 0 1 BIT_MASK 0x0004 ECU_ADDRESS 0xFFFFB7E5 DISPLAY_IDENTIFIER Vbx_ddcm_lk_stt /begin FUNCTION_LIST R204.1.CanComm_1_9_2 /end FUNCTION_LIST /end MEASUREMENT
/begin MEASUREMENT fCNXUCE3 "conection status with ECU NO.3" UBYTE COMP_0283 1 100 0 1 BIT_MASK 0x0002 ECU_ADDRESS 0xFFFFB7E5 DISPLAY_IDENTIFIER Cnxuce3 /begin FUNCTION_LIST R204.1.CanComm_1_9_2 R901.1.Diag_on_can_app_1_6_2 /end FUNCTION_LIST /end MEASUREMENT
/begin MEASUREMENT fCNXUCE4 "conection status with ECU NO.4" UBYTE COMP_0283 1 100 0 1 BIT_MASK 0x0001 ECU_ADDRESS 0xFFFFB7E5 DISPLAY_IDENTIFIER Cnxuce4 /begin FUNCTION_LIST R204.1.CanComm_1_9_2 R901.1.Diag_on_can_app_1_6_2 /end FUNCTION_LIST /end MEASUREMENT
/begin MEASUREMENT fCNXAC "Air Conditioning option detection with security on configuration" UBYTE COMP_0283 1 100 0 1 BIT_MASK 0x0080 ECU_ADDRESS 0xFFFFB7EB DISPLAY_IDENTIFIER Vbx_ac_prs_lk_stt /begin FUNCTION_LIST R202.1.acx_acprs_1_2_3 R901.1.Diag_on_can_app_1_6_2 /end FUNCTION_LIST /end MEASUREMENT
/begin MEASUREMENT fCNXCLURN "Begin stroke clutch switch connection detection. Stored in E? PROM." UBYTE COMP_0283 1 100 0 1 BIT_MASK 0x0020 ECU_ADDRESS 0xFFFFB7EB DISPLAY_IDENTIFIER Vbx_wf_bgin_clu_lk_stt
 /begin FUNCTION_LIST R204.1.CanComm_1_9_2 R208.9.SAFETYX_1_3_2 R901.1.Diag_on_can_app_1_6_2 /end FUNCTION_LIST
/end MEASUREMENT
/begin MEASUREMENT fCNXLV "speed limiter option detection with security on configuration detection. Stored in E^PROM." UBYTE COMP_0283 1 100 0 1 BIT_MASK 0x0010 ECU_ADDRESS 0xFFFFB7EB DISPLAY_IDENTIFIER Cnxlv
 /begin FUNCTION_LIST R208.1.SWTCH_1_1_7 R208.2.VSINT_1_1_2 R208.4.STFLW_1_2_2 R208.7.OUTMX_1_1_3 R208.8.DACAX_1_1_5 R208.9.SAFETYX_1_3_2 R901.1.Diag_on_can_app_1_6_2 /end FUNCTION_LIST
/end MEASUREMENT
/begin MEASUREMENT fCNXLVSW "Detect the speed limiter switch connection. Stored in E? PROM." UBYTE COMP_0283 1 100 0 1 BIT_MASK 0x0008 ECU_ADDRESS 0xFFFFB7EB DISPLAY_IDENTIFIER Vbx_sl_swi_lk_stt /begin FUNCTION_LIST R208.1.SWTCH_1_1_7 R901.1.Diag_on_can_app_1_6_2 /end FUNCTION_LIST /end MEASUREMENT
/begin MEASUREMENT fCNXRV "Detect cruise control option with security on configuration detection. Stored in E^PROM." UBYTE COMP_0283 1 100 0 1 BIT_MASK 0x0004 ECU_ADDRESS 0xFFFFB7EB DISPLAY_IDENTIFIER Cnxrv
 /begin FUNCTION_LIST R208.1.SWTCH_1_1_7 R208.2.VSINT_1_1_2 R208.4.STFLW_1_2_2 R208.7.OUTMX_1_1_3 R208.8.DACAX_1_1_5 R208.9.SAFETYX_1_3_2 R901.1.Diag_on_can_app_1_6_2 /end FUNCTION_LIST
/end MEASUREMENT
/begin MEASUREMENT fCNXRVSW "Detect the cruise control switch connection. Stored in E? PROM." UBYTE COMP_0283 1 100 0 1 BIT_MASK 0x0002 ECU_ADDRESS 0xFFFFB7EB DISPLAY_IDENTIFIER Vbx_cru_swi_lk_stt /begin FUNCTION_LIST R208.1.SWTCH_1_1_7 R901.1.Diag_on_can_app_1_6_2 /end FUNCTION_LIST /end MEASUREMENT
/begin MEASUREMENT fFCNXBTV "Steering wheel switches connection detection. Stored in E^PROM." UBYTE COMP_0283 1 100 0 1 BIT_MASK 0x0040 ECU_ADDRESS 0xFFFFB7EC DISPLAY_IDENTIFIER Cnxbtvol /begin FUNCTION_LIST R208.1.SWTCH_1_1_7 R901.1.Diag_on_can_app_1_6_2 /end FUNCTION_LIST /end MEASUREMENT
/begin MEASUREMENT tTMDIAGON "timer for TMDIAMUX" UBYTE COMP_0202_S 1 100 0 255 ECU_ADDRESS 0xFFFF451A /begin FUNCTION_LIST R204.1.CanComm_1_9_2 /end FUNCTION_LIST /end MEASUREMENT
/begin MEASUREMENT vACISS "Air conditioning idle speed setpoint" UWORD COMP_0337_S 1 100 0 65535 ECU_ADDRESS 0xFFFF277E DISPLAY_IDENTIFIER Vxx_ac_min_is_n /begin FUNCTION_LIST R107.1.iss_ariss_1_0_4 R107.4.iss_mciss_1_0_2 /end FUNCTION_LIST /end MEASUREMENT
/begin MEASUREMENT vACMNISR "Idle speed set-point requested by the air conditioning from the CAN network" UBYTE COMP_0542_S 1 100 500 13250 ECU_ADDRESS 0xFFFF48A6 DISPLAY_IDENTIFIER Vxx_mux_ac_is_acel_req /begin FUNCTION_LIST R107.4.iss_mciss_1_0_2 R204.1.CanComm_1_9_2 /end FUNCTION_LIST /end MEASUREMENT
/begin MEASUREMENT vACPRSDIG "Relative AC pressure for diagnosis" UBYTE COMP_0543_S 1 100 0 51 ECU_ADDRESS 0xFFFF10EC DISPLAY_IDENTIFIER Vxx_ac_prs_diag /begin FUNCTION_LIST R202.1.acx_acprs_1_2_3 R901.1.Diag_on_can_app_1_6_2 /end FUNCTION_LIST /end MEASUREMENT
/begin MEASUREMENT vAFFRVMX "Cruise control and speed limiter status : parameter sent to the cluster by CAN for display" UBYTE COMP_0068 1 100 0 255 ECU_ADDRESS 0xFFFF41B5 DISPLAY_IDENTIFIER Affrvmx
 /begin FUNCTION_LIST R204.1.CanComm_1_9_2 R208.7.OUTMX_1_1_3 R208.9.SAFETYX_1_3_2 R301.13.FFDforDiagOnCAN_1_1_3 R901.1.Diag_on_can_app_1_6_2 /end FUNCTION_LIST
/end MEASUREMENT
/begin MEASUREMENT vAGBCLOCK "AGB clock" UBYTE COMP_0068 1 100 0 255 ECU_ADDRESS 0xFFFF380C DISPLAY_IDENTIFIER Vxx_mux_agb_clck /begin FUNCTION_LIST R105.2.tra_sdfta_1_1_2 R204.1.CanComm_1_9_2 /end FUNCTION_LIST /end MEASUREMENT
/begin MEASUREMENT vAGBGEAR "AGB Gear ratio engaged (-1 0 1 2 3 4 5 6)" SBYTE COMP_0263 1 100 -128 127 ECU_ADDRESS 0xFFFF48B5 DISPLAY_IDENTIFIER Vxx_agb_gear
 /begin FUNCTION_LIST R108.1.dls_gbrat_vmm_1_1_5 R204.1.CanComm_1_9_2 R901.1.Diag_on_can_app_1_6_2 /end FUNCTION_LIST
/end MEASUREMENT
/begin MEASUREMENT vAGBISS "Automatic Transmission idle speed setpoint required" UWORD COMP_0337_S 1 100 0 65535 ECU_ADDRESS 0xFFFF27E4 DISPLAY_IDENTIFIER Vxx_agb_min_is_n /begin FUNCTION_LIST R107.1.iss_ariss_1_0_4 R107.2.iss_atiss_1_0_2 /end FUNCTION_LIST /end MEASUREMENT
/begin MEASUREMENT vAGBTQTYP "Type AGB requested torque control" UBYTE COMP_0068 1 100 0 255 ECU_ADDRESS 0xFFFF38D5 DISPLAY_IDENTIFIER Vsx_mux_agb_tq_ctl_typ /begin FUNCTION_LIST R204.1.CanComm_1_9_2 /end FUNCTION_LIST /end MEASUREMENT
/begin MEASUREMENT vAGBTRQF "Automatic transmission fast-acting torque setting acquired on the CAN" UWORD COMP_0345_S 1 100 -400 1647.96875 ECU_ADDRESS 0xFFFF38D6 DISPLAY_IDENTIFIER Vxx_mux_agb_tqe_sp /begin FUNCTION_LIST R105.2.tra_sdfta_1_1_2 R204.1.CanComm_1_9_2 /end FUNCTION_LIST /end MEASUREMENT
/begin MEASUREMENT vAGBTRQFR "Automatic transmission fast-acting raw torque setting acquired on the CAN" UWORD COMP_0068 1 100 0 65535 ECU_ADDRESS 0xFFFF38D8 DISPLAY_IDENTIFIER Vxx_mux_agb_tqe_sp_raw /begin FUNCTION_LIST R204.1.CanComm_1_9_2 /end FUNCTION_LIST /end MEASUREMENT
/begin MEASUREMENT vAGBTRQS "Automatic transmission slow-acting torque setting acquired on the CAN" UWORD COMP_0345_S 1 100 -400 1647.96875 ECU_ADDRESS 0xFFFF38DA DISPLAY_IDENTIFIER Vxx_mux_agb_tqe_tgt_lim
 /begin FUNCTION_LIST R105.2.tra_sdfta_1_1_2 R204.1.CanComm_1_9_2 R901.1.Diag_on_can_app_1_6_2 /end FUNCTION_LIST
/end MEASUREMENT
/begin MEASUREMENT vAGBTRQSR "Automatic transmission slow-acting raw torque setting acquired on the CAN" UWORD COMP_0068 1 100 0 65535 ECU_ADDRESS 0xFFFF38DC DISPLAY_IDENTIFIER Vxx_mux_agb_tqe_tgt_lim_raw /begin FUNCTION_LIST R204.1.CanComm_1_9_2 /end FUNCTION_LIST /end MEASUREMENT
/begin MEASUREMENT vALTFPTRS "Alternator filtered power used for transcients detection." ULONG COMP_0553_S 1 100 0 42949672.95 ECU_ADDRESS 0xFFFF1150 DISPLAY_IDENTIFIER Vxx_fil_alt_pow_load_trs /begin FUNCTION_LIST R106.7.epw_tqalt_1_1_0 /end FUNCTION_LIST /end MEASUREMENT
/begin MEASUREMENT vALTFPW "Filtered alternator mechanical power (W) ." UWORD COMP_0365_S 1 100 0 655350 ECU_ADDRESS 0xFFFF23AA DISPLAY_IDENTIFIER Vxx_fil_alt_pow
 /begin FUNCTION_LIST R106.2.epw_mxalt_1_1_0 R106.5.epw_ptcxx_1_1_0 R106.7.epw_tqalt_1_1_0 R301.6.IscAirflow_1_4_5 R901.1.Diag_on_can_app_1_6_2 /end FUNCTION_LIST
/end MEASUREMENT
/begin MEASUREMENT vALTPMX "Maximum power available for the alternator" UWORD COMP_0365_S 1 100 0 655350 ECU_ADDRESS 0xFFFF1158 DISPLAY_IDENTIFIER Vxx_alt_max_pow_ena /begin FUNCTION_LIST R106.1.epw_altxx_1_1_0 R106.2.epw_mxalt_1_1_0 /end FUNCTION_LIST /end MEASUREMENT
/begin MEASUREMENT vALTPMXNR "Maximum power available for the alternator in nominal case" UWORD COMP_0365_S 1 100 0 655350 ECU_ADDRESS 0xFFFF115A DISPLAY_IDENTIFIER Vxx_alt_max_pow_ena_clc /begin FUNCTION_LIST R106.2.epw_mxalt_1_1_0 /end FUNCTION_LIST /end MEASUREMENT
/begin MEASUREMENT vALTPMXST "Maximum power available for the alternator after start" UWORD COMP_0365_S 1 100 0 655350 ECU_ADDRESS 0xFFFF115C DISPLAY_IDENTIFIER Vxx_alt_max_pow_ena_ini /begin FUNCTION_LIST R106.2.epw_mxalt_1_1_0 /end FUNCTION_LIST /end MEASUREMENT
/begin MEASUREMENT vALTPW "Alternator mechanical power (W) ." UWORD COMP_0365_S 1 100 0 655350 ECU_ADDRESS 0xFFFF115E DISPLAY_IDENTIFIER Vxx_alt_pow /begin FUNCTION_LIST R106.4.epw_paltx_1_1_0 R106.7.epw_tqalt_1_1_0 /end FUNCTION_LIST /end MEASUREMENT
/begin MEASUREMENT vALTPWLD "Alternator power load (W), output of Torque_calculation block" UWORD COMP_0365_S 1 100 0 655350 ECU_ADDRESS 0xFFFF1160 DISPLAY_IDENTIFIER Vxx_alt_pow_load /begin FUNCTION_LIST R106.7.epw_tqalt_1_1_0 /end FUNCTION_LIST /end MEASUREMENT
/begin MEASUREMENT vALTPWMUX "Instant InstantMecanicalPowerByAlt" UBYTE COMP_0360_S 1 100 0 10200 ECU_ADDRESS 0xFFFF48B8 DISPLAY_IDENTIFIER Vxx_mux_alt_pow /begin FUNCTION_LIST R106.3.epw_palmx_1_1_0 R204.1.CanComm_1_9_2 /end FUNCTION_LIST /end MEASUREMENT
/begin MEASUREMENT vALTPWSLP "Power slope sent to the USM" UBYTE COMP_0463_S 1 100 0 10200 ECU_ADDRESS 0xFFFF1162 DISPLAY_IDENTIFIER Vxx_alt_slop_req /begin FUNCTION_LIST R106.1.epw_altxx_1_1_0 R106.6.epw_slope_1_1_0 /end FUNCTION_LIST /end MEASUREMENT
/begin MEASUREMENT vALTPWUS "Alternator power load (W) from USM" UWORD COMP_0365_S 1 100 0 655350 ECU_ADDRESS 0xFFFF1164 DISPLAY_IDENTIFIER Vxx_usm_alt_pow /begin FUNCTION_LIST R106.3.epw_palmx_1_1_0 R106.4.epw_paltx_1_1_0 /end FUNCTION_LIST /end MEASUREMENT
/begin MEASUREMENT vAUTFTMOT "Synthesis of the stop_engine requests related to vehicle functions" UBYTE COMP_0068 1 100 0 255 ECU_ADDRESS 0xFFFF3926 DISPLAY_IDENTIFIER Autftmot /begin FUNCTION_LIST R201.1.stp_mngtx_1_2_2 /end FUNCTION_LIST /end MEASUREMENT
/begin MEASUREMENT vBBLKCTRM "Maximum value of counter for detection of blocked button. Saved in EEPROM" UBYTE COMP_0068 1 100 0 255 ECU_ADDRESS 0xFFFFB72A DISPLAY_IDENTIFIER Vxx_cru_sl_whl_cmd_blk_ctr_max /begin FUNCTION_LIST R208.1.SWTCH_1_1_7 R901.1.Diag_on_can_app_1_6_2 /end FUNCTION_LIST /end MEASUREMENT
/begin MEASUREMENT vBRKPDLF "Brake pedal failure states" UBYTE COMP_0068 1 100 0 255 ECU_ADDRESS 0xFFFF4044 DISPLAY_IDENTIFIER Vsx_brk_pdl_fail /begin FUNCTION_LIST R204.1.CanComm_1_9_2 /end FUNCTION_LIST /end MEASUREMENT
/begin MEASUREMENT vCABSENT "Array of volatile counters accounting for current failures  Absent unit " UBYTE COMP_0068 1 100 0 255 ECU_ADDRESS 0xFFFF48F6 /begin FUNCTION_LIST R204.1.CanComm_1_9_2 /end FUNCTION_LIST /end MEASUREMENT
/begin MEASUREMENT vCABSENT_C#1_R#1 "Array of volatile counters accounting for current failures  Absent unit " UBYTE COMP_0068 1 100 0 255 ECU_ADDRESS 0xFFFF48F6 /begin FUNCTION_LIST R204.1.CanComm_1_9_2 /end FUNCTION_LIST /end MEASUREMENT
/begin MEASUREMENT vCABSENT_C#2_R#1 "Array of volatile counters accounting for current failures  Absent unit " UBYTE COMP_0068 1 100 0 255 ECU_ADDRESS 0xFFFF48F7 /begin FUNCTION_LIST R204.1.CanComm_1_9_2 /end FUNCTION_LIST /end MEASUREMENT
/begin MEASUREMENT vCABSENT_C#3_R#1 "Array of volatile counters accounting for current failures  Absent unit " UBYTE COMP_0068 1 100 0 255 ECU_ADDRESS 0xFFFF48F8 /begin FUNCTION_LIST R204.1.CanComm_1_9_2 /end FUNCTION_LIST /end MEASUREMENT
/begin MEASUREMENT vCABSENT_C#4_R#1 "Array of volatile counters accounting for current failures  Absent unit " UBYTE COMP_0068 1 100 0 255 ECU_ADDRESS 0xFFFF48F9 /begin FUNCTION_LIST R204.1.CanComm_1_9_2 /end FUNCTION_LIST /end MEASUREMENT
/begin MEASUREMENT vCABSENT_C#5_R#1 "Array of volatile counters accounting for current failures  Absent unit " UBYTE COMP_0068 1 100 0 255 ECU_ADDRESS 0xFFFF48FA /begin FUNCTION_LIST R204.1.CanComm_1_9_2 /end FUNCTION_LIST /end MEASUREMENT
/begin MEASUREMENT vCABSENT_C#6_R#1 "Array of volatile counters accounting for current failures  Absent unit " UBYTE COMP_0068 1 100 0 255 ECU_ADDRESS 0xFFFF48FB /begin FUNCTION_LIST R204.1.CanComm_1_9_2 /end FUNCTION_LIST /end MEASUREMENT
/begin MEASUREMENT vCABSENT_C#7_R#1 "Array of volatile counters accounting for current failures  Absent unit " UBYTE COMP_0068 1 100 0 255 ECU_ADDRESS 0xFFFF48FC /begin FUNCTION_LIST R204.1.CanComm_1_9_2 /end FUNCTION_LIST /end MEASUREMENT
/begin MEASUREMENT vCABSENT_C#8_R#1 "Array of volatile counters accounting for current failures  Absent unit " UBYTE COMP_0068 1 100 0 255 ECU_ADDRESS 0xFFFF48FD /begin FUNCTION_LIST R204.1.CanComm_1_9_2 /end FUNCTION_LIST /end MEASUREMENT
/begin MEASUREMENT vCABSENT_C#9_R#1 "Array of volatile counters accounting for current failures  Absent unit " UBYTE COMP_0068 1 100 0 255 ECU_ADDRESS 0xFFFF48FE /begin FUNCTION_LIST R204.1.CanComm_1_9_2 /end FUNCTION_LIST /end MEASUREMENT
/begin MEASUREMENT vCABSENT_C#10_R#1 "Array of volatile counters accounting for current failures  Absent unit " UBYTE COMP_0068 1 100 0 255 ECU_ADDRESS 0xFFFF48FF /begin FUNCTION_LIST R204.1.CanComm_1_9_2 /end FUNCTION_LIST /end MEASUREMENT
/begin MEASUREMENT vCABSENT_C#11_R#1 "Array of volatile counters accounting for current failures  Absent unit " UBYTE COMP_0068 1 100 0 255 ECU_ADDRESS 0xFFFF4900 /begin FUNCTION_LIST R204.1.CanComm_1_9_2 /end FUNCTION_LIST /end MEASUREMENT
/begin MEASUREMENT vCABSENT_C#12_R#1 "Array of volatile counters accounting for current failures  Absent unit " UBYTE COMP_0068 1 100 0 255 ECU_ADDRESS 0xFFFF4901 /begin FUNCTION_LIST R204.1.CanComm_1_9_2 /end FUNCTION_LIST /end MEASUREMENT
/begin MEASUREMENT vCABSENT_C#13_R#1 "Array of volatile counters accounting for current failures  Absent unit " UBYTE COMP_0068 1 100 0 255 ECU_ADDRESS 0xFFFF4902 /begin FUNCTION_LIST R204.1.CanComm_1_9_2 /end FUNCTION_LIST /end MEASUREMENT
/begin MEASUREMENT vCABSENT_C#14_R#1 "Array of volatile counters accounting for current failures  Absent unit " UBYTE COMP_0068 1 100 0 255 ECU_ADDRESS 0xFFFF4903 /begin FUNCTION_LIST R204.1.CanComm_1_9_2 /end FUNCTION_LIST /end MEASUREMENT
/begin MEASUREMENT vCABSENT_C#15_R#1 "Array of volatile counters accounting for current failures  Absent unit " UBYTE COMP_0068 1 100 0 255 ECU_ADDRESS 0xFFFF4904 /begin FUNCTION_LIST R204.1.CanComm_1_9_2 /end FUNCTION_LIST /end MEASUREMENT
/begin MEASUREMENT vCABSENT_C#16_R#1 "Array of volatile counters accounting for current failures  Absent unit " UBYTE COMP_0068 1 100 0 255 ECU_ADDRESS 0xFFFF4905 /begin FUNCTION_LIST R204.1.CanComm_1_9_2 /end FUNCTION_LIST /end MEASUREMENT
/begin MEASUREMENT vCABSENT_C#17_R#1 "Array of volatile counters accounting for current failures  Absent unit " UBYTE COMP_0068 1 100 0 255 ECU_ADDRESS 0xFFFF4906 /begin FUNCTION_LIST R204.1.CanComm_1_9_2 /end FUNCTION_LIST /end MEASUREMENT
/begin MEASUREMENT vCABSENT_C#18_R#1 "Array of volatile counters accounting for current failures  Absent unit " UBYTE COMP_0068 1 100 0 255 ECU_ADDRESS 0xFFFF4907 /begin FUNCTION_LIST R204.1.CanComm_1_9_2 /end FUNCTION_LIST /end MEASUREMENT
/begin MEASUREMENT vCABSENT_C#19_R#1 "Array of volatile counters accounting for current failures  Absent unit " UBYTE COMP_0068 1 100 0 255 ECU_ADDRESS 0xFFFF4908 /begin FUNCTION_LIST R204.1.CanComm_1_9_2 /end FUNCTION_LIST /end MEASUREMENT
/begin MEASUREMENT vCABSENT_C#20_R#1 "Array of volatile counters accounting for current failures  Absent unit " UBYTE COMP_0068 1 100 0 255 ECU_ADDRESS 0xFFFF4909 /begin FUNCTION_LIST R204.1.CanComm_1_9_2 /end FUNCTION_LIST /end MEASUREMENT
/begin MEASUREMENT vCABSENT_C#21_R#1 "Array of volatile counters accounting for current failures  Absent unit " UBYTE COMP_0068 1 100 0 255 ECU_ADDRESS 0xFFFF490A /begin FUNCTION_LIST R204.1.CanComm_1_9_2 /end FUNCTION_LIST /end MEASUREMENT
/begin MEASUREMENT vCABSENT_C#22_R#1 "Array of volatile counters accounting for current failures  Absent unit " UBYTE COMP_0068 1 100 0 255 ECU_ADDRESS 0xFFFF490B /begin FUNCTION_LIST R204.1.CanComm_1_9_2 /end FUNCTION_LIST /end MEASUREMENT
/begin MEASUREMENT vCABSENT_C#23_R#1 "Array of volatile counters accounting for current failures  Absent unit " UBYTE COMP_0068 1 100 0 255 ECU_ADDRESS 0xFFFF490C /begin FUNCTION_LIST R204.1.CanComm_1_9_2 /end FUNCTION_LIST /end MEASUREMENT
/begin MEASUREMENT vCABSENT_C#24_R#1 "Array of volatile counters accounting for current failures  Absent unit " UBYTE COMP_0068 1 100 0 255 ECU_ADDRESS 0xFFFF490D /begin FUNCTION_LIST R204.1.CanComm_1_9_2 /end FUNCTION_LIST /end MEASUREMENT
/begin MEASUREMENT vCABSENT_C#25_R#1 "Array of volatile counters accounting for current failures  Absent unit " UBYTE COMP_0068 1 100 0 255 ECU_ADDRESS 0xFFFF490E /begin FUNCTION_LIST R204.1.CanComm_1_9_2 /end FUNCTION_LIST /end MEASUREMENT
/begin MEASUREMENT vCABSENT_C#26_R#1 "Array of volatile counters accounting for current failures  Absent unit " UBYTE COMP_0068 1 100 0 255 ECU_ADDRESS 0xFFFF490F /begin FUNCTION_LIST R204.1.CanComm_1_9_2 /end FUNCTION_LIST /end MEASUREMENT
/begin MEASUREMENT vCABSENT_C#27_R#1 "Array of volatile counters accounting for current failures  Absent unit " UBYTE COMP_0068 1 100 0 255 ECU_ADDRESS 0xFFFF4910 /begin FUNCTION_LIST R204.1.CanComm_1_9_2 /end FUNCTION_LIST /end MEASUREMENT
/begin MEASUREMENT vCABSENT_C#28_R#1 "Array of volatile counters accounting for current failures  Absent unit " UBYTE COMP_0068 1 100 0 255 ECU_ADDRESS 0xFFFF4911 /begin FUNCTION_LIST R204.1.CanComm_1_9_2 /end FUNCTION_LIST /end MEASUREMENT
/begin MEASUREMENT vCABSENT_C#29_R#1 "Array of volatile counters accounting for current failures  Absent unit " UBYTE COMP_0068 1 100 0 255 ECU_ADDRESS 0xFFFF4912 /begin FUNCTION_LIST R204.1.CanComm_1_9_2 /end FUNCTION_LIST /end MEASUREMENT
/begin MEASUREMENT vCABSENT_C#30_R#1 "Array of volatile counters accounting for current failures  Absent unit " UBYTE COMP_0068 1 100 0 255 ECU_ADDRESS 0xFFFF4913 /begin FUNCTION_LIST R204.1.CanComm_1_9_2 /end FUNCTION_LIST /end MEASUREMENT
/begin MEASUREMENT vCBUSOFF "Volatile counter for Unit BusOff current fault" UBYTE COMP_0068 1 100 0 255 ECU_ADDRESS 0xFFFF3A85 DISPLAY_IDENTIFIER CNTBUSOF /begin FUNCTION_LIST R204.1.CanComm_1_9_2 /end FUNCTION_LIST /end MEASUREMENT
/begin MEASUREMENT vCCSLVSIN "Vehicle speed that enters in the cruise control and speed limiter strategy" UWORD COMP_0375_S 1 100 0 655.35 ECU_ADDRESS 0xFFFF3A9E /begin FUNCTION_LIST R204.1.CanComm_1_9_2 /end FUNCTION_LIST /end MEASUREMENT
/begin MEASUREMENT vCLUMAXMX "End stroke clutch pedal switch" UBYTE COMP_0068 1 100 0 255 ECU_ADDRESS 0xFFFF404E /begin FUNCTION_LIST R204.1.CanComm_1_9_2 R901.1.Diag_on_can_app_1_6_2 /end FUNCTION_LIST /end MEASUREMENT
/begin MEASUREMENT vCLUMINMX "Begin stroke clutch pedal switch" UBYTE COMP_0068 1 100 0 255 ECU_ADDRESS 0xFFFF4764 DISPLAY_IDENTIFIER Vsx_bgin_str_clu_cnt
 /begin FUNCTION_LIST R108.1.dls_gbrat_vmm_1_1_5 R204.1.CanComm_1_9_2 R301.5.FuelCut_1_2_2 R301.8.Inverse_filter_1_1_3 R301.23.ADV_calculation_1_1_2 R901.1.Diag_on_can_app_1_6_2 /end FUNCTION_LIST
/end MEASUREMENT
/begin MEASUREMENT vCMUTE "Volatile counter for Unit Mute current fault" UBYTE COMP_0068 1 100 0 255 ECU_ADDRESS 0xFFFF3AB3 DISPLAY_IDENTIFIER CNTMUTE /begin FUNCTION_LIST R204.1.CanComm_1_9_2 /end FUNCTION_LIST /end MEASUREMENT
/begin MEASUREMENT vCNT127 "Electric balance counter" UBYTE COMP_0068 1 100 0 255 ECU_ADDRESS 0xFFFFA2BA DISPLAY_IDENTIFIER Vxx_el_csm_ctr /begin FUNCTION_LIST R107.3.iss_eliss_1_0_4 /end FUNCTION_LIST /end MEASUREMENT
/begin MEASUREMENT vCNTTMP "Electric balance counter temporary value" ULONG COMP_0564_S 1 100 0 16843.0148950532 ECU_ADDRESS 0xFFFFA2C0 /begin FUNCTION_LIST R107.3.iss_eliss_1_0_4 /end FUNCTION_LIST /end MEASUREMENT
/begin MEASUREMENT vCOMDRACC "ACC steering wheel commands transmitted to ACC ECU" UBYTE COMP_0068 1 100 0 255 ECU_ADDRESS 0xFFFF41E8 DISPLAY_IDENTIFIER Comdracc /begin FUNCTION_LIST R204.1.CanComm_1_9_2 R208.1.SWTCH_1_1_7 /end FUNCTION_LIST /end MEASUREMENT
/begin MEASUREMENT vCOMDTMP "State of the steering wheel buttons : not filtered" UBYTE COMP_0068 1 100 0 255 ECU_ADDRESS 0xFFFF41E9 DISPLAY_IDENTIFIER Vxx_cru_sl_whl_cmd_raw
 /begin FUNCTION_LIST R208.1.SWTCH_1_1_7 R301.13.FFDforDiagOnCAN_1_1_3 R901.1.Diag_on_can_app_1_6_2 /end FUNCTION_LIST
/end MEASUREMENT
/begin MEASUREMENT vCONSOMAP "Formatted fuel consumption for tuning needs" UWORD COMP_0565_S 1 100 0 1342156800 ECU_ADDRESS 0xFFFFA2C4 /begin FUNCTION_LIST R205.1.ADAC_spec_1_1_0 R901.1.Diag_on_can_app_1_6_2 /end FUNCTION_LIST /end MEASUREMENT
/begin MEASUREMENT vCRASHMX1 "Air bag crash byte NO.1" UBYTE COMP_0068 1 100 0 255 ECU_ADDRESS 0xFFFF4055 DISPLAY_IDENTIFIER CRASHMX1 /begin FUNCTION_LIST R201.1.stp_mngtx_1_2_2 R204.1.CanComm_1_9_2 /end FUNCTION_LIST /end MEASUREMENT
/begin MEASUREMENT vCRASHMX2 "Air bag crash byte NO.2" UBYTE COMP_0068 1 100 0 255 ECU_ADDRESS 0xFFFF4056 DISPLAY_IDENTIFIER CRASHMX2 /begin FUNCTION_LIST R201.1.stp_mngtx_1_2_2 R204.1.CanComm_1_9_2 /end FUNCTION_LIST /end MEASUREMENT
/begin MEASUREMENT vCSACMXDS "Maximum duration of SET+ button press" UBYTE COMP_0013 1 100 0 255 ECU_ADDRESS 0xFFFFB73B DISPLAY_IDENTIFIER Vxx_cru_sl_acel_blk_dly_max /begin FUNCTION_LIST R208.1.SWTCH_1_1_7 R901.1.Diag_on_can_app_1_6_2 /end FUNCTION_LIST /end MEASUREMENT
/begin MEASUREMENT vCSDEMXDS "Maximum duration of SET- button press" UBYTE COMP_0013 1 100 0 255 ECU_ADDRESS 0xFFFFB73C DISPLAY_IDENTIFIER Vxx_cru_sl_decl_blk_dly_max /begin FUNCTION_LIST R208.1.SWTCH_1_1_7 R901.1.Diag_on_can_app_1_6_2 /end FUNCTION_LIST /end MEASUREMENT
/begin MEASUREMENT vCSRSMXDS "Maximum duration of RESUME button press" UBYTE COMP_0013 1 100 0 255 ECU_ADDRESS 0xFFFFB73D DISPLAY_IDENTIFIER Vxx_cru_sl_resu_blk_dly_max /begin FUNCTION_LIST R208.1.SWTCH_1_1_7 R901.1.Diag_on_can_app_1_6_2 /end FUNCTION_LIST /end MEASUREMENT
/begin MEASUREMENT vCSSUMXDS "Maximum duration of SUSPEND button press" UBYTE COMP_0013 1 100 0 255 ECU_ADDRESS 0xFFFFB73E DISPLAY_IDENTIFIER Vxx_cru_sl_susp_blk_dly_max /begin FUNCTION_LIST R208.1.SWTCH_1_1_7 R901.1.Diag_on_can_app_1_6_2 /end FUNCTION_LIST /end MEASUREMENT
/begin MEASUREMENT vDECSLOP "Arbitrated decrease slope applied to the current arbitrated idle speed setpoint" UWORD COMP_0406_S 1 100 -65535 0 ECU_ADDRESS 0xFFFF2A26 DISPLAY_IDENTIFIER Vxx_arb_dec_slop /begin FUNCTION_LIST R107.1.iss_ariss_1_0_4 /end FUNCTION_LIST /end MEASUREMENT
/begin MEASUREMENT vDIAGBUMU "diagnosis of  mute module " UBYTE COMP_0068 1 100 0 255 ECU_ADDRESS 0xFFFF3AF3 DISPLAY_IDENTIFIER Vxx_mute_stt_diag /begin FUNCTION_LIST R204.1.CanComm_1_9_2 R901.1.Diag_on_can_app_1_6_2 /end FUNCTION_LIST /end MEASUREMENT
/begin MEASUREMENT vDIAGBUOF "diagnosis of  busoff module " UBYTE COMP_0068 1 100 0 255 ECU_ADDRESS 0xFFFF3AF4 DISPLAY_IDENTIFIER Vxx_bus_off_stt_diag /begin FUNCTION_LIST R204.1.CanComm_1_9_2 R901.1.Diag_on_can_app_1_6_2 /end FUNCTION_LIST /end MEASUREMENT
/begin MEASUREMENT vDIAGISS "After sale idle speed setpoint" UWORD COMP_0337_S 1 100 0 65535 ECU_ADDRESS 0xFFFF2A46 DISPLAY_IDENTIFIER Vxx_diag_min_is_n /begin FUNCTION_LIST R107.1.iss_ariss_1_0_4 /end FUNCTION_LIST /end MEASUREMENT
/begin MEASUREMENT vDIAGUCX2 "diagnosis of mux ecu absent mumber2" UBYTE COMP_0068 1 100 0 255 ECU_ADDRESS 0xFFFF3AF6 DISPLAY_IDENTIFIER Vxx_abs_ecu_stt_diag /begin FUNCTION_LIST R204.1.CanComm_1_9_2 R901.1.Diag_on_can_app_1_6_2 /end FUNCTION_LIST /end MEASUREMENT
/begin MEASUREMENT vDIAGUCX3 "diagnosis of mux ecu absent mumber3" UBYTE COMP_0068 1 100 0 255 ECU_ADDRESS 0xFFFF3AF7 DISPLAY_IDENTIFIER Vxx_ip_ecu_stt_diag /begin FUNCTION_LIST R204.1.CanComm_1_9_2 R901.1.Diag_on_can_app_1_6_2 /end FUNCTION_LIST /end MEASUREMENT
/begin MEASUREMENT vDIAGUCX4 "diagnosis of mux ecu absent mumber4" UBYTE COMP_0068 1 100 0 255 ECU_ADDRESS 0xFFFF3AF8 DISPLAY_IDENTIFIER Vxx_ccu_ecu_stt_diag /begin FUNCTION_LIST R204.1.CanComm_1_9_2 R901.1.Diag_on_can_app_1_6_2 /end FUNCTION_LIST /end MEASUREMENT
/begin MEASUREMENT vDIAGUCX7 "diagnosis of mux ecu absent mumber7" UBYTE COMP_0068 1 100 0 255 ECU_ADDRESS 0xFFFF3AFB DISPLAY_IDENTIFIER Vxx_acc_ecu_stt_diag /begin FUNCTION_LIST R204.1.CanComm_1_9_2 R901.1.Diag_on_can_app_1_6_2 /end FUNCTION_LIST /end MEASUREMENT
/begin MEASUREMENT vDIAGUCX8 "diagnosis of mux ecu absent mumber8" UBYTE COMP_0068 1 100 0 255 ECU_ADDRESS 0xFFFF3AFC DISPLAY_IDENTIFIER Vxx_ac_ecu_stt_diag /begin FUNCTION_LIST R204.1.CanComm_1_9_2 R901.1.Diag_on_can_app_1_6_2 /end FUNCTION_LIST /end MEASUREMENT
/begin MEASUREMENT vDIAGUCX9 "diagnosis of mux ecu absent mumber9" UBYTE COMP_0068 1 100 0 255 ECU_ADDRESS 0xFFFF3AFD DISPLAY_IDENTIFIER Vxx_agb_ecu_stt_diag /begin FUNCTION_LIST R204.1.CanComm_1_9_2 R901.1.Diag_on_can_app_1_6_2 /end FUNCTION_LIST /end MEASUREMENT
/begin MEASUREMENT vDIAGUCXE "diagnosis of mux ecu absent mumber14" UBYTE COMP_0068 1 100 0 255 ECU_ADDRESS 0xFFFF3B02 DISPLAY_IDENTIFIER Vxx_swa_ecu_stt_diag /begin FUNCTION_LIST R204.1.CanComm_1_9_2 R901.1.Diag_on_can_app_1_6_2 /end FUNCTION_LIST /end MEASUREMENT
/begin MEASUREMENT vDIAGUCXK "diagnosis of mux ecu absent mumber20" UBYTE COMP_0068 1 100 0 255 ECU_ADDRESS 0xFFFF3B08 DISPLAY_IDENTIFIER Vxx_usm_ecu_stt_diag /begin FUNCTION_LIST R204.1.CanComm_1_9_2 R901.1.Diag_on_can_app_1_6_2 /end FUNCTION_LIST /end MEASUREMENT
/begin MEASUREMENT vDIAGUCXX "State of DDCM Control Unit failure detection for Mux Network frame" UBYTE COMP_0068 1 100 0 255 ECU_ADDRESS 0xFFFF3B0D DISPLAY_IDENTIFIER Vxx_ddcm_ecu_stt_diag /begin FUNCTION_LIST R204.1.CanComm_1_9_2 /end FUNCTION_LIST /end MEASUREMENT
/begin MEASUREMENT vEGEARRAW "Current raw gear taken from CAN du to electronic gearbox" SBYTE COMP_0263 1 100 -128 127 ECU_ADDRESS 0xFFFF3C18 DISPLAY_IDENTIFIER Vsx_raw_egb_gear /begin FUNCTION_LIST R204.1.CanComm_1_9_2 /end FUNCTION_LIST /end MEASUREMENT
/begin MEASUREMENT vETAMXABS "ABS ECU status for CAN" UBYTE COMP_0068 1 100 0 255 ECU_ADDRESS 0xFFFF492C DISPLAY_IDENTIFIER ETAMXABS /begin FUNCTION_LIST R204.1.CanComm_1_9_2 R301.23.ADV_calculation_1_1_2 /end FUNCTION_LIST /end MEASUREMENT
/begin MEASUREMENT vETAMXACC "State of Automatic Cruise Control Unit  for CAN." UBYTE COMP_0068 1 100 0 255 ECU_ADDRESS 0xFFFF3CB6 DISPLAY_IDENTIFIER ETAMXACC /begin FUNCTION_LIST R204.1.CanComm_1_9_2 /end FUNCTION_LIST /end MEASUREMENT
/begin MEASUREMENT vETAMXBOF "ABS ECU status for CAN" UBYTE COMP_0068 1 100 0 255 ECU_ADDRESS 0xFFFF3CB8 DISPLAY_IDENTIFIER Vxx_bus_off_stt /begin FUNCTION_LIST R204.1.CanComm_1_9_2 /end FUNCTION_LIST /end MEASUREMENT
/begin MEASUREMENT vETAMXBVA "Gearbox ECU status for CAN" UBYTE COMP_0068 1 100 0 255 ECU_ADDRESS 0xFFFF492D DISPLAY_IDENTIFIER ETAMXBVA
 /begin FUNCTION_LIST R107.2.iss_atiss_1_0_2 R202.2.acx_mdfan_1_2_2 R204.1.CanComm_1_9_2 R208.3.GRBOX_1_2_2 R301.6.IscAirflow_1_4_5 R301.23.ADV_calculation_1_1_2 /end FUNCTION_LIST
/end MEASUREMENT
/begin MEASUREMENT vETAMXCLU "ABS ECU status for CAN" UBYTE COMP_0068 1 100 0 255 ECU_ADDRESS 0xFFFF492F DISPLAY_IDENTIFIER ETAMXTDB /begin FUNCTION_LIST R204.1.CanComm_1_9_2 R208.2.VSINT_1_1_2 /end FUNCTION_LIST /end MEASUREMENT
/begin MEASUREMENT vETAMXDDC "State of DDCM control unit for CAN failure detection" UBYTE COMP_0068 1 100 0 255 ECU_ADDRESS 0xFFFF3CB9 DISPLAY_IDENTIFIER Vxx_ddcm_ecu_stt /begin FUNCTION_LIST R204.1.CanComm_1_9_2 /end FUNCTION_LIST /end MEASUREMENT
/begin MEASUREMENT vETAMXINJ "Engine control ECU status for CAN" UBYTE COMP_0068 1 100 0 255 ECU_ADDRESS 0xFFFF3CBB DISPLAY_IDENTIFIER Vxx_mute_stt /begin FUNCTION_LIST R204.1.CanComm_1_9_2 /end FUNCTION_LIST /end MEASUREMENT
/begin MEASUREMENT vETAMXSWA "ABS ECU status for CAN" UBYTE COMP_0068 1 100 0 255 ECU_ADDRESS 0xFFFF3CBD DISPLAY_IDENTIFIER Vxx_swa_ecu_stt /begin FUNCTION_LIST R204.1.CanComm_1_9_2 /end FUNCTION_LIST /end MEASUREMENT
/begin MEASUREMENT vETAMXUCH "UCH (Body Controller) status for CAN" UBYTE COMP_0068 1 100 0 255 ECU_ADDRESS 0xFFFF4930 DISPLAY_IDENTIFIER ETAMXUCH /begin FUNCTION_LIST R108.1.dls_gbrat_vmm_1_1_5 R204.1.CanComm_1_9_2 /end FUNCTION_LIST /end MEASUREMENT
/begin MEASUREMENT vETAMXUPC "UPC ECU status for CAN" UBYTE COMP_0068 1 100 0 255 ECU_ADDRESS 0xFFFF4931 DISPLAY_IDENTIFIER ETAMXUPC
 /begin FUNCTION_LIST R106.3.epw_palmx_1_1_0 R108.1.dls_gbrat_vmm_1_1_5 R203.1.crk_mngtx_1_2_1 R204.1.CanComm_1_9_2 R301.23.ADV_calculation_1_1_2 /end FUNCTION_LIST
/end MEASUREMENT
/begin MEASUREMENT vETARVMX "Engine states" UBYTE COMP_0068 1 100 0 255 ECU_ADDRESS 0xFFFF41F0 DISPLAY_IDENTIFIER Etarvmx
 /begin FUNCTION_LIST R204.1.CanComm_1_9_2 R208.7.OUTMX_1_1_3 R208.9.SAFETYX_1_3_2 /end FUNCTION_LIST
/end MEASUREMENT
/begin MEASUREMENT vETCONBVA "Torque converter state" UBYTE COMP_0068 1 100 0 255 ECU_ADDRESS 0xFFFF3CC0 DISPLAY_IDENTIFIER Vsx_agb_coup
 /begin FUNCTION_LIST R204.1.CanComm_1_9_2 R301.26.Dashpot_DandN_1_0_2 R901.1.Diag_on_can_app_1_6_2 /end FUNCTION_LIST
/end MEASUREMENT
/begin MEASUREMENT vFILFALTP "Alternator power filtering factor" UWORD COMP_0361_S 1 100 0 65.535 ECU_ADDRESS 0xFFFF138E DISPLAY_IDENTIFIER Vxx_alt_pow_fil_fac /begin FUNCTION_LIST R106.7.epw_tqalt_1_1_0 /end FUNCTION_LIST /end MEASUREMENT
/begin MEASUREMENT vFREIN1MX "Close active brake switch_UCH" UBYTE COMP_0068 1 100 0 255 ECU_ADDRESS 0xFFFF3D89 /begin FUNCTION_LIST R204.1.CanComm_1_9_2 /end FUNCTION_LIST /end MEASUREMENT
/begin MEASUREMENT vGBDVSPTF "Sportivity factor sent by AT on CAN" UBYTE COMP_0460_S 1 100 0 1.00000035 ECU_ADDRESS 0xFFFF3D92 DISPLAY_IDENTIFIER SportivityCriteria /begin FUNCTION_LIST R204.1.CanComm_1_9_2 /end FUNCTION_LIST /end MEASUREMENT
/begin MEASUREMENT vGBMNISMX "Automatic Transmission idle speed setpoint acceleration required" UWORD COMP_0443 1 100 0 65535 ECU_ADDRESS 0xFFFF4946 DISPLAY_IDENTIFIER Vxx_mux_agb_is_acel_req /begin FUNCTION_LIST R107.2.iss_atiss_1_0_2 R204.1.CanComm_1_9_2 /end FUNCTION_LIST /end MEASUREMENT
/begin MEASUREMENT vINCSLOP "Arbitrated increase slope applied to the current arbitrated idle speed setpoint" UWORD COMP_0407_S 1 100 0 65535 ECU_ADDRESS 0xFFFF2E4C DISPLAY_IDENTIFIER Vxx_arb_inc_slop /begin FUNCTION_LIST R107.1.iss_ariss_1_0_4 /end FUNCTION_LIST /end MEASUREMENT
/begin MEASUREMENT vMABSENT "Array of non volatile counters accounting for current failures  Absent unit " UBYTE COMP_0068 1 100 0 255 ECU_ADDRESS 0xFFFFB610 /begin FUNCTION_LIST R204.1.CanComm_1_9_2 /end FUNCTION_LIST /end MEASUREMENT
/begin MEASUREMENT vMABSENT_C#1_R#1 "Array of non volatile counters accounting for current failures  Absent unit " UBYTE COMP_0068 1 100 0 255 ECU_ADDRESS 0xFFFFB610 /begin FUNCTION_LIST R204.1.CanComm_1_9_2 /end FUNCTION_LIST /end MEASUREMENT
/begin MEASUREMENT vMABSENT_C#2_R#1 "Array of non volatile counters accounting for current failures  Absent unit " UBYTE COMP_0068 1 100 0 255 ECU_ADDRESS 0xFFFFB611 /begin FUNCTION_LIST R204.1.CanComm_1_9_2 /end FUNCTION_LIST /end MEASUREMENT
/begin MEASUREMENT vMABSENT_C#3_R#1 "Array of non volatile counters accounting for current failures  Absent unit " UBYTE COMP_0068 1 100 0 255 ECU_ADDRESS 0xFFFFB612 /begin FUNCTION_LIST R204.1.CanComm_1_9_2 /end FUNCTION_LIST /end MEASUREMENT
/begin MEASUREMENT vMABSENT_C#4_R#1 "Array of non volatile counters accounting for current failures  Absent unit " UBYTE COMP_0068 1 100 0 255 ECU_ADDRESS 0xFFFFB613 /begin FUNCTION_LIST R204.1.CanComm_1_9_2 /end FUNCTION_LIST /end MEASUREMENT
/begin MEASUREMENT vMABSENT_C#5_R#1 "Array of non volatile counters accounting for current failures  Absent unit " UBYTE COMP_0068 1 100 0 255 ECU_ADDRESS 0xFFFFB614 /begin FUNCTION_LIST R204.1.CanComm_1_9_2 /end FUNCTION_LIST /end MEASUREMENT
/begin MEASUREMENT vMABSENT_C#6_R#1 "Array of non volatile counters accounting for current failures  Absent unit " UBYTE COMP_0068 1 100 0 255 ECU_ADDRESS 0xFFFFB615 /begin FUNCTION_LIST R204.1.CanComm_1_9_2 /end FUNCTION_LIST /end MEASUREMENT
/begin MEASUREMENT vMABSENT_C#7_R#1 "Array of non volatile counters accounting for current failures  Absent unit " UBYTE COMP_0068 1 100 0 255 ECU_ADDRESS 0xFFFFB616 /begin FUNCTION_LIST R204.1.CanComm_1_9_2 /end FUNCTION_LIST /end MEASUREMENT
/begin MEASUREMENT vMABSENT_C#8_R#1 "Array of non volatile counters accounting for current failures  Absent unit " UBYTE COMP_0068 1 100 0 255 ECU_ADDRESS 0xFFFFB617 /begin FUNCTION_LIST R204.1.CanComm_1_9_2 /end FUNCTION_LIST /end MEASUREMENT
/begin MEASUREMENT vMABSENT_C#9_R#1 "Array of non volatile counters accounting for current failures  Absent unit " UBYTE COMP_0068 1 100 0 255 ECU_ADDRESS 0xFFFFB618 /begin FUNCTION_LIST R204.1.CanComm_1_9_2 /end FUNCTION_LIST /end MEASUREMENT
/begin MEASUREMENT vMABSENT_C#10_R#1 "Array of non volatile counters accounting for current failures  Absent unit " UBYTE COMP_0068 1 100 0 255 ECU_ADDRESS 0xFFFFB619 /begin FUNCTION_LIST R204.1.CanComm_1_9_2 /end FUNCTION_LIST /end MEASUREMENT
/begin MEASUREMENT vMABSENT_C#11_R#1 "Array of non volatile counters accounting for current failures  Absent unit " UBYTE COMP_0068 1 100 0 255 ECU_ADDRESS 0xFFFFB61A /begin FUNCTION_LIST R204.1.CanComm_1_9_2 /end FUNCTION_LIST /end MEASUREMENT
/begin MEASUREMENT vMABSENT_C#12_R#1 "Array of non volatile counters accounting for current failures  Absent unit " UBYTE COMP_0068 1 100 0 255 ECU_ADDRESS 0xFFFFB61B /begin FUNCTION_LIST R204.1.CanComm_1_9_2 /end FUNCTION_LIST /end MEASUREMENT
/begin MEASUREMENT vMABSENT_C#13_R#1 "Array of non volatile counters accounting for current failures  Absent unit " UBYTE COMP_0068 1 100 0 255 ECU_ADDRESS 0xFFFFB61C /begin FUNCTION_LIST R204.1.CanComm_1_9_2 /end FUNCTION_LIST /end MEASUREMENT
/begin MEASUREMENT vMABSENT_C#14_R#1 "Array of non volatile counters accounting for current failures  Absent unit " UBYTE COMP_0068 1 100 0 255 ECU_ADDRESS 0xFFFFB61D /begin FUNCTION_LIST R204.1.CanComm_1_9_2 /end FUNCTION_LIST /end MEASUREMENT
/begin MEASUREMENT vMABSENT_C#15_R#1 "Array of non volatile counters accounting for current failures  Absent unit " UBYTE COMP_0068 1 100 0 255 ECU_ADDRESS 0xFFFFB61E /begin FUNCTION_LIST R204.1.CanComm_1_9_2 /end FUNCTION_LIST /end MEASUREMENT
/begin MEASUREMENT vMABSENT_C#16_R#1 "Array of non volatile counters accounting for current failures  Absent unit " UBYTE COMP_0068 1 100 0 255 ECU_ADDRESS 0xFFFFB61F /begin FUNCTION_LIST R204.1.CanComm_1_9_2 /end FUNCTION_LIST /end MEASUREMENT
/begin MEASUREMENT vMABSENT_C#17_R#1 "Array of non volatile counters accounting for current failures  Absent unit " UBYTE COMP_0068 1 100 0 255 ECU_ADDRESS 0xFFFFB620 /begin FUNCTION_LIST R204.1.CanComm_1_9_2 /end FUNCTION_LIST /end MEASUREMENT
/begin MEASUREMENT vMABSENT_C#18_R#1 "Array of non volatile counters accounting for current failures  Absent unit " UBYTE COMP_0068 1 100 0 255 ECU_ADDRESS 0xFFFFB621 /begin FUNCTION_LIST R204.1.CanComm_1_9_2 /end FUNCTION_LIST /end MEASUREMENT
/begin MEASUREMENT vMABSENT_C#19_R#1 "Array of non volatile counters accounting for current failures  Absent unit " UBYTE COMP_0068 1 100 0 255 ECU_ADDRESS 0xFFFFB622 /begin FUNCTION_LIST R204.1.CanComm_1_9_2 /end FUNCTION_LIST /end MEASUREMENT
/begin MEASUREMENT vMABSENT_C#20_R#1 "Array of non volatile counters accounting for current failures  Absent unit " UBYTE COMP_0068 1 100 0 255 ECU_ADDRESS 0xFFFFB623 /begin FUNCTION_LIST R204.1.CanComm_1_9_2 /end FUNCTION_LIST /end MEASUREMENT
/begin MEASUREMENT vMABSENT_C#21_R#1 "Array of non volatile counters accounting for current failures  Absent unit " UBYTE COMP_0068 1 100 0 255 ECU_ADDRESS 0xFFFFB624 /begin FUNCTION_LIST R204.1.CanComm_1_9_2 /end FUNCTION_LIST /end MEASUREMENT
/begin MEASUREMENT vMABSENT_C#22_R#1 "Array of non volatile counters accounting for current failures  Absent unit " UBYTE COMP_0068 1 100 0 255 ECU_ADDRESS 0xFFFFB625 /begin FUNCTION_LIST R204.1.CanComm_1_9_2 /end FUNCTION_LIST /end MEASUREMENT
/begin MEASUREMENT vMABSENT_C#23_R#1 "Array of non volatile counters accounting for current failures  Absent unit " UBYTE COMP_0068 1 100 0 255 ECU_ADDRESS 0xFFFFB626 /begin FUNCTION_LIST R204.1.CanComm_1_9_2 /end FUNCTION_LIST /end MEASUREMENT
/begin MEASUREMENT vMABSENT_C#24_R#1 "Array of non volatile counters accounting for current failures  Absent unit " UBYTE COMP_0068 1 100 0 255 ECU_ADDRESS 0xFFFFB627 /begin FUNCTION_LIST R204.1.CanComm_1_9_2 /end FUNCTION_LIST /end MEASUREMENT
/begin MEASUREMENT vMABSENT_C#25_R#1 "Array of non volatile counters accounting for current failures  Absent unit " UBYTE COMP_0068 1 100 0 255 ECU_ADDRESS 0xFFFFB628 /begin FUNCTION_LIST R204.1.CanComm_1_9_2 /end FUNCTION_LIST /end MEASUREMENT
/begin MEASUREMENT vMABSENT_C#26_R#1 "Array of non volatile counters accounting for current failures  Absent unit " UBYTE COMP_0068 1 100 0 255 ECU_ADDRESS 0xFFFFB629 /begin FUNCTION_LIST R204.1.CanComm_1_9_2 /end FUNCTION_LIST /end MEASUREMENT
/begin MEASUREMENT vMABSENT_C#27_R#1 "Array of non volatile counters accounting for current failures  Absent unit " UBYTE COMP_0068 1 100 0 255 ECU_ADDRESS 0xFFFFB62A /begin FUNCTION_LIST R204.1.CanComm_1_9_2 /end FUNCTION_LIST /end MEASUREMENT
/begin MEASUREMENT vMABSENT_C#28_R#1 "Array of non volatile counters accounting for current failures  Absent unit " UBYTE COMP_0068 1 100 0 255 ECU_ADDRESS 0xFFFFB62B /begin FUNCTION_LIST R204.1.CanComm_1_9_2 /end FUNCTION_LIST /end MEASUREMENT
/begin MEASUREMENT vMABSENT_C#29_R#1 "Array of non volatile counters accounting for current failures  Absent unit " UBYTE COMP_0068 1 100 0 255 ECU_ADDRESS 0xFFFFB62C /begin FUNCTION_LIST R204.1.CanComm_1_9_2 /end FUNCTION_LIST /end MEASUREMENT
/begin MEASUREMENT vMABSENT_C#30_R#1 "Array of non volatile counters accounting for current failures  Absent unit " UBYTE COMP_0068 1 100 0 255 ECU_ADDRESS 0xFFFFB62D /begin FUNCTION_LIST R204.1.CanComm_1_9_2 /end FUNCTION_LIST /end MEASUREMENT
/begin MEASUREMENT vMAXEGAUT "Output of Ctp_max_n_eng_aut_thd cartography" UWORD COMP_0443 1 100 0 65535 ECU_ADDRESS 0xFFFF3DEC DISPLAY_IDENTIFIER Vxx_max_n_eng_aut /begin FUNCTION_LIST R203.1.crk_mngtx_1_2_1 /end FUNCTION_LIST /end MEASUREMENT
/begin MEASUREMENT vMBUSOFF "Non volatile unit BusOff counter" UBYTE COMP_0068 1 100 0 255 ECU_ADDRESS 0xFFFFB62E DISPLAY_IDENTIFIER MBUSOFF /begin FUNCTION_LIST R204.1.CanComm_1_9_2 /end FUNCTION_LIST /end MEASUREMENT
/begin MEASUREMENT vMGBGR "Manual Gearbox ratio engaged (-1 0 1 2 3 4 5 6)" SBYTE COMP_0263 1 100 -128 127 ECU_ADDRESS 0xFFFF2F8B DISPLAY_IDENTIFIER Vxx_mgb_gear /begin FUNCTION_LIST R108.1.dls_gbrat_vmm_1_1_5 /end FUNCTION_LIST /end MEASUREMENT
/begin MEASUREMENT vMGBGRFS "Manual Gearbox ratio engaged (VSP failure Failsafe)" SBYTE COMP_0263 1 100 -128 127 ECU_ADDRESS 0xFFFF2F8C DISPLAY_IDENTIFIER Vxx_mgb_gear_fs /begin FUNCTION_LIST R108.1.dls_gbrat_vmm_1_1_5 /end FUNCTION_LIST /end MEASUREMENT
/begin MEASUREMENT vMILEMEM "Total vehicle distance secured" ULONG COMP_0470 1 100 0 4294967295 ECU_ADDRESS 0xFFFFA014 DISPLAY_IDENTIFIER Vxx_vh_dist
 /begin FUNCTION_LIST R204.1.CanComm_1_9_2 R208.10.dgn_ccadd_1_3_2 R901.1.Diag_on_can_app_1_6_2 R902.1.SafetyDiagManager_1_3_6 R902.2.DiagMiscell_1_3_5 /end FUNCTION_LIST
/end MEASUREMENT
/begin MEASUREMENT vMILOUTMX "MILLlamp" UBYTE COMP_0068 1 100 0 255 ECU_ADDRESS 0xFFFF4208 DISPLAY_IDENTIFIER Vxx_mux_mil_req /begin FUNCTION_LIST R204.1.CanComm_1_9_2 R902.2.DiagMiscell_1_3_5 /end FUNCTION_LIST /end MEASUREMENT
/begin MEASUREMENT vMMUTE "Non volatile unit Mute counter" UBYTE COMP_0068 1 100 0 255 ECU_ADDRESS 0xFFFFB63F DISPLAY_IDENTIFIER MMUTE /begin FUNCTION_LIST R204.1.CanComm_1_9_2 /end FUNCTION_LIST /end MEASUREMENT
/begin MEASUREMENT vMRGBMX "Major AGB fault logic input" UBYTE COMP_0068 1 100 0 255 ECU_ADDRESS 0xFFFF3DF2 /begin FUNCTION_LIST R204.1.CanComm_1_9_2 /end FUNCTION_LIST /end MEASUREMENT
/begin MEASUREMENT vMUXBRKPD "CAN brake pedal states" UBYTE COMP_0068 1 100 0 255 ECU_ADDRESS 0xFFFF4076 DISPLAY_IDENTIFIER Vsx_mux_brk_pdl /begin FUNCTION_LIST R204.1.CanComm_1_9_2 /end FUNCTION_LIST /end MEASUREMENT
/begin MEASUREMENT vMUXCLUMN "Begin stroke clutch pedal switch" UBYTE COMP_0068 1 100 0 255 ECU_ADDRESS 0xFFFF4077 DISPLAY_IDENTIFIER Vsx_mux_bgin_str_clu_cnt /begin FUNCTION_LIST R204.1.CanComm_1_9_2 /end FUNCTION_LIST /end MEASUREMENT
/begin MEASUREMENT vMVEGAUT "Output of Ctp_mv_n_eng_aut_thd cartography" UWORD COMP_0443 1 100 0 65535 ECU_ADDRESS 0xFFFF3E00 DISPLAY_IDENTIFIER Vxx_mv_n_eng_aut /begin FUNCTION_LIST R203.1.crk_mngtx_1_2_1 /end FUNCTION_LIST /end MEASUREMENT
/begin MEASUREMENT vNEUTMUX "Neutral contact" UBYTE COMP_0068 1 100 0 255 ECU_ADDRESS 0xFFFF4952 DISPLAY_IDENTIFIER Vsx_neut_cnt
 /begin FUNCTION_LIST R108.1.dls_gbrat_vmm_1_1_5 R204.1.CanComm_1_9_2 R301.5.FuelCut_1_2_2 /end FUNCTION_LIST
/end MEASUREMENT
/begin MEASUREMENT vOTORIAB "Engine operate authorization dependent on Airbag function" UBYTE COMP_0068 1 100 0 255 ECU_ADDRESS 0xFFFF4079 DISPLAY_IDENTIFIER Otoriab /begin FUNCTION_LIST R201.1.stp_mngtx_1_2_2 /end FUNCTION_LIST /end MEASUREMENT
/begin MEASUREMENT vOTORIBVR "Engine operate authorization dependent on the major failure from BVR" UBYTE COMP_0068 1 100 0 255 ECU_ADDRESS 0xFFFF3E20 DISPLAY_IDENTIFIER Otoribvr /begin FUNCTION_LIST R201.1.stp_mngtx_1_2_2 /end FUNCTION_LIST /end MEASUREMENT
/begin MEASUREMENT vOTORISSG "Engine running authorisation dependent on SSG function" UBYTE COMP_0068 1 100 0 255 ECU_ADDRESS 0xFFFF3E21 DISPLAY_IDENTIFIER Otorissg /begin FUNCTION_LIST R201.1.stp_mngtx_1_2_2 /end FUNCTION_LIST /end MEASUREMENT
/begin MEASUREMENT vOTORIUCH "Engine operate authorization dependent on stop request from UCH" UBYTE COMP_0068 1 100 0 255 ECU_ADDRESS 0xFFFF3E22 DISPLAY_IDENTIFIER Otoriuch /begin FUNCTION_LIST R201.1.stp_mngtx_1_2_2 /end FUNCTION_LIST /end MEASUREMENT
/begin MEASUREMENT vOTORIVL "Engine running authorisation dependent on the anti theft strategy" UBYTE COMP_0068 1 100 0 255 ECU_ADDRESS 0xFFFF4957 DISPLAY_IDENTIFIER Otorivl /begin FUNCTION_LIST R201.1.stp_mngtx_1_2_2 R203.2.crk_restx_1_0_8 /end FUNCTION_LIST /end MEASUREMENT
/begin MEASUREMENT vPMAXALT "MaximumMechanicalPowerAllowed" UBYTE COMP_0360_S 1 100 0 10200 ECU_ADDRESS 0xFFFF4213 DISPLAY_IDENTIFIER Vxx_mux_alt_max_pow_ena /begin FUNCTION_LIST R106.1.epw_altxx_1_1_0 R204.1.CanComm_1_9_2 /end FUNCTION_LIST /end MEASUREMENT
/begin MEASUREMENT vPMAXCTP "AlternatorMaximumPower" UBYTE COMP_0439_S 1 100 0 5100 ECU_ADDRESS 0xFFFF4214 DISPLAY_IDENTIFIER Vxx_ptc_max_pow /begin FUNCTION_LIST R106.5.epw_ptcxx_1_1_0 R204.1.CanComm_1_9_2 /end FUNCTION_LIST /end MEASUREMENT
/begin MEASUREMENT vPRSCLIM "Relative AC pressure for diagnosis" UWORD COMP_0420_S 1 100 0 6553.5 ECU_ADDRESS 0xFFFF23F4 DISPLAY_IDENTIFIER PRSCLIM
 /begin FUNCTION_LIST R202.1.acx_acprs_1_2_3 R202.2.acx_mdfan_1_2_2 R204.1.CanComm_1_9_2 R301.13.FFDforDiagOnCAN_1_1_3 R901.1.Diag_on_can_app_1_6_2 /end FUNCTION_LIST
/end MEASUREMENT
/begin MEASUREMENT vPSLPALT "AllowedPowerGradient" UBYTE COMP_0463_S 1 100 0 10200 ECU_ADDRESS 0xFFFF4215 DISPLAY_IDENTIFIER Vxx_mux_alt_slop_req /begin FUNCTION_LIST R106.1.epw_altxx_1_1_0 R204.1.CanComm_1_9_2 /end FUNCTION_LIST /end MEASUREMENT
/begin MEASUREMENT vPTCISS "PTC idle speed setpoint" UWORD COMP_0337_S 1 100 0 65535 ECU_ADDRESS 0xFFFF30AA DISPLAY_IDENTIFIER Vxx_ptc_min_is_n /begin FUNCTION_LIST R107.1.iss_ariss_1_0_4 R107.3.iss_eliss_1_0_4 /end FUNCTION_LIST /end MEASUREMENT
/begin MEASUREMENT vPTCPOW "Information de la puissance de commande des CTP" UBYTE COMP_0519_S 1 100 0 25500 ECU_ADDRESS 0xFFFF4765 DISPLAY_IDENTIFIER Vxx_ptc_pow /begin FUNCTION_LIST R204.1.CanComm_1_9_2 R301.6.IscAirflow_1_4_5 /end FUNCTION_LIST /end MEASUREMENT
/begin MEASUREMENT vPVSTAT "Mailbox ventilation status" UBYTE COMP_0068 1 100 0 255 ECU_ADDRESS 0xFFFF40E9 /begin FUNCTION_LIST R202.2.acx_mdfan_1_2_2 R301.3.FanAftPwl_1_0_4 /end FUNCTION_LIST /end MEASUREMENT
/begin MEASUREMENT vPWSTISS "Power steering idle speed setpoint" UWORD COMP_0337_S 1 100 0 65535 ECU_ADDRESS 0xFFFF3E34 DISPLAY_IDENTIFIER Vxx_pwst_min_is_n /begin FUNCTION_LIST R107.1.iss_ariss_1_0_4 R107.4.iss_mciss_1_0_2 /end FUNCTION_LIST /end MEASUREMENT
/begin MEASUREMENT vRAPORENG "Engaged gear ratio input table" UBYTE COMP_0068 1 100 0 255 ECU_ADDRESS 0xFFFF4960 DISPLAY_IDENTIFIER Raporeng
 /begin FUNCTION_LIST R204.1.CanComm_1_9_2 R301.23.ADV_calculation_1_1_2 R301.28.StarterSwitch_1_0_2 /end FUNCTION_LIST
/end MEASUREMENT
/begin MEASUREMENT vRAWGEARA "Taget raw gear taken from CAN du to electronic gearbox" SBYTE COMP_0263 1 100 -128 127 ECU_ADDRESS 0xFFFF3E3E DISPLAY_IDENTIFIER Vsx_raw_egb_ant_gear /begin FUNCTION_LIST R204.1.CanComm_1_9_2 R901.1.Diag_on_can_app_1_6_2 /end FUNCTION_LIST /end MEASUREMENT
/begin MEASUREMENT vRAWISS "Arbitrated raw idle speed setpoint (without min/max limitation)" UWORD COMP_0337_S 1 100 0 65535 ECU_ADDRESS 0xFFFF30F2 DISPLAY_IDENTIFIER Vxx_arb_raw_is /begin FUNCTION_LIST R107.1.iss_ariss_1_0_4 /end FUNCTION_LIST /end MEASUREMENT
/begin MEASUREMENT vREGVSC "Engine speed  for cranking management strategy" UWORD COMP_0443 1 100 0 65535 ECU_ADDRESS 0xFFFF1F04 DISPLAY_IDENTIFIER REGVSC /begin FUNCTION_LIST R203.1.crk_mngtx_1_2_1 /end FUNCTION_LIST /end MEASUREMENT
/begin MEASUREMENT vRESTCOR "Fuel Injection Mass correction factor for Re-Start" UBYTE COMP_0068 1 100 0 255 ECU_ADDRESS 0xFFFF311D DISPLAY_IDENTIFIER Vxx_appl_rest_cor /begin FUNCTION_LIST R203.2.crk_restx_1_0_8 /end FUNCTION_LIST /end MEASUREMENT
/begin MEASUREMENT vRESTCORR "Fuel Injection Mass reference correction factor for Re-Start" UBYTE COMP_0068 1 100 0 255 ECU_ADDRESS 0xFFFF311E DISPLAY_IDENTIFIER Vxx_ref_rest_cor /begin FUNCTION_LIST R203.2.crk_restx_1_0_8 /end FUNCTION_LIST /end MEASUREMENT
/begin MEASUREMENT vRESTCORT "Basic value of fuel Injection Mass reference correction factor for Re-Start" UBYTE COMP_0068 1 100 0 255 ECU_ADDRESS 0xFFFF311F /begin FUNCTION_LIST R203.2.crk_restx_1_0_8 /end FUNCTION_LIST /end MEASUREMENT
/begin MEASUREMENT vRESTCORZ "Previous value of fuel Injection Mass reference correction factor for Re-Start" UBYTE COMP_0068 1 100 0 255 ECU_ADDRESS 0xFFFF3120 /begin FUNCTION_LIST R203.2.crk_restx_1_0_8 /end FUNCTION_LIST /end MEASUREMENT
/begin MEASUREMENT vRESTCRMZ "Previous value of memorized fuel Injection Mass correction factor for Re-Start" UBYTE COMP_0068 1 100 0 255 ECU_ADDRESS 0xFFFF3122 /begin FUNCTION_LIST R203.2.crk_restx_1_0_8 /end FUNCTION_LIST /end MEASUREMENT
/begin MEASUREMENT vRESTSTT "Restart status" UBYTE COMP_0068 1 100 0 255 ECU_ADDRESS 0xFFFF3123 /begin FUNCTION_LIST R203.2.crk_restx_1_0_8 /end FUNCTION_LIST /end MEASUREMENT
/begin MEASUREMENT vRESTUFCZ "Previous value of engine unflooding counter" UBYTE COMP_0068 1 100 0 255 ECU_ADDRESS 0xFFFF3125 /begin FUNCTION_LIST R203.2.crk_restx_1_0_8 /end FUNCTION_LIST /end MEASUREMENT
/begin MEASUREMENT vREVSWMUX "Rear gear engaged" UBYTE COMP_0068 1 100 0 255 ECU_ADDRESS 0xFFFF4965 DISPLAY_IDENTIFIER Vsx_rvr_cnt /begin FUNCTION_LIST R108.1.dls_gbrat_vmm_1_1_5 R204.1.CanComm_1_9_2 /end FUNCTION_LIST /end MEASUREMENT
/begin MEASUREMENT vRUNISS "Running   vehicule idle speed setpoint" UWORD COMP_0337_S 1 100 0 65535 ECU_ADDRESS 0xFFFF31B6 DISPLAY_IDENTIFIER Vxx_run_vh_min_is_n /begin FUNCTION_LIST R107.1.iss_ariss_1_0_4 /end FUNCTION_LIST /end MEASUREMENT
/begin MEASUREMENT vSTATUDEM "Starter status" UBYTE COMP_0068 1 100 0 255 ECU_ADDRESS 0xFFFF3F12 DISPLAY_IDENTIFIER Statudem
 /begin FUNCTION_LIST R203.1.crk_mngtx_1_2_1 R204.1.CanComm_1_9_2 R901.1.Diag_on_can_app_1_6_2 /end FUNCTION_LIST
/end MEASUREMENT
/begin MEASUREMENT vSTMANSW "CC or SL strategy requested by the driver" UBYTE COMP_0068 1 100 0 255 ECU_ADDRESS 0xFFFF3214 DISPLAY_IDENTIFIER Vsx_cru_sl_on_off /begin FUNCTION_LIST R208.1.SWTCH_1_1_7 R208.4.STFLW_1_2_2 R208.7.OUTMX_1_1_3 /end FUNCTION_LIST /end MEASUREMENT
/begin MEASUREMENT vSTMANSWR "State of the on off main switch before filtering" UBYTE COMP_0068 1 100 0 255 ECU_ADDRESS 0xFFFF3215 DISPLAY_IDENTIFIER Vsx_cru_sl_on_off_raw /begin FUNCTION_LIST R208.1.SWTCH_1_1_7 /end FUNCTION_LIST /end MEASUREMENT
/begin MEASUREMENT vSTOPBVRX "Engine stop requested by robotized gearbox" UBYTE COMP_0068 1 100 0 255 ECU_ADDRESS 0xFFFF3F18 DISPLAY_IDENTIFIER STOPBVRX /begin FUNCTION_LIST R201.1.stp_mngtx_1_2_2 R204.1.CanComm_1_9_2 /end FUNCTION_LIST /end MEASUREMENT
/begin MEASUREMENT vSTOPSSGX "Engine stop requested by SSG" UBYTE COMP_0068 1 100 0 255 ECU_ADDRESS 0xFFFF3F19 DISPLAY_IDENTIFIER Vxx_eng_stop_req_ssg /begin FUNCTION_LIST R201.1.stp_mngtx_1_2_2 R204.1.CanComm_1_9_2 /end FUNCTION_LIST /end MEASUREMENT
/begin MEASUREMENT vSTOPUCHX "Emergency Engine Stop" UBYTE COMP_0068 1 100 0 255 ECU_ADDRESS 0xFFFF4080 DISPLAY_IDENTIFIER STOPUCHX /begin FUNCTION_LIST R201.1.stp_mngtx_1_2_2 R204.1.CanComm_1_9_2 /end FUNCTION_LIST /end MEASUREMENT
/begin MEASUREMENT vSTSTRSW "State of the steering wheel push buttons" UBYTE COMP_0068 1 100 0 255 ECU_ADDRESS 0xFFFF4241 DISPLAY_IDENTIFIER Vxx_cru_sl_whl_cmd_stt /begin FUNCTION_LIST R208.1.SWTCH_1_1_7 R208.10.dgn_ccadd_1_3_2 /end FUNCTION_LIST /end MEASUREMENT
/begin MEASUREMENT vSTSWACTR "Counter : increment at each START button" UBYTE COMP_0068 1 100 0 255 ECU_ADDRESS 0xFFFF4970 DISPLAY_IDENTIFIER Vxx_sta_swi_act_ctr
 /begin FUNCTION_LIST R204.1.CanComm_1_9_2 R208.4.STFLW_1_2_2 R901.1.Diag_on_can_app_1_6_2 /end FUNCTION_LIST
/end MEASUREMENT
/begin MEASUREMENT vSWMANACC "ACC/speed limiter main switch position transmitted to ACC ECU" UBYTE COMP_0068 1 100 0 255 ECU_ADDRESS 0xFFFF4244 DISPLAY_IDENTIFIER Swmanacc /begin FUNCTION_LIST R204.1.CanComm_1_9_2 R208.1.SWTCH_1_1_7 /end FUNCTION_LIST /end MEASUREMENT
/begin MEASUREMENT vTHPLISS "Thermoplunger idle speed setpoint" UWORD COMP_0337_S 1 100 0 65535 ECU_ADDRESS 0xFFFF3324 DISPLAY_IDENTIFIER Vxx_thpl_min_is_n /begin FUNCTION_LIST R107.1.iss_ariss_1_0_4 R107.3.iss_eliss_1_0_4 /end FUNCTION_LIST /end MEASUREMENT
/begin MEASUREMENT vTMPMYVSC "Output of Ctp_mv_n_eng_aut_dly cartography" UBYTE COMP_0165_S 1 100 0 2.55 ECU_ADDRESS 0xFFFF3F5A DISPLAY_IDENTIFIER TMPMYVSC /begin FUNCTION_LIST R203.1.crk_mngtx_1_2_1 /end FUNCTION_LIST /end MEASUREMENT
/begin MEASUREMENT vTOPECM "CAN output data indicating the cranking authorization ECM" UBYTE COMP_0068 1 100 0 255 ECU_ADDRESS 0xFFFF3F6A DISPLAY_IDENTIFIER Topecm
 /begin FUNCTION_LIST R203.1.crk_mngtx_1_2_1 R204.1.CanComm_1_9_2 R901.1.Diag_on_can_app_1_6_2 /end FUNCTION_LIST
/end MEASUREMENT
/begin MEASUREMENT vTQ12AGBF "AGB requirement FAST torque" UWORD COMP_0636_S 1 100 -400 32367.5 ECU_ADDRESS 0xFFFF3F76 /begin FUNCTION_LIST R204.1.CanComm_1_9_2 /end FUNCTION_LIST /end MEASUREMENT
/begin MEASUREMENT vTQ12AGBS "AGB requirement SLOW torque" UWORD COMP_0636_S 1 100 -400 32367.5 ECU_ADDRESS 0xFFFF3F78 /begin FUNCTION_LIST R204.1.CanComm_1_9_2 /end FUNCTION_LIST /end MEASUREMENT
/begin MEASUREMENT vTQGBCSMX "Converter friction Torque" UWORD COMP_0345_S 1 100 -400 1647.96875 ECU_ADDRESS 0xFFFF4988 DISPLAY_IDENTIFIER Vxx_mux_csm_agb_tq /begin FUNCTION_LIST R204.1.CanComm_1_9_2 R301.6.IscAirflow_1_4_5 /end FUNCTION_LIST /end MEASUREMENT
/begin MEASUREMENT vTQREQSF "Torque request status" UBYTE COMP_0068 1 100 0 255 ECU_ADDRESS 0xFFFF4250 DISPLAY_IDENTIFIER Vsx_mux_tq_req_ans
 /begin FUNCTION_LIST R106.1.epw_altxx_1_1_0 R106.2.epw_mxalt_1_1_0 R106.3.epw_palmx_1_1_0 R106.4.epw_paltx_1_1_0 R106.5.epw_ptcxx_1_1_0 R106.6.epw_slope_1_1_0 R106.7.epw_tqalt_1_1_0 R204.1.CanComm_1_9_2 R901.1.Diag_on_can_app_1_6_2 R902.2.DiagMiscell_1_3_5 /end FUNCTION_LIST
/end MEASUREMENT
/begin MEASUREMENT vTRAACEL "Transverse acceleration from device" UWORD COMP_0639_S 1 100 -131.068 131.072 ECU_ADDRESS 0xFFFF3F96 /begin FUNCTION_LIST R204.1.CanComm_1_9_2 /end FUNCTION_LIST /end MEASUREMENT
/begin MEASUREMENT vTWAGBISS "Nominal idle speed setpoint under drive or drag reduction mode" UWORD COMP_0337_S 1 100 0 65535 ECU_ADDRESS 0xFFFF3428 DISPLAY_IDENTIFIER Vxx_tco_agb_min_is_n /begin FUNCTION_LIST R107.1.iss_ariss_1_0_4 R107.2.iss_atiss_1_0_2 /end FUNCTION_LIST /end MEASUREMENT
/begin MEASUREMENT vTWISS "Coolant temperature idle speed setpoint arbitrated between the engine and the AGB setpoint" UWORD COMP_0337_S 1 100 0 65535 ECU_ADDRESS 0xFFFF342C DISPLAY_IDENTIFIER Vxx_tco_sp_min_is_n /begin FUNCTION_LIST R107.1.iss_ariss_1_0_4 /end FUNCTION_LIST /end MEASUREMENT
/begin MEASUREMENT vVBISSO "Electric balance protection idle speed setpoint offset" UWORD COMP_0337_S 1 100 0 65535 ECU_ADDRESS 0xFFFF344C DISPLAY_IDENTIFIER Vxx_min_vb_is_ofs /begin FUNCTION_LIST R107.1.iss_ariss_1_0_4 R107.3.iss_eliss_1_0_4 /end FUNCTION_LIST /end MEASUREMENT
/begin MEASUREMENT vVHDSTMX "Total vehicle distance" ULONG COMP_0470 1 100 0 4294967295 ECU_ADDRESS 0xFFFF3FBC /begin FUNCTION_LIST R204.1.CanComm_1_9_2 /end FUNCTION_LIST /end MEASUREMENT
/begin MEASUREMENT vVITCONMX "Requested speed selected by the driver" UBYTE COMP_0068 1 100 0 255 ECU_ADDRESS 0xFFFF425C DISPLAY_IDENTIFIER VITCONMX
 /begin FUNCTION_LIST R204.1.CanComm_1_9_2 R208.7.OUTMX_1_1_3 R208.9.SAFETYX_1_3_2 R901.1.Diag_on_can_app_1_6_2 /end FUNCTION_LIST
/end MEASUREMENT
/begin MEASUREMENT vVITESDSP "Displayed speed" UWORD COMP_0373 1 100 0 655.35 ECU_ADDRESS 0xFFFF499A DISPLAY_IDENTIFIER Vxx_mux_dspl_vs
 /begin FUNCTION_LIST R204.1.CanComm_1_9_2 R208.2.VSINT_1_1_2 R301.13.FFDforDiagOnCAN_1_1_3 R901.1.Diag_on_can_app_1_6_2 /end FUNCTION_LIST
/end MEASUREMENT
/begin MEASUREMENT vVITESMUX "Vehicle speed that enters in the cruise control and speed limiter strategy" UWORD COMP_0375_S 1 100 0 655.35 ECU_ADDRESS 0xFFFF499C DISPLAY_IDENTIFIER VITESMUX
 /begin FUNCTION_LIST R108.1.dls_gbrat_vmm_1_1_5 R204.1.CanComm_1_9_2 R208.2.VSINT_1_1_2 R208.6.SERVO_1_2_2 R301.23.ADV_calculation_1_1_2 R901.1.Diag_on_can_app_1_6_2 /end FUNCTION_LIST
/end MEASUREMENT
/begin MEASUREMENT vVITESTMP "Vehicle speed temporary vaule received on the CAN network" UWORD COMP_0375_S 1 100 0 655.35 ECU_ADDRESS 0xFFFF3FD4 /begin FUNCTION_LIST R204.1.CanComm_1_9_2 /end FUNCTION_LIST /end MEASUREMENT
/begin MEASUREMENT vVSNRATF "Filtered value of VehicleSpeed/Neng ratio. If equal to -10, ratio value is incoherent." UWORD COMP_0645_S 1 100 -10 645.35 ECU_ADDRESS 0xFFFF1A9C DISPLAY_IDENTIFIER Vxx_vs_n_rat_fil
 /begin FUNCTION_LIST R106.1.epw_altxx_1_1_0 R106.2.epw_mxalt_1_1_0 R106.3.epw_palmx_1_1_0 R106.4.epw_paltx_1_1_0 R106.5.epw_ptcxx_1_1_0 R106.6.epw_slope_1_1_0 R106.7.epw_tqalt_1_1_0 R108.1.dls_gbrat_vmm_1_1_5 /end FUNCTION_LIST
/end MEASUREMENT
/begin MEASUREMENT vVSNRATR "VehicleSpeed/Neng ratio. If equal to -10 ratio value is incoherent" UWORD COMP_0413_S 1 100 -10 645.35 ECU_ADDRESS 0xFFFF345E DISPLAY_IDENTIFIER Vxx_vs_n_rat /begin FUNCTION_LIST R108.1.dls_gbrat_vmm_1_1_5 /end FUNCTION_LIST /end MEASUREMENT
/begin MEASUREMENT vWINDISS "Electric windshield idle speed setpoint" UWORD COMP_0337_S 1 100 0 65535 ECU_ADDRESS 0xFFFF34C2 DISPLAY_IDENTIFIER Vxx_el_wind_min_is_n /begin FUNCTION_LIST R107.1.iss_ariss_1_0_4 R107.3.iss_eliss_1_0_4 /end FUNCTION_LIST /end MEASUREMENT
/begin MEASUREMENT vWSPDRL "Rear left wheel speed" UWORD COMP_0375_S 1 100 0 655.35 ECU_ADDRESS 0xFFFF4018 /begin FUNCTION_LIST R204.1.CanComm_1_9_2 /end FUNCTION_LIST /end MEASUREMENT
/begin MEASUREMENT vWSPDRLR "Rear left wheel speed (raw)" UWORD COMP_0655_S 1 100 0 2732.8095 ECU_ADDRESS 0xFFFF401A /begin FUNCTION_LIST R204.1.CanComm_1_9_2 /end FUNCTION_LIST /end MEASUREMENT
/begin MEASUREMENT vWSPDRR "Rear right wheel speed" UWORD COMP_0375_S 1 100 0 655.35 ECU_ADDRESS 0xFFFF401C /begin FUNCTION_LIST R204.1.CanComm_1_9_2 /end FUNCTION_LIST /end MEASUREMENT
/begin MEASUREMENT vWSPDRRR "Rear right wheel speed (raw)" UWORD COMP_0655_S 1 100 0 2732.8095 ECU_ADDRESS 0xFFFF401E /begin FUNCTION_LIST R204.1.CanComm_1_9_2 /end FUNCTION_LIST /end MEASUREMENT
/begin COMPU_METHOD COMP_0068 "1-" RAT_FUNC "%8.2" "-" COEFFS 0 1 0 0 0 1 /end COMPU_METHOD
/begin COMPU_METHOD COMP_0023 "5mV" RAT_FUNC "%8.2" "mV" COEFFS 0 1 0 0 0 5 /end COMPU_METHOD
/begin COMPU_METHOD COMP_0014 "10ms" RAT_FUNC "%8.2" "ms" COEFFS 0 1 0 0 0 10 /end COMPU_METHOD
/begin COMPU_METHOD COMP_0008 "100ms" RAT_FUNC "%8.2" "ms" COEFFS 0 1 0 0 0 100 /end COMPU_METHOD
/begin COMPU_METHOD COMP_0337_S "1r/min" RAT_FUNC "%8.2" "r/min" COEFFS 0 1 0 0 0 1 /end COMPU_METHOD
/begin COMPU_METHOD COMP_0013 "1s" RAT_FUNC "%8.2" "s" COEFFS 0 1 0 0 0 1 /end COMPU_METHOD
/begin COMPU_METHOD COMP_0033 "80mV" RAT_FUNC "%8.2" "mV" COEFFS 0 1 0 0 0 80 /end COMPU_METHOD
/begin COMPU_METHOD COMP_0165_S "secsec" RAT_FUNC "%8.3" "sec" COEFFS 0 1 0 0 0 0.01 /end COMPU_METHOD
/begin COMPU_METHOD COMP_0063 "1/256-" RAT_FUNC "%8.4" "-" COEFFS 0 1 0 0 0 0.00390625 /end COMPU_METHOD
/begin COMPU_METHOD COMP_0344_S "0.01s" RAT_FUNC "%8.3" "s" COEFFS 0 1 0 0 0 0.01 /end COMPU_METHOD
/begin COMPU_METHOD COMP_0443 "1rpm" RAT_FUNC "%8.2" "rpm" COEFFS 0 1 0 0 0 1 /end COMPU_METHOD
/begin COMPU_METHOD COMP_0345_S "1/32Nm" RAT_FUNC "%8.3" "Nm" COEFFS 0 1 400 0 0 0.03125 /end COMPU_METHOD
/begin COMPU_METHOD COMP_0347_S "5Nm/s" RAT_FUNC "%8.2" "Nm/s" COEFFS 0 1 0 0 0 5 /end COMPU_METHOD
/begin COMPU_METHOD COMP_0348_S "1/10Nms" RAT_FUNC "%8.2" "Nms" COEFFS 0 1 0 0 0 0.1 /end COMPU_METHOD
/begin COMPU_METHOD COMP_0360_S "40W" RAT_FUNC "%8.2" "W" COEFFS 0 1 0 0 0 40 /end COMPU_METHOD
/begin COMPU_METHOD COMP_0361_S "0.001-" RAT_FUNC "%8.4" "-" COEFFS 0 1 0 0 0 0.001 /end COMPU_METHOD
/begin COMPU_METHOD COMP_0362_S "0.125%" RAT_FUNC "%8.2" "%" COEFFS 0 1 0 0 0 0.125 /end COMPU_METHOD
/begin COMPU_METHOD COMP_0363_S "10W/s" RAT_FUNC "%8.2" "W/s" COEFFS 0 1 655350 0 0 10 /end COMPU_METHOD
/begin COMPU_METHOD COMP_0364_S "10W/s" RAT_FUNC "%8.2" "W/s" COEFFS 0 1 0 0 0 10 /end COMPU_METHOD
/begin COMPU_METHOD COMP_0183 "20ms" RAT_FUNC "%8.2" "ms" COEFFS 0 1 0 0 0 20 /end COMPU_METHOD
/begin COMPU_METHOD COMP_0365_S "10W" RAT_FUNC "%8.2" "W" COEFFS 0 1 0 0 0 10 /end COMPU_METHOD
/begin COMPU_METHOD COMP_0366_S "0.02s" RAT_FUNC "%8.3" "s" COEFFS 0 1 0 0 0 0.02 /end COMPU_METHOD
/begin COMPU_METHOD COMP_0371_S "0.04s" RAT_FUNC "%8.3" "s" COEFFS 0 1 0 0 0 0.04 /end COMPU_METHOD
/begin COMPU_METHOD COMP_0373 "1/100-" RAT_FUNC "%8.3" "-" COEFFS 0 1 0 0 0 0.01 /end COMPU_METHOD
/begin COMPU_METHOD COMP_0105 "0.1s" RAT_FUNC "%8.2" "s" COEFFS 0 1 0 0 0 0.1 /end COMPU_METHOD
/begin COMPU_METHOD COMP_0375_S "0.01km/h" RAT_FUNC "%8.3" "km/h" COEFFS 0 1 0 0 0 0.01 /end COMPU_METHOD
/begin COMPU_METHOD COMP_0377_S "0.12s" RAT_FUNC "%8.2" "s" COEFFS 0 1 0 0 0 0.12 /end COMPU_METHOD
/begin COMPU_METHOD COMP_0380_S "0.2s" RAT_FUNC "%8.2" "s" COEFFS 0 1 0 0 0 0.2 /end COMPU_METHOD
/begin COMPU_METHOD COMP_0406_S "1rpm/s" RAT_FUNC "%8.2" "rpm/s" COEFFS 0 1 65535 0 0 1 /end COMPU_METHOD
/begin COMPU_METHOD COMP_0407_S "1rpm/s" RAT_FUNC "%8.2" "rpm/s" COEFFS 0 1 0 0 0 1 /end COMPU_METHOD
/begin COMPU_METHOD COMP_0410_S "0.00078125V/bar" RAT_FUNC "%8.5" "V/bar" COEFFS 0 1 0 0 0 0.00078125 /end COMPU_METHOD
/begin COMPU_METHOD COMP_0411_S "5.12/65536V" RAT_FUNC "%8.6" "V" COEFFS 0 1 0 0 0 0.000078125 /end COMPU_METHOD
/begin COMPU_METHOD COMP_0412_S "1/2551/V" RAT_FUNC "%8.4" "1/V" COEFFS 0 1 0 0 0 0.00392157 /end COMPU_METHOD
/begin COMPU_METHOD COMP_0413_S "0.01(km/h)/k" RAT_FUNC "%8.3" "(km/h)/k" COEFFS 0 1 10 0 0 0.01 /end COMPU_METHOD
/begin COMPU_METHOD COMP_0420_S "0.1Bar" RAT_FUNC "%8.2" "Bar" COEFFS 0 1 0 0 0 0.1 /end COMPU_METHOD
/begin COMPU_METHOD COMP_0215 "0.2sec" RAT_FUNC "%8.2" "sec" COEFFS 0 1 0 0 0 0.2 /end COMPU_METHOD
/begin COMPU_METHOD COMP_0492 "20/256mV" RAT_FUNC "%8.2" "mV" COEFFS 0 1 0 0 0 1 /end COMPU_METHOD
/begin COMPU_METHOD COMP_0263 "1-" RAT_FUNC "%8.2" "-" COEFFS 0 1 0 0 0 1 /end COMPU_METHOD
/begin COMPU_METHOD COMP_0439_S "20W" RAT_FUNC "%8.2" "W" COEFFS 0 1 0 0 0 20 /end COMPU_METHOD
/begin COMPU_METHOD COMP_0440_S "4W/s" RAT_FUNC "%8.2" "W/s" COEFFS 0 1 1020 0 0 4 /end COMPU_METHOD
/begin COMPU_METHOD COMP_0441_S "4W/s" RAT_FUNC "%8.2" "W/s" COEFFS 0 1 0 0 0 4 /end COMPU_METHOD
/begin COMPU_METHOD COMP_0443_S "0.02S" RAT_FUNC "%8.3" "S" COEFFS 0 1 0 0 0 0.02 /end COMPU_METHOD
/begin COMPU_METHOD COMP_0449_S "1/255-" RAT_FUNC "%8.4" "-" COEFFS 0 1 0 0 0 0.00392157 /end COMPU_METHOD
/begin COMPU_METHOD COMP_0450_S "0.625Åé" RAT_FUNC "%8.2" "Åé" COEFFS 0 1 0 0 0 0.625 /end COMPU_METHOD
/begin COMPU_METHOD COMP_0356 "0.625X-40Åé" RAT_FUNC "%8.2" "Åé" COEFFS 0 1 40 0 0 0.625 /end COMPU_METHOD
/begin COMPU_METHOD COMP_0451_S "0.00125ratio" RAT_FUNC "%8.4" "ratio" COEFFS 0 1 0 0 0 0.00125 /end COMPU_METHOD
/begin COMPU_METHOD COMP_0460_S "1/255ratio" RAT_FUNC "%8.4" "ratio" COEFFS 0 1 0 0 0 0.00392157 /end COMPU_METHOD
/begin COMPU_METHOD COMP_0461_S "1TDC" RAT_FUNC "%8.2" "TDC" COEFFS 0 1 0 0 0 1 /end COMPU_METHOD
/begin COMPU_METHOD COMP_0463_S "40W/s" RAT_FUNC "%8.2" "W/s" COEFFS 0 1 0 0 0 40 /end COMPU_METHOD
/begin COMPU_METHOD COMP_0467_S "10W/s" RAT_FUNC "%8.2" "W/s" COEFFS 0 1 0 0 0 10 /end COMPU_METHOD
/begin COMPU_METHOD COMP_0471_S "10/255s" RAT_FUNC "%8.3" "s" COEFFS 0 1 0 0 0 0.0392157 /end COMPU_METHOD
/begin COMPU_METHOD COMP_0472_S "0.01km/h/100" RAT_FUNC "%8.3" "km/h/100" COEFFS 0 1 0 0 0 0.01 /end COMPU_METHOD
/begin COMPU_METHOD COMP_0355 "1/256s" RAT_FUNC "%8.4" "s" COEFFS 0 1 0 0 0 0.00390625 /end COMPU_METHOD
/begin COMPU_METHOD COMP_0479_S "0.001m" RAT_FUNC "%8.4" "m" COEFFS 0 1 -0.2 0 0 0.001 /end COMPU_METHOD
/begin COMPU_METHOD COMP_0484_S "fixed axis -" RAT_FUNC "%8.2" "-" COEFFS 0 1 1 0 0 1 /end COMPU_METHOD
/begin COMPU_METHOD COMP_0280_S "fixed axis Åé" RAT_FUNC "%8.2" "Åé" COEFFS 0 1 40 0 0 10 /end COMPU_METHOD
/begin COMPU_METHOD COMP_0498_S "50r/min" RAT_FUNC "%8.2" "r/min" COEFFS 0 1 0 0 0 50 /end COMPU_METHOD
/begin COMPU_METHOD COMP_0500_S "0.625/256X-40degC" RAT_FUNC "%8.4" "degC" COEFFS 0 1 40 0 0 0.002441406 /end COMPU_METHOD
/begin COMPU_METHOD COMP_0510_S "0.00244140625Åé" RAT_FUNC "%8.4" "Åé" COEFFS 0 1 40 0 0 0.00244141 /end COMPU_METHOD
/begin COMPU_METHOD COMP_0512_S "0.078125W" RAT_FUNC "%8.3" "W" COEFFS 0 1 0 0 0 0.078125 /end COMPU_METHOD
/begin COMPU_METHOD COMP_0519_S "100W" RAT_FUNC "%8.2" "W" COEFFS 0 1 0 0 0 100 /end COMPU_METHOD
/begin COMPU_METHOD COMP_0283 "1flag" RAT_FUNC "%8.2" "flag" COEFFS 0 1 0 0 0 1 /end COMPU_METHOD
/begin COMPU_METHOD COMP_0202_S "100ms100ms" RAT_FUNC "%8.2" "100ms" COEFFS 0 1 0 0 0 1 /end COMPU_METHOD
/begin COMPU_METHOD COMP_0470 "1km" RAT_FUNC "%8.2" "km" COEFFS 0 1 0 0 0 1 /end COMPU_METHOD
/begin COMPU_METHOD COMP_0542_S "rpmrpm" RAT_FUNC "%8.2" "rpm" COEFFS 0 1 -500 0 0 50 /end COMPU_METHOD
/begin COMPU_METHOD COMP_0543_S "BarBar" RAT_FUNC "%8.2" "Bar" COEFFS 0 1 0 0 0 0.2 /end COMPU_METHOD
/begin COMPU_METHOD COMP_0553_S "WW" RAT_FUNC "%8.3" "W" COEFFS 0 1 0 0 0 0.01 /end COMPU_METHOD
/begin COMPU_METHOD COMP_0564_S "--" RAT_FUNC "%8.6" "-" COEFFS 0 1 0 0 0 0.00000392157 /end COMPU_METHOD
/begin COMPU_METHOD COMP_0565_S "mm^3mm^3" RAT_FUNC "%8.2" "mm^3" COEFFS 0 1 0 0 0 20480 /end COMPU_METHOD
/begin COMPU_METHOD COMP_0636_S "NmNm" RAT_FUNC "%8.2" "Nm" COEFFS 0 1 400 0 0 0.5 /end COMPU_METHOD
/begin COMPU_METHOD COMP_0639_S "gg" RAT_FUNC "%8.4" "g" COEFFS 0 1 131.068 0 0 0.004 /end COMPU_METHOD
/begin COMPU_METHOD COMP_0645_S "km/h/1000rpmkm/h/100" RAT_FUNC "%8.3" "km/h/100" COEFFS 0 1 10 0 0 0.01 /end COMPU_METHOD
/begin COMPU_METHOD COMP_0655_S "rpmrpm" RAT_FUNC "%8.3" "rpm" COEFFS 0 1 0 0 0 0.0417 /end COMPU_METHOD
/* RECORD_LAYOUT ------------------------------------------------------ */
/begin RECORD_LAYOUT REC_UBYTE_C FNC_VALUES 1 UBYTE COLUMN_DIR DIRECT /end RECORD_LAYOUT
/begin RECORD_LAYOUT REC_UWORD_C FNC_VALUES 1 UWORD COLUMN_DIR DIRECT /end RECORD_LAYOUT
/begin RECORD_LAYOUT REC_SBYTE_C FNC_VALUES 1 SBYTE COLUMN_DIR DIRECT /end RECORD_LAYOUT
/begin RECORD_LAYOUT REC_AXIS_UBYTE AXIS_PTS_X 1 UBYTE INDEX_INCR DIRECT /end RECORD_LAYOUT
/begin RECORD_LAYOUT REC_AXIS_UWORD AXIS_PTS_X 1 UWORD INDEX_INCR DIRECT /end RECORD_LAYOUT
/end MODULE
/end PROJECT
