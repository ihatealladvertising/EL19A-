ASAP2_VERSION 1 3_BETA
/begin PROJECT TK_X91_EUR_VC ""
/begin HEADER "" /* key HEADER ++ "comment" Ç… Par.scomment */ PROJECT_NO TK_X91_EUR_VC /* key PROJECT_NO ++ project number Ç… car_eng_desti_lot */ VERSION "7V4YHZEB2" /* key VERSION ++ version number Ç… mProgver */ /end HEADER
/begin MODULE DIM ""
/begin MOD_COMMON "" DEPOSIT ABSOLUTE BYTE_ORDER MSB_FIRST /* ﬁ≤ƒµ∞¿ﬁ∞Ç™ÿÃﬂ⁄∞ΩÇ≥ÇÍÇÈ */ /end MOD_COMMON
/begin MEASUREMENT vFLASHRAM_R#128 "VIN flash write data" UBYTE COMP_0068 1 100 0 255 ECU_ADDRESS 0xFFFF3D59 /begin FUNCTION_LIST /end FUNCTION_LIST /end MEASUREMENT
/begin MEASUREMENT vFLCLPf "Slowdown lean clamp control-in-progress" UBYTE COMP_0004 1 100 0 255 ECU_ADDRESS 0xFFFF1390 /begin FUNCTION_LIST /end FUNCTION_LIST /end MEASUREMENT
/begin MEASUREMENT vFLGCLIM1 "Carrier for data received from BCM" UBYTE COMP_0283 1 100 0 255 ECU_ADDRESS 0xFFFF3D5A /begin FUNCTION_LIST /end FUNCTION_LIST /end MEASUREMENT
/begin MEASUREMENT vFLGCLIM2 "Carrier for data received from AT" UBYTE COMP_0283 1 100 0 255 ECU_ADDRESS 0xFFFF3D5B /begin FUNCTION_LIST /end FUNCTION_LIST /end MEASUREMENT
/begin MEASUREMENT vFLGCLIM3 "Carrier for data received from ECM" UBYTE COMP_0283 1 100 0 255 ECU_ADDRESS 0xFFFF3D5C /begin FUNCTION_LIST /end FUNCTION_LIST /end MEASUREMENT
/begin MEASUREMENT vFLGCLIM4 "Carrier for data received from ECM" UBYTE COMP_0283 1 100 0 255 ECU_ADDRESS 0xFFFF3D5D /begin FUNCTION_LIST /end FUNCTION_LIST /end MEASUREMENT
/begin MEASUREMENT vFLGCLIM5 "Carrier for data produced by ECM" UBYTE COMP_0283 1 100 0 255 ECU_ADDRESS 0xFFFF3D5E /begin FUNCTION_LIST /end FUNCTION_LIST /end MEASUREMENT
/begin MEASUREMENT vFLGCLIM6 "Carrier for data produced by ECM" UBYTE COMP_0283 1 100 0 255 ECU_ADDRESS 0xFFFF3D5F /begin FUNCTION_LIST /end FUNCTION_LIST /end MEASUREMENT
/begin MEASUREMENT vFLGFPCM "FPCM diagnosis condition variable" UBYTE COMP_0068 1 100 0 255 ECU_ADDRESS 0xFFFF2D6A /begin FUNCTION_LIST /end FUNCTION_LIST /end MEASUREMENT
/begin MEASUREMENT vFLGFSX "FLGFS set one's personal history (for the joint flag treatment)" UBYTE COMP_0004 1 100 0 255 ECU_ADDRESS 0xFFFF2D6B /begin FUNCTION_LIST /end FUNCTION_LIST /end MEASUREMENT
/begin MEASUREMENT vFLGRLV1 "Carrier for data received from BCM" UBYTE COMP_0283 1 100 0 255 ECU_ADDRESS 0xFFFF3D63 /begin FUNCTION_LIST /end FUNCTION_LIST /end MEASUREMENT
/begin MEASUREMENT vFLGRLV2 "Carrier for data received from BCM" UBYTE COMP_0283 1 100 0 255 ECU_ADDRESS 0xFFFF3D64 /begin FUNCTION_LIST /end FUNCTION_LIST /end MEASUREMENT
/begin MEASUREMENT vFLGRLV3 "Carrier for data physical data acquired from ECM" UBYTE COMP_0283 1 100 0 255 ECU_ADDRESS 0xFFFF3D65 /begin FUNCTION_LIST /end FUNCTION_LIST /end MEASUREMENT
/begin MEASUREMENT vFLGRLV4 "Carrier for data physical data acquired from ECM" UBYTE COMP_0283 1 100 0 255 ECU_ADDRESS 0xFFFF3D66 /begin FUNCTION_LIST /end FUNCTION_LIST /end MEASUREMENT
/begin MEASUREMENT vFLGRLV5 "Carrier for data produced from ECM" UBYTE COMP_0283 1 100 0 255 ECU_ADDRESS 0xFFFF3D67 /begin FUNCTION_LIST /end FUNCTION_LIST /end MEASUREMENT
/begin MEASUREMENT vFLGRLV6 "Carrier for data produced from ECM" UBYTE COMP_0283 1 100 0 255 ECU_ADDRESS 0xFFFF3D68 /begin FUNCTION_LIST /end FUNCTION_LIST /end MEASUREMENT
/begin MEASUREMENT vFLGRLV7 "Carrier for data produced from ECM" UBYTE COMP_0283 1 100 0 255 ECU_ADDRESS 0xFFFF3D69 /begin FUNCTION_LIST /end FUNCTION_LIST /end MEASUREMENT
/begin MEASUREMENT vFLGRLV8 "Carrier for data produced from ECM" UBYTE COMP_0283 1 100 0 255 ECU_ADDRESS 0xFFFF3D6A /begin FUNCTION_LIST /end FUNCTION_LIST /end MEASUREMENT
/begin MEASUREMENT vFLGVSC1 "Carrier for data received from AT" UBYTE COMP_0004 1 100 0 255 ECU_ADDRESS 0xFFFF3D6C /begin FUNCTION_LIST /end FUNCTION_LIST /end MEASUREMENT
/begin MEASUREMENT vFLGVSC2 "Carrier for data received from UPC" UBYTE COMP_0004 1 100 0 255 ECU_ADDRESS 0xFFFF3D6D /begin FUNCTION_LIST /end FUNCTION_LIST /end MEASUREMENT
/begin MEASUREMENT vFLGVSC3 "Carrier for physical data acquired from ECM" UBYTE COMP_0004 1 100 0 255 ECU_ADDRESS 0xFFFF3D6E /begin FUNCTION_LIST /end FUNCTION_LIST /end MEASUREMENT
/begin MEASUREMENT vFLGVSC4 "Carrier for data produced by ECM" UBYTE COMP_0004 1 100 0 255 ECU_ADDRESS 0xFFFF3D6F /begin FUNCTION_LIST /end FUNCTION_LIST /end MEASUREMENT
/begin MEASUREMENT vFLGVSC5 "Carrier for data produced by ECM" UBYTE COMP_0004 1 100 0 255 ECU_ADDRESS 0xFFFF3D70 /begin FUNCTION_LIST /end FUNCTION_LIST /end MEASUREMENT
/begin MEASUREMENT vFLGWCNT "A joint flag clear treatment mode" UBYTE COMP_0068 1 100 0 255 ECU_ADDRESS 0xFFFF2D6D /begin FUNCTION_LIST /end FUNCTION_LIST /end MEASUREMENT
/begin MEASUREMENT vFLLMJGf "O2 sensor MIN condition memory" UBYTE COMP_0004 1 100 0 255 ECU_ADDRESS 0xFFFF37E8 /begin FUNCTION_LIST /end FUNCTION_LIST /end MEASUREMENT
/begin MEASUREMENT vFLMDCHGf "LMD(RICH -> LERN) (LERN -> RICH) switching judgement flag" UBYTE COMP_0004 1 100 0 255 ECU_ADDRESS 0xFFFF1393 /begin FUNCTION_LIST /end FUNCTION_LIST /end MEASUREMENT
/begin MEASUREMENT vFLML0 "Layer way flame speed basic value" UBYTE COMP_0253 1 100 0 0.0159375 ECU_ADDRESS 0xFFFF1395 /begin FUNCTION_LIST /end FUNCTION_LIST /end MEASUREMENT
/begin MEASUREMENT vFLRNTDf "Map learning convergent judgement flag" UBYTE COMP_0004 1 100 0 255 ECU_ADDRESS 0xFFFF2D7A /begin FUNCTION_LIST /end FUNCTION_LIST /end MEASUREMENT
/begin MEASUREMENT vFLSTAS "Immobilizer condition value" UBYTE COMP_0068 1 100 0 255 ECU_ADDRESS 0xFFFF3D73 /begin FUNCTION_LIST /end FUNCTION_LIST /end MEASUREMENT
/begin MEASUREMENT vFLSTASSV "Immobilizer condition value (for the preservation)" UBYTE COMP_0068 1 100 0 255 ECU_ADDRESS 0xFFFF3D74 /begin FUNCTION_LIST /end FUNCTION_LIST /end MEASUREMENT
/begin MEASUREMENT vFLTS4f "Idle 4 periodic learning judgement" UBYTE COMP_0004 1 100 0 255 ECU_ADDRESS 0xFFFF2D7B /begin FUNCTION_LIST /end FUNCTION_LIST /end MEASUREMENT
/begin MEASUREMENT vFMAD "A voltage for the fuel level gauge breakage diagnosis" UWORD COMP_0023 1 100 0 327675 ECU_ADDRESS 0xFFFF4940 /begin FUNCTION_LIST /end FUNCTION_LIST /end MEASUREMENT
/begin MEASUREMENT vFMADC "A voltage for the fuel level gauge breakage diagnosis" UWORD COMP_0023 1 100 0 327675 ECU_ADDRESS 0xFFFF3D76 /begin FUNCTION_LIST /end FUNCTION_LIST /end MEASUREMENT
/begin MEASUREMENT vFMFMEX "Misfire conditions memory flag (for the monitor)" UBYTE COMP_0016 1 100 0 255 ECU_ADDRESS 0xFFFF2D7E /begin FUNCTION_LIST /end FUNCTION_LIST /end MEASUREMENT
/begin MEASUREMENT vFMRCPC1f "A purge cut requirement from the fuel system diagnosis" UBYTE COMP_0004 1 100 0 255 ECU_ADDRESS 0xFFFF4942 /begin FUNCTION_LIST /end FUNCTION_LIST /end MEASUREMENT
/begin MEASUREMENT vFMRCPC2f "A purge cut requirement from the fuel system diagnosis" UBYTE COMP_0004 1 100 0 255 ECU_ADDRESS 0xFFFF4783 /begin FUNCTION_LIST /end FUNCTION_LIST /end MEASUREMENT
/begin MEASUREMENT vFMRJG1f "Fuel system diagnosis condition 1 distinction" UBYTE COMP_0004 1 100 0 255 ECU_ADDRESS 0xFFFF3D78 /begin FUNCTION_LIST /end FUNCTION_LIST /end MEASUREMENT
/begin MEASUREMENT vFMRJG2f "Fuel system diagnosis condition 2 distinction" UBYTE COMP_0004 1 100 0 255 ECU_ADDRESS 0xFFFF3D79 /begin FUNCTION_LIST /end FUNCTION_LIST /end MEASUREMENT
/begin MEASUREMENT vFNFO2Sf "The inside of the former O2/s deterioration judgement" UBYTE COMP_0004 1 100 0 255 ECU_ADDRESS 0xFFFFA425 /begin FUNCTION_LIST /end FUNCTION_LIST /end MEASUREMENT
/begin MEASUREMENT vFNRPM2Z0 "Computed engine speed for the hard cranking judgement" UBYTE COMP_0006 1 100 0 3187.5 ECU_ADDRESS 0xFFFF3D7C /begin FUNCTION_LIST /end FUNCTION_LIST /end MEASUREMENT
/begin MEASUREMENT vFNRPM2Z1 "The front of a computed engine speed 1 time for the hard cranking judgement" UBYTE COMP_0006 1 100 0 3187.5 ECU_ADDRESS 0xFFFF3D7D /begin FUNCTION_LIST /end FUNCTION_LIST /end MEASUREMENT
/begin MEASUREMENT vFNRPM2Z2 "The front of a computed engine speed 2 times for the hard cranking judgement" UBYTE COMP_0006 1 100 0 3187.5 ECU_ADDRESS 0xFFFF3D7E /begin FUNCTION_LIST /end FUNCTION_LIST /end MEASUREMENT
/begin MEASUREMENT vFO2CYUf "At the time of the high exhaust temperature, former O2/S diagnosis condition for the lambda control" UBYTE COMP_0004 1 100 0 255 ECU_ADDRESS 0xFFFF2D82 /begin FUNCTION_LIST /end FUNCTION_LIST /end MEASUREMENT
/begin MEASUREMENT vFO2HCNf "O2 heater diagnosis judgement trip judgement distinction" UBYTE COMP_0004 1 100 0 255 ECU_ADDRESS 0xFFFF2D83 /begin FUNCTION_LIST /end FUNCTION_LIST /end MEASUREMENT
/begin MEASUREMENT vFO2HDONf "O2 heater duty output flag" UBYTE COMP_0004 1 100 0 255 ECU_ADDRESS 0xFFFF23D6 /begin FUNCTION_LIST /end FUNCTION_LIST /end MEASUREMENT
/begin MEASUREMENT vFO2HMFTf "A former O2 heater timer 2sec progress flag" UBYTE COMP_0004 1 100 0 255 ECU_ADDRESS 0xFFFF2D84 /begin FUNCTION_LIST /end FUNCTION_LIST /end MEASUREMENT
/begin MEASUREMENT vFO2HMf "A former O2 heater CPU input signal" UBYTE COMP_0004 1 100 0 255 ECU_ADDRESS 0xFFFF4944 /begin FUNCTION_LIST /end FUNCTION_LIST /end MEASUREMENT
/begin MEASUREMENT vFO2HNG1f "O2 heater diagnosis NG the first time judgement distinction" UBYTE COMP_0004 1 100 0 255 ECU_ADDRESS 0xFFFFA426 /begin FUNCTION_LIST /end FUNCTION_LIST /end MEASUREMENT
/begin MEASUREMENT vFO2HNG2f "O2 heater diagnosis NG the second time judgement distinction" UBYTE COMP_0004 1 100 0 255 ECU_ADDRESS 0xFFFFA427 /begin FUNCTION_LIST /end FUNCTION_LIST /end MEASUREMENT
/begin MEASUREMENT vFO2HNGf "O2H NG Flag" UBYTE COMP_0004 1 100 0 255 ECU_ADDRESS 0xFFFF3D82 /begin FUNCTION_LIST /end FUNCTION_LIST /end MEASUREMENT
/begin MEASUREMENT vFO2HOK2f "O2 heater diagnosis OK judgement distinction" UBYTE COMP_0004 1 100 0 255 ECU_ADDRESS 0xFFFFA428 /begin FUNCTION_LIST /end FUNCTION_LIST /end MEASUREMENT
/begin MEASUREMENT vFO2HONf "FrO2 heater" UBYTE COMP_0004 1 100 0 255 ECU_ADDRESS 0xFFFF23D7 /begin FUNCTION_LIST /end FUNCTION_LIST /end MEASUREMENT
/begin MEASUREMENT vFO2HTUf "O2H energizing flag" UBYTE COMP_0004 1 100 0 255 ECU_ADDRESS 0xFFFF3D83 /begin FUNCTION_LIST /end FUNCTION_LIST /end MEASUREMENT
/begin MEASUREMENT vFO2HZNGf "In the same TRIP, NG judgement flag" UBYTE COMP_0004 1 100 0 255 ECU_ADDRESS 0xFFFF37E9 /begin FUNCTION_LIST /end FUNCTION_LIST /end MEASUREMENT
/begin MEASUREMENT vFO2JHMf "O2 sensor condition memory (Rich->Lean)" UBYTE COMP_0004 1 100 0 255 ECU_ADDRESS 0xFFFF37EA /begin FUNCTION_LIST /end FUNCTION_LIST /end MEASUREMENT
/begin MEASUREMENT vFO2JLMf "O2 sensor condition memory (Lean->Rich)" UBYTE COMP_0004 1 100 0 255 ECU_ADDRESS 0xFFFF37EB /begin FUNCTION_LIST /end FUNCTION_LIST /end MEASUREMENT
/begin MEASUREMENT vFO2MLOKf "O2 sensor diagnosis OK judgement distinction" UBYTE COMP_0004 1 100 0 255 ECU_ADDRESS 0xFFFF2D85 /begin FUNCTION_LIST /end FUNCTION_LIST /end MEASUREMENT
/begin MEASUREMENT vFO2OK2f "O2 sensor diagnosis OK judgement distinction" UBYTE COMP_0004 1 100 0 255 ECU_ADDRESS 0xFFFF2D86 /begin FUNCTION_LIST /end FUNCTION_LIST /end MEASUREMENT
/begin MEASUREMENT vFO2OVf "In the O2 sensor unusual voltage 2 diagnosis incumbent trip, NG judgement distinction" UBYTE COMP_0004 1 100 0 255 ECU_ADDRESS 0xFFFF2D87 /begin FUNCTION_LIST /end FUNCTION_LIST /end MEASUREMENT
/begin MEASUREMENT vFO2SCNDf "O2 sensor breakage/short diagnosis condition" UBYTE COMP_0004 1 100 0 255 ECU_ADDRESS 0xFFFF2D88 /begin FUNCTION_LIST /end FUNCTION_LIST /end MEASUREMENT
/begin MEASUREMENT vFO2SJ1f "O2 sensor diagnosis permission condition judgement distinction" UBYTE COMP_0004 1 100 0 255 ECU_ADDRESS 0xFFFF2D89 /begin FUNCTION_LIST /end FUNCTION_LIST /end MEASUREMENT
/begin MEASUREMENT vFO2SJ2f "Diagnosis region condition judgement flag" UBYTE COMP_0004 1 100 0 255 ECU_ADDRESS 0xFFFF2D8A /begin FUNCTION_LIST /end FUNCTION_LIST /end MEASUREMENT
/begin MEASUREMENT vFO2SJ3f "O2 sensor unusual voltage diagnosis region condition judgement distinction" UBYTE COMP_0004 1 100 0 255 ECU_ADDRESS 0xFFFF2D8B /begin FUNCTION_LIST /end FUNCTION_LIST /end MEASUREMENT
/begin MEASUREMENT vFO2SJ4f "O2 sensor breakage diagnosis permission condition judgement distinction" UBYTE COMP_0004 1 100 0 255 ECU_ADDRESS 0xFFFF2D8C /begin FUNCTION_LIST /end FUNCTION_LIST /end MEASUREMENT
/begin MEASUREMENT vFO2SJ5f "O2 sensor unusual voltage diagnosis region condition" UBYTE COMP_0004 1 100 0 255 ECU_ADDRESS 0xFFFF2D8D /begin FUNCTION_LIST /end FUNCTION_LIST /end MEASUREMENT
/begin MEASUREMENT vFO2TEf "Diagnosis completion judgement flag" UBYTE COMP_0004 1 100 0 255 ECU_ADDRESS 0xFFFF37EC /begin FUNCTION_LIST /end FUNCTION_LIST /end MEASUREMENT
/begin MEASUREMENT vFOADDEf "O2 sensor switchover condition memory (decrease)" UBYTE COMP_0004 1 100 0 255 ECU_ADDRESS 0xFFFF37ED /begin FUNCTION_LIST /end FUNCTION_LIST /end MEASUREMENT
/begin MEASUREMENT vFOADINf "O2 sensor switchover condition memory (increase)" UBYTE COMP_0004 1 100 0 255 ECU_ADDRESS 0xFFFF37EE /begin FUNCTION_LIST /end FUNCTION_LIST /end MEASUREMENT
/begin MEASUREMENT vFOHMLOKf "O2 heater diagnosis OK judgement distinction" UBYTE COMP_0004 1 100 0 255 ECU_ADDRESS 0xFFFF2D92 /begin FUNCTION_LIST /end FUNCTION_LIST /end MEASUREMENT
/begin MEASUREMENT vFOLDCNf "FrO2/SÉ… point shift diagnosis trip judgement distinction" UBYTE COMP_0004 1 100 0 255 ECU_ADDRESS 0xFFFF2D93 /begin FUNCTION_LIST /end FUNCTION_LIST /end MEASUREMENT
/begin MEASUREMENT vFOLNCNf "O2 sensor unusual voltage diagnosis lean-shift judgement trip judgement distinction" UBYTE COMP_0004 1 100 0 255 ECU_ADDRESS 0xFFFF2D94 /begin FUNCTION_LIST /end FUNCTION_LIST /end MEASUREMENT
/begin MEASUREMENT vFOLNNG1f "O2 sensor unusual voltage diagnosis lean-shift NG the first time judgement distinction" UBYTE COMP_0004 1 100 0 255 ECU_ADDRESS 0xFFFFA429 /begin FUNCTION_LIST /end FUNCTION_LIST /end MEASUREMENT
/begin MEASUREMENT vFOLNNG2f "O2 sensor unusual voltage diagnosis lean-shift NG the second time judgement distinction" UBYTE COMP_0004 1 100 0 255 ECU_ADDRESS 0xFFFFA42A /begin FUNCTION_LIST /end FUNCTION_LIST /end MEASUREMENT
/begin MEASUREMENT vFOLNOKf "O2 sensor unusual voltage diagnosis lean-shift OK judgement distinction" UBYTE COMP_0004 1 100 0 255 ECU_ADDRESS 0xFFFF2D95 /begin FUNCTION_LIST /end FUNCTION_LIST /end MEASUREMENT
/begin MEASUREMENT vFONCTDIV "Other failures and status indicators" UBYTE COMP_0004 1 100 0 255 ECU_ADDRESS 0xFFFF3D84 /begin FUNCTION_LIST /end FUNCTION_LIST /end MEASUREMENT
/begin MEASUREMENT vFOOPCNf "O2 sensor breakage diagnosis judgement trip judgement distinction" UBYTE COMP_0004 1 100 0 255 ECU_ADDRESS 0xFFFF2D98 /begin FUNCTION_LIST /end FUNCTION_LIST /end MEASUREMENT
/begin MEASUREMENT vFOOPNG1f "O2 sensor breakage diagnosis NG the first time judgement distinction" UBYTE COMP_0004 1 100 0 255 ECU_ADDRESS 0xFFFFA42B /begin FUNCTION_LIST /end FUNCTION_LIST /end MEASUREMENT
/begin MEASUREMENT vFOOPNG2f "O2 sensor breakage diagnosis NG the second time judgement distinction" UBYTE COMP_0004 1 100 0 255 ECU_ADDRESS 0xFFFFA42C /begin FUNCTION_LIST /end FUNCTION_LIST /end MEASUREMENT
/begin MEASUREMENT vFORC2NG1f "O2 sensor unusual voltage the second diagnosis NG one time judgement distinction" UBYTE COMP_0004 1 100 0 255 ECU_ADDRESS 0xFFFFA42D /begin FUNCTION_LIST /end FUNCTION_LIST /end MEASUREMENT
/begin MEASUREMENT vFORC2NG2f "O2 sensor unusual voltage the second diagnosis NG two times judgement distinction" UBYTE COMP_0004 1 100 0 255 ECU_ADDRESS 0xFFFFA42E /begin FUNCTION_LIST /end FUNCTION_LIST /end MEASUREMENT
/begin MEASUREMENT vFORCCNf "O2 sensor unusual voltage diagnosis rich-shift judgement trip judgement distinction" UBYTE COMP_0004 1 100 0 255 ECU_ADDRESS 0xFFFF2D99 /begin FUNCTION_LIST /end FUNCTION_LIST /end MEASUREMENT
/begin MEASUREMENT vFORCNG1f "O2 sensor unusual voltage diagnosis rich-shift NG the first time judgement distinction" UBYTE COMP_0004 1 100 0 255 ECU_ADDRESS 0xFFFFA42F /begin FUNCTION_LIST /end FUNCTION_LIST /end MEASUREMENT
/begin MEASUREMENT vFORCNG2f "O2 sensor unusual voltage diagnosis rich-shift NG the second time judgement distinction" UBYTE COMP_0004 1 100 0 255 ECU_ADDRESS 0xFFFFA430 /begin FUNCTION_LIST /end FUNCTION_LIST /end MEASUREMENT
/begin MEASUREMENT vFORCOKf "O2 sensor unusual voltage diagnosis rich-shift OK judgement distinction" UBYTE COMP_0004 1 100 0 255 ECU_ADDRESS 0xFFFF2D9A /begin FUNCTION_LIST /end FUNCTION_LIST /end MEASUREMENT
/begin MEASUREMENT vFORPSNG1f "O2 sensor response time diagnosis (frequency monitor form) NG the first time judgement distinction" UBYTE COMP_0004 1 100 0 255 ECU_ADDRESS 0xFFFFB54D /begin FUNCTION_LIST /end FUNCTION_LIST /end MEASUREMENT
/begin MEASUREMENT vFORPSNG2f "O2 sensor response time diagnosis (frequency monitor form) NG the second time judgement distinction" UBYTE COMP_0004 1 100 0 255 ECU_ADDRESS 0xFFFFB54E /begin FUNCTION_LIST /end FUNCTION_LIST /end MEASUREMENT
/begin MEASUREMENT vFORPSOKf "O2 sensor response time diagnosis (frequency monitor form) OK judgement distinction" UBYTE COMP_0004 1 100 0 255 ECU_ADDRESS 0xFFFF37EF /begin FUNCTION_LIST /end FUNCTION_LIST /end MEASUREMENT
/begin MEASUREMENT vFPERR "The amount of actual fuel pressure deviation" UWORD COMP_0077_S 1 100 -9.99424 9.993935 ECU_ADDRESS 0xFFFF139A /begin FUNCTION_LIST /end FUNCTION_LIST /end MEASUREMENT
/begin MEASUREMENT vFPHASEIN "The PHASE distinction of judging control-in-progress ÅEREF at the time of the 6cyl crank angle sensor trouble" UBYTE COMP_0068 1 100 0 255 ECU_ADDRESS 0xFFFF139C /begin FUNCTION_LIST /end FUNCTION_LIST /end MEASUREMENT
/begin MEASUREMENT vFPIDPUGf "Idle purge permission flag" UBYTE COMP_0004 1 100 0 255 ECU_ADDRESS 0xFFFF2DA3 /begin FUNCTION_LIST /end FUNCTION_LIST /end MEASUREMENT
/begin MEASUREMENT vFPRCYC "Fuel pump relay cycle count to Active test" UBYTE COMP_0468_S 1 100 0 255 ECU_ADDRESS 0xFFFF2DA4 /begin FUNCTION_LIST /end FUNCTION_LIST /end MEASUREMENT
/begin MEASUREMENT vFREBTIMIf "Retard side response time measuring flag" UBYTE COMP_0004 1 100 0 255 ECU_ADDRESS 0xFFFF139F /begin FUNCTION_LIST /end FUNCTION_LIST /end MEASUREMENT
/begin MEASUREMENT vFREFTIMIf "Advance side response time measuring flag" UBYTE COMP_0004 1 100 0 255 ECU_ADDRESS 0xFFFF13A0 /begin FUNCTION_LIST /end FUNCTION_LIST /end MEASUREMENT
/begin MEASUREMENT vFRESBIf "Retard side parameter monitor treatment permission condition formation flag" UBYTE COMP_0004 1 100 0 255 ECU_ADDRESS 0xFFFF13A1 /begin FUNCTION_LIST /end FUNCTION_LIST /end MEASUREMENT
/begin MEASUREMENT vFRESFIf "Advance side parameter monitor treatment permission condition formation flag" UBYTE COMP_0004 1 100 0 255 ECU_ADDRESS 0xFFFF13A2 /begin FUNCTION_LIST /end FUNCTION_LIST /end MEASUREMENT
/begin MEASUREMENT vFRESTIMIf "VTC response measuring flag" UBYTE COMP_0004 1 100 0 255 ECU_ADDRESS 0xFFFF13A3 /begin FUNCTION_LIST /end FUNCTION_LIST /end MEASUREMENT
/begin MEASUREMENT vFRLJUGf "O2 sensor condition" UBYTE COMP_0004 1 100 0 255 ECU_ADDRESS 0xFFFF37F0 /begin FUNCTION_LIST /end FUNCTION_LIST /end MEASUREMENT
/begin MEASUREMENT vFRLMJGf "O2 sensor MAX condition memory" UBYTE COMP_0004 1 100 0 255 ECU_ADDRESS 0xFFFF37F1 /begin FUNCTION_LIST /end FUNCTION_LIST /end MEASUREMENT
/begin MEASUREMENT vFRO2FCf "The rest of the fuel cut recovers" UBYTE COMP_0004 1 100 0 255 ECU_ADDRESS 0xFFFF2DAF /begin FUNCTION_LIST /end FUNCTION_LIST /end MEASUREMENT
/begin MEASUREMENT vFROHCMNf "The rest O2/S parameter backup condition distinction" UBYTE COMP_0004 1 100 0 255 ECU_ADDRESS 0xFFFF2DB2 /begin FUNCTION_LIST /end FUNCTION_LIST /end MEASUREMENT
/begin MEASUREMENT vFROHCMXf "The rest O2/S parameter backup condition distinction" UBYTE COMP_0004 1 100 0 255 ECU_ADDRESS 0xFFFF2DB3 /begin FUNCTION_LIST /end FUNCTION_LIST /end MEASUREMENT
/begin MEASUREMENT vFRTHSE "The amount of VTC maximum-retard degree diagnosis reference position initial compensation" UBYTE COMP_0256 1 100 -64 63.5 ECU_ADDRESS 0xFFFF13A8 /begin FUNCTION_LIST /end FUNCTION_LIST /end MEASUREMENT
/begin MEASUREMENT vFRTHSE_R#1 "The amount of VTC maximum-retard degree diagnosis reference position initial compensation" UBYTE COMP_0256 1 100 -64 63.5 ECU_ADDRESS 0xFFFF13A8 /begin FUNCTION_LIST /end FUNCTION_LIST /end MEASUREMENT
/begin MEASUREMENT vFRTHSE_R#2 "The amount of VTC maximum-retard degree diagnosis reference position initial compensation" UBYTE COMP_0256 1 100 -64 63.5 ECU_ADDRESS 0xFFFF13A9 /begin FUNCTION_LIST /end FUNCTION_LIST /end MEASUREMENT
/begin MEASUREMENT vFRTHSI "The amount of VTC maximum-retard degree diagnosis reference position initial compensation" UBYTE COMP_0256 1 100 -64 63.5 ECU_ADDRESS 0xFFFF13AA /begin FUNCTION_LIST /end FUNCTION_LIST /end MEASUREMENT
/begin MEASUREMENT vFRTHSI_R#1 "The amount of VTC maximum-retard degree diagnosis reference position initial compensation" UBYTE COMP_0256 1 100 -64 63.5 ECU_ADDRESS 0xFFFF13AA /begin FUNCTION_LIST /end FUNCTION_LIST /end MEASUREMENT
/begin MEASUREMENT vFRTHSI_R#2 "The amount of VTC maximum-retard degree diagnosis reference position initial compensation" UBYTE COMP_0256 1 100 -64 63.5 ECU_ADDRESS 0xFFFF13AB /begin FUNCTION_LIST /end FUNCTION_LIST /end MEASUREMENT
/begin MEASUREMENT vFRTLRNEf "VTC maximum-retard degree diagnosis reference position initial deviation quantity computed experience flag" UBYTE COMP_0004 1 100 0 255 ECU_ADDRESS 0xFFFFA431 /begin FUNCTION_LIST /end FUNCTION_LIST /end MEASUREMENT
/begin MEASUREMENT vFRTLRNIf "VTC maximum-retard degree diagnosis reference position initial deviation quantity computed experience flag" UBYTE COMP_0004 1 100 0 255 ECU_ADDRESS 0xFFFFA432 /begin FUNCTION_LIST /end FUNCTION_LIST /end MEASUREMENT
/begin MEASUREMENT vFRWIP "Front wiper status" UBYTE COMP_0068 1 100 0 255 ECU_ADDRESS 0xFFFF89A0 /begin FUNCTION_LIST /end FUNCTION_LIST /end MEASUREMENT
/begin MEASUREMENT vFRZFR "Freeze frame NO." UBYTE COMP_0004 1 100 0 255 ECU_ADDRESS 0xFFFF3D8C /begin FUNCTION_LIST /end FUNCTION_LIST /end MEASUREMENT
/begin MEASUREMENT vFSEQTE "Clutch surface balance temperature" UBYTE COMP_0035 1 100 -50 205 ECU_ADDRESS 0xFFFF2DBC /begin FUNCTION_LIST /end FUNCTION_LIST /end MEASUREMENT
/begin MEASUREMENT vFSEQTE_R#1 "Clutch surface balance temperature" UBYTE COMP_0035 1 100 -50 205 ECU_ADDRESS 0xFFFF2DBC /begin FUNCTION_LIST /end FUNCTION_LIST /end MEASUREMENT
/begin MEASUREMENT vFSEQTE_R#2 "Clutch surface balance temperature" UBYTE COMP_0035 1 100 -50 205 ECU_ADDRESS 0xFFFF2DBD /begin FUNCTION_LIST /end FUNCTION_LIST /end MEASUREMENT
/begin MEASUREMENT vFSEQTI "Clutch surface balance temperature" UBYTE COMP_0035 1 100 -50 205 ECU_ADDRESS 0xFFFF2DBE /begin FUNCTION_LIST /end FUNCTION_LIST /end MEASUREMENT
/begin MEASUREMENT vFSEQTI_R#1 "Clutch surface balance temperature" UBYTE COMP_0035 1 100 -50 205 ECU_ADDRESS 0xFFFF2DBE /begin FUNCTION_LIST /end FUNCTION_LIST /end MEASUREMENT
/begin MEASUREMENT vFSEQTI_R#2 "Clutch surface balance temperature" UBYTE COMP_0035 1 100 -50 205 ECU_ADDRESS 0xFFFF2DBF /begin FUNCTION_LIST /end FUNCTION_LIST /end MEASUREMENT
/begin MEASUREMENT vFSESTE "Clutch side estimated temperature" ULONG COMP_0590_S 1 100 -50 205.999807631557 ECU_ADDRESS 0xFFFF2DC0 /begin FUNCTION_LIST /end FUNCTION_LIST /end MEASUREMENT
/begin MEASUREMENT vFSESTE_R#1 "Clutch side estimated temperature" ULONG COMP_0590_S 1 100 -50 205.999807631557 ECU_ADDRESS 0xFFFF2DC0 /begin FUNCTION_LIST /end FUNCTION_LIST /end MEASUREMENT
/begin MEASUREMENT vFSESTE_R#2 "Clutch side estimated temperature" ULONG COMP_0590_S 1 100 -50 205.999807631557 ECU_ADDRESS 0xFFFF2DC4 /begin FUNCTION_LIST /end FUNCTION_LIST /end MEASUREMENT
/begin MEASUREMENT vFSESTETM "Clutch surface temperature estimated timer (100mS) (exhaust)" UBYTE COMP_0068 1 100 0 255 ECU_ADDRESS 0xFFFF2DC8 /begin FUNCTION_LIST /end FUNCTION_LIST /end MEASUREMENT
/begin MEASUREMENT vFSESTEZ "Clutch side estimated temperature (before 100mS)" ULONG COMP_0590_S 1 100 -50 205.999807631557 ECU_ADDRESS 0xFFFF2DCC /begin FUNCTION_LIST /end FUNCTION_LIST /end MEASUREMENT
/begin MEASUREMENT vFSESTEZ_R#1 "Clutch side estimated temperature (before 100mS)" ULONG COMP_0590_S 1 100 -50 205.999807631557 ECU_ADDRESS 0xFFFF2DCC /begin FUNCTION_LIST /end FUNCTION_LIST /end MEASUREMENT
/begin MEASUREMENT vFSESTEZ_R#2 "Clutch side estimated temperature (before 100mS)" ULONG COMP_0590_S 1 100 -50 205.999807631557 ECU_ADDRESS 0xFFFF2DD0 /begin FUNCTION_LIST /end FUNCTION_LIST /end MEASUREMENT
/begin MEASUREMENT vFSESTI "Clutch side estimated temperature" ULONG COMP_0590_S 1 100 -50 205.999807631557 ECU_ADDRESS 0xFFFF2DD4 /begin FUNCTION_LIST /end FUNCTION_LIST /end MEASUREMENT
/begin MEASUREMENT vFSESTI_R#1 "Clutch side estimated temperature" ULONG COMP_0590_S 1 100 -50 205.999807631557 ECU_ADDRESS 0xFFFF2DD4 /begin FUNCTION_LIST /end FUNCTION_LIST /end MEASUREMENT
/begin MEASUREMENT vFSESTI_R#2 "Clutch side estimated temperature" ULONG COMP_0590_S 1 100 -50 205.999807631557 ECU_ADDRESS 0xFFFF2DD8 /begin FUNCTION_LIST /end FUNCTION_LIST /end MEASUREMENT
/begin MEASUREMENT vFSESTITM "Clutch surface temperature estimated timer (100mS) (intake)" UBYTE COMP_0068 1 100 0 255 ECU_ADDRESS 0xFFFF2DDC /begin FUNCTION_LIST /end FUNCTION_LIST /end MEASUREMENT
/begin MEASUREMENT vFSESTIZ "Clutch side estimated temperature (before 100mS)" ULONG COMP_0590_S 1 100 -50 205.999807631557 ECU_ADDRESS 0xFFFF2DE0 /begin FUNCTION_LIST /end FUNCTION_LIST /end MEASUREMENT
/begin MEASUREMENT vFSESTIZ_R#1 "Clutch side estimated temperature (before 100mS)" ULONG COMP_0590_S 1 100 -50 205.999807631557 ECU_ADDRESS 0xFFFF2DE0 /begin FUNCTION_LIST /end FUNCTION_LIST /end MEASUREMENT
/begin MEASUREMENT vFSESTIZ_R#2 "Clutch side estimated temperature (before 100mS)" ULONG COMP_0590_S 1 100 -50 205.999807631557 ECU_ADDRESS 0xFFFF2DE4 /begin FUNCTION_LIST /end FUNCTION_LIST /end MEASUREMENT
/begin MEASUREMENT vFSJBCNT "Failsafe JOB timing setup counter" UBYTE COMP_0068 1 100 0 255 ECU_ADDRESS 0xFFFF2DE8 /begin FUNCTION_LIST /end FUNCTION_LIST /end MEASUREMENT
/begin MEASUREMENT vFSKNEE "Engine speed element" UBYTE COMP_0035 1 100 -50 205 ECU_ADDRESS 0xFFFF2DE9 /begin FUNCTION_LIST /end FUNCTION_LIST /end MEASUREMENT
/begin MEASUREMENT vFSKNEI "Engine speed element" UBYTE COMP_0035 1 100 -50 205 ECU_ADDRESS 0xFFFF2DEA /begin FUNCTION_LIST /end FUNCTION_LIST /end MEASUREMENT
/begin MEASUREMENT vFSKNOWE "VTC conversion corner element" UBYTE COMP_0035 1 100 -50 205 ECU_ADDRESS 0xFFFF2DEB /begin FUNCTION_LIST /end FUNCTION_LIST /end MEASUREMENT
/begin MEASUREMENT vFSKNOWE_R#1 "VTC conversion corner element" UBYTE COMP_0035 1 100 -50 205 ECU_ADDRESS 0xFFFF2DEB /begin FUNCTION_LIST /end FUNCTION_LIST /end MEASUREMENT
/begin MEASUREMENT vFSKNOWE_R#2 "VTC conversion corner element" UBYTE COMP_0035 1 100 -50 205 ECU_ADDRESS 0xFFFF2DEC /begin FUNCTION_LIST /end FUNCTION_LIST /end MEASUREMENT
/begin MEASUREMENT vFSKNOWI "VTC conversion corner element" UBYTE COMP_0035 1 100 -50 205 ECU_ADDRESS 0xFFFF2DED /begin FUNCTION_LIST /end FUNCTION_LIST /end MEASUREMENT
/begin MEASUREMENT vFSKNOWI_R#1 "VTC conversion corner element" UBYTE COMP_0035 1 100 -50 205 ECU_ADDRESS 0xFFFF2DED /begin FUNCTION_LIST /end FUNCTION_LIST /end MEASUREMENT
/begin MEASUREMENT vFSKNOWI_R#2 "VTC conversion corner element" UBYTE COMP_0035 1 100 -50 205 ECU_ADDRESS 0xFFFF2DEE /begin FUNCTION_LIST /end FUNCTION_LIST /end MEASUREMENT
/begin MEASUREMENT vFSKOILE "Oil temperature element" UBYTE COMP_0035 1 100 -50 205 ECU_ADDRESS 0xFFFF2DEF /begin FUNCTION_LIST /end FUNCTION_LIST /end MEASUREMENT
/begin MEASUREMENT vFSKOILI "Oil temperature element" UBYTE COMP_0035 1 100 -50 205 ECU_ADDRESS 0xFFFF2DF0 /begin FUNCTION_LIST /end FUNCTION_LIST /end MEASUREMENT
/begin MEASUREMENT vFSO2NGf "O2 sensor NG judgement (It isn't cleared in OK.)" UBYTE COMP_0004 1 100 0 255 ECU_ADDRESS 0xFFFF8A3C /begin FUNCTION_LIST /end FUNCTION_LIST /end MEASUREMENT
/begin MEASUREMENT vFSO2Sf "O2 sensor failsafe flag" UBYTE COMP_0004 1 100 0 255 ECU_ADDRESS 0xFFFF8A3D /begin FUNCTION_LIST /end FUNCTION_LIST /end MEASUREMENT
/begin MEASUREMENT vFSTHTE "The amount of VTC clutch temperature deviation" UBYTE COMP_0078_S 1 100 -128 127 ECU_ADDRESS 0xFFFF13AD /begin FUNCTION_LIST /end FUNCTION_LIST /end MEASUREMENT
/begin MEASUREMENT vFSTHTI "The amount of VTC clutch temperature deviation" UBYTE COMP_0078_S 1 100 -128 127 ECU_ADDRESS 0xFFFF13AE /begin FUNCTION_LIST /end FUNCTION_LIST /end MEASUREMENT
/begin MEASUREMENT vFSTICHG "Stratified pulse change permission judgement" UBYTE COMP_0068 1 100 0 255 ECU_ADDRESS 0xFFFF1FD3 /begin FUNCTION_LIST /end FUNCTION_LIST /end MEASUREMENT
/begin MEASUREMENT vFSYSIMR "An evapo system diagnosis completion flag for for 2TRIP-ization" UBYTE COMP_0004 1 100 0 255 ECU_ADDRESS 0xFFFF2DF6 /begin FUNCTION_LIST /end FUNCTION_LIST /end MEASUREMENT
/begin MEASUREMENT vFTO2Mf "TO2M operation condition" UBYTE COMP_0004 1 100 0 255 ECU_ADDRESS 0xFFFF37F2 /begin FUNCTION_LIST /end FUNCTION_LIST /end MEASUREMENT
/begin MEASUREMENT vFTXR "Response requirement judgement registor" UBYTE COMP_0004 1 100 0 255 ECU_ADDRESS 0xFFFF2DFE /begin FUNCTION_LIST /end FUNCTION_LIST /end MEASUREMENT
/begin MEASUREMENT vFVONN "A FOXMN MIN value monitor for the experiment car" UBYTE COMP_0104 1 100 0 2550 ECU_ADDRESS 0xFFFFA436 /begin FUNCTION_LIST /end FUNCTION_LIST /end MEASUREMENT
/begin MEASUREMENT vFVOXN "A FOXMX MIN value monitor for the experiment car" UBYTE COMP_0104 1 100 0 2550 ECU_ADDRESS 0xFFFFA438 /begin FUNCTION_LIST /end FUNCTION_LIST /end MEASUREMENT
/begin MEASUREMENT vFVTBSKEf "VTC reference position computed permission flag" UBYTE COMP_0004 1 100 0 255 ECU_ADDRESS 0xFFFF13B2 /begin FUNCTION_LIST /end FUNCTION_LIST /end MEASUREMENT
/begin MEASUREMENT vFVTCBSKf "VTC reference position computed permission flag" UBYTE COMP_0004 1 100 0 255 ECU_ADDRESS 0xFFFF13B3 /begin FUNCTION_LIST /end FUNCTION_LIST /end MEASUREMENT
/begin MEASUREMENT vFVTCPOSf "VTC reference angle fixed requirement flag" UBYTE COMP_0004 1 100 0 255 ECU_ADDRESS 0xFFFF2DFF /begin FUNCTION_LIST /end FUNCTION_LIST /end MEASUREMENT
/begin MEASUREMENT vFVTPOSEf "VTC reference angle fixed requirement flag" UBYTE COMP_0004 1 100 0 255 ECU_ADDRESS 0xFFFF2E00 /begin FUNCTION_LIST /end FUNCTION_LIST /end MEASUREMENT
/begin MEASUREMENT vFWKSTGf "WKSTRG clear requirement flag" UBYTE COMP_0004 1 100 0 255 ECU_ADDRESS 0xFFFF2E01 /begin FUNCTION_LIST /end FUNCTION_LIST /end MEASUREMENT
/begin MEASUREMENT vGALPR "ALPHA/ purge rate learning value" UBYTE COMP_0015 1 100 0 31.875 ECU_ADDRESS 0xFFFF13C1 /begin FUNCTION_LIST /end FUNCTION_LIST /end MEASUREMENT
/begin MEASUREMENT vGALPR_R#1 "ALPHA/ purge rate learning value" UBYTE COMP_0015 1 100 0 31.875 ECU_ADDRESS 0xFFFF13C1 /begin FUNCTION_LIST /end FUNCTION_LIST /end MEASUREMENT
/begin MEASUREMENT vGALPR_R#2 "ALPHA/ purge rate learning value" UBYTE COMP_0015 1 100 0 31.875 ECU_ADDRESS 0xFFFF13C2 /begin FUNCTION_LIST /end FUNCTION_LIST /end MEASUREMENT
/begin MEASUREMENT vGALPRN "ALPHA/ purge rate learning value" UBYTE COMP_0425_S 1 100 -1 30.875 ECU_ADDRESS 0xFFFF13C3 /begin FUNCTION_LIST /end FUNCTION_LIST /end MEASUREMENT
/begin MEASUREMENT vGALPRN_R#1 "ALPHA/ purge rate learning value" UBYTE COMP_0425_S 1 100 -1 30.875 ECU_ADDRESS 0xFFFF13C3 /begin FUNCTION_LIST /end FUNCTION_LIST /end MEASUREMENT
/begin MEASUREMENT vGALPRN_R#2 "ALPHA/ purge rate learning value" UBYTE COMP_0425_S 1 100 -1 30.875 ECU_ADDRESS 0xFFFF13C4 /begin FUNCTION_LIST /end FUNCTION_LIST /end MEASUREMENT
/begin MEASUREMENT vGASCD "ASCD acceleration" UWORD COMP_0083_S 1 100 -4.079616 4.0794915 ECU_ADDRESS 0xFFFF3D90 /begin FUNCTION_LIST /end FUNCTION_LIST /end MEASUREMENT
/begin MEASUREMENT vGAVGAFHf "GST parameter renewal ó" UBYTE COMP_0004 1 100 0 255 ECU_ADDRESS 0xFFFF2E04 /begin FUNCTION_LIST /end FUNCTION_LIST /end MEASUREMENT
/begin MEASUREMENT vGDEGR1 "É¢EGRT (for EGRTM1#) -GST parameter" UBYTE COMP_0050_S 1 100 0 255 ECU_ADDRESS 0xFFFFA45E /begin FUNCTION_LIST /end FUNCTION_LIST /end MEASUREMENT
/begin MEASUREMENT vGDEGR2 "É¢EGRT (for EGRTM2#) -GST parameter" UBYTE COMP_0050_S 1 100 0 255 ECU_ADDRESS 0xFFFFA45F /begin FUNCTION_LIST /end FUNCTION_LIST /end MEASUREMENT
/begin MEASUREMENT vGDEGR3 "The difference-GST parameter of the EGR temperature maximum and EGR temperature" UBYTE COMP_0003 1 100 0 255 ECU_ADDRESS 0xFFFFA460 /begin FUNCTION_LIST /end FUNCTION_LIST /end MEASUREMENT
/begin MEASUREMENT vGDTC "Group Of DTC" UWORD COMP_0004 1 100 0 65535 ECU_ADDRESS 0xFFFF3D94 /begin FUNCTION_LIST /end FUNCTION_LIST /end MEASUREMENT
/begin MEASUREMENT vGDTC32 "Group Of DTC (32bit)" ULONG COMP_0004 1 100 0 4294967295 ECU_ADDRESS 0xFFFF3D98 /begin FUNCTION_LIST /end FUNCTION_LIST /end MEASUREMENT
/begin MEASUREMENT vGEARMT "Transmission ratio for manual gearbox calculated by the engine control unit via Vitrap" UBYTE COMP_0068 1 100 0 255 ECU_ADDRESS 0xFFFF41FA /begin FUNCTION_LIST /end FUNCTION_LIST /end MEASUREMENT
/begin MEASUREMENT vGEAROLD "Gear position (OLD)" UBYTE COMP_0068 1 100 0 255 ECU_ADDRESS 0xFFFF2E06 /begin FUNCTION_LIST /end FUNCTION_LIST /end MEASUREMENT
/begin MEASUREMENT vGEGRO "EGR temperature change quantity-GST parameter" UBYTE COMP_0003 1 100 0 255 ECU_ADDRESS 0xFFFFA461 /begin FUNCTION_LIST /end FUNCTION_LIST /end MEASUREMENT
/begin MEASUREMENT vGFO2H "A former O2 sensor heater diagnosis parameter for GST" UBYTE COMP_0054 1 100 0 5100 ECU_ADDRESS 0xFFFFA474 /begin FUNCTION_LIST /end FUNCTION_LIST /end MEASUREMENT
/begin MEASUREMENT vGGSM8RE "Mode 8 response code (GST)" UBYTE COMP_0068 1 100 0 255 ECU_ADDRESS 0xFFFF2E07 /begin FUNCTION_LIST /end FUNCTION_LIST /end MEASUREMENT
/begin MEASUREMENT vGKTVOFZ "Throttle sensor offset learning value" UBYTE COMP_0023 1 100 0 1275 ECU_ADDRESS 0xFFFFA478 /begin FUNCTION_LIST /end FUNCTION_LIST /end MEASUREMENT
/begin MEASUREMENT vGLEKAL "An estimated leak hole area 1 for the GST output" UBYTE COMP_0232 1 100 0 1.9921875 ECU_ADDRESS 0xFFFFA479 /begin FUNCTION_LIST /end FUNCTION_LIST /end MEASUREMENT
/begin MEASUREMENT vGLEKALV "An estimated leak hole area 1 for the GST output" UBYTE COMP_0086_S 1 100 0 3.984375 ECU_ADDRESS 0xFFFFA47A /begin FUNCTION_LIST /end FUNCTION_LIST /end MEASUREMENT
/begin MEASUREMENT vGLEKLM "Estimated leak upper limit value for the GST output" UBYTE COMP_0232 1 100 0 1.9921875 ECU_ADDRESS 0xFFFFA47B /begin FUNCTION_LIST /end FUNCTION_LIST /end MEASUREMENT
/begin MEASUREMENT vGLKAL2 "An estimated leak hole area 1 for the GST output" UBYTE COMP_0232 1 100 0 1.9921875 ECU_ADDRESS 0xFFFFA47C /begin FUNCTION_LIST /end FUNCTION_LIST /end MEASUREMENT
/begin MEASUREMENT vGLKLM2 "Estimated leak upper limit value for the GST output" UBYTE COMP_0232 1 100 0 1.9921875 ECU_ADDRESS 0xFFFFA47D /begin FUNCTION_LIST /end FUNCTION_LIST /end MEASUREMENT
/begin MEASUREMENT vGM "The reciprocal number of the tire diameter/gear ratio" UWORD COMP_0231_S 1 100 0 0.1999970916 ECU_ADDRESS 0xFFFF2E08 /begin FUNCTION_LIST /end FUNCTION_LIST /end MEASUREMENT
/begin MEASUREMENT vGNEW "A new computed gain" UWORD COMP_0015 1 100 0 8191.875 ECU_ADDRESS 0xFFFF13CE /begin FUNCTION_LIST /end FUNCTION_LIST /end MEASUREMENT
/begin MEASUREMENT vGNEW_R#1 "A new computed gain" UWORD COMP_0015 1 100 0 8191.875 ECU_ADDRESS 0xFFFF13CE /begin FUNCTION_LIST /end FUNCTION_LIST /end MEASUREMENT
/begin MEASUREMENT vGNEW_R#2 "A new computed gain" UWORD COMP_0015 1 100 0 8191.875 ECU_ADDRESS 0xFFFF13D0 /begin FUNCTION_LIST /end FUNCTION_LIST /end MEASUREMENT
/begin MEASUREMENT vGNEW1 "A new computed gain" UWORD COMP_0425_S 1 100 -1 8190.875 ECU_ADDRESS 0xFFFF13D2 /begin FUNCTION_LIST /end FUNCTION_LIST /end MEASUREMENT
/begin MEASUREMENT vGNEW1_R#1 "A new computed gain" UWORD COMP_0425_S 1 100 -1 8190.875 ECU_ADDRESS 0xFFFF13D2 /begin FUNCTION_LIST /end FUNCTION_LIST /end MEASUREMENT
/begin MEASUREMENT vGNEW1_R#2 "A new computed gain" UWORD COMP_0425_S 1 100 -1 8190.875 ECU_ADDRESS 0xFFFF13D4 /begin FUNCTION_LIST /end FUNCTION_LIST /end MEASUREMENT
/begin MEASUREMENT vGNOWE "VTC conversion corner sensitivity parameter" UBYTE COMP_0089_S 1 100 0 1.275 ECU_ADDRESS 0xFFFF2E0A /begin FUNCTION_LIST /end FUNCTION_LIST /end MEASUREMENT
/begin MEASUREMENT vGNOWI "VTC conversion corner sensitivity parameter" UBYTE COMP_0089_S 1 100 0 1.275 ECU_ADDRESS 0xFFFF2E0B /begin FUNCTION_LIST /end FUNCTION_LIST /end MEASUREMENT
/begin MEASUREMENT vGNRTRP2 "ÉWÉFÉlÉâÉãÉgÉäÉbÉv for the CMM diagnosis" UWORD COMP_0016 1 100 0 65535 ECU_ADDRESS 0xFFFFA480 /begin FUNCTION_LIST /end FUNCTION_LIST /end MEASUREMENT
/begin MEASUREMENT vGOILE "Oil temperature sensitivity parameter" UBYTE COMP_0091_S 1 100 0 12.75 ECU_ADDRESS 0xFFFF2E0C /begin FUNCTION_LIST /end FUNCTION_LIST /end MEASUREMENT
/begin MEASUREMENT vGOILI "Oil temperature sensitivity parameter" UBYTE COMP_0091_S 1 100 0 12.75 ECU_ADDRESS 0xFFFF2E0D /begin FUNCTION_LIST /end FUNCTION_LIST /end MEASUREMENT
/begin MEASUREMENT vGOVDMPWK "Work for the GOVDMP computation" SBYTE COMP_0018 1 100 -128 127 ECU_ADDRESS 0xFFFF13D9 /begin FUNCTION_LIST /end FUNCTION_LIST /end MEASUREMENT
/begin MEASUREMENT vGPSEV "Limit value for the GST output" UBYTE COMP_0054 1 100 0 5100 ECU_ADDRESS 0xFFFFA482 /begin FUNCTION_LIST /end FUNCTION_LIST /end MEASUREMENT
/begin MEASUREMENT vGPSYSP "GST output parameter" UBYTE COMP_0054 1 100 0 5100 ECU_ADDRESS 0xFFFFA483 /begin FUNCTION_LIST /end FUNCTION_LIST /end MEASUREMENT
/begin MEASUREMENT vGRLCNTA "Gravity Lamp treatment counter (for 100mS)" UBYTE COMP_0035_S 1 100 0 255 ECU_ADDRESS 0xFFFF2E0E /begin FUNCTION_LIST /end FUNCTION_LIST /end MEASUREMENT
/begin MEASUREMENT vGRLCNTB "Gravity Lamp treatment counter (for 500mS)" UBYTE COMP_0035_S 1 100 0 255 ECU_ADDRESS 0xFFFF2E0F /begin FUNCTION_LIST /end FUNCTION_LIST /end MEASUREMENT
/begin MEASUREMENT vGRO2Hf "GST parameter renewal ó" UBYTE COMP_0004 1 100 0 255 ECU_ADDRESS 0xFFFF2E10 /begin FUNCTION_LIST /end FUNCTION_LIST /end MEASUREMENT
/begin MEASUREMENT vGSTMLONZ "The excuse (previous value) of the diagnosis of FMILON (trouble alarm indication flag) =1" UBYTE COMP_0004 1 100 0 255 ECU_ADDRESS 0xFFFFA486 /begin FUNCTION_LIST /end FUNCTION_LIST /end MEASUREMENT
/begin MEASUREMENT vGTBL "Learning table value" UWORD COMP_0015 1 100 0 8191.875 ECU_ADDRESS 0xFFFF13DE /begin FUNCTION_LIST /end FUNCTION_LIST /end MEASUREMENT
/begin MEASUREMENT vGTBLN "Learning table value" UWORD COMP_0598_S 1 100 -0.999999488 30.999495847 ECU_ADDRESS 0xFFFF13E0 /begin FUNCTION_LIST /end FUNCTION_LIST /end MEASUREMENT
/begin MEASUREMENT vGTBLN_R#1 "Learning table value" UWORD COMP_0598_S 1 100 -0.999999488 30.999495847 ECU_ADDRESS 0xFFFF13E0 /begin FUNCTION_LIST /end FUNCTION_LIST /end MEASUREMENT
/begin MEASUREMENT vGTBLN_R#2 "Learning table value" UWORD COMP_0598_S 1 100 -0.999999488 30.999495847 ECU_ADDRESS 0xFFFF13E2 /begin FUNCTION_LIST /end FUNCTION_LIST /end MEASUREMENT
/begin MEASUREMENT vGTEGMX "EGR temperature maximum value-GST parameter" UBYTE COMP_0035 1 100 -50 205 ECU_ADDRESS 0xFFFFA487 /begin FUNCTION_LIST /end FUNCTION_LIST /end MEASUREMENT
/begin MEASUREMENT vGTEGOK "TEGRMX- OK judgement value-GST parameter" UBYTE COMP_0035 1 100 -50 205 ECU_ADDRESS 0xFFFFA488 /begin FUNCTION_LIST /end FUNCTION_LIST /end MEASUREMENT
/begin MEASUREMENT vGZCYN "GZCYn operation start data" UBYTE COMP_0068 1 100 0 255 ECU_ADDRESS 0xFFFF13F0 /begin FUNCTION_LIST /end FUNCTION_LIST /end MEASUREMENT
/begin MEASUREMENT vHAMN "HZRAA minimum value region A" UBYTE COMP_0027 1 100 0 255 ECU_ADDRESS 0xFFFFA489 /begin FUNCTION_LIST /end FUNCTION_LIST /end MEASUREMENT
/begin MEASUREMENT vHAMN_R#1 "HZRAA minimum value region A" UBYTE COMP_0027 1 100 0 255 ECU_ADDRESS 0xFFFFA489 /begin FUNCTION_LIST /end FUNCTION_LIST /end MEASUREMENT
/begin MEASUREMENT vHAMN_R#2 "HZRAA minimum value region A" UBYTE COMP_0027 1 100 0 255 ECU_ADDRESS 0xFFFFA48A /begin FUNCTION_LIST /end FUNCTION_LIST /end MEASUREMENT
/begin MEASUREMENT vHAMN_R#3 "HZRAA minimum value region A" UBYTE COMP_0027 1 100 0 255 ECU_ADDRESS 0xFFFFA48B /begin FUNCTION_LIST /end FUNCTION_LIST /end MEASUREMENT
/begin MEASUREMENT vHAMN_R#4 "HZRAA minimum value region A" UBYTE COMP_0027 1 100 0 255 ECU_ADDRESS 0xFFFFA48C /begin FUNCTION_LIST /end FUNCTION_LIST /end MEASUREMENT
/begin MEASUREMENT vHCSENRF1 "Final FAN speed (0.0512.5rpm)" UBYTE COMP_0006 1 100 0 3187.5 ECU_ADDRESS 0xFFFF2E16 /begin FUNCTION_LIST /end FUNCTION_LIST /end MEASUREMENT
/begin MEASUREMENT vHCSTGRF "Target FAN speed" UBYTE COMP_0006 1 100 0 3187.5 ECU_ADDRESS 0xFFFF2E17 /begin FUNCTION_LIST /end FUNCTION_LIST /end MEASUREMENT
/begin MEASUREMENT vHHTQHOS "The amount of highlands, heat area compensation" UWORD COMP_0271 1 100 0 199.99696053 ECU_ADDRESS 0xFFFFA48E /begin FUNCTION_LIST /end FUNCTION_LIST /end MEASUREMENT
/begin MEASUREMENT vHHTQHO_S "The amount of highlands, heat area compensation" UWORD COMP_0271 1 100 0 199.99696053 ECU_ADDRESS 0xFFFF34F2 /begin FUNCTION_LIST /end FUNCTION_LIST /end MEASUREMENT
/begin MEASUREMENT vHHTQRTO "An actual torque/target torque ratio" UWORD COMP_0271 1 100 0 199.99696053 ECU_ADDRESS 0xFFFF1402 /begin FUNCTION_LIST /end FUNCTION_LIST /end MEASUREMENT
/begin MEASUREMENT vHHTQTTE "PTD requirement combustion torque" UWORD COMP_0196 1 100 0 6553.5 ECU_ADDRESS 0xFFFF1404 /begin FUNCTION_LIST /end FUNCTION_LIST /end MEASUREMENT
/begin MEASUREMENT vHIAIRFCf "A high air quantity fuel cut judgement" UBYTE COMP_0004 1 100 0 255 ECU_ADDRESS 0xFFFF1406 /begin FUNCTION_LIST /end FUNCTION_LIST /end MEASUREMENT
/begin MEASUREMENT vHNRPM10Z "100mS previous value of HNRPM10" UBYTE COMP_0020 1 100 0 12750 ECU_ADDRESS 0xFFFF89A5 /begin FUNCTION_LIST /end FUNCTION_LIST /end MEASUREMENT
/begin MEASUREMENT vHOSAPD "Purge duct area compensation coefficient" UBYTE COMP_0009 1 100 0 199.21875 ECU_ADDRESS 0xFFFF1408 /begin FUNCTION_LIST /end FUNCTION_LIST /end MEASUREMENT
/begin MEASUREMENT vHOSCINBLf "HOSCMAX learning renewal permission flag" UBYTE COMP_0004 1 100 0 255 ECU_ADDRESS 0xFFFF2E21 /begin FUNCTION_LIST /end FUNCTION_LIST /end MEASUREMENT
/begin MEASUREMENT vHOSHONOf "HOSCMAX learning region condition judgement flag" UBYTE COMP_0004 1 100 0 255 ECU_ADDRESS 0xFFFF2E22 /begin FUNCTION_LIST /end FUNCTION_LIST /end MEASUREMENT
/begin MEASUREMENT vHOSLGOf "HOSCMAX learning permission flag" UBYTE COMP_0004 1 100 0 255 ECU_ADDRESS 0xFFFF2E23 /begin FUNCTION_LIST /end FUNCTION_LIST /end MEASUREMENT
/begin MEASUREMENT vHOSTF "Fuel temperature compensation coefficient" UBYTE COMP_0044 1 100 0 1.9921875 ECU_ADDRESS 0xFFFF2E28 /begin FUNCTION_LIST /end FUNCTION_LIST /end MEASUREMENT
/begin MEASUREMENT vHOTRESET "Reset classification" UBYTE COMP_0068 1 100 0 255 ECU_ADDRESS 0xFFFF2E29 /begin FUNCTION_LIST /end FUNCTION_LIST /end MEASUREMENT
/begin MEASUREMENT vHRPBOST "After purge compensation, intake manifold pressure/atomospheric pressure ratio" UBYTE COMP_0063 1 100 0 0.99609375 ECU_ADDRESS 0xFFFF1409 /begin FUNCTION_LIST /end FUNCTION_LIST /end MEASUREMENT
/begin MEASUREMENT vHSDTSP "Leak area compensation coefficient" UBYTE COMP_0044 1 100 0 1.9921875 ECU_ADDRESS 0xFFFF2E30 /begin FUNCTION_LIST /end FUNCTION_LIST /end MEASUREMENT
/begin MEASUREMENT vHST "MISx molecule" ULONG COMP_0068 1 100 0 4294967295 ECU_ADDRESS 0xFFFF364C /begin FUNCTION_LIST /end FUNCTION_LIST /end MEASUREMENT
/begin MEASUREMENT vHT "Work RAM for the 5-times collation" UBYTE COMP_0068 1 100 0 255 ECU_ADDRESS 0xFFFF4948 /begin FUNCTION_LIST /end FUNCTION_LIST /end MEASUREMENT
/begin MEASUREMENT vHT_R#1 "Work RAM for the 5-times collation" UBYTE COMP_0068 1 100 0 255 ECU_ADDRESS 0xFFFF4948 /begin FUNCTION_LIST /end FUNCTION_LIST /end MEASUREMENT
/begin MEASUREMENT vHT_R#2 "Work RAM for the 5-times collation" UBYTE COMP_0068 1 100 0 255 ECU_ADDRESS 0xFFFF4949 /begin FUNCTION_LIST /end FUNCTION_LIST /end MEASUREMENT
/begin MEASUREMENT vHT_R#3 "Work RAM for the 5-times collation" UBYTE COMP_0068 1 100 0 255 ECU_ADDRESS 0xFFFF494A /begin FUNCTION_LIST /end FUNCTION_LIST /end MEASUREMENT
/begin MEASUREMENT vHT_R#4 "Work RAM for the 5-times collation" UBYTE COMP_0068 1 100 0 255 ECU_ADDRESS 0xFFFF494B /begin FUNCTION_LIST /end FUNCTION_LIST /end MEASUREMENT
/begin MEASUREMENT vHT_R#5 "Work RAM for the 5-times collation" UBYTE COMP_0068 1 100 0 255 ECU_ADDRESS 0xFFFF494C /begin FUNCTION_LIST /end FUNCTION_LIST /end MEASUREMENT
/begin MEASUREMENT vHTFMNT "At the time of switching, homogeneous air-fuel ratio lower limit value" UWORD COMP_0057 1 100 0 3.999941832 ECU_ADDRESS 0xFFFF1410 /begin FUNCTION_LIST /end FUNCTION_LIST /end MEASUREMENT
/begin MEASUREMENT vHTLMDDGEf "A diagnosis completion condition for the high exhaust temperature lambda control trawl control" UBYTE COMP_0004 1 100 0 255 ECU_ADDRESS 0xFFFF2E3C /begin FUNCTION_LIST /end FUNCTION_LIST /end MEASUREMENT
/begin MEASUREMENT vHTLMDJf "At the time of the high exhaust temperature, lambda control trawl control condition" UBYTE COMP_0004 1 100 0 255 ECU_ADDRESS 0xFFFF1412 /begin FUNCTION_LIST /end FUNCTION_LIST /end MEASUREMENT
/begin MEASUREMENT vHTWLMT0 "High coolant temperature limiter torque reference value" SWORD COMP_0228 1 100 -3276.8 3276.7 ECU_ADDRESS 0xFFFF1416 /begin FUNCTION_LIST /end FUNCTION_LIST /end MEASUREMENT
/begin MEASUREMENT vHTWTWN "A high coolant temperature limiter coolant temperature" UWORD COMP_0383 1 100 -50 205.99609375 ECU_ADDRESS 0xFFFF1418 /begin FUNCTION_LIST /end FUNCTION_LIST /end MEASUREMENT
/begin MEASUREMENT vHYSALP0f "mHYSALP0 switching flag" UBYTE COMP_0004 1 100 0 255 ECU_ADDRESS 0xFFFF141A /begin FUNCTION_LIST /end FUNCTION_LIST /end MEASUREMENT
/begin MEASUREMENT vHYSALPf "mHYSALP switching flag" UBYTE COMP_0004 1 100 0 255 ECU_ADDRESS 0xFFFF141B /begin FUNCTION_LIST /end FUNCTION_LIST /end MEASUREMENT
/begin MEASUREMENT vHYSRBS "Base re-learning judgement area hysteresis" UWORD COMP_0068 1 100 0 65535 ECU_ADDRESS 0xFFFF141C /begin FUNCTION_LIST /end FUNCTION_LIST /end MEASUREMENT
/begin MEASUREMENT vHYSRBS_R#1 "Base re-learning judgement area hysteresis" UWORD COMP_0068 1 100 0 65535 ECU_ADDRESS 0xFFFF141C /begin FUNCTION_LIST /end FUNCTION_LIST /end MEASUREMENT
/begin MEASUREMENT vHYSRBS_R#2 "Base re-learning judgement area hysteresis" UWORD COMP_0068 1 100 0 65535 ECU_ADDRESS 0xFFFF141E /begin FUNCTION_LIST /end FUNCTION_LIST /end MEASUREMENT
/begin MEASUREMENT vHYSRBS1 "Base re-learning judgement area 1 hysteresis" UWORD COMP_0068 1 100 0 65535 ECU_ADDRESS 0xFFFF1420 /begin FUNCTION_LIST /end FUNCTION_LIST /end MEASUREMENT
/begin MEASUREMENT vHYSRBS1_R#1 "Base re-learning judgement area 1 hysteresis" UWORD COMP_0068 1 100 0 65535 ECU_ADDRESS 0xFFFF1420 /begin FUNCTION_LIST /end FUNCTION_LIST /end MEASUREMENT
/begin MEASUREMENT vHYSRBS1_R#2 "Base re-learning judgement area 1 hysteresis" UWORD COMP_0068 1 100 0 65535 ECU_ADDRESS 0xFFFF1422 /begin FUNCTION_LIST /end FUNCTION_LIST /end MEASUREMENT
/begin MEASUREMENT vIALP "Air-fuel ratio compensation I-gain" SWORD COMP_0438 1 100 -128 127.99609375 ECU_ADDRESS 0xFFFF1424 /begin FUNCTION_LIST /end FUNCTION_LIST /end MEASUREMENT
/begin MEASUREMENT vIALP_R#1 "Air-fuel ratio compensation I-gain" SWORD COMP_0438 1 100 -128 127.99609375 ECU_ADDRESS 0xFFFF1424 /begin FUNCTION_LIST /end FUNCTION_LIST /end MEASUREMENT
/begin MEASUREMENT vIALP_R#2 "Air-fuel ratio compensation I-gain" SWORD COMP_0438 1 100 -128 127.99609375 ECU_ADDRESS 0xFFFF1426 /begin FUNCTION_LIST /end FUNCTION_LIST /end MEASUREMENT
/begin MEASUREMENT vIANG "The amount of I element compensation" UWORD COMP_0497_S 1 100 -128 127.99609375 ECU_ADDRESS 0xFFFF1428 /begin FUNCTION_LIST /end FUNCTION_LIST /end MEASUREMENT
/begin MEASUREMENT vIBRF0 "1st BRF input" SWORD COMP_0439 1 100 -8192 8191.75 ECU_ADDRESS 0xFFFF142A /begin FUNCTION_LIST /end FUNCTION_LIST /end MEASUREMENT
/begin MEASUREMENT vIBRF1 "1st BRF input" SWORD COMP_0439 1 100 -8192 8191.75 ECU_ADDRESS 0xFFFF142C /begin FUNCTION_LIST /end FUNCTION_LIST /end MEASUREMENT
/begin MEASUREMENT vIBRF10 "2nd BRF input" SWORD COMP_0440 1 100 -256 255.9921875 ECU_ADDRESS 0xFFFF142E /begin FUNCTION_LIST /end FUNCTION_LIST /end MEASUREMENT
/begin MEASUREMENT vIBRF11 "2nd BRF input" SWORD COMP_0440 1 100 -256 255.9921875 ECU_ADDRESS 0xFFFF1430 /begin FUNCTION_LIST /end FUNCTION_LIST /end MEASUREMENT
/begin MEASUREMENT vIBRF12 "2nd BRF input" SWORD COMP_0440 1 100 -256 255.9921875 ECU_ADDRESS 0xFFFF1432 /begin FUNCTION_LIST /end FUNCTION_LIST /end MEASUREMENT
/begin MEASUREMENT vIBRF2 "1st BRF input" SWORD COMP_0439 1 100 -8192 8191.75 ECU_ADDRESS 0xFFFF1434 /begin FUNCTION_LIST /end FUNCTION_LIST /end MEASUREMENT
/begin MEASUREMENT vICOM1S_1 "The sign of ICOM1_1" UBYTE COMP_0004 1 100 0 255 ECU_ADDRESS 0xFFFF3660 /begin FUNCTION_LIST /end FUNCTION_LIST /end MEASUREMENT
/begin MEASUREMENT vICOM1_1 "The variable for the operation of the model matching compensation vessel 1/R output" ULONG COMP_0178_S 1 100 0 16385.300230425 ECU_ADDRESS 0xFFFF365C /begin FUNCTION_LIST /end FUNCTION_LIST /end MEASUREMENT
/begin MEASUREMENT vICOM1z2 "The absolute value (last but one value) of the model matching compensation vessel 1/R output" ULONG COMP_0178_S 1 100 0 16385.300230425 ECU_ADDRESS 0xFFFF3664 /begin FUNCTION_LIST /end FUNCTION_LIST /end MEASUREMENT
/begin MEASUREMENT vICOM2S_1 "The sign of ICOM2_1" UBYTE COMP_0004 1 100 0 255 ECU_ADDRESS 0xFFFF366C /begin FUNCTION_LIST /end FUNCTION_LIST /end MEASUREMENT
/begin MEASUREMENT vICOM2Sz2 "The sign of ICOM2z2" UBYTE COMP_0004 1 100 0 255 ECU_ADDRESS 0xFFFF366D /begin FUNCTION_LIST /end FUNCTION_LIST /end MEASUREMENT
/begin MEASUREMENT vICOM2_1 "The variable for the operation of the electric current order value (after the limiter)" ULONG COMP_0600_S 1 100 0 32766.305493555 ECU_ADDRESS 0xFFFF3668 /begin FUNCTION_LIST /end FUNCTION_LIST /end MEASUREMENT
/begin MEASUREMENT vICOM2z2 "The absolute value (last but one value) of the electric current order value (after the limiter)" ULONG COMP_0600_S 1 100 0 32766.305493555 ECU_ADDRESS 0xFFFF3670 /begin FUNCTION_LIST /end FUNCTION_LIST /end MEASUREMENT
/begin MEASUREMENT vIDAPSH_S "mIDAPSH_S opening area conversion value" UWORD COMP_0042 1 100 0 52.428 ECU_ADDRESS 0xFFFF1C42 /begin FUNCTION_LIST /end FUNCTION_LIST /end MEASUREMENT
/begin MEASUREMENT vIDLETIM "APP idling time" ULONG COMP_0376 1 100 0 429496729.5 ECU_ADDRESS 0xFFFF1FD8 /begin FUNCTION_LIST /end FUNCTION_LIST /end MEASUREMENT
/begin MEASUREMENT vIDLNENDf "Idle learning completion flag" UBYTE COMP_0004 1 100 0 255 ECU_ADDRESS 0xFFFF143A /begin FUNCTION_LIST /end FUNCTION_LIST /end MEASUREMENT
/begin MEASUREMENT vIFBKS_1 "The sign of IFBK_1" UBYTE COMP_0004 1 100 0 255 ECU_ADDRESS 0xFFFF3690 /begin FUNCTION_LIST /end FUNCTION_LIST /end MEASUREMENT
/begin MEASUREMENT vIFBKS_2 "The sign of IFBK_2" UBYTE COMP_0004 1 100 0 255 ECU_ADDRESS 0xFFFF3691 /begin FUNCTION_LIST /end FUNCTION_LIST /end MEASUREMENT
/begin MEASUREMENT vIFBKS_3 "The sign of IFBK_3" UBYTE COMP_0004 1 100 0 255 ECU_ADDRESS 0xFFFF3692 /begin FUNCTION_LIST /end FUNCTION_LIST /end MEASUREMENT
/begin MEASUREMENT vIFBKS_4 "The sign of IFBK_4" UBYTE COMP_0004 1 100 0 255 ECU_ADDRESS 0xFFFF3693 /begin FUNCTION_LIST /end FUNCTION_LIST /end MEASUREMENT
/begin MEASUREMENT vIFBKS_5 "The sign of IFBK_5" UBYTE COMP_0004 1 100 0 255 ECU_ADDRESS 0xFFFF3694 /begin FUNCTION_LIST /end FUNCTION_LIST /end MEASUREMENT
/begin MEASUREMENT vIFBKS_6 "The sign of IFBK_6" UBYTE COMP_0004 1 100 0 255 ECU_ADDRESS 0xFFFF3695 /begin FUNCTION_LIST /end FUNCTION_LIST /end MEASUREMENT
/begin MEASUREMENT vIFBK_1 "A variable for robust compensator H/G output operation" ULONG COMP_0601_S 1 100 0 32766.305493555 ECU_ADDRESS 0xFFFF3678 /begin FUNCTION_LIST /end FUNCTION_LIST /end MEASUREMENT
/begin MEASUREMENT vIFBK_2 "A variable for robust compensator H/G output operation" ULONG COMP_0601_S 1 100 0 32766.305493555 ECU_ADDRESS 0xFFFF367C /begin FUNCTION_LIST /end FUNCTION_LIST /end MEASUREMENT
/begin MEASUREMENT vIFBK_3 "A variable for robust compensator H/G output operation" ULONG COMP_0601_S 1 100 0 32766.305493555 ECU_ADDRESS 0xFFFF3680 /begin FUNCTION_LIST /end FUNCTION_LIST /end MEASUREMENT
/begin MEASUREMENT vIFBK_4 "A variable for robust compensator H/G output operation" ULONG COMP_0601_S 1 100 0 32766.305493555 ECU_ADDRESS 0xFFFF3684 /begin FUNCTION_LIST /end FUNCTION_LIST /end MEASUREMENT
/begin MEASUREMENT vIFBK_5 "A variable for robust compensator H/G output operation" ULONG COMP_0601_S 1 100 0 32766.305493555 ECU_ADDRESS 0xFFFF3688 /begin FUNCTION_LIST /end FUNCTION_LIST /end MEASUREMENT
/begin MEASUREMENT vIFBK_6 "A variable for robust compensator H/G output operation" ULONG COMP_0601_S 1 100 0 32766.305493555 ECU_ADDRESS 0xFFFF368C /begin FUNCTION_LIST /end FUNCTION_LIST /end MEASUREMENT
/begin MEASUREMENT vIGOFCN "IGN SW operation number of times" UBYTE COMP_0016 1 100 0 255 ECU_ADDRESS 0xFFFFB604 /begin FUNCTION_LIST /end FUNCTION_LIST /end MEASUREMENT
/begin MEASUREMENT vIHMCNT "The monitor number of times for the IH-M check" UBYTE COMP_0030 1 100 0 255 ECU_ADDRESS 0xFFFF2E4A /begin FUNCTION_LIST /end FUNCTION_LIST /end MEASUREMENT
/begin MEASUREMENT vIJHCNTUP "Injector circuit high at engine run NG counter up flag" UBYTE COMP_0283 1 100 0 255 ECU_ADDRESS 0xFFFF4063 /begin FUNCTION_LIST /end FUNCTION_LIST /end MEASUREMENT
/begin MEASUREMENT vIJHIENRN "Injector circuit high at engine run judge permission status flag" UBYTE COMP_0283 1 100 0 255 ECU_ADDRESS 0xFFFF1446 /begin FUNCTION_LIST /end FUNCTION_LIST /end MEASUREMENT
/begin MEASUREMENT vIJHIENST "Injector circuit high at engine stop judge permission status flag" UBYTE COMP_0283 1 100 0 255 ECU_ADDRESS 0xFFFF144C /begin FUNCTION_LIST /end FUNCTION_LIST /end MEASUREMENT
/begin MEASUREMENT vIJLOENRN "Injector circuit low at engine run judge permission status flag" UBYTE COMP_0283 1 100 0 255 ECU_ADDRESS 0xFFFF144D /begin FUNCTION_LIST /end FUNCTION_LIST /end MEASUREMENT
/begin MEASUREMENT vIJLOENST "Injector circuit low at engine stop judge permission status flag" UBYTE COMP_0283 1 100 0 255 ECU_ADDRESS 0xFFFF144E /begin FUNCTION_LIST /end FUNCTION_LIST /end MEASUREMENT
/begin MEASUREMENT vILI2MX "Parameter maximum value for the line pressure sensor function diagnosis" UWORD COMP_0050 1 100 0 5119.921875 ECU_ADDRESS 0xFFFFA49C /begin FUNCTION_LIST /end FUNCTION_LIST /end MEASUREMENT
/begin MEASUREMENT vIMEM "The memory value of the I-gain" UBYTE COMP_0031 1 100 0 0.99609375 ECU_ADDRESS 0xFFFF3DAE /begin FUNCTION_LIST /end FUNCTION_LIST /end MEASUREMENT
/begin MEASUREMENT vIMMEEPRQ "EEPROM writing requirement condition value" UBYTE COMP_0068 1 100 0 255 ECU_ADDRESS 0xFFFF3DB0 /begin FUNCTION_LIST /end FUNCTION_LIST /end MEASUREMENT
/begin MEASUREMENT vIMMRXBF "Immobilizer receiving buffer" UBYTE COMP_0068 1 100 0 255 ECU_ADDRESS 0xFFFF3DB1 /begin FUNCTION_LIST /end FUNCTION_LIST /end MEASUREMENT
/begin MEASUREMENT vIMMRXBF_R#1 "Immobilizer receiving buffer" UBYTE COMP_0068 1 100 0 255 ECU_ADDRESS 0xFFFF3DB1 /begin FUNCTION_LIST /end FUNCTION_LIST /end MEASUREMENT
/begin MEASUREMENT vIMMRXBF_R#2 "Immobilizer receiving buffer" UBYTE COMP_0068 1 100 0 255 ECU_ADDRESS 0xFFFF3DB2 /begin FUNCTION_LIST /end FUNCTION_LIST /end MEASUREMENT
/begin MEASUREMENT vIMMRXBF_R#3 "Immobilizer receiving buffer" UBYTE COMP_0068 1 100 0 255 ECU_ADDRESS 0xFFFF3DB3 /begin FUNCTION_LIST /end FUNCTION_LIST /end MEASUREMENT
/begin MEASUREMENT vIMMRXBF_R#4 "Immobilizer receiving buffer" UBYTE COMP_0068 1 100 0 255 ECU_ADDRESS 0xFFFF3DB4 /begin FUNCTION_LIST /end FUNCTION_LIST /end MEASUREMENT
/begin MEASUREMENT vIMMRXBF_R#5 "Immobilizer receiving buffer" UBYTE COMP_0068 1 100 0 255 ECU_ADDRESS 0xFFFF3DB5 /begin FUNCTION_LIST /end FUNCTION_LIST /end MEASUREMENT
/begin MEASUREMENT vIMMTXBF "Immobilizer transmitting buffer" UBYTE COMP_0068 1 100 0 255 ECU_ADDRESS 0xFFFF3DB6 /begin FUNCTION_LIST /end FUNCTION_LIST /end MEASUREMENT
/begin MEASUREMENT vIMMTXBF_R#1 "Immobilizer transmitting buffer" UBYTE COMP_0068 1 100 0 255 ECU_ADDRESS 0xFFFF3DB6 /begin FUNCTION_LIST /end FUNCTION_LIST /end MEASUREMENT
/begin MEASUREMENT vIMMTXBF_R#2 "Immobilizer transmitting buffer" UBYTE COMP_0068 1 100 0 255 ECU_ADDRESS 0xFFFF3DB7 /begin FUNCTION_LIST /end FUNCTION_LIST /end MEASUREMENT
/begin MEASUREMENT vIMMTXBF_R#3 "Immobilizer transmitting buffer" UBYTE COMP_0068 1 100 0 255 ECU_ADDRESS 0xFFFF3DB8 /begin FUNCTION_LIST /end FUNCTION_LIST /end MEASUREMENT
/begin MEASUREMENT vIMMTXBF_R#4 "Immobilizer transmitting buffer" UBYTE COMP_0068 1 100 0 255 ECU_ADDRESS 0xFFFF3DB9 /begin FUNCTION_LIST /end FUNCTION_LIST /end MEASUREMENT
/begin MEASUREMENT vIMMTXBF_R#5 "Immobilizer transmitting buffer" UBYTE COMP_0068 1 100 0 255 ECU_ADDRESS 0xFFFF3DBA /begin FUNCTION_LIST /end FUNCTION_LIST /end MEASUREMENT
/begin MEASUREMENT vIMMTXCNT "Immobilizer transmitting counter" UBYTE COMP_0068 1 100 0 255 ECU_ADDRESS 0xFFFF3DBB /begin FUNCTION_LIST /end FUNCTION_LIST /end MEASUREMENT
/begin MEASUREMENT vINCYL "This time, injection cylinder" UBYTE COMP_0004 1 100 0 255 ECU_ADDRESS 0xFFFF205C /begin FUNCTION_LIST /end FUNCTION_LIST /end MEASUREMENT
/begin MEASUREMENT vINJACC "The cylinder which did an interrupt injection" UBYTE COMP_0421 1 100 0 255 ECU_ADDRESS 0xFFFF1020 /begin FUNCTION_LIST /end FUNCTION_LIST /end MEASUREMENT
/begin MEASUREMENT vINJCYM "A profit by the cylinder gets crowded, permission timing flag" UBYTE COMP_0068 1 100 0 255 ECU_ADDRESS 0xFFFF1464 /begin FUNCTION_LIST /end FUNCTION_LIST /end MEASUREMENT
/begin MEASUREMENT vINJHDEND "Injector circuit high NG judgement status flag store ram" UBYTE COMP_0283 1 100 0 255 ECU_ADDRESS 0xFFFF2E4E /begin FUNCTION_LIST /end FUNCTION_LIST /end MEASUREMENT
/begin MEASUREMENT vINJLDEND "Injector circuit low NG judgement status flag store ram" UBYTE COMP_0283 1 100 0 255 ECU_ADDRESS 0xFFFF2E54 /begin FUNCTION_LIST /end FUNCTION_LIST /end MEASUREMENT
/begin MEASUREMENT vINJMON "The cylinder which usually did an injection" UBYTE COMP_0421 1 100 0 255 ECU_ADDRESS 0xFFFF205D /begin FUNCTION_LIST /end FUNCTION_LIST /end MEASUREMENT
/begin MEASUREMENT vINJVBNG "Injector circuit VB Short NG flag" UBYTE COMP_0283 1 100 0 255 ECU_ADDRESS 0xFFFFA49E /begin FUNCTION_LIST /end FUNCTION_LIST /end MEASUREMENT
/begin MEASUREMENT vINJVLMX1 "Verlog Injection Datum NO.1" UBYTE COMP_0068 1 100 0 255 ECU_ADDRESS 0xFFFF3DBC /begin FUNCTION_LIST /end FUNCTION_LIST /end MEASUREMENT
/begin MEASUREMENT vINJVLMX2 "Verlog Injection Datum NO.2" UBYTE COMP_0068 1 100 0 255 ECU_ADDRESS 0xFFFF3DBD /begin FUNCTION_LIST /end FUNCTION_LIST /end MEASUREMENT
/begin MEASUREMENT vINJVLMX3 "Verlog Injection Datum NO.3" UBYTE COMP_0068 1 100 0 255 ECU_ADDRESS 0xFFFF3DBE /begin FUNCTION_LIST /end FUNCTION_LIST /end MEASUREMENT
/begin MEASUREMENT vINJVLMX4 "Verlog Injection Datum NO.4" UBYTE COMP_0068 1 100 0 255 ECU_ADDRESS 0xFFFF3DBF /begin FUNCTION_LIST /end FUNCTION_LIST /end MEASUREMENT
/begin MEASUREMENT vINJVLMX5 "Verlog Injection Datum NO.5" UBYTE COMP_0068 1 100 0 255 ECU_ADDRESS 0xFFFF3DC0 /begin FUNCTION_LIST /end FUNCTION_LIST /end MEASUREMENT
/begin MEASUREMENT vINJVLMX6 "Verlog Injection Datum NO.6" UBYTE COMP_0068 1 100 0 255 ECU_ADDRESS 0xFFFF3DC1 /begin FUNCTION_LIST /end FUNCTION_LIST /end MEASUREMENT
/begin MEASUREMENT vINJVLMX7 "Verlog Injection Datum NO.7" UBYTE COMP_0068 1 100 0 255 ECU_ADDRESS 0xFFFF3DC2 /begin FUNCTION_LIST /end FUNCTION_LIST /end MEASUREMENT
/begin MEASUREMENT vINPOS10 "At the time of the POS10 signal interruption, micro-computer timer value (timer1)" UWORD COMP_0189 1 100 0 209712 ECU_ADDRESS 0xFFFF1470 /begin FUNCTION_LIST /end FUNCTION_LIST /end MEASUREMENT
/begin MEASUREMENT vINPOS10D "At the time of the POS10 signal interruption, micro-computer timer value (timer1)" ULONG COMP_0376 1 100 0 429496729.5 ECU_ADDRESS 0xFFFF2060 /begin FUNCTION_LIST /end FUNCTION_LIST /end MEASUREMENT
/begin MEASUREMENT vINTGSTPf "An integral stop flag" UBYTE COMP_0004 1 100 0 255 ECU_ADDRESS 0xFFFF2E60 /begin FUNCTION_LIST /end FUNCTION_LIST /end MEASUREMENT
/begin MEASUREMENT vINTPA "A timer for the atomospheric pressure monitor" UBYTE COMP_0096 1 100 0 2550 ECU_ADDRESS 0xFFFF1474 /begin FUNCTION_LIST /end FUNCTION_LIST /end MEASUREMENT
/begin MEASUREMENT vINVALTIM "INTVAL# pulse width measuring counter" UBYTE COMP_0053 1 100 0 255 ECU_ADDRESS 0xFFFF1D1C /begin FUNCTION_LIST /end FUNCTION_LIST /end MEASUREMENT
/begin MEASUREMENT vIOCLID "DIAGCAN The ID data that I/O Control is local" UBYTE COMP_0004 1 100 0 255 ECU_ADDRESS 0xFFFF380F /begin FUNCTION_LIST /end FUNCTION_LIST /end MEASUREMENT
/begin MEASUREMENT vIOCLIDZ "DIAGCAN The ID data that I/O Control I/O is local" UBYTE COMP_0004 1 100 0 255 ECU_ADDRESS 0xFFFF3DC3 /begin FUNCTION_LIST /end FUNCTION_LIST /end MEASUREMENT
/begin MEASUREMENT vIOLIDTBL "DIAGCAN The ID data that I/O Control is local" UBYTE COMP_0004 1 100 0 255 ECU_ADDRESS 0xFFFF3DC4 /begin FUNCTION_LIST /end FUNCTION_LIST /end MEASUREMENT
/begin MEASUREMENT vIOLIDTBL_R#1 "DIAGCAN The ID data that I/O Control is local" UBYTE COMP_0004 1 100 0 255 ECU_ADDRESS 0xFFFF3DC4 /begin FUNCTION_LIST /end FUNCTION_LIST /end MEASUREMENT
/begin MEASUREMENT vIOLIDTBL_R#2 "DIAGCAN The ID data that I/O Control is local" UBYTE COMP_0004 1 100 0 255 ECU_ADDRESS 0xFFFF3DC5 /begin FUNCTION_LIST /end FUNCTION_LIST /end MEASUREMENT
/begin MEASUREMENT vIOLIDTBL_R#3 "DIAGCAN The ID data that I/O Control is local" UBYTE COMP_0004 1 100 0 255 ECU_ADDRESS 0xFFFF3DC6 /begin FUNCTION_LIST /end FUNCTION_LIST /end MEASUREMENT
/begin MEASUREMENT vIOLIDTBL_R#4 "DIAGCAN The ID data that I/O Control is local" UBYTE COMP_0004 1 100 0 255 ECU_ADDRESS 0xFFFF3DC7 /begin FUNCTION_LIST /end FUNCTION_LIST /end MEASUREMENT
/begin MEASUREMENT vIOLIDTBL_R#5 "DIAGCAN The ID data that I/O Control is local" UBYTE COMP_0004 1 100 0 255 ECU_ADDRESS 0xFFFF3DC8 /begin FUNCTION_LIST /end FUNCTION_LIST /end MEASUREMENT
/begin MEASUREMENT vIOLIDTBL_R#6 "DIAGCAN The ID data that I/O Control is local" UBYTE COMP_0004 1 100 0 255 ECU_ADDRESS 0xFFFF3DC9 /begin FUNCTION_LIST /end FUNCTION_LIST /end MEASUREMENT
/begin MEASUREMENT vIOLIDTBL_R#7 "DIAGCAN The ID data that I/O Control is local" UBYTE COMP_0004 1 100 0 255 ECU_ADDRESS 0xFFFF3DCA /begin FUNCTION_LIST /end FUNCTION_LIST /end MEASUREMENT
/begin MEASUREMENT vIOLIDTBL_R#8 "DIAGCAN The ID data that I/O Control is local" UBYTE COMP_0004 1 100 0 255 ECU_ADDRESS 0xFFFF3DCB /begin FUNCTION_LIST /end FUNCTION_LIST /end MEASUREMENT
/begin MEASUREMENT vIOLIDTBL_R#9 "DIAGCAN The ID data that I/O Control is local" UBYTE COMP_0004 1 100 0 255 ECU_ADDRESS 0xFFFF3DCC /begin FUNCTION_LIST /end FUNCTION_LIST /end MEASUREMENT
/begin MEASUREMENT vIOLIDTBL_R#10 "DIAGCAN The ID data that I/O Control is local" UBYTE COMP_0004 1 100 0 255 ECU_ADDRESS 0xFFFF3DCD /begin FUNCTION_LIST /end FUNCTION_LIST /end MEASUREMENT
/begin MEASUREMENT vIOLIDTBL_R#11 "DIAGCAN The ID data that I/O Control is local" UBYTE COMP_0004 1 100 0 255 ECU_ADDRESS 0xFFFF3DCE /begin FUNCTION_LIST /end FUNCTION_LIST /end MEASUREMENT
/begin MEASUREMENT vIOLIDTBL_R#12 "DIAGCAN The ID data that I/O Control is local" UBYTE COMP_0004 1 100 0 255 ECU_ADDRESS 0xFFFF3DCF /begin FUNCTION_LIST /end FUNCTION_LIST /end MEASUREMENT
/begin MEASUREMENT vIOLIDTBL_R#13 "DIAGCAN The ID data that I/O Control is local" UBYTE COMP_0004 1 100 0 255 ECU_ADDRESS 0xFFFF3DD0 /begin FUNCTION_LIST /end FUNCTION_LIST /end MEASUREMENT
/begin MEASUREMENT vIOLIDTBL_R#14 "DIAGCAN The ID data that I/O Control is local" UBYTE COMP_0004 1 100 0 255 ECU_ADDRESS 0xFFFF3DD1 /begin FUNCTION_LIST /end FUNCTION_LIST /end MEASUREMENT
/begin MEASUREMENT vIOLIDTBL_R#15 "DIAGCAN The ID data that I/O Control is local" UBYTE COMP_0004 1 100 0 255 ECU_ADDRESS 0xFFFF3DD2 /begin FUNCTION_LIST /end FUNCTION_LIST /end MEASUREMENT
/begin MEASUREMENT vIOLIDTBL_R#16 "DIAGCAN The ID data that I/O Control is local" UBYTE COMP_0004 1 100 0 255 ECU_ADDRESS 0xFFFF3DD3 /begin FUNCTION_LIST /end FUNCTION_LIST /end MEASUREMENT
/begin MEASUREMENT vIOSTS "DiagOnCAN IOCBLID executive status" UBYTE COMP_0004 1 100 0 255 ECU_ADDRESS 0xFFFF3DD4 /begin FUNCTION_LIST /end FUNCTION_LIST /end MEASUREMENT
/begin MEASUREMENT vIREFS_1 "The sign of IREF_1" UBYTE COMP_0004 1 100 0 255 ECU_ADDRESS 0xFFFF36A8 /begin FUNCTION_LIST /end FUNCTION_LIST /end MEASUREMENT
/begin MEASUREMENT vIREFS_2 "The sign of IREF_2" UBYTE COMP_0004 1 100 0 255 ECU_ADDRESS 0xFFFF36A9 /begin FUNCTION_LIST /end FUNCTION_LIST /end MEASUREMENT
/begin MEASUREMENT vIREFS_3 "The sign of IREF_3" UBYTE COMP_0004 1 100 0 255 ECU_ADDRESS 0xFFFF36AA /begin FUNCTION_LIST /end FUNCTION_LIST /end MEASUREMENT
/begin MEASUREMENT vIREFS_4 "The sign of IREF_4" UBYTE COMP_0004 1 100 0 255 ECU_ADDRESS 0xFFFF36AB /begin FUNCTION_LIST /end FUNCTION_LIST /end MEASUREMENT
/begin MEASUREMENT vIREF_1 "A variable for robust compensator H output computation" ULONG COMP_0178_S 1 100 0 16385.300230425 ECU_ADDRESS 0xFFFF3698 /begin FUNCTION_LIST /end FUNCTION_LIST /end MEASUREMENT
/begin MEASUREMENT vIREF_2 "A variable for robust compensator H output computation" ULONG COMP_0178_S 1 100 0 16385.300230425 ECU_ADDRESS 0xFFFF369C /begin FUNCTION_LIST /end FUNCTION_LIST /end MEASUREMENT
/begin MEASUREMENT vIREF_3 "A variable for robust compensator H output computation" ULONG COMP_0178_S 1 100 0 16385.300230425 ECU_ADDRESS 0xFFFF36A0 /begin FUNCTION_LIST /end FUNCTION_LIST /end MEASUREMENT
/begin MEASUREMENT vIREF_4 "A variable for robust compensator H output computation" ULONG COMP_0178_S 1 100 0 16385.300230425 ECU_ADDRESS 0xFFFF36A4 /begin FUNCTION_LIST /end FUNCTION_LIST /end MEASUREMENT
/begin MEASUREMENT vIRbuf "Control registor buffer" UWORD COMP_0004 1 100 0 65535 ECU_ADDRESS 0xFFFF3DD6 /begin FUNCTION_LIST /end FUNCTION_LIST /end MEASUREMENT
/begin MEASUREMENT vISCLRC0 "Idle speed learning operation value" SWORD COMP_0106_S 1 100 -128 127.99609375 ECU_ADDRESS 0xFFFFA4AC /begin FUNCTION_LIST /end FUNCTION_LIST /end MEASUREMENT
/begin MEASUREMENT vISCLRC1 "Idle speed learning value" SBYTE COMP_0277 1 100 -128 127 ECU_ADDRESS 0xFFFF1482 /begin FUNCTION_LIST /end FUNCTION_LIST /end MEASUREMENT
/begin MEASUREMENT vISCLRC2 "Idle speed learning value" SBYTE COMP_0277 1 100 -128 127 ECU_ADDRESS 0xFFFFA4B4 /begin FUNCTION_LIST /end FUNCTION_LIST /end MEASUREMENT
/begin MEASUREMENT vISCLRCBZ "Idle speed learning value (previous value)" SWORD COMP_0277 1 100 -32768 32767 ECU_ADDRESS 0xFFFF1486 /begin FUNCTION_LIST /end FUNCTION_LIST /end MEASUREMENT
/begin MEASUREMENT vISCLRCZ1 "Idle speed learning value" SBYTE COMP_0277 1 100 -128 127 ECU_ADDRESS 0xFFFF1490 /begin FUNCTION_LIST /end FUNCTION_LIST /end MEASUREMENT
/begin MEASUREMENT vISCSTM "At the time of the start, the amount of ISC compensation" UBYTE COMP_0293 1 100 0 510 ECU_ADDRESS 0xFFFF14A4 /begin FUNCTION_LIST /end FUNCTION_LIST /end MEASUREMENT
/begin MEASUREMENT vISCSTM_R "The amount of ISC compensation at the time of starting (enlarged)" UWORD COMP_0293 1 100 0 131070 ECU_ADDRESS 0xFFFF14A6 /begin FUNCTION_LIST /end FUNCTION_LIST /end MEASUREMENT
/begin MEASUREMENT vISLRCOLD "Idle speed learning previous value" SBYTE COMP_0277 1 100 -128 127 ECU_ADDRESS 0xFFFF14AA /begin FUNCTION_LIST /end FUNCTION_LIST /end MEASUREMENT
/begin MEASUREMENT vISLRCOLD0 "Idle speed learning previous value" SWORD COMP_0106_S 1 100 -128 127.99609375 ECU_ADDRESS 0xFFFF14AC /begin FUNCTION_LIST /end FUNCTION_LIST /end MEASUREMENT
/begin MEASUREMENT vISRINT0 "At the time of the initial, ISCLRC0" SWORD COMP_0106_S 1 100 -128 127.99609375 ECU_ADDRESS 0xFFFF14AE /begin FUNCTION_LIST /end FUNCTION_LIST /end MEASUREMENT
/begin MEASUREMENT vISRINT01 "At the time of the initial, ISCLRC01" SLONG COMP_0602_S 1 100 -32768.0234881024 32768.0234728436 ECU_ADDRESS 0xFFFF14B0 /begin FUNCTION_LIST /end FUNCTION_LIST /end MEASUREMENT
/begin MEASUREMENT vITEROMB "Combustion efficiency compensation coefficient adjustment mode EEP-ROM reading buffer" UWORD COMP_0009 1 100 0 51199.21875 ECU_ADDRESS 0xFFFF2E68 /begin FUNCTION_LIST /end FUNCTION_LIST /end MEASUREMENT
/begin MEASUREMENT vITINIT "Combustion efficiency compensation coefficient adjustment value evacuation value" UBYTE COMP_0009 1 100 0 199.21875 ECU_ADDRESS 0xFFFF2E6A /begin FUNCTION_LIST /end FUNCTION_LIST /end MEASUREMENT
/begin MEASUREMENT vITPQLS "Low speed air learning value (reversal value)" UWORD COMP_0131 1 100 0 1279.98046875 ECU_ADDRESS 0xFFFFA4BA /begin FUNCTION_LIST /end FUNCTION_LIST /end MEASUREMENT
/begin MEASUREMENT vIVSPCOMN "Vehicle speed order value mirror value" SLONG COMP_0209_S 1 100 -1843.20024746394 1843.20024660563 ECU_ADDRESS 0xFFFF41FC /begin FUNCTION_LIST /end FUNCTION_LIST /end MEASUREMENT
/begin MEASUREMENT vJUGCNTf "STRAG operation" UBYTE COMP_0004 1 100 0 255 ECU_ADDRESS 0xFFFF2E76 /begin FUNCTION_LIST /end FUNCTION_LIST /end MEASUREMENT
/begin MEASUREMENT vKAFCUT "At the time of the fuel cut, compensation coefficient" UBYTE COMP_0388 1 100 0 25.5 ECU_ADDRESS 0xFFFF3DD8 /begin FUNCTION_LIST /end FUNCTION_LIST /end MEASUREMENT
/begin MEASUREMENT vKAPS1BK "APS1 movement average number of times" UWORD COMP_0004 1 100 0 65535 ECU_ADDRESS 0xFFFF3DDA /begin FUNCTION_LIST /end FUNCTION_LIST /end MEASUREMENT
/begin MEASUREMENT vKAPS2BK "APS2 movement average number of times" UWORD COMP_0004 1 100 0 65535 ECU_ADDRESS 0xFFFF3DDC /begin FUNCTION_LIST /end FUNCTION_LIST /end MEASUREMENT
/begin MEASUREMENT vKBLRC0 "Region learning value" UWORD COMP_0031 1 100 0 255.99609375 ECU_ADDRESS 0xFFFF14C0 /begin FUNCTION_LIST /end FUNCTION_LIST /end MEASUREMENT
/begin MEASUREMENT vKCKMIN "CKKRPM judgement time" UBYTE COMP_0014 1 100 0 2550 ECU_ADDRESS 0xFFFFB60A /begin FUNCTION_LIST /end FUNCTION_LIST /end MEASUREMENT
/begin MEASUREMENT vKDBIDX "(Knock detection inside variable)" UBYTE COMP_0004 1 100 0 255 ECU_ADDRESS 0xFFFF2064 /begin FUNCTION_LIST /end FUNCTION_LIST /end MEASUREMENT
/begin MEASUREMENT vKDGROMAD "ROM operation address" ULONG COMP_0068 1 100 0 4294967295 ECU_ADDRESS 0xFFFF2E7C /begin FUNCTION_LIST /end FUNCTION_LIST /end MEASUREMENT
/begin MEASUREMENT vKDSPWR "Normalized pedal pushing quantity filter weight coefficient MAP reference value" UBYTE COMP_0063 1 100 0 0.99609375 ECU_ADDRESS 0xFFFF2E80 /begin FUNCTION_LIST /end FUNCTION_LIST /end MEASUREMENT
/begin MEASUREMENT vKDVTCE "D gain" UBYTE COMP_0027 1 100 0 255 ECU_ADDRESS 0xFFFF14C8 /begin FUNCTION_LIST /end FUNCTION_LIST /end MEASUREMENT
/begin MEASUREMENT vKDVTCE_R#1 "D gain" UBYTE COMP_0027 1 100 0 255 ECU_ADDRESS 0xFFFF14C8 /begin FUNCTION_LIST /end FUNCTION_LIST /end MEASUREMENT
/begin MEASUREMENT vKDVTCE_R#2 "D gain" UBYTE COMP_0027 1 100 0 255 ECU_ADDRESS 0xFFFF14C9 /begin FUNCTION_LIST /end FUNCTION_LIST /end MEASUREMENT
/begin MEASUREMENT vKDVTCI "D gain" UBYTE COMP_0027 1 100 0 255 ECU_ADDRESS 0xFFFF14CA /begin FUNCTION_LIST /end FUNCTION_LIST /end MEASUREMENT
/begin MEASUREMENT vKDVTCI_R#1 "D gain" UBYTE COMP_0027 1 100 0 255 ECU_ADDRESS 0xFFFF14CA /begin FUNCTION_LIST /end FUNCTION_LIST /end MEASUREMENT
/begin MEASUREMENT vKDVTCI_R#2 "D gain" UBYTE COMP_0027 1 100 0 255 ECU_ADDRESS 0xFFFF14CB /begin FUNCTION_LIST /end FUNCTION_LIST /end MEASUREMENT
/begin MEASUREMENT vKINSIf "Prohibition of STRAG operation" UBYTE COMP_0004 1 100 0 255 ECU_ADDRESS 0xFFFF26E6 /begin FUNCTION_LIST /end FUNCTION_LIST /end MEASUREMENT
/begin MEASUREMENT vKITAEGR0 "EGR At the time of ON/ off, combustion efficiency compensation basic value" UBYTE COMP_0009 1 100 0 199.21875 ECU_ADDRESS 0xFFFF14D4 /begin FUNCTION_LIST /end FUNCTION_LIST /end MEASUREMENT
/begin MEASUREMENT vKITAEGR1 "EGR At the time of ON/ off, in front of the combustion efficiency compensation value lower limit limiter, value" UBYTE COMP_0009 1 100 0 199.21875 ECU_ADDRESS 0xFFFF14D5 /begin FUNCTION_LIST /end FUNCTION_LIST /end MEASUREMENT
/begin MEASUREMENT vKITAEGR2 "EGR At the time of ON/ off, combustion efficiency compensation value lower limit treatment value" UBYTE COMP_0009 1 100 0 199.21875 ECU_ADDRESS 0xFFFF14D6 /begin FUNCTION_LIST /end FUNCTION_LIST /end MEASUREMENT
/begin MEASUREMENT vKNCYLC "Reference position renewal cylinder distinction value for the knock" UBYTE COMP_0068 1 100 0 255 ECU_ADDRESS 0xFFFF20E7 /begin FUNCTION_LIST /end FUNCTION_LIST /end MEASUREMENT
/begin MEASUREMENT vKNFILR1 "The knock-fail voltage 1VCC adjustment-less-ization front" UBYTE COMP_0054 1 100 0 5100 ECU_ADDRESS 0xFFFF406F /begin FUNCTION_LIST /end FUNCTION_LIST /end MEASUREMENT
/begin MEASUREMENT vKNFILR2 "The knock-fail voltage 2VCC adjustment-less-ization front" UBYTE COMP_0054 1 100 0 5100 ECU_ADDRESS 0xFFFF4070 /begin FUNCTION_LIST /end FUNCTION_LIST /end MEASUREMENT
/begin MEASUREMENT vKNXOFS "For the NOx concentration estimated offset" UBYTE COMP_0115_S 1 100 -512 508 ECU_ADDRESS 0xFFFF14E9 /begin FUNCTION_LIST /end FUNCTION_LIST /end MEASUREMENT
/begin MEASUREMENT vKPB "The difference pressure compensation coefficient" UBYTE COMP_0246 1 100 0 1593.75 ECU_ADDRESS 0xFFFF14EA /begin FUNCTION_LIST /end FUNCTION_LIST /end MEASUREMENT
/begin MEASUREMENT vKPIP "Atomospheric pressure compensation coefficient" UBYTE COMP_0027 1 100 0 255 ECU_ADDRESS 0xFFFF409B /begin FUNCTION_LIST /end FUNCTION_LIST /end MEASUREMENT
/begin MEASUREMENT vKPVTCE "P-gain gain" UBYTE COMP_0027 1 100 0 255 ECU_ADDRESS 0xFFFF14ED /begin FUNCTION_LIST /end FUNCTION_LIST /end MEASUREMENT
/begin MEASUREMENT vKPVTCE_R#1 "P-gain gain" UBYTE COMP_0027 1 100 0 255 ECU_ADDRESS 0xFFFF14ED /begin FUNCTION_LIST /end FUNCTION_LIST /end MEASUREMENT
/begin MEASUREMENT vKPVTCE_R#2 "P-gain gain" UBYTE COMP_0027 1 100 0 255 ECU_ADDRESS 0xFFFF14EE /begin FUNCTION_LIST /end FUNCTION_LIST /end MEASUREMENT
/begin MEASUREMENT vKPVTCI "P-gain gain" UBYTE COMP_0027 1 100 0 255 ECU_ADDRESS 0xFFFF14EF /begin FUNCTION_LIST /end FUNCTION_LIST /end MEASUREMENT
/begin MEASUREMENT vKPVTCI_R#1 "P-gain gain" UBYTE COMP_0027 1 100 0 255 ECU_ADDRESS 0xFFFF14EF /begin FUNCTION_LIST /end FUNCTION_LIST /end MEASUREMENT
/begin MEASUREMENT vKPVTCI_R#2 "P-gain gain" UBYTE COMP_0027 1 100 0 255 ECU_ADDRESS 0xFFFF14F0 /begin FUNCTION_LIST /end FUNCTION_LIST /end MEASUREMENT
/begin MEASUREMENT vKROMDIV "The operation number of times of an APP one time" ULONG COMP_0068 1 100 0 4294967295 ECU_ADDRESS 0xFFFF2E88 /begin FUNCTION_LIST /end FUNCTION_LIST /end MEASUREMENT
/begin MEASUREMENT vKRPM10 "Engine speed MainCPU" UWORD COMP_0064 1 100 0 102398.4375 ECU_ADDRESS 0xFFFF1EBC /begin FUNCTION_LIST /end FUNCTION_LIST /end MEASUREMENT
/begin MEASUREMENT vKSR "A former compensated knock index number" SLONG COMP_0415 1 100 -8388608 8388607.99609375 ECU_ADDRESS 0xFFFF219C /begin FUNCTION_LIST /end FUNCTION_LIST /end MEASUREMENT
/begin MEASUREMENT vKSR_R#1 "A former compensated knock index number" SLONG COMP_0415 1 100 -8388608 8388607.99609375 ECU_ADDRESS 0xFFFF219C /begin FUNCTION_LIST /end FUNCTION_LIST /end MEASUREMENT
/begin MEASUREMENT vKSR_R#2 "A former compensated knock index number" SLONG COMP_0415 1 100 -8388608 8388607.99609375 ECU_ADDRESS 0xFFFF21A0 /begin FUNCTION_LIST /end FUNCTION_LIST /end MEASUREMENT
/begin MEASUREMENT vKSR_R#3 "A former compensated knock index number" SLONG COMP_0415 1 100 -8388608 8388607.99609375 ECU_ADDRESS 0xFFFF21A4 /begin FUNCTION_LIST /end FUNCTION_LIST /end MEASUREMENT
/begin MEASUREMENT vKSR_R#4 "A former compensated knock index number" SLONG COMP_0415 1 100 -8388608 8388607.99609375 ECU_ADDRESS 0xFFFF21A8 /begin FUNCTION_LIST /end FUNCTION_LIST /end MEASUREMENT
/begin MEASUREMENT vKSR_R#5 "A former compensated knock index number" SLONG COMP_0415 1 100 -8388608 8388607.99609375 ECU_ADDRESS 0xFFFF21AC /begin FUNCTION_LIST /end FUNCTION_LIST /end MEASUREMENT
/begin MEASUREMENT vKSR_R#6 "A former compensated knock index number" SLONG COMP_0415 1 100 -8388608 8388607.99609375 ECU_ADDRESS 0xFFFF21B0 /begin FUNCTION_LIST /end FUNCTION_LIST /end MEASUREMENT
/begin MEASUREMENT vKSR_R#7 "A former compensated knock index number" SLONG COMP_0415 1 100 -8388608 8388607.99609375 ECU_ADDRESS 0xFFFF21B4 /begin FUNCTION_LIST /end FUNCTION_LIST /end MEASUREMENT
/begin MEASUREMENT vKSR_R#8 "A former compensated knock index number" SLONG COMP_0415 1 100 -8388608 8388607.99609375 ECU_ADDRESS 0xFFFF21B8 /begin FUNCTION_LIST /end FUNCTION_LIST /end MEASUREMENT
/begin MEASUREMENT vKTETXD "First-ordered filter weight coefficient" UWORD COMP_0604_S 1 100 0 0.999985458 ECU_ADDRESS 0xFFFF1502 /begin FUNCTION_LIST /end FUNCTION_LIST /end MEASUREMENT
/begin MEASUREMENT vKUDCNTEf "Parameter acquisition permission flag" UBYTE COMP_0004 1 100 0 255 ECU_ADDRESS 0xFFFF1509 /begin FUNCTION_LIST /end FUNCTION_LIST /end MEASUREMENT
/begin MEASUREMENT vKUDCNTI "Parameter acquisition counter" UWORD COMP_0030 1 100 0 65535 ECU_ADDRESS 0xFFFFA4BE /begin FUNCTION_LIST /end FUNCTION_LIST /end MEASUREMENT
/begin MEASUREMENT vKUDCNTI_R#1 "Parameter acquisition counter" UWORD COMP_0030 1 100 0 65535 ECU_ADDRESS 0xFFFFA4BE /begin FUNCTION_LIST /end FUNCTION_LIST /end MEASUREMENT
/begin MEASUREMENT vKUDCNTI_R#2 "Parameter acquisition counter" UWORD COMP_0030 1 100 0 65535 ECU_ADDRESS 0xFFFFA4C0 /begin FUNCTION_LIST /end FUNCTION_LIST /end MEASUREMENT
/begin MEASUREMENT vKUPDTYN "KUPDTY* operation number of times" UWORD COMP_0433_S 1 100 0 6553.5 ECU_ADDRESS 0xFFFF1EC0 /begin FUNCTION_LIST /end FUNCTION_LIST /end MEASUREMENT
/begin MEASUREMENT vKUPDTYT "KUPDTY* operation number of times" UWORD COMP_0433_S 1 100 0 6553.5 ECU_ADDRESS 0xFFFF3DE0 /begin FUNCTION_LIST /end FUNCTION_LIST /end MEASUREMENT
/begin MEASUREMENT vKVBHOS "The VB compensation coefficient of the duty" UBYTE COMP_0373 1 100 0 2.55 ECU_ADDRESS 0xFFFF3DE4 /begin FUNCTION_LIST /end FUNCTION_LIST /end MEASUREMENT
/begin MEASUREMENT vKVTNWE "VTC operation angle computed weighted average coefficient" UBYTE COMP_0063 1 100 0 0.99609375 ECU_ADDRESS 0xFFFF150B /begin FUNCTION_LIST /end FUNCTION_LIST /end MEASUREMENT
/begin MEASUREMENT vKVTNWI "VTC operation angle computed weighted average coefficient" UBYTE COMP_0063 1 100 0 0.99609375 ECU_ADDRESS 0xFFFF150C /begin FUNCTION_LIST /end FUNCTION_LIST /end MEASUREMENT
/begin MEASUREMENT vLADVTR0H "At the time of the SCV open, trimming-map compensation value high-octane" UBYTE COMP_0245 1 100 -64 191 ECU_ADDRESS 0xFFFF150D /begin FUNCTION_LIST /end FUNCTION_LIST /end MEASUREMENT
/begin MEASUREMENT vLADVTR1H "At the time of the SCV close, trimming-map compensation value high-octane" UBYTE COMP_0245 1 100 -64 191 ECU_ADDRESS 0xFFFF150E /begin FUNCTION_LIST /end FUNCTION_LIST /end MEASUREMENT
/begin MEASUREMENT vLADVTRM "Trimming-map compensation value" UBYTE COMP_0245 1 100 -64 191 ECU_ADDRESS 0xFFFF150F /begin FUNCTION_LIST /end FUNCTION_LIST /end MEASUREMENT
/begin MEASUREMENT vLADVTRM0 "At the time of the SCV open, trimming-map compensation value" UBYTE COMP_0245 1 100 -64 191 ECU_ADDRESS 0xFFFF1510 /begin FUNCTION_LIST /end FUNCTION_LIST /end MEASUREMENT
/begin MEASUREMENT vLADVTRM1 "At the time of the SCV close, trimming-map compensation value" UBYTE COMP_0245 1 100 -64 191 ECU_ADDRESS 0xFFFF1511 /begin FUNCTION_LIST /end FUNCTION_LIST /end MEASUREMENT
/begin MEASUREMENT vLADVTRMH "Trimming-map compensation value high-octane" UBYTE COMP_0245 1 100 -64 191 ECU_ADDRESS 0xFFFF1512 /begin FUNCTION_LIST /end FUNCTION_LIST /end MEASUREMENT
/begin MEASUREMENT vLANTPO "Engine torque equivalent signal" UBYTE COMP_0001 1 100 0 31.875 ECU_ADDRESS 0xFFFF4200 /begin FUNCTION_LIST /end FUNCTION_LIST /end MEASUREMENT
/begin MEASUREMENT vLAONf "In the lambda point compensation mode, flag" UBYTE COMP_0004 1 100 0 255 ECU_ADDRESS 0xFFFF3DE6 /begin FUNCTION_LIST /end FUNCTION_LIST /end MEASUREMENT
/begin MEASUREMENT vLATRGE "Target angle latch" UBYTE COMP_0256 1 100 -64 63.5 ECU_ADDRESS 0xFFFF1513 /begin FUNCTION_LIST /end FUNCTION_LIST /end MEASUREMENT
/begin MEASUREMENT vLATRGE_R#1 "Target angle latch" UBYTE COMP_0256 1 100 -64 63.5 ECU_ADDRESS 0xFFFF1513 /begin FUNCTION_LIST /end FUNCTION_LIST /end MEASUREMENT
/begin MEASUREMENT vLATRGE_R#2 "Target angle latch" UBYTE COMP_0256 1 100 -64 63.5 ECU_ADDRESS 0xFFFF1514 /begin FUNCTION_LIST /end FUNCTION_LIST /end MEASUREMENT
/begin MEASUREMENT vLATRGI "Target angle latch" UBYTE COMP_0256 1 100 -64 63.5 ECU_ADDRESS 0xFFFF1515 /begin FUNCTION_LIST /end FUNCTION_LIST /end MEASUREMENT
/begin MEASUREMENT vLATRGI_R#1 "Target angle latch" UBYTE COMP_0256 1 100 -64 63.5 ECU_ADDRESS 0xFFFF1515 /begin FUNCTION_LIST /end FUNCTION_LIST /end MEASUREMENT
/begin MEASUREMENT vLATRGI_R#2 "Target angle latch" UBYTE COMP_0256 1 100 -64 63.5 ECU_ADDRESS 0xFFFF1516 /begin FUNCTION_LIST /end FUNCTION_LIST /end MEASUREMENT
/begin MEASUREMENT vLEAKAC "A temporary leak hole area" UWORD COMP_0550_S 1 100 0 1.999970916 ECU_ADDRESS 0xFFFF2E9A /begin FUNCTION_LIST /end FUNCTION_LIST /end MEASUREMENT
/begin MEASUREMENT vLEANIf "After the lean, rich-shift control judgement" UBYTE COMP_0004 1 100 0 255 ECU_ADDRESS 0xFFFF1517 /begin FUNCTION_LIST /end FUNCTION_LIST /end MEASUREMENT
/begin MEASUREMENT vLEARNJf "Lean switchover prohibition condition (It is not a closed-loop.) flag" UBYTE COMP_0004 1 100 0 255 ECU_ADDRESS 0xFFFF2E9C /begin FUNCTION_LIST /end FUNCTION_LIST /end MEASUREMENT
/begin MEASUREMENT vLEDCNT "At the time of the engine stall, a MIL flashing time measure timer for ÉÇÅ[Ég 2" UBYTE COMP_0008 1 100 0 25500 ECU_ADDRESS 0xFFFF2E9D /begin FUNCTION_LIST /end FUNCTION_LIST /end MEASUREMENT
/begin MEASUREMENT vLEDPAT "MIL flashing data" UWORD COMP_0092 1 100 0 65535 ECU_ADDRESS 0xFFFF1EC4 /begin FUNCTION_LIST /end FUNCTION_LIST /end MEASUREMENT
/begin MEASUREMENT vLEDPAT_R#1 "MIL flashing data" UWORD COMP_0092 1 100 0 65535 ECU_ADDRESS 0xFFFF1EC4 /begin FUNCTION_LIST /end FUNCTION_LIST /end MEASUREMENT
/begin MEASUREMENT vLEDPAT_R#2 "MIL flashing data" UWORD COMP_0092 1 100 0 65535 ECU_ADDRESS 0xFFFF1EC6 /begin FUNCTION_LIST /end FUNCTION_LIST /end MEASUREMENT
/begin MEASUREMENT vLEDPAT_R#3 "MIL flashing data" UWORD COMP_0092 1 100 0 65535 ECU_ADDRESS 0xFFFF1EC8 /begin FUNCTION_LIST /end FUNCTION_LIST /end MEASUREMENT
/begin MEASUREMENT vLEDPAT_R#4 "MIL flashing data" UWORD COMP_0092 1 100 0 65535 ECU_ADDRESS 0xFFFF1ECA /begin FUNCTION_LIST /end FUNCTION_LIST /end MEASUREMENT
/begin MEASUREMENT vLEDSTG "At the time of the engine stop, MIL lighting treatment condition" UBYTE COMP_0068 1 100 0 255 ECU_ADDRESS 0xFFFF1ECC /begin FUNCTION_LIST /end FUNCTION_LIST /end MEASUREMENT
/begin MEASUREMENT vLEKAL3 "An evapo leak diagnosis parameter for 0.02inch" UWORD COMP_0550_S 1 100 0 1.999970916 ECU_ADDRESS 0xFFFF2E9E /begin FUNCTION_LIST /end FUNCTION_LIST /end MEASUREMENT
/begin MEASUREMENT vLEKCNT2 "At the time of the cold start condition relaxation, evapo leak diagnosis complete number of times counter" UWORD COMP_0016 1 100 0 65535 ECU_ADDRESS 0xFFFFA4C6 /begin FUNCTION_LIST /end FUNCTION_LIST /end MEASUREMENT
/begin MEASUREMENT vLEKCNT3 "At the time of the cold start condition, evapo leak diagnosis complete number of times counter" UWORD COMP_0016 1 100 0 65535 ECU_ADDRESS 0xFFFFA4C8 /begin FUNCTION_LIST /end FUNCTION_LIST /end MEASUREMENT
/begin MEASUREMENT vLEKM "Imaginary leak-down timer" UWORD COMP_0008 1 100 0 6553500 ECU_ADDRESS 0xFFFF2EA0 /begin FUNCTION_LIST /end FUNCTION_LIST /end MEASUREMENT
/begin MEASUREMENT vLEKTRP2 "A RATE law evapo leak diagnosis trip counter for LEKCNT2" UWORD COMP_0016 1 100 0 65535 ECU_ADDRESS 0xFFFFA4CC /begin FUNCTION_LIST /end FUNCTION_LIST /end MEASUREMENT
/begin MEASUREMENT vLHPDLS_S "At the time of the limphome, pedal ratio (vice-operation part)" UWORD COMP_0362_S 1 100 0 8191.875 ECU_ADDRESS 0xFFFF34F6 /begin FUNCTION_LIST /end FUNCTION_LIST /end MEASUREMENT
/begin MEASUREMENT vLJUDGEf "AFSHOS renewal permission flag" UBYTE COMP_0004 1 100 0 255 ECU_ADDRESS 0xFFFF2EAA /begin FUNCTION_LIST /end FUNCTION_LIST /end MEASUREMENT
/begin MEASUREMENT vLJUONEf "A/F sensor learning renewal flag" UBYTE COMP_0004 1 100 0 255 ECU_ADDRESS 0xFFFF2EAB /begin FUNCTION_LIST /end FUNCTION_LIST /end MEASUREMENT
/begin MEASUREMENT vLJUONHf "HOSCMAX learning renewal flag (lean)" UBYTE COMP_0004 1 100 0 255 ECU_ADDRESS 0xFFFF2EAC /begin FUNCTION_LIST /end FUNCTION_LIST /end MEASUREMENT
/begin MEASUREMENT vLL "Lower limit limitation value (QP small region)" UWORD COMP_0015 1 100 0 8191.875 ECU_ADDRESS 0xFFFF151C /begin FUNCTION_LIST /end FUNCTION_LIST /end MEASUREMENT
/begin MEASUREMENT vLLCALP1 "MLRLDM reference lattice NO." UBYTE COMP_0004 1 100 0 255 ECU_ADDRESS 0xFFFF151E /begin FUNCTION_LIST /end FUNCTION_LIST /end MEASUREMENT
/begin MEASUREMENT vLLJES0 "A change in rotation" SWORD COMP_0440 1 100 -256 255.9921875 ECU_ADDRESS 0xFFFF1524 /begin FUNCTION_LIST /end FUNCTION_LIST /end MEASUREMENT
/begin MEASUREMENT vLLJES1 "A change in rotation" SWORD COMP_0440 1 100 -256 255.9921875 ECU_ADDRESS 0xFFFF1526 /begin FUNCTION_LIST /end FUNCTION_LIST /end MEASUREMENT
/begin MEASUREMENT vLLJES2 "A change in rotation" SWORD COMP_0440 1 100 -256 255.9921875 ECU_ADDRESS 0xFFFF1528 /begin FUNCTION_LIST /end FUNCTION_LIST /end MEASUREMENT
/begin MEASUREMENT vLLSL1 "Lean-ization judgement threshold" UBYTE COMP_0103 1 100 0 7.96875 ECU_ADDRESS 0xFFFF152A /begin FUNCTION_LIST /end FUNCTION_LIST /end MEASUREMENT
/begin MEASUREMENT vLLSL2 "Rich-ization judgement threshold" UBYTE COMP_0103 1 100 0 7.96875 ECU_ADDRESS 0xFFFF152B /begin FUNCTION_LIST /end FUNCTION_LIST /end MEASUREMENT
/begin MEASUREMENT vLMDAPLf "Lambda application executive judgement" UBYTE COMP_0004 1 100 0 255 ECU_ADDRESS 0xFFFF152D /begin FUNCTION_LIST /end FUNCTION_LIST /end MEASUREMENT
/begin MEASUREMENT vLMDCLPf "Lambda control open close judgement flag (the rest O2 sensor feedback in the CLOSED LOOP control prohibition condition is ignored.)" UBYTE COMP_0004 1 100 0 255 ECU_ADDRESS 0xFFFF152E /begin FUNCTION_LIST /end FUNCTION_LIST /end MEASUREMENT
/begin MEASUREMENT vLMNR10R "Before MNRPM 100mS, memory" UBYTE COMP_0000 1 100 0 6375 ECU_ADDRESS 0xFFFF2EB2 /begin FUNCTION_LIST /end FUNCTION_LIST /end MEASUREMENT
/begin MEASUREMENT vLMTTTE "Engine torque limiter value" SWORD COMP_0228 1 100 -3276.8 3276.7 ECU_ADDRESS 0xFFFF1532 /begin FUNCTION_LIST /end FUNCTION_LIST /end MEASUREMENT
/begin MEASUREMENT vLMTTVO "(SubCPU) Target throttle open-degree upper limit value" UWORD COMP_0005 1 100 0 7208.85 ECU_ADDRESS 0xFFFF3DE8 /begin FUNCTION_LIST /end FUNCTION_LIST /end MEASUREMENT
/begin MEASUREMENT vLNCNDOKf "Learning permission condition formation flag" UBYTE COMP_0004 1 100 0 255 ECU_ADDRESS 0xFFFF1534 /begin FUNCTION_LIST /end FUNCTION_LIST /end MEASUREMENT
/begin MEASUREMENT vLNRPMOST "The 10mS front LNRPM for the soft SW" UBYTE COMP_0006 1 100 0 3187.5 ECU_ADDRESS 0xFFFF1ECD /begin FUNCTION_LIST /end FUNCTION_LIST /end MEASUREMENT
/begin MEASUREMENT vLNRPMUP "LNRPM two times continuous rise judgement flag" UBYTE COMP_0068 1 100 0 255 ECU_ADDRESS 0xFFFF21BC /begin FUNCTION_LIST /end FUNCTION_LIST /end MEASUREMENT
/begin MEASUREMENT vLNRSETf "Lean side reset flag" UBYTE COMP_0004 1 100 0 255 ECU_ADDRESS 0xFFFF2EB8 /begin FUNCTION_LIST /end FUNCTION_LIST /end MEASUREMENT
/begin MEASUREMENT vLNRSETzf "Lean side reset flag (previous value)" UBYTE COMP_0004 1 100 0 255 ECU_ADDRESS 0xFFFF2EB9 /begin FUNCTION_LIST /end FUNCTION_LIST /end MEASUREMENT
/begin MEASUREMENT vLNSTSWCNT "A LNRPM rise counter for the soft SW" UBYTE COMP_0016 1 100 0 255 ECU_ADDRESS 0xFFFF1ECE /begin FUNCTION_LIST /end FUNCTION_LIST /end MEASUREMENT
/begin MEASUREMENT vLRCQBAK "It is required to ISC learning. (a vTASLRCQ backup for engine stall éû)" UBYTE COMP_0068 1 100 0 255 ECU_ADDRESS 0xFFFF2EBE /begin FUNCTION_LIST /end FUNCTION_LIST /end MEASUREMENT
/begin MEASUREMENT vLRDNGZf "Lean rich diagnosis NG flag previous value" UBYTE COMP_0004 1 100 0 255 ECU_ADDRESS 0xFFFF2EC4 /begin FUNCTION_LIST /end FUNCTION_LIST /end MEASUREMENT
/begin MEASUREMENT vLRDOKZf "Lean rich diagnosis OK flag previous value" UBYTE COMP_0004 1 100 0 255 ECU_ADDRESS 0xFFFF2EC5 /begin FUNCTION_LIST /end FUNCTION_LIST /end MEASUREMENT
/begin MEASUREMENT vLRFO2f "It changed from the rich to the lean." UBYTE COMP_0004 1 100 0 255 ECU_ADDRESS 0xFFFF2ED0 /begin FUNCTION_LIST /end FUNCTION_LIST /end MEASUREMENT
/begin MEASUREMENT vLRLDML "Usually, LLC learning value" UWORD COMP_0271 1 100 0 199.99696053 ECU_ADDRESS 0xFFFF2ED2 /begin FUNCTION_LIST /end FUNCTION_LIST /end MEASUREMENT
/begin MEASUREMENT vLRNALP "Learning map reference value" UWORD COMP_0031 1 100 0 255.99609375 ECU_ADDRESS 0xFFFF1536 /begin FUNCTION_LIST /end FUNCTION_LIST /end MEASUREMENT
/begin MEASUREMENT vLRNALP_R#1 "Learning map reference value" UWORD COMP_0031 1 100 0 255.99609375 ECU_ADDRESS 0xFFFF1536 /begin FUNCTION_LIST /end FUNCTION_LIST /end MEASUREMENT
/begin MEASUREMENT vLRNALP_R#2 "Learning map reference value" UWORD COMP_0031 1 100 0 255.99609375 ECU_ADDRESS 0xFFFF1538 /begin FUNCTION_LIST /end FUNCTION_LIST /end MEASUREMENT
/begin MEASUREMENT vLRNALP0 "Learning map reference value" UWORD COMP_0031 1 100 0 255.99609375 ECU_ADDRESS 0xFFFF153A /begin FUNCTION_LIST /end FUNCTION_LIST /end MEASUREMENT
/begin MEASUREMENT vLRNALP0_R#1 "Learning map reference value" UWORD COMP_0031 1 100 0 255.99609375 ECU_ADDRESS 0xFFFF153A /begin FUNCTION_LIST /end FUNCTION_LIST /end MEASUREMENT
/begin MEASUREMENT vLRNALP0_R#2 "Learning map reference value" UWORD COMP_0031 1 100 0 255.99609375 ECU_ADDRESS 0xFFFF153C /begin FUNCTION_LIST /end FUNCTION_LIST /end MEASUREMENT
/begin MEASUREMENT vLRNCHGAf "Map position switching flag" UBYTE COMP_0004 1 100 0 255 ECU_ADDRESS 0xFFFF153E /begin FUNCTION_LIST /end FUNCTION_LIST /end MEASUREMENT
/begin MEASUREMENT vLRNCHGf "Damper control switching flag" UBYTE COMP_0004 1 100 0 255 ECU_ADDRESS 0xFFFF153F /begin FUNCTION_LIST /end FUNCTION_LIST /end MEASUREMENT
/begin MEASUREMENT vLRNCJOKf "A common learning permission condition judgement flag" UBYTE COMP_0004 1 100 0 255 ECU_ADDRESS 0xFFFF1540 /begin FUNCTION_LIST /end FUNCTION_LIST /end MEASUREMENT
/begin MEASUREMENT vLRNCLEARf "Learning memory RAM clear flag" UBYTE COMP_0004 1 100 0 255 ECU_ADDRESS 0xFFFF1541 /begin FUNCTION_LIST /end FUNCTION_LIST /end MEASUREMENT
/begin MEASUREMENT vLRNKAI "Progress time from key on" UBYTE COMP_0122_S 1 100 0 510 ECU_ADDRESS 0xFFFF36BA /begin FUNCTION_LIST /end FUNCTION_LIST /end MEASUREMENT
/begin MEASUREMENT vLRNRCHf "A rich/lean flag for learning" UBYTE COMP_0004 1 100 0 255 ECU_ADDRESS 0xFFFF1542 /begin FUNCTION_LIST /end FUNCTION_LIST /end MEASUREMENT
/begin MEASUREMENT vLRNSELf "Learning is beaten down, it is changed, flag" UBYTE COMP_0004 1 100 0 255 ECU_ADDRESS 0xFFFF1021 /begin FUNCTION_LIST /end FUNCTION_LIST /end MEASUREMENT
/begin MEASUREMENT vLRNUPDATE "RAM value vLRNUPDATE" UBYTE COMP_0004 1 100 0 255 ECU_ADDRESS 0xFFFF1543 /begin FUNCTION_LIST /end FUNCTION_LIST /end MEASUREMENT
/begin MEASUREMENT vLRf "REF timing rich lean condition" UBYTE COMP_0004 1 100 0 255 ECU_ADDRESS 0xFFFF4071 /begin FUNCTION_LIST /end FUNCTION_LIST /end MEASUREMENT
/begin MEASUREMENT vLSPCV "Space capacity for the leak area computation" UWORD COMP_0312 1 100 0 127.998046875 ECU_ADDRESS 0xFFFF2EE4 /begin FUNCTION_LIST /end FUNCTION_LIST /end MEASUREMENT
/begin MEASUREMENT vLTP10R "Before TP 100mS, memory" UBYTE COMP_0001 1 100 0 31.875 ECU_ADDRESS 0xFFFF2EE6 /begin FUNCTION_LIST /end FUNCTION_LIST /end MEASUREMENT
/begin MEASUREMENT vLTREFW "The minimum value of TREFWR" UBYTE COMP_0009 1 100 0 199.21875 ECU_ADDRESS 0xFFFF4072 /begin FUNCTION_LIST /end FUNCTION_LIST /end MEASUREMENT
/begin MEASUREMENT vLTSMAX2 "TS learning upper limit TP compensation" UWORD COMP_0458 1 100 -1280 1279.9609375 ECU_ADDRESS 0xFFFF1544 /begin FUNCTION_LIST /end FUNCTION_LIST /end MEASUREMENT
/begin MEASUREMENT vLTSMAX2_R#1 "TS learning upper limit TP compensation" UWORD COMP_0458 1 100 -1280 1279.9609375 ECU_ADDRESS 0xFFFF1544 /begin FUNCTION_LIST /end FUNCTION_LIST /end MEASUREMENT
/begin MEASUREMENT vLTSMAX2_R#2 "TS learning upper limit TP compensation" UWORD COMP_0458 1 100 -1280 1279.9609375 ECU_ADDRESS 0xFFFF1546 /begin FUNCTION_LIST /end FUNCTION_LIST /end MEASUREMENT
/begin MEASUREMENT vLTSMIN2 "TS learning lower limit TP compensation" UWORD COMP_0458 1 100 -1280 1279.9609375 ECU_ADDRESS 0xFFFF1548 /begin FUNCTION_LIST /end FUNCTION_LIST /end MEASUREMENT
/begin MEASUREMENT vLTSMIN2_R#1 "TS learning lower limit TP compensation" UWORD COMP_0458 1 100 -1280 1279.9609375 ECU_ADDRESS 0xFFFF1548 /begin FUNCTION_LIST /end FUNCTION_LIST /end MEASUREMENT
/begin MEASUREMENT vLTSMIN2_R#2 "TS learning lower limit TP compensation" UWORD COMP_0458 1 100 -1280 1279.9609375 ECU_ADDRESS 0xFFFF154A /begin FUNCTION_LIST /end FUNCTION_LIST /end MEASUREMENT
/begin MEASUREMENT vLTSMNE "TS learning lower limit TIEVP compensation" UWORD COMP_0458 1 100 -1280 1279.9609375 ECU_ADDRESS 0xFFFF154C /begin FUNCTION_LIST /end FUNCTION_LIST /end MEASUREMENT
/begin MEASUREMENT vLTSMNE_R#1 "TS learning lower limit TIEVP compensation" UWORD COMP_0458 1 100 -1280 1279.9609375 ECU_ADDRESS 0xFFFF154C /begin FUNCTION_LIST /end FUNCTION_LIST /end MEASUREMENT
/begin MEASUREMENT vLTSMNE_R#2 "TS learning lower limit TIEVP compensation" UWORD COMP_0458 1 100 -1280 1279.9609375 ECU_ADDRESS 0xFFFF154E /begin FUNCTION_LIST /end FUNCTION_LIST /end MEASUREMENT
/begin MEASUREMENT vLTSMXE "TS learning upper limit TIEVP compensation" UWORD COMP_0458 1 100 -1280 1279.9609375 ECU_ADDRESS 0xFFFF1550 /begin FUNCTION_LIST /end FUNCTION_LIST /end MEASUREMENT
/begin MEASUREMENT vLTSMXE_R#1 "TS learning upper limit TIEVP compensation" UWORD COMP_0458 1 100 -1280 1279.9609375 ECU_ADDRESS 0xFFFF1550 /begin FUNCTION_LIST /end FUNCTION_LIST /end MEASUREMENT
/begin MEASUREMENT vLTSMXE_R#2 "TS learning upper limit TIEVP compensation" UWORD COMP_0458 1 100 -1280 1279.9609375 ECU_ADDRESS 0xFFFF1552 /begin FUNCTION_LIST /end FUNCTION_LIST /end MEASUREMENT
/begin MEASUREMENT vLTVO10R "Before TVO 100mS, memory" UBYTE COMP_0002 1 100 0 89.25 ECU_ADDRESS 0xFFFF2EE7 /begin FUNCTION_LIST /end FUNCTION_LIST /end MEASUREMENT
/begin MEASUREMENT vLTVOS1 "Before TVOi* 50mS" UBYTE COMP_0002 1 100 0 89.25 ECU_ADDRESS 0xFFFF1ECF /begin FUNCTION_LIST /end FUNCTION_LIST /end MEASUREMENT
/begin MEASUREMENT vLTVOS2 "Before TVOi* 50mS" UBYTE COMP_0002 1 100 0 89.25 ECU_ADDRESS 0xFFFF1ED0 /begin FUNCTION_LIST /end FUNCTION_LIST /end MEASUREMENT
/begin MEASUREMENT vM96GO "ATCUNO, ATSUM store condition" UBYTE COMP_0004 1 100 0 255 ECU_ADDRESS 0xFFFFA4D6 /begin FUNCTION_LIST /end FUNCTION_LIST /end MEASUREMENT
/begin MEASUREMENT vMADSADR "The sub-side RAM address of the MAD command" UWORD COMP_0068 1 100 0 65535 ECU_ADDRESS 0xFFFF2EE8 /begin FUNCTION_LIST /end FUNCTION_LIST /end MEASUREMENT
/begin MEASUREMENT vMADSADR_R#1 "The sub-side RAM address of the MAD command" UWORD COMP_0068 1 100 0 65535 ECU_ADDRESS 0xFFFF2EE8 /begin FUNCTION_LIST /end FUNCTION_LIST /end MEASUREMENT
/begin MEASUREMENT vMADSADR_R#2 "The sub-side RAM address of the MAD command" UWORD COMP_0068 1 100 0 65535 ECU_ADDRESS 0xFFFF2EEA /begin FUNCTION_LIST /end FUNCTION_LIST /end MEASUREMENT
/begin MEASUREMENT vMADSDAT "The sub-side RAM data of the MAD command" UBYTE COMP_0068 1 100 0 255 ECU_ADDRESS 0xFFFF2EEC /begin FUNCTION_LIST /end FUNCTION_LIST /end MEASUREMENT
/begin MEASUREMENT vMADSDAT_R#1 "The sub-side RAM data of the MAD command" UBYTE COMP_0068 1 100 0 255 ECU_ADDRESS 0xFFFF2EEC /begin FUNCTION_LIST /end FUNCTION_LIST /end MEASUREMENT
/begin MEASUREMENT vMADSDAT_R#2 "The sub-side RAM data of the MAD command" UBYTE COMP_0068 1 100 0 255 ECU_ADDRESS 0xFFFF2EED /begin FUNCTION_LIST /end FUNCTION_LIST /end MEASUREMENT
/begin MEASUREMENT vMALCHKf "At the time of A< 100%, C/P Check complete distinction" UBYTE COMP_0004 1 100 0 255 ECU_ADDRESS 0xFFFF3DEB /begin FUNCTION_LIST /end FUNCTION_LIST /end MEASUREMENT
/begin MEASUREMENT vMAPLRNOKf "Map learning condition judgement flag" UBYTE COMP_0004 1 100 0 255 ECU_ADDRESS 0xFFFF155D /begin FUNCTION_LIST /end FUNCTION_LIST /end MEASUREMENT
/begin MEASUREMENT vMAUTPMD "Power mode judgement criteria MAP reference value" UWORD COMP_0583_S 1 100 0 8191.875 ECU_ADDRESS 0xFFFF2EF4 /begin FUNCTION_LIST /end FUNCTION_LIST /end MEASUREMENT
/begin MEASUREMENT vMAXDTYI "At the time of learning, operation corner stable requirement maximum DUTY value" UBYTE COMP_0391 1 100 0 99.705 ECU_ADDRESS 0xFFFFA4D7 /begin FUNCTION_LIST /end FUNCTION_LIST /end MEASUREMENT
/begin MEASUREMENT vMAXDTYI_R#1 "At the time of learning, operation corner stable requirement maximum DUTY value" UBYTE COMP_0391 1 100 0 99.705 ECU_ADDRESS 0xFFFFA4D7 /begin FUNCTION_LIST /end FUNCTION_LIST /end MEASUREMENT
/begin MEASUREMENT vMAXDTYI_R#2 "At the time of learning, operation corner stable requirement maximum DUTY value" UBYTE COMP_0391 1 100 0 99.705 ECU_ADDRESS 0xFFFFA4D8 /begin FUNCTION_LIST /end FUNCTION_LIST /end MEASUREMENT
/begin MEASUREMENT vMAXTFD "Before gear shift, the maximum drive power" UWORD COMP_0123_S 1 100 -32768 32767 ECU_ADDRESS 0xFFFF1ED2 /begin FUNCTION_LIST /end FUNCTION_LIST /end MEASUREMENT
/begin MEASUREMENT vMBCJOKf "Base learning, map learning common condition judgement flag" UBYTE COMP_0004 1 100 0 255 ECU_ADDRESS 0xFFFF1562 /begin FUNCTION_LIST /end FUNCTION_LIST /end MEASUREMENT
/begin MEASUREMENT vMCLPEKBf "Non-monitor clamp-> monitor clamp judgement (for the KBLRCB operation)" UBYTE COMP_0004 1 100 0 255 ECU_ADDRESS 0xFFFF2EFA /begin FUNCTION_LIST /end FUNCTION_LIST /end MEASUREMENT
/begin MEASUREMENT vMCLPKBf "Non-monitor clamp-> monitor clamp judgement (for the KBLRCB operation)" UBYTE COMP_0004 1 100 0 255 ECU_ADDRESS 0xFFFF2EFB /begin FUNCTION_LIST /end FUNCTION_LIST /end MEASUREMENT
/begin MEASUREMENT vMCMEEPA "EEPROM related treatment address RAM" UWORD COMP_0068 1 100 0 65535 ECU_ADDRESS 0xFFFF2EFC /begin FUNCTION_LIST /end FUNCTION_LIST /end MEASUREMENT
/begin MEASUREMENT vMCMEEPC "EEPROM initialization and check treatment condition counter" UBYTE COMP_0068 1 100 0 255 ECU_ADDRESS 0xFFFF2EFE /begin FUNCTION_LIST /end FUNCTION_LIST /end MEASUREMENT
/begin MEASUREMENT vMCMEEPC2 "EEPROM collective initialization counter" UWORD COMP_0068 1 100 0 65535 ECU_ADDRESS 0xFFFF2F00 /begin FUNCTION_LIST /end FUNCTION_LIST /end MEASUREMENT
/begin MEASUREMENT vMCMEEPC3 "EEPROM collective initialization counter" UWORD COMP_0068 1 100 0 65535 ECU_ADDRESS 0xFFFF2F02 /begin FUNCTION_LIST /end FUNCTION_LIST /end MEASUREMENT
/begin MEASUREMENT vMCMEEPCHK "4K Data RAM for the EEPROM check" UBYTE COMP_0068 1 100 0 255 ECU_ADDRESS 0xFFFF2F04 /begin FUNCTION_LIST /end FUNCTION_LIST /end MEASUREMENT
/begin MEASUREMENT vMCMEEPCHK_C#1_R#1 "4K Data RAM for the EEPROM check" UBYTE COMP_0068 1 100 0 255 ECU_ADDRESS 0xFFFF2F04 /begin FUNCTION_LIST /end FUNCTION_LIST /end MEASUREMENT
/begin MEASUREMENT vMCMEEPCHK_C#2_R#1 "4K Data RAM for the EEPROM check" UBYTE COMP_0068 1 100 0 255 ECU_ADDRESS 0xFFFF2F05 /begin FUNCTION_LIST /end FUNCTION_LIST /end MEASUREMENT
/begin MEASUREMENT vMCMEEPCHK_C#3_R#1 "4K Data RAM for the EEPROM check" UBYTE COMP_0068 1 100 0 255 ECU_ADDRESS 0xFFFF2F06 /begin FUNCTION_LIST /end FUNCTION_LIST /end MEASUREMENT
/begin MEASUREMENT vMCMEEPCHK_C#4_R#1 "4K Data RAM for the EEPROM check" UBYTE COMP_0068 1 100 0 255 ECU_ADDRESS 0xFFFF2F07 /begin FUNCTION_LIST /end FUNCTION_LIST /end MEASUREMENT
/begin MEASUREMENT vMCMEEPCHK_C#5_R#1 "4K Data RAM for the EEPROM check" UBYTE COMP_0068 1 100 0 255 ECU_ADDRESS 0xFFFF2F08 /begin FUNCTION_LIST /end FUNCTION_LIST /end MEASUREMENT
/begin MEASUREMENT vMCMEEPCHK_C#6_R#1 "4K Data RAM for the EEPROM check" UBYTE COMP_0068 1 100 0 255 ECU_ADDRESS 0xFFFF2F09 /begin FUNCTION_LIST /end FUNCTION_LIST /end MEASUREMENT
/begin MEASUREMENT vMCMEEPCHK_C#7_R#1 "4K Data RAM for the EEPROM check" UBYTE COMP_0068 1 100 0 255 ECU_ADDRESS 0xFFFF2F0A /begin FUNCTION_LIST /end FUNCTION_LIST /end MEASUREMENT
/begin MEASUREMENT vMCMEEPCHK_C#8_R#1 "4K Data RAM for the EEPROM check" UBYTE COMP_0068 1 100 0 255 ECU_ADDRESS 0xFFFF2F0B /begin FUNCTION_LIST /end FUNCTION_LIST /end MEASUREMENT
/begin MEASUREMENT vMCMEEPCHK_C#9_R#1 "4K Data RAM for the EEPROM check" UBYTE COMP_0068 1 100 0 255 ECU_ADDRESS 0xFFFF2F0C /begin FUNCTION_LIST /end FUNCTION_LIST /end MEASUREMENT
/begin MEASUREMENT vMCMEEPCHK_C#10_R#1 "4K Data RAM for the EEPROM check" UBYTE COMP_0068 1 100 0 255 ECU_ADDRESS 0xFFFF2F0D /begin FUNCTION_LIST /end FUNCTION_LIST /end MEASUREMENT
/begin MEASUREMENT vMCMEEPCHK_C#11_R#1 "4K Data RAM for the EEPROM check" UBYTE COMP_0068 1 100 0 255 ECU_ADDRESS 0xFFFF2F0E /begin FUNCTION_LIST /end FUNCTION_LIST /end MEASUREMENT
/begin MEASUREMENT vMCMEEPCHK_C#12_R#1 "4K Data RAM for the EEPROM check" UBYTE COMP_0068 1 100 0 255 ECU_ADDRESS 0xFFFF2F0F /begin FUNCTION_LIST /end FUNCTION_LIST /end MEASUREMENT
/begin MEASUREMENT vMCMEEPCHK_C#13_R#1 "4K Data RAM for the EEPROM check" UBYTE COMP_0068 1 100 0 255 ECU_ADDRESS 0xFFFF2F10 /begin FUNCTION_LIST /end FUNCTION_LIST /end MEASUREMENT
/begin MEASUREMENT vMCMEEPCHK_C#14_R#1 "4K Data RAM for the EEPROM check" UBYTE COMP_0068 1 100 0 255 ECU_ADDRESS 0xFFFF2F11 /begin FUNCTION_LIST /end FUNCTION_LIST /end MEASUREMENT
/begin MEASUREMENT vMCMEEPCHK_C#15_R#1 "4K Data RAM for the EEPROM check" UBYTE COMP_0068 1 100 0 255 ECU_ADDRESS 0xFFFF2F12 /begin FUNCTION_LIST /end FUNCTION_LIST /end MEASUREMENT
/begin MEASUREMENT vMCMEEPCHK_C#16_R#1 "4K Data RAM for the EEPROM check" UBYTE COMP_0068 1 100 0 255 ECU_ADDRESS 0xFFFF2F13 /begin FUNCTION_LIST /end FUNCTION_LIST /end MEASUREMENT
/begin MEASUREMENT vMCMEEPCHK_C#17_R#1 "4K Data RAM for the EEPROM check" UBYTE COMP_0068 1 100 0 255 ECU_ADDRESS 0xFFFF2F14 /begin FUNCTION_LIST /end FUNCTION_LIST /end MEASUREMENT
/begin MEASUREMENT vMCMEEPCHK_C#18_R#1 "4K Data RAM for the EEPROM check" UBYTE COMP_0068 1 100 0 255 ECU_ADDRESS 0xFFFF2F15 /begin FUNCTION_LIST /end FUNCTION_LIST /end MEASUREMENT
/begin MEASUREMENT vMCMEEPCHK_C#19_R#1 "4K Data RAM for the EEPROM check" UBYTE COMP_0068 1 100 0 255 ECU_ADDRESS 0xFFFF2F16 /begin FUNCTION_LIST /end FUNCTION_LIST /end MEASUREMENT
/begin MEASUREMENT vMCMEEPCHK_C#20_R#1 "4K Data RAM for the EEPROM check" UBYTE COMP_0068 1 100 0 255 ECU_ADDRESS 0xFFFF2F17 /begin FUNCTION_LIST /end FUNCTION_LIST /end MEASUREMENT
/begin MEASUREMENT vMCMEEPCHK_C#21_R#1 "4K Data RAM for the EEPROM check" UBYTE COMP_0068 1 100 0 255 ECU_ADDRESS 0xFFFF2F18 /begin FUNCTION_LIST /end FUNCTION_LIST /end MEASUREMENT
/begin MEASUREMENT vMCMEEPCHK_C#22_R#1 "4K Data RAM for the EEPROM check" UBYTE COMP_0068 1 100 0 255 ECU_ADDRESS 0xFFFF2F19 /begin FUNCTION_LIST /end FUNCTION_LIST /end MEASUREMENT
/begin MEASUREMENT vMCMEEPCHK_C#23_R#1 "4K Data RAM for the EEPROM check" UBYTE COMP_0068 1 100 0 255 ECU_ADDRESS 0xFFFF2F1A /begin FUNCTION_LIST /end FUNCTION_LIST /end MEASUREMENT
/begin MEASUREMENT vMCMEEPCHK_C#24_R#1 "4K Data RAM for the EEPROM check" UBYTE COMP_0068 1 100 0 255 ECU_ADDRESS 0xFFFF2F1B /begin FUNCTION_LIST /end FUNCTION_LIST /end MEASUREMENT
/begin MEASUREMENT vMCMEEPCHK_C#25_R#1 "4K Data RAM for the EEPROM check" UBYTE COMP_0068 1 100 0 255 ECU_ADDRESS 0xFFFF2F1C /begin FUNCTION_LIST /end FUNCTION_LIST /end MEASUREMENT
/begin MEASUREMENT vMCMEEPCHK_C#26_R#1 "4K Data RAM for the EEPROM check" UBYTE COMP_0068 1 100 0 255 ECU_ADDRESS 0xFFFF2F1D /begin FUNCTION_LIST /end FUNCTION_LIST /end MEASUREMENT
/begin MEASUREMENT vMCMEEPCHK_C#27_R#1 "4K Data RAM for the EEPROM check" UBYTE COMP_0068 1 100 0 255 ECU_ADDRESS 0xFFFF2F1E /begin FUNCTION_LIST /end FUNCTION_LIST /end MEASUREMENT
/begin MEASUREMENT vMCMEEPCHK_C#28_R#1 "4K Data RAM for the EEPROM check" UBYTE COMP_0068 1 100 0 255 ECU_ADDRESS 0xFFFF2F1F /begin FUNCTION_LIST /end FUNCTION_LIST /end MEASUREMENT
/begin MEASUREMENT vMCMEEPCHK_C#29_R#1 "4K Data RAM for the EEPROM check" UBYTE COMP_0068 1 100 0 255 ECU_ADDRESS 0xFFFF2F20 /begin FUNCTION_LIST /end FUNCTION_LIST /end MEASUREMENT
/begin MEASUREMENT vMCMEEPCHK_C#30_R#1 "4K Data RAM for the EEPROM check" UBYTE COMP_0068 1 100 0 255 ECU_ADDRESS 0xFFFF2F21 /begin FUNCTION_LIST /end FUNCTION_LIST /end MEASUREMENT
/begin MEASUREMENT vMCMEEPCHK_C#31_R#1 "4K Data RAM for the EEPROM check" UBYTE COMP_0068 1 100 0 255 ECU_ADDRESS 0xFFFF2F22 /begin FUNCTION_LIST /end FUNCTION_LIST /end MEASUREMENT
/begin MEASUREMENT vMCMEEPCHK_C#32_R#1 "4K Data RAM for the EEPROM check" UBYTE COMP_0068 1 100 0 255 ECU_ADDRESS 0xFFFF2F23 /begin FUNCTION_LIST /end FUNCTION_LIST /end MEASUREMENT
/begin MEASUREMENT vMCMEEPCLR "4K All EEPROMs region clear address counter" UWORD COMP_0068 1 100 0 65535 ECU_ADDRESS 0xFFFF2F24 /begin FUNCTION_LIST /end FUNCTION_LIST /end MEASUREMENT
/begin MEASUREMENT vMCMEEPCNT "4K EEPROM Page Write relation data counter" UBYTE COMP_0068 1 100 0 255 ECU_ADDRESS 0xFFFF2F26 /begin FUNCTION_LIST /end FUNCTION_LIST /end MEASUREMENT
/begin MEASUREMENT vMCMEEPD "EEPROM related treatment data RAM" UWORD COMP_0068 1 100 0 65535 ECU_ADDRESS 0xFFFF2F28 /begin FUNCTION_LIST /end FUNCTION_LIST /end MEASUREMENT
/begin MEASUREMENT vMCMEEPD32 "4K EEPROM Page Write related treatment data RAM" UBYTE COMP_0068 1 100 0 255 ECU_ADDRESS 0xFFFF2F2A /begin FUNCTION_LIST /end FUNCTION_LIST /end MEASUREMENT
/begin MEASUREMENT vMCMEEPD32_C#1_R#1 "4K EEPROM Page Write related treatment data RAM" UBYTE COMP_0068 1 100 0 255 ECU_ADDRESS 0xFFFF2F2A /begin FUNCTION_LIST /end FUNCTION_LIST /end MEASUREMENT
/begin MEASUREMENT vMCMEEPD32_C#2_R#1 "4K EEPROM Page Write related treatment data RAM" UBYTE COMP_0068 1 100 0 255 ECU_ADDRESS 0xFFFF2F2B /begin FUNCTION_LIST /end FUNCTION_LIST /end MEASUREMENT
/begin MEASUREMENT vMCMEEPD32_C#3_R#1 "4K EEPROM Page Write related treatment data RAM" UBYTE COMP_0068 1 100 0 255 ECU_ADDRESS 0xFFFF2F2C /begin FUNCTION_LIST /end FUNCTION_LIST /end MEASUREMENT
/begin MEASUREMENT vMCMEEPD32_C#4_R#1 "4K EEPROM Page Write related treatment data RAM" UBYTE COMP_0068 1 100 0 255 ECU_ADDRESS 0xFFFF2F2D /begin FUNCTION_LIST /end FUNCTION_LIST /end MEASUREMENT
/begin MEASUREMENT vMCMEEPD32_C#5_R#1 "4K EEPROM Page Write related treatment data RAM" UBYTE COMP_0068 1 100 0 255 ECU_ADDRESS 0xFFFF2F2E /begin FUNCTION_LIST /end FUNCTION_LIST /end MEASUREMENT
/begin MEASUREMENT vMCMEEPD32_C#6_R#1 "4K EEPROM Page Write related treatment data RAM" UBYTE COMP_0068 1 100 0 255 ECU_ADDRESS 0xFFFF2F2F /begin FUNCTION_LIST /end FUNCTION_LIST /end MEASUREMENT
/begin MEASUREMENT vMCMEEPD32_C#7_R#1 "4K EEPROM Page Write related treatment data RAM" UBYTE COMP_0068 1 100 0 255 ECU_ADDRESS 0xFFFF2F30 /begin FUNCTION_LIST /end FUNCTION_LIST /end MEASUREMENT
/begin MEASUREMENT vMCMEEPD32_C#8_R#1 "4K EEPROM Page Write related treatment data RAM" UBYTE COMP_0068 1 100 0 255 ECU_ADDRESS 0xFFFF2F31 /begin FUNCTION_LIST /end FUNCTION_LIST /end MEASUREMENT
/begin MEASUREMENT vMCMEEPD32_C#9_R#1 "4K EEPROM Page Write related treatment data RAM" UBYTE COMP_0068 1 100 0 255 ECU_ADDRESS 0xFFFF2F32 /begin FUNCTION_LIST /end FUNCTION_LIST /end MEASUREMENT
/begin MEASUREMENT vMCMEEPD32_C#10_R#1 "4K EEPROM Page Write related treatment data RAM" UBYTE COMP_0068 1 100 0 255 ECU_ADDRESS 0xFFFF2F33 /begin FUNCTION_LIST /end FUNCTION_LIST /end MEASUREMENT
/begin MEASUREMENT vMCMEEPD32_C#11_R#1 "4K EEPROM Page Write related treatment data RAM" UBYTE COMP_0068 1 100 0 255 ECU_ADDRESS 0xFFFF2F34 /begin FUNCTION_LIST /end FUNCTION_LIST /end MEASUREMENT
/begin MEASUREMENT vMCMEEPD32_C#12_R#1 "4K EEPROM Page Write related treatment data RAM" UBYTE COMP_0068 1 100 0 255 ECU_ADDRESS 0xFFFF2F35 /begin FUNCTION_LIST /end FUNCTION_LIST /end MEASUREMENT
/begin MEASUREMENT vMCMEEPD32_C#13_R#1 "4K EEPROM Page Write related treatment data RAM" UBYTE COMP_0068 1 100 0 255 ECU_ADDRESS 0xFFFF2F36 /begin FUNCTION_LIST /end FUNCTION_LIST /end MEASUREMENT
/begin MEASUREMENT vMCMEEPD32_C#14_R#1 "4K EEPROM Page Write related treatment data RAM" UBYTE COMP_0068 1 100 0 255 ECU_ADDRESS 0xFFFF2F37 /begin FUNCTION_LIST /end FUNCTION_LIST /end MEASUREMENT
/begin MEASUREMENT vMCMEEPD32_C#15_R#1 "4K EEPROM Page Write related treatment data RAM" UBYTE COMP_0068 1 100 0 255 ECU_ADDRESS 0xFFFF2F38 /begin FUNCTION_LIST /end FUNCTION_LIST /end MEASUREMENT
/begin MEASUREMENT vMCMEEPD32_C#16_R#1 "4K EEPROM Page Write related treatment data RAM" UBYTE COMP_0068 1 100 0 255 ECU_ADDRESS 0xFFFF2F39 /begin FUNCTION_LIST /end FUNCTION_LIST /end MEASUREMENT
/begin MEASUREMENT vMCMEEPD32_C#17_R#1 "4K EEPROM Page Write related treatment data RAM" UBYTE COMP_0068 1 100 0 255 ECU_ADDRESS 0xFFFF2F3A /begin FUNCTION_LIST /end FUNCTION_LIST /end MEASUREMENT
/begin MEASUREMENT vMCMEEPD32_C#18_R#1 "4K EEPROM Page Write related treatment data RAM" UBYTE COMP_0068 1 100 0 255 ECU_ADDRESS 0xFFFF2F3B /begin FUNCTION_LIST /end FUNCTION_LIST /end MEASUREMENT
/begin MEASUREMENT vMCMEEPD32_C#19_R#1 "4K EEPROM Page Write related treatment data RAM" UBYTE COMP_0068 1 100 0 255 ECU_ADDRESS 0xFFFF2F3C /begin FUNCTION_LIST /end FUNCTION_LIST /end MEASUREMENT
/begin MEASUREMENT vMCMEEPD32_C#20_R#1 "4K EEPROM Page Write related treatment data RAM" UBYTE COMP_0068 1 100 0 255 ECU_ADDRESS 0xFFFF2F3D /begin FUNCTION_LIST /end FUNCTION_LIST /end MEASUREMENT
/begin MEASUREMENT vMCMEEPD32_C#21_R#1 "4K EEPROM Page Write related treatment data RAM" UBYTE COMP_0068 1 100 0 255 ECU_ADDRESS 0xFFFF2F3E /begin FUNCTION_LIST /end FUNCTION_LIST /end MEASUREMENT
/begin MEASUREMENT vMCMEEPD32_C#22_R#1 "4K EEPROM Page Write related treatment data RAM" UBYTE COMP_0068 1 100 0 255 ECU_ADDRESS 0xFFFF2F3F /begin FUNCTION_LIST /end FUNCTION_LIST /end MEASUREMENT
/begin MEASUREMENT vMCMEEPD32_C#23_R#1 "4K EEPROM Page Write related treatment data RAM" UBYTE COMP_0068 1 100 0 255 ECU_ADDRESS 0xFFFF2F40 /begin FUNCTION_LIST /end FUNCTION_LIST /end MEASUREMENT
/begin MEASUREMENT vMCMEEPD32_C#24_R#1 "4K EEPROM Page Write related treatment data RAM" UBYTE COMP_0068 1 100 0 255 ECU_ADDRESS 0xFFFF2F41 /begin FUNCTION_LIST /end FUNCTION_LIST /end MEASUREMENT
/begin MEASUREMENT vMCMEEPD32_C#25_R#1 "4K EEPROM Page Write related treatment data RAM" UBYTE COMP_0068 1 100 0 255 ECU_ADDRESS 0xFFFF2F42 /begin FUNCTION_LIST /end FUNCTION_LIST /end MEASUREMENT
/begin MEASUREMENT vMCMEEPD32_C#26_R#1 "4K EEPROM Page Write related treatment data RAM" UBYTE COMP_0068 1 100 0 255 ECU_ADDRESS 0xFFFF2F43 /begin FUNCTION_LIST /end FUNCTION_LIST /end MEASUREMENT
/begin MEASUREMENT vMCMEEPD32_C#27_R#1 "4K EEPROM Page Write related treatment data RAM" UBYTE COMP_0068 1 100 0 255 ECU_ADDRESS 0xFFFF2F44 /begin FUNCTION_LIST /end FUNCTION_LIST /end MEASUREMENT
/begin MEASUREMENT vMCMEEPD32_C#28_R#1 "4K EEPROM Page Write related treatment data RAM" UBYTE COMP_0068 1 100 0 255 ECU_ADDRESS 0xFFFF2F45 /begin FUNCTION_LIST /end FUNCTION_LIST /end MEASUREMENT
/begin MEASUREMENT vMCMEEPD32_C#29_R#1 "4K EEPROM Page Write related treatment data RAM" UBYTE COMP_0068 1 100 0 255 ECU_ADDRESS 0xFFFF2F46 /begin FUNCTION_LIST /end FUNCTION_LIST /end MEASUREMENT
/begin MEASUREMENT vMCMEEPD32_C#30_R#1 "4K EEPROM Page Write related treatment data RAM" UBYTE COMP_0068 1 100 0 255 ECU_ADDRESS 0xFFFF2F47 /begin FUNCTION_LIST /end FUNCTION_LIST /end MEASUREMENT
/begin MEASUREMENT vMCMEEPD32_C#31_R#1 "4K EEPROM Page Write related treatment data RAM" UBYTE COMP_0068 1 100 0 255 ECU_ADDRESS 0xFFFF2F48 /begin FUNCTION_LIST /end FUNCTION_LIST /end MEASUREMENT
/begin MEASUREMENT vMCMEEPD32_C#32_R#1 "4K EEPROM Page Write related treatment data RAM" UBYTE COMP_0068 1 100 0 255 ECU_ADDRESS 0xFFFF2F49 /begin FUNCTION_LIST /end FUNCTION_LIST /end MEASUREMENT
/begin MEASUREMENT vMCMEEPM32 "4K EEPROM Page Write related treatment data RAM" UBYTE COMP_0068 1 100 0 255 ECU_ADDRESS 0xFFFF2F4A /begin FUNCTION_LIST /end FUNCTION_LIST /end MEASUREMENT
/begin MEASUREMENT vMCMEEPM32_C#1_R#1 "4K EEPROM Page Write related treatment data RAM" UBYTE COMP_0068 1 100 0 255 ECU_ADDRESS 0xFFFF2F4A /begin FUNCTION_LIST /end FUNCTION_LIST /end MEASUREMENT
/begin MEASUREMENT vMCMEEPM32_C#2_R#1 "4K EEPROM Page Write related treatment data RAM" UBYTE COMP_0068 1 100 0 255 ECU_ADDRESS 0xFFFF2F4B /begin FUNCTION_LIST /end FUNCTION_LIST /end MEASUREMENT
/begin MEASUREMENT vMCMEEPM32_C#3_R#1 "4K EEPROM Page Write related treatment data RAM" UBYTE COMP_0068 1 100 0 255 ECU_ADDRESS 0xFFFF2F4C /begin FUNCTION_LIST /end FUNCTION_LIST /end MEASUREMENT
/begin MEASUREMENT vMCMEEPM32_C#4_R#1 "4K EEPROM Page Write related treatment data RAM" UBYTE COMP_0068 1 100 0 255 ECU_ADDRESS 0xFFFF2F4D /begin FUNCTION_LIST /end FUNCTION_LIST /end MEASUREMENT
/begin MEASUREMENT vMCMEEPM32_C#5_R#1 "4K EEPROM Page Write related treatment data RAM" UBYTE COMP_0068 1 100 0 255 ECU_ADDRESS 0xFFFF2F4E /begin FUNCTION_LIST /end FUNCTION_LIST /end MEASUREMENT
/begin MEASUREMENT vMCMEEPM32_C#6_R#1 "4K EEPROM Page Write related treatment data RAM" UBYTE COMP_0068 1 100 0 255 ECU_ADDRESS 0xFFFF2F4F /begin FUNCTION_LIST /end FUNCTION_LIST /end MEASUREMENT
/begin MEASUREMENT vMCMEEPM32_C#7_R#1 "4K EEPROM Page Write related treatment data RAM" UBYTE COMP_0068 1 100 0 255 ECU_ADDRESS 0xFFFF2F50 /begin FUNCTION_LIST /end FUNCTION_LIST /end MEASUREMENT
/begin MEASUREMENT vMCMEEPM32_C#8_R#1 "4K EEPROM Page Write related treatment data RAM" UBYTE COMP_0068 1 100 0 255 ECU_ADDRESS 0xFFFF2F51 /begin FUNCTION_LIST /end FUNCTION_LIST /end MEASUREMENT
/begin MEASUREMENT vMCMEEPM32_C#9_R#1 "4K EEPROM Page Write related treatment data RAM" UBYTE COMP_0068 1 100 0 255 ECU_ADDRESS 0xFFFF2F52 /begin FUNCTION_LIST /end FUNCTION_LIST /end MEASUREMENT
/begin MEASUREMENT vMCMEEPM32_C#10_R#1 "4K EEPROM Page Write related treatment data RAM" UBYTE COMP_0068 1 100 0 255 ECU_ADDRESS 0xFFFF2F53 /begin FUNCTION_LIST /end FUNCTION_LIST /end MEASUREMENT
/begin MEASUREMENT vMCMEEPM32_C#11_R#1 "4K EEPROM Page Write related treatment data RAM" UBYTE COMP_0068 1 100 0 255 ECU_ADDRESS 0xFFFF2F54 /begin FUNCTION_LIST /end FUNCTION_LIST /end MEASUREMENT
/begin MEASUREMENT vMCMEEPM32_C#12_R#1 "4K EEPROM Page Write related treatment data RAM" UBYTE COMP_0068 1 100 0 255 ECU_ADDRESS 0xFFFF2F55 /begin FUNCTION_LIST /end FUNCTION_LIST /end MEASUREMENT
/begin MEASUREMENT vMCMEEPM32_C#13_R#1 "4K EEPROM Page Write related treatment data RAM" UBYTE COMP_0068 1 100 0 255 ECU_ADDRESS 0xFFFF2F56 /begin FUNCTION_LIST /end FUNCTION_LIST /end MEASUREMENT
/begin MEASUREMENT vMCMEEPM32_C#14_R#1 "4K EEPROM Page Write related treatment data RAM" UBYTE COMP_0068 1 100 0 255 ECU_ADDRESS 0xFFFF2F57 /begin FUNCTION_LIST /end FUNCTION_LIST /end MEASUREMENT
/begin MEASUREMENT vMCMEEPM32_C#15_R#1 "4K EEPROM Page Write related treatment data RAM" UBYTE COMP_0068 1 100 0 255 ECU_ADDRESS 0xFFFF2F58 /begin FUNCTION_LIST /end FUNCTION_LIST /end MEASUREMENT
/begin MEASUREMENT vMCMEEPM32_C#16_R#1 "4K EEPROM Page Write related treatment data RAM" UBYTE COMP_0068 1 100 0 255 ECU_ADDRESS 0xFFFF2F59 /begin FUNCTION_LIST /end FUNCTION_LIST /end MEASUREMENT
/begin MEASUREMENT vMCMEEPM32_C#17_R#1 "4K EEPROM Page Write related treatment data RAM" UBYTE COMP_0068 1 100 0 255 ECU_ADDRESS 0xFFFF2F5A /begin FUNCTION_LIST /end FUNCTION_LIST /end MEASUREMENT
/begin MEASUREMENT vMCMEEPM32_C#18_R#1 "4K EEPROM Page Write related treatment data RAM" UBYTE COMP_0068 1 100 0 255 ECU_ADDRESS 0xFFFF2F5B /begin FUNCTION_LIST /end FUNCTION_LIST /end MEASUREMENT
/begin MEASUREMENT vMCMEEPM32_C#19_R#1 "4K EEPROM Page Write related treatment data RAM" UBYTE COMP_0068 1 100 0 255 ECU_ADDRESS 0xFFFF2F5C /begin FUNCTION_LIST /end FUNCTION_LIST /end MEASUREMENT
/begin MEASUREMENT vMCMEEPM32_C#20_R#1 "4K EEPROM Page Write related treatment data RAM" UBYTE COMP_0068 1 100 0 255 ECU_ADDRESS 0xFFFF2F5D /begin FUNCTION_LIST /end FUNCTION_LIST /end MEASUREMENT
/begin MEASUREMENT vMCMEEPM32_C#21_R#1 "4K EEPROM Page Write related treatment data RAM" UBYTE COMP_0068 1 100 0 255 ECU_ADDRESS 0xFFFF2F5E /begin FUNCTION_LIST /end FUNCTION_LIST /end MEASUREMENT
/begin MEASUREMENT vMCMEEPM32_C#22_R#1 "4K EEPROM Page Write related treatment data RAM" UBYTE COMP_0068 1 100 0 255 ECU_ADDRESS 0xFFFF2F5F /begin FUNCTION_LIST /end FUNCTION_LIST /end MEASUREMENT
/begin MEASUREMENT vMCMEEPM32_C#23_R#1 "4K EEPROM Page Write related treatment data RAM" UBYTE COMP_0068 1 100 0 255 ECU_ADDRESS 0xFFFF2F60 /begin FUNCTION_LIST /end FUNCTION_LIST /end MEASUREMENT
/begin MEASUREMENT vMCMEEPM32_C#24_R#1 "4K EEPROM Page Write related treatment data RAM" UBYTE COMP_0068 1 100 0 255 ECU_ADDRESS 0xFFFF2F61 /begin FUNCTION_LIST /end FUNCTION_LIST /end MEASUREMENT
/begin MEASUREMENT vMCMEEPM32_C#25_R#1 "4K EEPROM Page Write related treatment data RAM" UBYTE COMP_0068 1 100 0 255 ECU_ADDRESS 0xFFFF2F62 /begin FUNCTION_LIST /end FUNCTION_LIST /end MEASUREMENT
/begin MEASUREMENT vMCMEEPM32_C#26_R#1 "4K EEPROM Page Write related treatment data RAM" UBYTE COMP_0068 1 100 0 255 ECU_ADDRESS 0xFFFF2F63 /begin FUNCTION_LIST /end FUNCTION_LIST /end MEASUREMENT
/begin MEASUREMENT vMCMEEPM32_C#27_R#1 "4K EEPROM Page Write related treatment data RAM" UBYTE COMP_0068 1 100 0 255 ECU_ADDRESS 0xFFFF2F64 /begin FUNCTION_LIST /end FUNCTION_LIST /end MEASUREMENT
/begin MEASUREMENT vMCMEEPM32_C#28_R#1 "4K EEPROM Page Write related treatment data RAM" UBYTE COMP_0068 1 100 0 255 ECU_ADDRESS 0xFFFF2F65 /begin FUNCTION_LIST /end FUNCTION_LIST /end MEASUREMENT
/begin MEASUREMENT vMCMEEPM32_C#29_R#1 "4K EEPROM Page Write related treatment data RAM" UBYTE COMP_0068 1 100 0 255 ECU_ADDRESS 0xFFFF2F66 /begin FUNCTION_LIST /end FUNCTION_LIST /end MEASUREMENT
/begin MEASUREMENT vMCMEEPM32_C#30_R#1 "4K EEPROM Page Write related treatment data RAM" UBYTE COMP_0068 1 100 0 255 ECU_ADDRESS 0xFFFF2F67 /begin FUNCTION_LIST /end FUNCTION_LIST /end MEASUREMENT
/begin MEASUREMENT vMCMEEPM32_C#31_R#1 "4K EEPROM Page Write related treatment data RAM" UBYTE COMP_0068 1 100 0 255 ECU_ADDRESS 0xFFFF2F68 /begin FUNCTION_LIST /end FUNCTION_LIST /end MEASUREMENT
/begin MEASUREMENT vMCMEEPM32_C#32_R#1 "4K EEPROM Page Write related treatment data RAM" UBYTE COMP_0068 1 100 0 255 ECU_ADDRESS 0xFFFF2F69 /begin FUNCTION_LIST /end FUNCTION_LIST /end MEASUREMENT
/begin MEASUREMENT vMCMEPCLR2 "4K All EEPROMs region clear address counter" UWORD COMP_0068 1 100 0 65535 ECU_ADDRESS 0xFFFF2F6A /begin FUNCTION_LIST /end FUNCTION_LIST /end MEASUREMENT
/begin MEASUREMENT vMCMEPCNT2 "4K EEPROM Page Write relation data counter" UBYTE COMP_0068 1 100 0 255 ECU_ADDRESS 0xFFFF2F6C /begin FUNCTION_LIST /end FUNCTION_LIST /end MEASUREMENT
/begin MEASUREMENT vMCMRAMA "A check applicable address for the RAM check" ULONG COMP_0068 1 100 0 4294967295 ECU_ADDRESS 0xFFFF2F70 /begin FUNCTION_LIST /end FUNCTION_LIST /end MEASUREMENT
/begin MEASUREMENT vMCYLGATE "At the time of the mis-electric supply prevention logic operation, electric supply cylinder distinction value" UBYTE COMP_0567_S 1 100 0 255 ECU_ADDRESS 0xFFFF1563 /begin FUNCTION_LIST /end FUNCTION_LIST /end MEASUREMENT
/begin MEASUREMENT vMDE_TW "At the time of the NSET00D computation, condition transition" UBYTE COMP_0068 1 100 0 255 ECU_ADDRESS 0xFFFF1564 /begin FUNCTION_LIST /end FUNCTION_LIST /end MEASUREMENT
/begin MEASUREMENT vMEANPF "ON- Average fuel pressure for off P/REG control" UWORD COMP_0164 1 100 0 19.988175 ECU_ADDRESS 0xFFFF885E /begin FUNCTION_LIST /end FUNCTION_LIST /end MEASUREMENT
/begin MEASUREMENT vMEANPFz1 "ON- Before average fuel pressure 10mS for off P/REG control" UWORD COMP_0164 1 100 0 19.988175 ECU_ADDRESS 0xFFFF1566 /begin FUNCTION_LIST /end FUNCTION_LIST /end MEASUREMENT
/begin MEASUREMENT vMEANPFz10 "ON- Before average fuel pressure 100mS for off P/REG control" UWORD COMP_0164 1 100 0 19.988175 ECU_ADDRESS 0xFFFF1568 /begin FUNCTION_LIST /end FUNCTION_LIST /end MEASUREMENT
/begin MEASUREMENT vMEANPFz2 "ON- Before average fuel pressure 20mS for off P/REG control" UWORD COMP_0164 1 100 0 19.988175 ECU_ADDRESS 0xFFFF156A /begin FUNCTION_LIST /end FUNCTION_LIST /end MEASUREMENT
/begin MEASUREMENT vMEANPFz3 "ON- Before average fuel pressure 30mS for off P/REG control" UWORD COMP_0164 1 100 0 19.988175 ECU_ADDRESS 0xFFFF156C /begin FUNCTION_LIST /end FUNCTION_LIST /end MEASUREMENT
/begin MEASUREMENT vMEANPFz4 "ON- Before average fuel pressure 40mS for off P/REG control" UWORD COMP_0164 1 100 0 19.988175 ECU_ADDRESS 0xFFFF156E /begin FUNCTION_LIST /end FUNCTION_LIST /end MEASUREMENT
/begin MEASUREMENT vMEANPFz5 "ON- Before average fuel pressure 50mS for off P/REG control" UWORD COMP_0164 1 100 0 19.988175 ECU_ADDRESS 0xFFFF1570 /begin FUNCTION_LIST /end FUNCTION_LIST /end MEASUREMENT
/begin MEASUREMENT vMEANPFz6 "ON- Before average fuel pressure 60mS for off P/REG control" UWORD COMP_0164 1 100 0 19.988175 ECU_ADDRESS 0xFFFF1572 /begin FUNCTION_LIST /end FUNCTION_LIST /end MEASUREMENT
/begin MEASUREMENT vMEANPFz7 "ON- Before average fuel pressure 70mS for off P/REG control" UWORD COMP_0164 1 100 0 19.988175 ECU_ADDRESS 0xFFFF1574 /begin FUNCTION_LIST /end FUNCTION_LIST /end MEASUREMENT
/begin MEASUREMENT vMEANPFz8 "ON- Before average fuel pressure 80mS for off P/REG control" UWORD COMP_0164 1 100 0 19.988175 ECU_ADDRESS 0xFFFF1576 /begin FUNCTION_LIST /end FUNCTION_LIST /end MEASUREMENT
/begin MEASUREMENT vMEANPFz9 "ON- Before average fuel pressure 90mS for off P/REG control" UWORD COMP_0164 1 100 0 19.988175 ECU_ADDRESS 0xFFFF1578 /begin FUNCTION_LIST /end FUNCTION_LIST /end MEASUREMENT
/begin MEASUREMENT vMEMAHHB "Address extreme upper byte" UBYTE COMP_0004 1 100 0 255 ECU_ADDRESS 0xFFFF2F7C /begin FUNCTION_LIST /end FUNCTION_LIST /end MEASUREMENT
/begin MEASUREMENT vMEMAHLB "In the address, upper byte" UBYTE COMP_0004 1 100 0 255 ECU_ADDRESS 0xFFFF2F7D /begin FUNCTION_LIST /end FUNCTION_LIST /end MEASUREMENT
/begin MEASUREMENT vMEMALHB "In the address, lower byte" UBYTE COMP_0004 1 100 0 255 ECU_ADDRESS 0xFFFF2F7E /begin FUNCTION_LIST /end FUNCTION_LIST /end MEASUREMENT
/begin MEASUREMENT vMEMALLB "Address lowest rank byte" UBYTE COMP_0004 1 100 0 255 ECU_ADDRESS 0xFFFF2F7F /begin FUNCTION_LIST /end FUNCTION_LIST /end MEASUREMENT
/begin MEASUREMENT vMETRQ "MeanEffectiveTorque" UBYTE COMP_0021_S 1 100 -100 410 ECU_ADDRESS 0xFFFF3DEF /begin FUNCTION_LIST /end FUNCTION_LIST /end MEASUREMENT
/begin MEASUREMENT vMFCYLN "Misfire cylinder number" UBYTE COMP_0068 1 100 0 255 ECU_ADDRESS 0xFFFF2F81 /begin FUNCTION_LIST /end FUNCTION_LIST /end MEASUREMENT
/begin MEASUREMENT vMFS "The store number of times of the arrangement in the NG judgement formation" UBYTE COMP_0016 1 100 0 255 ECU_ADDRESS 0xFFFFA596 /begin FUNCTION_LIST /end FUNCTION_LIST /end MEASUREMENT
/begin MEASUREMENT vMFTLIN "Misfire occurrence number integration counter (for the monitor)" UWORD COMP_0016 1 100 0 65535 ECU_ADDRESS 0xFFFF2F86 /begin FUNCTION_LIST /end FUNCTION_LIST /end MEASUREMENT
/begin MEASUREMENT vMFTLOUT "Misfire occurrence number integration counter (for the monitor)" UWORD COMP_0016 1 100 0 65535 ECU_ADDRESS 0xFFFF2F88 /begin FUNCTION_LIST /end FUNCTION_LIST /end MEASUREMENT
/begin MEASUREMENT vMIJOFS "Injection start offset quantity memory" UBYTE COMP_0068 1 100 0 255 ECU_ADDRESS 0xFFFF21BE /begin FUNCTION_LIST /end FUNCTION_LIST /end MEASUREMENT
/begin MEASUREMENT vMIL1MAX "MILCNG1MAX value" UBYTE COMP_0030 1 100 0 255 ECU_ADDRESS 0xFFFFA62C /begin FUNCTION_LIST /end FUNCTION_LIST /end MEASUREMENT
/begin MEASUREMENT vMIL2MAX "MILCNG2MAX value" UBYTE COMP_0030 1 100 0 255 ECU_ADDRESS 0xFFFFA62D /begin FUNCTION_LIST /end FUNCTION_LIST /end MEASUREMENT
/begin MEASUREMENT vMILBL1 "At the time of MIL flashing, 1s measuring timer counter" UBYTE COMP_0014 1 100 0 2550 ECU_ADDRESS 0xFFFF2F8F /begin FUNCTION_LIST /end FUNCTION_LIST /end MEASUREMENT
/begin MEASUREMENT vMILBL10 "At the time of MIL flashing, 10s measuring timer counter" UBYTE COMP_0049 1 100 0 255 ECU_ADDRESS 0xFFFF2F90 /begin FUNCTION_LIST /end FUNCTION_LIST /end MEASUREMENT
/begin MEASUREMENT vMILCNG1 "NG judgement number of times counter (the trouble which can't turn on MIL)" UBYTE COMP_0030 1 100 0 255 ECU_ADDRESS 0xFFFF2F91 /begin FUNCTION_LIST /end FUNCTION_LIST /end MEASUREMENT
/begin MEASUREMENT vMILCNG2 "NG judgement number of times counter (MIL lighting sticking trouble)" UBYTE COMP_0030 1 100 0 255 ECU_ADDRESS 0xFFFF2F92 /begin FUNCTION_LIST /end FUNCTION_LIST /end MEASUREMENT
/begin MEASUREMENT vMILEAGE "Accumulation mileage" ULONG COMP_0125_S 1 100 0 4294967295 ECU_ADDRESS 0xFFFFA630 /begin FUNCTION_LIST /end FUNCTION_LIST /end MEASUREMENT
/begin MEASUREMENT vMILECHK "Mileage for the BACKUP judgement" ULONG COMP_0125_S 1 100 0 4294967295 ECU_ADDRESS 0xFFFFA634 /begin FUNCTION_LIST /end FUNCTION_LIST /end MEASUREMENT
/begin MEASUREMENT vMINCYL "Last time, for the injection cylinder memory" UBYTE COMP_0004 1 100 0 255 ECU_ADDRESS 0xFFFF21BF /begin FUNCTION_LIST /end FUNCTION_LIST /end MEASUREMENT
/begin MEASUREMENT vMINCYLH "Last time, for the homogeneous injection cylinder memory" UBYTE COMP_0004 1 100 0 255 ECU_ADDRESS 0xFFFF21C0 /begin FUNCTION_LIST /end FUNCTION_LIST /end MEASUREMENT
/begin MEASUREMENT vMINDTYI "At the time of learning, operation corner stable requirement minimum DUTY value" UBYTE COMP_0391 1 100 0 99.705 ECU_ADDRESS 0xFFFFA639 /begin FUNCTION_LIST /end FUNCTION_LIST /end MEASUREMENT
/begin MEASUREMENT vMINDTYI_R#1 "At the time of learning, operation corner stable requirement minimum DUTY value" UBYTE COMP_0391 1 100 0 99.705 ECU_ADDRESS 0xFFFFA639 /begin FUNCTION_LIST /end FUNCTION_LIST /end MEASUREMENT
/begin MEASUREMENT vMINDTYI_R#2 "At the time of learning, operation corner stable requirement minimum DUTY value" UBYTE COMP_0391 1 100 0 99.705 ECU_ADDRESS 0xFFFFA63A /begin FUNCTION_LIST /end FUNCTION_LIST /end MEASUREMENT
/begin MEASUREMENT vMIN_50 "50mS progress judgement" UBYTE COMP_0068 1 100 0 255 ECU_ADDRESS 0xFFFF3DF0 /begin FUNCTION_LIST /end FUNCTION_LIST /end MEASUREMENT
/begin MEASUREMENT vMISCV "Idle speed adjustment volume voltage value for NSET00" UBYTE COMP_0054 1 100 0 5100 ECU_ADDRESS 0xFFFF1591 /begin FUNCTION_LIST /end FUNCTION_LIST /end MEASUREMENT
/begin MEASUREMENT vMKTW "Minus KTW basic value" SBYTE COMP_0472 1 100 -2 1.984375 ECU_ADDRESS 0xFFFF159A /begin FUNCTION_LIST /end FUNCTION_LIST /end MEASUREMENT
/begin MEASUREMENT vMLRLDM "Usually, LLC learning value map" UWORD COMP_0271 1 100 0 199.99696053 ECU_ADDRESS 0xFFFF2F94 /begin FUNCTION_LIST /end FUNCTION_LIST /end MEASUREMENT
/begin MEASUREMENT vMLRLDM_C#1_R#1 "Usually, LLC learning value map" UWORD COMP_0271 1 100 0 199.99696053 ECU_ADDRESS 0xFFFF2F94 /begin FUNCTION_LIST /end FUNCTION_LIST /end MEASUREMENT
/begin MEASUREMENT vMLRLDM_C#1_R#2 "Usually, LLC learning value map" UWORD COMP_0271 1 100 0 199.99696053 ECU_ADDRESS 0xFFFF2F96 /begin FUNCTION_LIST /end FUNCTION_LIST /end MEASUREMENT
/begin MEASUREMENT vMLRLDM_C#1_R#3 "Usually, LLC learning value map" UWORD COMP_0271 1 100 0 199.99696053 ECU_ADDRESS 0xFFFF2F98 /begin FUNCTION_LIST /end FUNCTION_LIST /end MEASUREMENT
/begin MEASUREMENT vMLRLDM_C#1_R#4 "Usually, LLC learning value map" UWORD COMP_0271 1 100 0 199.99696053 ECU_ADDRESS 0xFFFF2F9A /begin FUNCTION_LIST /end FUNCTION_LIST /end MEASUREMENT
/begin MEASUREMENT vMLRLDM_C#2_R#1 "Usually, LLC learning value map" UWORD COMP_0271 1 100 0 199.99696053 ECU_ADDRESS 0xFFFF2F9C /begin FUNCTION_LIST /end FUNCTION_LIST /end MEASUREMENT
/begin MEASUREMENT vMLRLDM_C#2_R#2 "Usually, LLC learning value map" UWORD COMP_0271 1 100 0 199.99696053 ECU_ADDRESS 0xFFFF2F9E /begin FUNCTION_LIST /end FUNCTION_LIST /end MEASUREMENT
/begin MEASUREMENT vMLRLDM_C#2_R#3 "Usually, LLC learning value map" UWORD COMP_0271 1 100 0 199.99696053 ECU_ADDRESS 0xFFFF2FA0 /begin FUNCTION_LIST /end FUNCTION_LIST /end MEASUREMENT
/begin MEASUREMENT vMLRLDM_C#2_R#4 "Usually, LLC learning value map" UWORD COMP_0271 1 100 0 199.99696053 ECU_ADDRESS 0xFFFF2FA2 /begin FUNCTION_LIST /end FUNCTION_LIST /end MEASUREMENT
/begin MEASUREMENT vMLRLDM_C#3_R#1 "Usually, LLC learning value map" UWORD COMP_0271 1 100 0 199.99696053 ECU_ADDRESS 0xFFFF2FA4 /begin FUNCTION_LIST /end FUNCTION_LIST /end MEASUREMENT
/begin MEASUREMENT vMLRLDM_C#3_R#2 "Usually, LLC learning value map" UWORD COMP_0271 1 100 0 199.99696053 ECU_ADDRESS 0xFFFF2FA6 /begin FUNCTION_LIST /end FUNCTION_LIST /end MEASUREMENT
/begin MEASUREMENT vMLRLDM_C#3_R#3 "Usually, LLC learning value map" UWORD COMP_0271 1 100 0 199.99696053 ECU_ADDRESS 0xFFFF2FA8 /begin FUNCTION_LIST /end FUNCTION_LIST /end MEASUREMENT
/begin MEASUREMENT vMLRLDM_C#3_R#4 "Usually, LLC learning value map" UWORD COMP_0271 1 100 0 199.99696053 ECU_ADDRESS 0xFFFF2FAA /begin FUNCTION_LIST /end FUNCTION_LIST /end MEASUREMENT
/begin MEASUREMENT vMLRLDM_C#4_R#1 "Usually, LLC learning value map" UWORD COMP_0271 1 100 0 199.99696053 ECU_ADDRESS 0xFFFF2FAC /begin FUNCTION_LIST /end FUNCTION_LIST /end MEASUREMENT
/begin MEASUREMENT vMLRLDM_C#4_R#2 "Usually, LLC learning value map" UWORD COMP_0271 1 100 0 199.99696053 ECU_ADDRESS 0xFFFF2FAE /begin FUNCTION_LIST /end FUNCTION_LIST /end MEASUREMENT
/begin MEASUREMENT vMLRLDM_C#4_R#3 "Usually, LLC learning value map" UWORD COMP_0271 1 100 0 199.99696053 ECU_ADDRESS 0xFFFF2FB0 /begin FUNCTION_LIST /end FUNCTION_LIST /end MEASUREMENT
/begin MEASUREMENT vMLRLDM_C#4_R#4 "Usually, LLC learning value map" UWORD COMP_0271 1 100 0 199.99696053 ECU_ADDRESS 0xFFFF2FB2 /begin FUNCTION_LIST /end FUNCTION_LIST /end MEASUREMENT
/begin MEASUREMENT vMLRLDMG "Usually, LLC learning value map" UWORD COMP_0271 1 100 0 199.99696053 ECU_ADDRESS 0xFFFF2FB4 /begin FUNCTION_LIST /end FUNCTION_LIST /end MEASUREMENT
/begin MEASUREMENT vMLRLDMG_C#1_R#1 "Usually, LLC learning value map" UWORD COMP_0271 1 100 0 199.99696053 ECU_ADDRESS 0xFFFF2FB4 /begin FUNCTION_LIST /end FUNCTION_LIST /end MEASUREMENT
/begin MEASUREMENT vMLRLDMG_C#1_R#2 "Usually, LLC learning value map" UWORD COMP_0271 1 100 0 199.99696053 ECU_ADDRESS 0xFFFF2FB6 /begin FUNCTION_LIST /end FUNCTION_LIST /end MEASUREMENT
/begin MEASUREMENT vMLRLDMG_C#1_R#3 "Usually, LLC learning value map" UWORD COMP_0271 1 100 0 199.99696053 ECU_ADDRESS 0xFFFF2FB8 /begin FUNCTION_LIST /end FUNCTION_LIST /end MEASUREMENT
/begin MEASUREMENT vMLRLDMG_C#1_R#4 "Usually, LLC learning value map" UWORD COMP_0271 1 100 0 199.99696053 ECU_ADDRESS 0xFFFF2FBA /begin FUNCTION_LIST /end FUNCTION_LIST /end MEASUREMENT
/begin MEASUREMENT vMLRLDMG_C#2_R#1 "Usually, LLC learning value map" UWORD COMP_0271 1 100 0 199.99696053 ECU_ADDRESS 0xFFFF2FBC /begin FUNCTION_LIST /end FUNCTION_LIST /end MEASUREMENT
/begin MEASUREMENT vMLRLDMG_C#2_R#2 "Usually, LLC learning value map" UWORD COMP_0271 1 100 0 199.99696053 ECU_ADDRESS 0xFFFF2FBE /begin FUNCTION_LIST /end FUNCTION_LIST /end MEASUREMENT
/begin MEASUREMENT vMLRLDMG_C#2_R#3 "Usually, LLC learning value map" UWORD COMP_0271 1 100 0 199.99696053 ECU_ADDRESS 0xFFFF2FC0 /begin FUNCTION_LIST /end FUNCTION_LIST /end MEASUREMENT
/begin MEASUREMENT vMLRLDMG_C#2_R#4 "Usually, LLC learning value map" UWORD COMP_0271 1 100 0 199.99696053 ECU_ADDRESS 0xFFFF2FC2 /begin FUNCTION_LIST /end FUNCTION_LIST /end MEASUREMENT
/begin MEASUREMENT vMLRLDMG_C#3_R#1 "Usually, LLC learning value map" UWORD COMP_0271 1 100 0 199.99696053 ECU_ADDRESS 0xFFFF2FC4 /begin FUNCTION_LIST /end FUNCTION_LIST /end MEASUREMENT
/begin MEASUREMENT vMLRLDMG_C#3_R#2 "Usually, LLC learning value map" UWORD COMP_0271 1 100 0 199.99696053 ECU_ADDRESS 0xFFFF2FC6 /begin FUNCTION_LIST /end FUNCTION_LIST /end MEASUREMENT
/begin MEASUREMENT vMLRLDMG_C#3_R#3 "Usually, LLC learning value map" UWORD COMP_0271 1 100 0 199.99696053 ECU_ADDRESS 0xFFFF2FC8 /begin FUNCTION_LIST /end FUNCTION_LIST /end MEASUREMENT
/begin MEASUREMENT vMLRLDMG_C#3_R#4 "Usually, LLC learning value map" UWORD COMP_0271 1 100 0 199.99696053 ECU_ADDRESS 0xFFFF2FCA /begin FUNCTION_LIST /end FUNCTION_LIST /end MEASUREMENT
/begin MEASUREMENT vMLRLDMG_C#4_R#1 "Usually, LLC learning value map" UWORD COMP_0271 1 100 0 199.99696053 ECU_ADDRESS 0xFFFF2FCC /begin FUNCTION_LIST /end FUNCTION_LIST /end MEASUREMENT
/begin MEASUREMENT vMLRLDMG_C#4_R#2 "Usually, LLC learning value map" UWORD COMP_0271 1 100 0 199.99696053 ECU_ADDRESS 0xFFFF2FCE /begin FUNCTION_LIST /end FUNCTION_LIST /end MEASUREMENT
/begin MEASUREMENT vMLRLDMG_C#4_R#3 "Usually, LLC learning value map" UWORD COMP_0271 1 100 0 199.99696053 ECU_ADDRESS 0xFFFF2FD0 /begin FUNCTION_LIST /end FUNCTION_LIST /end MEASUREMENT
/begin MEASUREMENT vMLRLDMG_C#4_R#4 "Usually, LLC learning value map" UWORD COMP_0271 1 100 0 199.99696053 ECU_ADDRESS 0xFFFF2FD2 /begin FUNCTION_LIST /end FUNCTION_LIST /end MEASUREMENT
/begin MEASUREMENT vMMALP "Just before the purge cut, MALPHA (R/L)" UBYTE COMP_0027 1 100 0 255 ECU_ADDRESS 0xFFFF159B /begin FUNCTION_LIST /end FUNCTION_LIST /end MEASUREMENT
/begin MEASUREMENT vMMALP_R#1 "Just before the purge cut, MALPHA (R/L)" UBYTE COMP_0027 1 100 0 255 ECU_ADDRESS 0xFFFF159B /begin FUNCTION_LIST /end FUNCTION_LIST /end MEASUREMENT
/begin MEASUREMENT vMMALP_R#2 "Just before the purge cut, MALPHA (R/L)" UBYTE COMP_0027 1 100 0 255 ECU_ADDRESS 0xFFFF159C /begin FUNCTION_LIST /end FUNCTION_LIST /end MEASUREMENT
/begin MEASUREMENT vMMALPH "After the weighted average, MALPHA" UWORD COMP_0031 1 100 0 255.99609375 ECU_ADDRESS 0xFFFF159E /begin FUNCTION_LIST /end FUNCTION_LIST /end MEASUREMENT
/begin MEASUREMENT vMMALPH_R#1 "After the weighted average, MALPHA" UWORD COMP_0031 1 100 0 255.99609375 ECU_ADDRESS 0xFFFF159E /begin FUNCTION_LIST /end FUNCTION_LIST /end MEASUREMENT
/begin MEASUREMENT vMMALPH_R#2 "After the weighted average, MALPHA" UWORD COMP_0031 1 100 0 255.99609375 ECU_ADDRESS 0xFFFF15A0 /begin FUNCTION_LIST /end FUNCTION_LIST /end MEASUREMENT
/begin MEASUREMENT vMNRPM_S "(SubCPU) Side speed" UBYTE COMP_0000 1 100 0 6375 ECU_ADDRESS 0xFFFF229A /begin FUNCTION_LIST /end FUNCTION_LIST /end MEASUREMENT
/begin MEASUREMENT vMNRPMz1 "Before 10mS, vMNRPM" UBYTE COMP_0000 1 100 0 6375 ECU_ADDRESS 0xFFFF21C1 /begin FUNCTION_LIST /end FUNCTION_LIST /end MEASUREMENT
/begin MEASUREMENT vMNRPMz10 "Before 100mS, vMNRPM" UBYTE COMP_0000 1 100 0 6375 ECU_ADDRESS 0xFFFF8A44 /begin FUNCTION_LIST /end FUNCTION_LIST /end MEASUREMENT
/begin MEASUREMENT vMNRPMz2 "Before 20mS, vMNRPM" UBYTE COMP_0000 1 100 0 6375 ECU_ADDRESS 0xFFFF21C2 /begin FUNCTION_LIST /end FUNCTION_LIST /end MEASUREMENT
/begin MEASUREMENT vMNRPMz3 "Before 30mS, vMNRPM" UBYTE COMP_0000 1 100 0 6375 ECU_ADDRESS 0xFFFF21C3 /begin FUNCTION_LIST /end FUNCTION_LIST /end MEASUREMENT
/begin MEASUREMENT vMNRPMz4 "Before 40mS, vMNRPM" UBYTE COMP_0000 1 100 0 6375 ECU_ADDRESS 0xFFFF21C4 /begin FUNCTION_LIST /end FUNCTION_LIST /end MEASUREMENT
/begin MEASUREMENT vMNRPMz5 "Before 50mS, vMNRPM" UBYTE COMP_0000 1 100 0 6375 ECU_ADDRESS 0xFFFF21C5 /begin FUNCTION_LIST /end FUNCTION_LIST /end MEASUREMENT
/begin MEASUREMENT vMNRPMz6 "Before 60mS, vMNRPM" UBYTE COMP_0000 1 100 0 6375 ECU_ADDRESS 0xFFFF21C6 /begin FUNCTION_LIST /end FUNCTION_LIST /end MEASUREMENT
/begin MEASUREMENT vMNRPMz7 "Before 70mS, vMNRPM" UBYTE COMP_0000 1 100 0 6375 ECU_ADDRESS 0xFFFF21C7 /begin FUNCTION_LIST /end FUNCTION_LIST /end MEASUREMENT
/begin MEASUREMENT vMNRPMz8 "Before 80mS, vMNRPM" UBYTE COMP_0000 1 100 0 6375 ECU_ADDRESS 0xFFFF21C8 /begin FUNCTION_LIST /end FUNCTION_LIST /end MEASUREMENT
/begin MEASUREMENT vMNRPMz9 "Before 90mS, vMNRPM" UBYTE COMP_0000 1 100 0 6375 ECU_ADDRESS 0xFFFF21C9 /begin FUNCTION_LIST /end FUNCTION_LIST /end MEASUREMENT
/begin MEASUREMENT vMOCYL "Usually, injection requirement cylinder" UBYTE COMP_0421 1 100 0 255 ECU_ADDRESS 0xFFFF21CA /begin FUNCTION_LIST /end FUNCTION_LIST /end MEASUREMENT
/begin MEASUREMENT vMODECNT "Cycle number {after TVO (APO) >=60deg, IDLE SW on}" UBYTE COMP_0030 1 100 0 255 ECU_ADDRESS 0xFFFF2FD5 /begin FUNCTION_LIST /end FUNCTION_LIST /end MEASUREMENT
/begin MEASUREMENT vMODEJDG "At the time of mode 1 mode 2 switching, transition condition" UBYTE COMP_0068 1 100 0 255 ECU_ADDRESS 0xFFFF2FD6 /begin FUNCTION_LIST /end FUNCTION_LIST /end MEASUREMENT
/begin MEASUREMENT vMODPAT "Bank switching distinction indication data" UBYTE COMP_0092 1 100 0 255 ECU_ADDRESS 0xFFFF3DF1 /begin FUNCTION_LIST /end FUNCTION_LIST /end MEASUREMENT
/begin MEASUREMENT vMODTM "Angle time conversion work data (so, advantage)" UBYTE COMP_0189 1 100 0 816 ECU_ADDRESS 0xFFFF15A6 /begin FUNCTION_LIST /end FUNCTION_LIST /end MEASUREMENT
/begin MEASUREMENT vMONDRV "The integration number of times for the DRV mean computation" UBYTE COMP_0016 1 100 0 255 ECU_ADDRESS 0xFFFF2FDC /begin FUNCTION_LIST /end FUNCTION_LIST /end MEASUREMENT
/begin MEASUREMENT vMONDTYI "A drive DUTY ratio for the electromagnetism VTC monitor" UBYTE COMP_0391 1 100 0 99.705 ECU_ADDRESS 0xFFFF15A7 /begin FUNCTION_LIST /end FUNCTION_LIST /end MEASUREMENT
/begin MEASUREMENT vMONDTYI_R#1 "A drive DUTY ratio for the electromagnetism VTC monitor" UBYTE COMP_0391 1 100 0 99.705 ECU_ADDRESS 0xFFFF15A7 /begin FUNCTION_LIST /end FUNCTION_LIST /end MEASUREMENT
/begin MEASUREMENT vMONDTYI_R#2 "A drive DUTY ratio for the electromagnetism VTC monitor" UBYTE COMP_0391 1 100 0 99.705 ECU_ADDRESS 0xFFFF15A8 /begin FUNCTION_LIST /end FUNCTION_LIST /end MEASUREMENT
/begin MEASUREMENT vMONFS1 "The indication of DGNSW of FLGFS= 1 o'clock" UBYTE COMP_0068 1 100 0 255 ECU_ADDRESS 0xFFFFAA44 /begin FUNCTION_LIST /end FUNCTION_LIST /end MEASUREMENT
/begin MEASUREMENT vMONFS2 "The indication of the bit position of FLGFS= 1 o'clock" UBYTE COMP_0068 1 100 0 255 ECU_ADDRESS 0xFFFFAA45 /begin FUNCTION_LIST /end FUNCTION_LIST /end MEASUREMENT
/begin MEASUREMENT vMONFSL "DGN_BU_APL of FLGFS=1 was located last time." UWORD COMP_0068 1 100 0 65535 ECU_ADDRESS 0xFFFF2FDE /begin FUNCTION_LIST /end FUNCTION_LIST /end MEASUREMENT
/begin MEASUREMENT vMONFSMEM "Self-diagnosis NG result indication 500mS counter" UBYTE COMP_0008 1 100 0 25500 ECU_ADDRESS 0xFFFF2FE0 /begin FUNCTION_LIST /end FUNCTION_LIST /end MEASUREMENT
/begin MEASUREMENT vMONMEM1 "The indication of DGNSW of FLGMEM= 1 o'clock" UBYTE COMP_0068 1 100 0 255 ECU_ADDRESS 0xFFFFAAA6 /begin FUNCTION_LIST /end FUNCTION_LIST /end MEASUREMENT
/begin MEASUREMENT vMONMEM2 "The indication of the bit position of FLGMEM= 1 o'clock" UBYTE COMP_0068 1 100 0 255 ECU_ADDRESS 0xFFFFAAA7 /begin FUNCTION_LIST /end FUNCTION_LIST /end MEASUREMENT
/begin MEASUREMENT vMONMEML "DGN_BU_APL of FLGMEM=1 was located last time." UWORD COMP_0068 1 100 0 65535 ECU_ADDRESS 0xFFFF2FE2 /begin FUNCTION_LIST /end FUNCTION_LIST /end MEASUREMENT
/begin MEASUREMENT vMONTCLPf "Monitor clamp experience distinction" UBYTE COMP_0004 1 100 0 255 ECU_ADDRESS 0xFFFF2FE4 /begin FUNCTION_LIST /end FUNCTION_LIST /end MEASUREMENT
/begin MEASUREMENT vMPHAMN "PHOSAZ minimum value" UBYTE COMP_0072 1 100 -8 7.9375 ECU_ADDRESS 0xFFFFAAA8 /begin FUNCTION_LIST /end FUNCTION_LIST /end MEASUREMENT
/begin MEASUREMENT vMPHAMN_R#1 "PHOSAZ minimum value" UBYTE COMP_0072 1 100 -8 7.9375 ECU_ADDRESS 0xFFFFAAA8 /begin FUNCTION_LIST /end FUNCTION_LIST /end MEASUREMENT
/begin MEASUREMENT vMPHAMN_R#2 "PHOSAZ minimum value" UBYTE COMP_0072 1 100 -8 7.9375 ECU_ADDRESS 0xFFFFAAA9 /begin FUNCTION_LIST /end FUNCTION_LIST /end MEASUREMENT
/begin MEASUREMENT vMPHMIN "PHOS minimum value" UBYTE COMP_0072 1 100 -8 7.9375 ECU_ADDRESS 0xFFFFAAAA /begin FUNCTION_LIST /end FUNCTION_LIST /end MEASUREMENT
/begin MEASUREMENT vMPHMIN_R#1 "PHOS minimum value" UBYTE COMP_0072 1 100 -8 7.9375 ECU_ADDRESS 0xFFFFAAAA /begin FUNCTION_LIST /end FUNCTION_LIST /end MEASUREMENT
/begin MEASUREMENT vMPHMIN_R#2 "PHOS minimum value" UBYTE COMP_0072 1 100 -8 7.9375 ECU_ADDRESS 0xFFFFAAAB /begin FUNCTION_LIST /end FUNCTION_LIST /end MEASUREMENT
/begin MEASUREMENT vMPLMD "Lambda control coefficient lower limit value" UWORD COMP_0031 1 100 0 255.99609375 ECU_ADDRESS 0xFFFF15AA /begin FUNCTION_LIST /end FUNCTION_LIST /end MEASUREMENT
/begin MEASUREMENT vMPLMD_R#1 "Lambda control coefficient lower limit value" UWORD COMP_0031 1 100 0 255.99609375 ECU_ADDRESS 0xFFFF15AA /begin FUNCTION_LIST /end FUNCTION_LIST /end MEASUREMENT
/begin MEASUREMENT vMPLMD_R#2 "Lambda control coefficient lower limit value" UWORD COMP_0031 1 100 0 255.99609375 ECU_ADDRESS 0xFFFF15AC /begin FUNCTION_LIST /end FUNCTION_LIST /end MEASUREMENT
/begin MEASUREMENT vMPXDIS "At the time of the S_AD4 practice, ADMPX cancellation flag" UBYTE COMP_0283 1 100 0 255 ECU_ADDRESS 0xFFFF15B1 /begin FUNCTION_LIST /end FUNCTION_LIST /end MEASUREMENT
/begin MEASUREMENT vMPXDIS10 "At the time of 10mS JOB practice, ADMPX cancellation flag" UBYTE COMP_0283 1 100 0 255 ECU_ADDRESS 0xFFFF15B2 /begin FUNCTION_LIST /end FUNCTION_LIST /end MEASUREMENT
/begin MEASUREMENT vMPX_CNT "A counter for the data acquisition from the A/D multiprex" UBYTE COMP_0068 1 100 0 255 ECU_ADDRESS 0xFFFF15B0 /begin FUNCTION_LIST /end FUNCTION_LIST /end MEASUREMENT
/begin MEASUREMENT vMRGKJKf "An O2/S NG distinction for fuel learning" UBYTE COMP_0004 1 100 0 255 ECU_ADDRESS 0xFFFF3DF3 /begin FUNCTION_LIST /end FUNCTION_LIST /end MEASUREMENT
/begin MEASUREMENT vMSACNT "After TINT measuring, REF counter" UBYTE COMP_0016 1 100 0 255 ECU_ADDRESS 0xFFFF3716 /begin FUNCTION_LIST /end FUNCTION_LIST /end MEASUREMENT
/begin MEASUREMENT vMSACNT2 "STSW After off, REF counter" UBYTE COMP_0016 1 100 0 255 ECU_ADDRESS 0xFFFF3717 /begin FUNCTION_LIST /end FUNCTION_LIST /end MEASUREMENT
/begin MEASUREMENT vMSACNT3 "After the misfire diagnosis permission condition (A STSW condition is removed.) formation, REF counter" UBYTE COMP_0016 1 100 0 255 ECU_ADDRESS 0xFFFF3718 /begin FUNCTION_LIST /end FUNCTION_LIST /end MEASUREMENT
/begin MEASUREMENT vMSGCTACC "ACC message counter" UBYTE COMP_0068 1 100 0 255 ECU_ADDRESS 0xFFFF1DE7 /begin FUNCTION_LIST /end FUNCTION_LIST /end MEASUREMENT
/begin MEASUREMENT vMSMODE "CONSULT mode" UBYTE COMP_0068 1 100 0 255 ECU_ADDRESS 0xFFFF2FEE /begin FUNCTION_LIST /end FUNCTION_LIST /end MEASUREMENT
/begin MEASUREMENT vMSRTQRQ "MSR requested torque" UBYTE COMP_0021_S 1 100 -100 410 ECU_ADDRESS 0xFFFF3DF4 /begin FUNCTION_LIST /end FUNCTION_LIST /end MEASUREMENT
/begin MEASUREMENT vMTF "Fuel temperature voltage weighted average value" UWORD COMP_0050 1 100 0 5119.921875 ECU_ADDRESS 0xFFFF15B6 /begin FUNCTION_LIST /end FUNCTION_LIST /end MEASUREMENT
/begin MEASUREMENT vMTMPCAT "Catalyst estimated temperature (at the time of the engine stall, for the maintenance)" UBYTE COMP_0062 1 100 0 1020 ECU_ADDRESS 0xFFFF2FF4 /begin FUNCTION_LIST /end FUNCTION_LIST /end MEASUREMENT
/begin MEASUREMENT vMTPIDL "TP weighted average value for the air-conditioning on judgement" UBYTE COMP_0001 1 100 0 31.875 ECU_ADDRESS 0xFFFFB551 /begin FUNCTION_LIST /end FUNCTION_LIST /end MEASUREMENT
/begin MEASUREMENT vMTPIDLW "TP weighted average value computed work for the air-conditioning on judgement" UWORD COMP_0144 1 100 0 31.999495335 ECU_ADDRESS 0xFFFFB552 /begin FUNCTION_LIST /end FUNCTION_LIST /end MEASUREMENT
/begin MEASUREMENT vMUCE12 "Byte for ECU12 status on mux network on diagnosis frame" UBYTE COMP_0068 1 100 0 255 ECU_ADDRESS 0xFFFF3DF5 /begin FUNCTION_LIST /end FUNCTION_LIST /end MEASUREMENT
/begin MEASUREMENT vMUCE14 "Byte for ECU12 status on mux network on diagnosis frame" UBYTE COMP_0068 1 100 0 255 ECU_ADDRESS 0xFFFF3DF6 /begin FUNCTION_LIST /end FUNCTION_LIST /end MEASUREMENT
/begin MEASUREMENT vMUCE2 "Byte for ECU2 status on mux network on diagnosis frame" UBYTE COMP_0068 1 100 0 255 ECU_ADDRESS 0xFFFF3DF7 /begin FUNCTION_LIST /end FUNCTION_LIST /end MEASUREMENT
/begin MEASUREMENT vMUCE20 "Byte for ECU20 status on mux network on diagnosis frame" UBYTE COMP_0068 1 100 0 255 ECU_ADDRESS 0xFFFF3DF8 /begin FUNCTION_LIST /end FUNCTION_LIST /end MEASUREMENT
/begin MEASUREMENT vMUCE24 "Byte for ECU24 status on mux network on diagnosis frame" UBYTE COMP_0068 1 100 0 255 ECU_ADDRESS 0xFFFF3DF9 /begin FUNCTION_LIST /end FUNCTION_LIST /end MEASUREMENT
/begin MEASUREMENT vMUCE3 "Byte for ECU3 status on mux network on diagnosis frame" UBYTE COMP_0068 1 100 0 255 ECU_ADDRESS 0xFFFF3DFA /begin FUNCTION_LIST /end FUNCTION_LIST /end MEASUREMENT
/begin MEASUREMENT vMUCE4 "Byte for ECU4 status on mux network on diagnosis frame" UBYTE COMP_0068 1 100 0 255 ECU_ADDRESS 0xFFFF3DFB /begin FUNCTION_LIST /end FUNCTION_LIST /end MEASUREMENT
/begin MEASUREMENT vMUCE7 "Byte for ECU7 status on mux network on diagnosis frame" UBYTE COMP_0068 1 100 0 255 ECU_ADDRESS 0xFFFF3DFC /begin FUNCTION_LIST /end FUNCTION_LIST /end MEASUREMENT
/begin MEASUREMENT vMUCE8 "Byte for ECU2 status on mux network on diagnosis frame" UBYTE COMP_0068 1 100 0 255 ECU_ADDRESS 0xFFFF3DFD /begin FUNCTION_LIST /end FUNCTION_LIST /end MEASUREMENT
/begin MEASUREMENT vMUCE9 "Byte for ECU9 status on mux network on diagnosis frame" UBYTE COMP_0068 1 100 0 255 ECU_ADDRESS 0xFFFF3DFE /begin FUNCTION_LIST /end FUNCTION_LIST /end MEASUREMENT
/begin MEASUREMENT vMVADO2T "3rdO2/S Output smoothing voltage" UWORD COMP_0023 1 100 0 327675 ECU_ADDRESS 0xFFFF1ED6 /begin FUNCTION_LIST /end FUNCTION_LIST /end MEASUREMENT
/begin MEASUREMENT vMVADO2T_R#1 "3rdO2/S Output smoothing voltage" UWORD COMP_0023 1 100 0 327675 ECU_ADDRESS 0xFFFF1ED6 /begin FUNCTION_LIST /end FUNCTION_LIST /end MEASUREMENT
/begin MEASUREMENT vMVADO2T_R#2 "3rdO2/S Output smoothing voltage" UWORD COMP_0023 1 100 0 327675 ECU_ADDRESS 0xFFFF1ED8 /begin FUNCTION_LIST /end FUNCTION_LIST /end MEASUREMENT
/begin MEASUREMENT vMXPWPTC "Max power PTC sent on CAN" UBYTE COMP_0519_S 1 100 0 25500 ECU_ADDRESS 0xFFFF3E02 /begin FUNCTION_LIST /end FUNCTION_LIST /end MEASUREMENT
/begin MEASUREMENT vNCAMIN "This time, at the time of the CAM input, timer value" ULONG COMP_0189 1 100 0 13743895344 ECU_ADDRESS 0xFFFF21CC /begin FUNCTION_LIST /end FUNCTION_LIST /end MEASUREMENT
/begin MEASUREMENT vNDTOIL "At the time of the N (DorR) select, table reference TOIL" UBYTE COMP_0128_S 1 100 -30 1245 ECU_ADDRESS 0xFFFF15CC /begin FUNCTION_LIST /end FUNCTION_LIST /end MEASUREMENT
/begin MEASUREMENT vNEDCNT "NEDWN lattice point" UBYTE COMP_0068 1 100 0 255 ECU_ADDRESS 0xFFFF15CE /begin FUNCTION_LIST /end FUNCTION_LIST /end MEASUREMENT
/begin MEASUREMENT vNETARGETZ "Idle speed target value" UWORD COMP_0476 1 100 0 12799.8046875 ECU_ADDRESS 0xFFFF21D2 /begin FUNCTION_LIST /end FUNCTION_LIST /end MEASUREMENT
/begin MEASUREMENT vNEZ1 "Engine speed (value before 10mS)" UWORD COMP_0065 1 100 0 204796.875 ECU_ADDRESS 0xFFFF15D4 /begin FUNCTION_LIST /end FUNCTION_LIST /end MEASUREMENT
/begin MEASUREMENT vNEZ2 "Engine speed (value before 20mS)" UWORD COMP_0065 1 100 0 204796.875 ECU_ADDRESS 0xFFFF15D6 /begin FUNCTION_LIST /end FUNCTION_LIST /end MEASUREMENT
/begin MEASUREMENT vNEZ3 "Engine speed (value before 30mS)" UWORD COMP_0065 1 100 0 204796.875 ECU_ADDRESS 0xFFFF15D8 /begin FUNCTION_LIST /end FUNCTION_LIST /end MEASUREMENT
/begin MEASUREMENT vNEZ4 "Engine speed (value before 40mS)" UWORD COMP_0065 1 100 0 204796.875 ECU_ADDRESS 0xFFFF15DA /begin FUNCTION_LIST /end FUNCTION_LIST /end MEASUREMENT
/begin MEASUREMENT vNGBSTPf "At the time of the former A/F sensor rich lean response deterioration diagnosis NG judgement, parameter acquisition completion flag" UBYTE COMP_0004 1 100 0 255 ECU_ADDRESS 0xFFFFACD8 /begin FUNCTION_LIST /end FUNCTION_LIST /end MEASUREMENT
/begin MEASUREMENT vNGOKf "Diagnosis judgement result flag" UBYTE COMP_0004 1 100 0 255 ECU_ADDRESS 0xFFFF300A /begin FUNCTION_LIST /end FUNCTION_LIST /end MEASUREMENT
/begin MEASUREMENT vNGSLMX "NGSLSH maximum value" UBYTE COMP_0016 1 100 0 255 ECU_ADDRESS 0xFFFFADDE /begin FUNCTION_LIST /end FUNCTION_LIST /end MEASUREMENT
/begin MEASUREMENT vNGSLSH "NG counter" UBYTE COMP_0016 1 100 0 255 ECU_ADDRESS 0xFFFF300B /begin FUNCTION_LIST /end FUNCTION_LIST /end MEASUREMENT
/begin MEASUREMENT vNINTV16 "A REF period for the DDL2 monitor" UWORD COMP_0478 1 100 0 1048560 ECU_ADDRESS 0xFFFF1EDA /begin FUNCTION_LIST /end FUNCTION_LIST /end MEASUREMENT
/begin MEASUREMENT vNINTV8 "A REF period for the DDL2 monitor" UWORD COMP_0417 1 100 0 524280 ECU_ADDRESS 0xFFFF1EDC /begin FUNCTION_LIST /end FUNCTION_LIST /end MEASUREMENT
/begin MEASUREMENT vNMAL3 "LEKAL3 operation number of times" UBYTE COMP_0016 1 100 0 255 ECU_ADDRESS 0xFFFFAE00 /begin FUNCTION_LIST /end FUNCTION_LIST /end MEASUREMENT
/begin MEASUREMENT vNMAL32 "At the time of the 0.04inch leak-down, LEKAL3 operation number of times" UBYTE COMP_0016 1 100 0 255 ECU_ADDRESS 0xFFFFAE01 /begin FUNCTION_LIST /end FUNCTION_LIST /end MEASUREMENT
/begin MEASUREMENT vNMPDC "Pull-down number of times operation number of times" UBYTE COMP_0016 1 100 0 255 ECU_ADDRESS 0xFFFFAE42 /begin FUNCTION_LIST /end FUNCTION_LIST /end MEASUREMENT
/begin MEASUREMENT vNOISEH "noise for immobi (high)" ULONG COMP_0068 1 100 0 4294967295 ECU_ADDRESS 0xFFFF3E04 /begin FUNCTION_LIST /end FUNCTION_LIST /end MEASUREMENT
/begin MEASUREMENT vNOISEL "noise for immobi (low)" UWORD COMP_0068 1 100 0 65535 ECU_ADDRESS 0xFFFF3E08 /begin FUNCTION_LIST /end FUNCTION_LIST /end MEASUREMENT
/begin MEASUREMENT vNOWERRE "The amount of a change in a VTC operation angle" UBYTE COMP_0256 1 100 -64 63.5 ECU_ADDRESS 0xFFFF15E2 /begin FUNCTION_LIST /end FUNCTION_LIST /end MEASUREMENT
/begin MEASUREMENT vNOWERRE_R#1 "The amount of a change in a VTC operation angle" UBYTE COMP_0256 1 100 -64 63.5 ECU_ADDRESS 0xFFFF15E2 /begin FUNCTION_LIST /end FUNCTION_LIST /end MEASUREMENT
/begin MEASUREMENT vNOWERRE_R#2 "The amount of a change in a VTC operation angle" UBYTE COMP_0256 1 100 -64 63.5 ECU_ADDRESS 0xFFFF15E3 /begin FUNCTION_LIST /end FUNCTION_LIST /end MEASUREMENT
/begin MEASUREMENT vNOWERRI "The amount of a change in a VTC operation angle" UBYTE COMP_0256 1 100 -64 63.5 ECU_ADDRESS 0xFFFF15E4 /begin FUNCTION_LIST /end FUNCTION_LIST /end MEASUREMENT
/begin MEASUREMENT vNOWERRI_R#1 "The amount of a change in a VTC operation angle" UBYTE COMP_0256 1 100 -64 63.5 ECU_ADDRESS 0xFFFF15E4 /begin FUNCTION_LIST /end FUNCTION_LIST /end MEASUREMENT
/begin MEASUREMENT vNOWERRI_R#2 "The amount of a change in a VTC operation angle" UBYTE COMP_0256 1 100 -64 63.5 ECU_ADDRESS 0xFFFF15E5 /begin FUNCTION_LIST /end FUNCTION_LIST /end MEASUREMENT
/begin MEASUREMENT vNPVSP "At the time of vehicle speed signal pulse periodic measuring, the number of pulses" UBYTE COMP_0068 1 100 0 255 ECU_ADDRESS 0xFFFF4078 /begin FUNCTION_LIST /end FUNCTION_LIST /end MEASUREMENT
/begin MEASUREMENT vNRESET "Lean prohibition release counter" UBYTE COMP_0016 1 100 0 255 ECU_ADDRESS 0xFFFF15E7 /begin FUNCTION_LIST /end FUNCTION_LIST /end MEASUREMENT
/begin MEASUREMENT vNRPM100 "Before 100mS, NRPM" UWORD COMP_0006 1 100 0 819187.5 ECU_ADDRESS 0xFFFF300E /begin FUNCTION_LIST /end FUNCTION_LIST /end MEASUREMENT
/begin MEASUREMENT vNRPM1000 "In front of 1s, NRPM" UWORD COMP_0006 1 100 0 819187.5 ECU_ADDRESS 0xFFFF3E0A /begin FUNCTION_LIST /end FUNCTION_LIST /end MEASUREMENT
/begin MEASUREMENT vNRPM100Z "Engine speed before 100mS" UWORD COMP_0006 1 100 0 819187.5 ECU_ADDRESS 0xFFFF15E8 /begin FUNCTION_LIST /end FUNCTION_LIST /end MEASUREMENT
/begin MEASUREMENT vNRPMCNT "NRPM<350rpm counter" UBYTE COMP_0030 1 100 0 255 ECU_ADDRESS 0xFFFF3010 /begin FUNCTION_LIST /end FUNCTION_LIST /end MEASUREMENT
/begin MEASUREMENT vNRPMDLT "Present engine speed -100mS front engine speed" ULONG COMP_0006 1 100 0 53687091187.5 ECU_ADDRESS 0xFFFF15EC /begin FUNCTION_LIST /end FUNCTION_LIST /end MEASUREMENT
/begin MEASUREMENT vNRPMRF "Engine speed (REF15)" UWORD COMP_0006 1 100 0 819187.5 ECU_ADDRESS 0xFFFF21DA /begin FUNCTION_LIST /end FUNCTION_LIST /end MEASUREMENT
/begin MEASUREMENT vNRPMz1 "Before 10mS, vNRPM" UWORD COMP_0006 1 100 0 819187.5 ECU_ADDRESS 0xFFFF21DC /begin FUNCTION_LIST /end FUNCTION_LIST /end MEASUREMENT
/begin MEASUREMENT vNRPMz2 "Before 20mS, vNRPM" UWORD COMP_0006 1 100 0 819187.5 ECU_ADDRESS 0xFFFF21DE /begin FUNCTION_LIST /end FUNCTION_LIST /end MEASUREMENT
/begin MEASUREMENT vNRPMz3 "Before 30mS, vNRPM" UWORD COMP_0006 1 100 0 819187.5 ECU_ADDRESS 0xFFFF21E0 /begin FUNCTION_LIST /end FUNCTION_LIST /end MEASUREMENT
/begin MEASUREMENT vNRPMz4 "Before 40mS, vNRPM" UWORD COMP_0006 1 100 0 819187.5 ECU_ADDRESS 0xFFFF21E2 /begin FUNCTION_LIST /end FUNCTION_LIST /end MEASUREMENT
/begin MEASUREMENT vNRPMz5 "Before 50mS, vNRPM" UWORD COMP_0006 1 100 0 819187.5 ECU_ADDRESS 0xFFFF8A4E /begin FUNCTION_LIST /end FUNCTION_LIST /end MEASUREMENT
/begin MEASUREMENT vNSETDT "Idle speed maintenance value" UBYTE COMP_0006 1 100 0 3187.5 ECU_ADDRESS 0xFFFF15F5 /begin FUNCTION_LIST /end FUNCTION_LIST /end MEASUREMENT
/begin MEASUREMENT vNSTTBLD "At the time of the NSET00D computation, Work RAM" UBYTE COMP_0006 1 100 0 3187.5 ECU_ADDRESS 0xFFFF15FB /begin FUNCTION_LIST /end FUNCTION_LIST /end MEASUREMENT
/begin MEASUREMENT vNTPCANf "At the time of a change in NÅ~TP, diagnosis cancellation condition judgement flag" UBYTE COMP_0004 1 100 0 255 ECU_ADDRESS 0xFFFF3027 /begin FUNCTION_LIST /end FUNCTION_LIST /end MEASUREMENT
/begin MEASUREMENT vNTPSTf "The flag which has calculated NTPST" UBYTE COMP_0004 1 100 0 255 ECU_ADDRESS 0xFFFF3038 /begin FUNCTION_LIST /end FUNCTION_LIST /end MEASUREMENT
/begin MEASUREMENT vNTXNOK "Number of transmission failures" UBYTE COMP_0068 1 100 0 255 ECU_ADDRESS 0xFFFF3E0C /begin FUNCTION_LIST /end FUNCTION_LIST /end MEASUREMENT
/begin MEASUREMENT vNWTONI "NEUT SW ONOFF time front I-gain" SWORD COMP_0277 1 100 -32768 32767 ECU_ADDRESS 0xFFFF303E /begin FUNCTION_LIST /end FUNCTION_LIST /end MEASUREMENT
/begin MEASUREMENT vO2CTR "VO2 A/D timing counter" UBYTE COMP_0004 1 100 0 255 ECU_ADDRESS 0xFFFF21E4 /begin FUNCTION_LIST /end FUNCTION_LIST /end MEASUREMENT
/begin MEASUREMENT vO2DGNGOf "An unusual O2 sensor breakage, voltage diagnosis permission condition formation distinction" UBYTE COMP_0004 1 100 0 255 ECU_ADDRESS 0xFFFF3040 /begin FUNCTION_LIST /end FUNCTION_LIST /end MEASUREMENT
/begin MEASUREMENT vO2DTYINF "O2 sensor heater duty initial value" UWORD COMP_0133_S 1 100 0 2559.9609375 ECU_ADDRESS 0xFFFF15FC /begin FUNCTION_LIST /end FUNCTION_LIST /end MEASUREMENT
/begin MEASUREMENT vO2HCHKf "O2NGTM Delay" UBYTE COMP_0004 1 100 0 255 ECU_ADDRESS 0xFFFF3E0D /begin FUNCTION_LIST /end FUNCTION_LIST /end MEASUREMENT
/begin MEASUREMENT vO2HCR0 "O2HCURA" UBYTE COMP_0022 1 100 0 5100 ECU_ADDRESS 0xFFFF3E0E /begin FUNCTION_LIST /end FUNCTION_LIST /end MEASUREMENT
/begin MEASUREMENT vO2HCR1 "O2HCURA Before 10mS" UBYTE COMP_0022 1 100 0 5100 ECU_ADDRESS 0xFFFF3E10 /begin FUNCTION_LIST /end FUNCTION_LIST /end MEASUREMENT
/begin MEASUREMENT vO2HCR2 "O2HCURA Before 20mS" UBYTE COMP_0022 1 100 0 5100 ECU_ADDRESS 0xFFFF3E12 /begin FUNCTION_LIST /end FUNCTION_LIST /end MEASUREMENT
/begin MEASUREMENT vO2HCR3 "O2HCURA Before 30mS" UBYTE COMP_0022 1 100 0 5100 ECU_ADDRESS 0xFFFF3E14 /begin FUNCTION_LIST /end FUNCTION_LIST /end MEASUREMENT
/begin MEASUREMENT vO2HCURA "O2H electric current" UBYTE COMP_0022 1 100 0 5100 ECU_ADDRESS 0xFFFF3E16 /begin FUNCTION_LIST /end FUNCTION_LIST /end MEASUREMENT
/begin MEASUREMENT vO2HFOKEXf "FO2 heater breakage OK judgement experience flag" UBYTE COMP_0004 1 100 0 255 ECU_ADDRESS 0xFFFF3041 /begin FUNCTION_LIST /end FUNCTION_LIST /end MEASUREMENT
/begin MEASUREMENT vO2HFOKf "FO2 heater breakage OK judgement" UBYTE COMP_0004 1 100 0 255 ECU_ADDRESS 0xFFFF15FF /begin FUNCTION_LIST /end FUNCTION_LIST /end MEASUREMENT
/begin MEASUREMENT vO2HIRLf "The rest O2 heater on condition flag (at the time of the start, coolant temperature, initialization)" UBYTE COMP_0004 1 100 0 255 ECU_ADDRESS 0xFFFF1600 /begin FUNCTION_LIST /end FUNCTION_LIST /end MEASUREMENT
/begin MEASUREMENT vO2SDGCf "O2 sensor unusual voltage diagnosis permission condition judgement distinction" UBYTE COMP_0004 1 100 0 255 ECU_ADDRESS 0xFFFF3042 /begin FUNCTION_LIST /end FUNCTION_LIST /end MEASUREMENT
/begin MEASUREMENT vO2SPL "A lambda control P-gain (Lean) for the O2 sensor diagnosis" UBYTE COMP_0163 1 100 0 15.9375 ECU_ADDRESS 0xFFFF3E18 /begin FUNCTION_LIST /end FUNCTION_LIST /end MEASUREMENT
/begin MEASUREMENT vO2SPR "A lambda control P-gain (Rich) for the O2 sensor diagnosis" UBYTE COMP_0163 1 100 0 15.9375 ECU_ADDRESS 0xFFFF3E1A /begin FUNCTION_LIST /end FUNCTION_LIST /end MEASUREMENT
/begin MEASUREMENT vO2TMRCNT1 "500mS counter (bank1) for the rear O2 sensor parameter backup" UBYTE COMP_0030 1 100 0 255 ECU_ADDRESS 0xFFFF3043 /begin FUNCTION_LIST /end FUNCTION_LIST /end MEASUREMENT
/begin MEASUREMENT vO2TMRCNT2 "500mS counter (bank2) for the rear O2 sensor parameter backup" UBYTE COMP_0030 1 100 0 255 ECU_ADDRESS 0xFFFF3044 /begin FUNCTION_LIST /end FUNCTION_LIST /end MEASUREMENT
/begin MEASUREMENT vO2VBHOS "O2 sensor heater duty VB compensation coefficient" UBYTE COMP_0009 1 100 0 199.21875 ECU_ADDRESS 0xFFFF1601 /begin FUNCTION_LIST /end FUNCTION_LIST /end MEASUREMENT
/begin MEASUREMENT vOBCDCV "Drain-cut valve CLOSEOPEN rest time" UBYTE COMP_0014 1 100 0 2550 ECU_ADDRESS 0xFFFF3E1C /begin FUNCTION_LIST /end FUNCTION_LIST /end MEASUREMENT
/begin MEASUREMENT vOBDCNT "A counter for the NG reference" UWORD COMP_0030 1 100 0 65535 ECU_ADDRESS 0xFFFF3E1E /begin FUNCTION_LIST /end FUNCTION_LIST /end MEASUREMENT
/begin MEASUREMENT vOBPF0 "BPF output" SWORD COMP_0439 1 100 -8192 8191.75 ECU_ADDRESS 0xFFFF1602 /begin FUNCTION_LIST /end FUNCTION_LIST /end MEASUREMENT
/begin MEASUREMENT vOBPF1 "BPF output" SWORD COMP_0439 1 100 -8192 8191.75 ECU_ADDRESS 0xFFFF1604 /begin FUNCTION_LIST /end FUNCTION_LIST /end MEASUREMENT
/begin MEASUREMENT vOBPF2 "BPF output" SWORD COMP_0439 1 100 -8192 8191.75 ECU_ADDRESS 0xFFFF1606 /begin FUNCTION_LIST /end FUNCTION_LIST /end MEASUREMENT
/begin MEASUREMENT vOBRF0 "1st BPF output" SWORD COMP_0482 1 100 -128 127.99609375 ECU_ADDRESS 0xFFFF1608 /begin FUNCTION_LIST /end FUNCTION_LIST /end MEASUREMENT
/begin MEASUREMENT vOBRF1 "1st BPF output" SWORD COMP_0482 1 100 -128 127.99609375 ECU_ADDRESS 0xFFFF160A /begin FUNCTION_LIST /end FUNCTION_LIST /end MEASUREMENT
/begin MEASUREMENT vOBRF10 "2nd BPF output" SWORD COMP_0440 1 100 -256 255.9921875 ECU_ADDRESS 0xFFFF160C /begin FUNCTION_LIST /end FUNCTION_LIST /end MEASUREMENT
/begin MEASUREMENT vOBRF11 "2nd BPF output" SWORD COMP_0440 1 100 -256 255.9921875 ECU_ADDRESS 0xFFFF160E /begin FUNCTION_LIST /end FUNCTION_LIST /end MEASUREMENT
/begin MEASUREMENT vOBRF12 "2nd BPF output" SWORD COMP_0440 1 100 -256 255.9921875 ECU_ADDRESS 0xFFFF1610 /begin FUNCTION_LIST /end FUNCTION_LIST /end MEASUREMENT
/begin MEASUREMENT vOBRF2 "1st BPF output" SWORD COMP_0482 1 100 -128 127.99609375 ECU_ADDRESS 0xFFFF1612 /begin FUNCTION_LIST /end FUNCTION_LIST /end MEASUREMENT
/begin MEASUREMENT vOEMAXI "An alignment extreme large quantity" UBYTE COMP_0256 1 100 -64 63.5 ECU_ADDRESS 0xFFFFAE6C /begin FUNCTION_LIST /end FUNCTION_LIST /end MEASUREMENT
/begin MEASUREMENT vOEMAXI_R#1 "An alignment extreme large quantity" UBYTE COMP_0256 1 100 -64 63.5 ECU_ADDRESS 0xFFFFAE6C /begin FUNCTION_LIST /end FUNCTION_LIST /end MEASUREMENT
/begin MEASUREMENT vOEMAXI_R#2 "An alignment extreme large quantity" UBYTE COMP_0256 1 100 -64 63.5 ECU_ADDRESS 0xFFFFAE6D /begin FUNCTION_LIST /end FUNCTION_LIST /end MEASUREMENT
/begin MEASUREMENT vOEMINI "The amount of alignment minimum" UBYTE COMP_0256 1 100 -64 63.5 ECU_ADDRESS 0xFFFFAE6E /begin FUNCTION_LIST /end FUNCTION_LIST /end MEASUREMENT
/begin MEASUREMENT vOEMINI_R#1 "The amount of alignment minimum" UBYTE COMP_0256 1 100 -64 63.5 ECU_ADDRESS 0xFFFFAE6E /begin FUNCTION_LIST /end FUNCTION_LIST /end MEASUREMENT
/begin MEASUREMENT vOEMINI_R#2 "The amount of alignment minimum" UBYTE COMP_0256 1 100 -64 63.5 ECU_ADDRESS 0xFFFFAE6F /begin FUNCTION_LIST /end FUNCTION_LIST /end MEASUREMENT
/begin MEASUREMENT vOERRORE "The amount of operation corner deviation" UBYTE COMP_0256 1 100 -64 63.5 ECU_ADDRESS 0xFFFF1618 /begin FUNCTION_LIST /end FUNCTION_LIST /end MEASUREMENT
/begin MEASUREMENT vOERRORE_R#1 "The amount of operation corner deviation" UBYTE COMP_0256 1 100 -64 63.5 ECU_ADDRESS 0xFFFF1618 /begin FUNCTION_LIST /end FUNCTION_LIST /end MEASUREMENT
/begin MEASUREMENT vOERRORE_R#2 "The amount of operation corner deviation" UBYTE COMP_0256 1 100 -64 63.5 ECU_ADDRESS 0xFFFF1619 /begin FUNCTION_LIST /end FUNCTION_LIST /end MEASUREMENT
/begin MEASUREMENT vOERRORI "The amount of operation corner deviation" UBYTE COMP_0256 1 100 -64 63.5 ECU_ADDRESS 0xFFFF161A /begin FUNCTION_LIST /end FUNCTION_LIST /end MEASUREMENT
/begin MEASUREMENT vOERRORI_R#1 "The amount of operation corner deviation" UBYTE COMP_0256 1 100 -64 63.5 ECU_ADDRESS 0xFFFF161A /begin FUNCTION_LIST /end FUNCTION_LIST /end MEASUREMENT
/begin MEASUREMENT vOERRORI_R#2 "The amount of operation corner deviation" UBYTE COMP_0256 1 100 -64 63.5 ECU_ADDRESS 0xFFFF161B /begin FUNCTION_LIST /end FUNCTION_LIST /end MEASUREMENT
/begin MEASUREMENT vOFF5 "Work RAM for the 5-times collation" UBYTE COMP_0068 1 100 0 255 ECU_ADDRESS 0xFFFF4955 /begin FUNCTION_LIST /end FUNCTION_LIST /end MEASUREMENT
/begin MEASUREMENT vOFSTPSE "The amount of VTC maximum-retard degree diagnosis reference position deviation" UBYTE COMP_0048 1 100 0 127.5 ECU_ADDRESS 0xFFFF161D /begin FUNCTION_LIST /end FUNCTION_LIST /end MEASUREMENT
/begin MEASUREMENT vOFSTPSE_R#1 "The amount of VTC maximum-retard degree diagnosis reference position deviation" UBYTE COMP_0048 1 100 0 127.5 ECU_ADDRESS 0xFFFF161D /begin FUNCTION_LIST /end FUNCTION_LIST /end MEASUREMENT
/begin MEASUREMENT vOFSTPSE_R#2 "The amount of VTC maximum-retard degree diagnosis reference position deviation" UBYTE COMP_0048 1 100 0 127.5 ECU_ADDRESS 0xFFFF161E /begin FUNCTION_LIST /end FUNCTION_LIST /end MEASUREMENT
/begin MEASUREMENT vOHPF0 "High pass filter output" SWORD COMP_0440 1 100 -256 255.9921875 ECU_ADDRESS 0xFFFF1620 /begin FUNCTION_LIST /end FUNCTION_LIST /end MEASUREMENT
/begin MEASUREMENT vOHPF1 "High pass filter output" SWORD COMP_0440 1 100 -256 255.9921875 ECU_ADDRESS 0xFFFF1622 /begin FUNCTION_LIST /end FUNCTION_LIST /end MEASUREMENT
/begin MEASUREMENT vOHPF2 "High pass filter output" SWORD COMP_0440 1 100 -256 255.9921875 ECU_ADDRESS 0xFFFF1624 /begin FUNCTION_LIST /end FUNCTION_LIST /end MEASUREMENT
/begin MEASUREMENT vOLPF0 "Low-pass filter output" SWORD COMP_0440 1 100 -256 255.9921875 ECU_ADDRESS 0xFFFF1626 /begin FUNCTION_LIST /end FUNCTION_LIST /end MEASUREMENT
/begin MEASUREMENT vOLPF1 "Low-pass filter output" SWORD COMP_0440 1 100 -256 255.9921875 ECU_ADDRESS 0xFFFF1628 /begin FUNCTION_LIST /end FUNCTION_LIST /end MEASUREMENT
/begin MEASUREMENT vOLPF2 "Low-pass filter output" SWORD COMP_0440 1 100 -256 255.9921875 ECU_ADDRESS 0xFFFF162A /begin FUNCTION_LIST /end FUNCTION_LIST /end MEASUREMENT
/begin MEASUREMENT vON5 "Work RAM for the 5-times collation" UBYTE COMP_0068 1 100 0 255 ECU_ADDRESS 0xFFFF4956 /begin FUNCTION_LIST /end FUNCTION_LIST /end MEASUREMENT
/begin MEASUREMENT vOPENJSf "OPEN LOOP Alpha judgement flag" UBYTE COMP_0004 1 100 0 255 ECU_ADDRESS 0xFFFF162E /begin FUNCTION_LIST /end FUNCTION_LIST /end MEASUREMENT
/begin MEASUREMENT vOPTAVTO "A TO2M mean for the option F.F. data buffer" UBYTE COMP_0483 1 100 0 2040 ECU_ADDRESS 0xFFFF3045 /begin FUNCTION_LIST /end FUNCTION_LIST /end MEASUREMENT
/begin MEASUREMENT vOPTAVTOS "A TO2S mean for the option F.F. data buffer" UBYTE COMP_0483 1 100 0 2040 ECU_ADDRESS 0xFFFF3047 /begin FUNCTION_LIST /end FUNCTION_LIST /end MEASUREMENT
/begin MEASUREMENT vOPTKBLRCA "Region learning control value for the option F.F. data buffer" UBYTE COMP_0423 1 100 -50 49.609375 ECU_ADDRESS 0xFFFF3049 /begin FUNCTION_LIST /end FUNCTION_LIST /end MEASUREMENT
/begin MEASUREMENT vOPTKBLRCA_R#1 "Region learning control value for the option F.F. data buffer" UBYTE COMP_0423 1 100 -50 49.609375 ECU_ADDRESS 0xFFFF3049 /begin FUNCTION_LIST /end FUNCTION_LIST /end MEASUREMENT
/begin MEASUREMENT vOPTKBLRCA_R#2 "Region learning control value for the option F.F. data buffer" UBYTE COMP_0423 1 100 -50 49.609375 ECU_ADDRESS 0xFFFF304A /begin FUNCTION_LIST /end FUNCTION_LIST /end MEASUREMENT
/begin MEASUREMENT vOPTKBLRCB "The whole area reflection learning value for the option F.F. data buffer" UBYTE COMP_0423 1 100 -50 49.609375 ECU_ADDRESS 0xFFFF304B /begin FUNCTION_LIST /end FUNCTION_LIST /end MEASUREMENT
/begin MEASUREMENT vOPTKBLRCB_R#1 "The whole area reflection learning value for the option F.F. data buffer" UBYTE COMP_0423 1 100 -50 49.609375 ECU_ADDRESS 0xFFFF304B /begin FUNCTION_LIST /end FUNCTION_LIST /end MEASUREMENT
/begin MEASUREMENT vOPTKBLRCB_R#2 "The whole area reflection learning value for the option F.F. data buffer" UBYTE COMP_0423 1 100 -50 49.609375 ECU_ADDRESS 0xFFFF304C /begin FUNCTION_LIST /end FUNCTION_LIST /end MEASUREMENT
/begin MEASUREMENT vOPTPHOSA "DOS PHOS learning value (for the option F.F. memory)" UWORD COMP_0265 1 100 -8.000012288 7.999768147 ECU_ADDRESS 0xFFFF304E /begin FUNCTION_LIST /end FUNCTION_LIST /end MEASUREMENT
/begin MEASUREMENT vOPTPHOSA_R#1 "DOS PHOS learning value (for the option F.F. memory)" UWORD COMP_0265 1 100 -8.000012288 7.999768147 ECU_ADDRESS 0xFFFF304E /begin FUNCTION_LIST /end FUNCTION_LIST /end MEASUREMENT
/begin MEASUREMENT vOPTPHOSA_R#2 "DOS PHOS learning value (for the option F.F. memory)" UWORD COMP_0265 1 100 -8.000012288 7.999768147 ECU_ADDRESS 0xFFFF3050 /begin FUNCTION_LIST /end FUNCTION_LIST /end MEASUREMENT
/begin MEASUREMENT vOSCNT "OS 10mS JOB counter" UBYTE COMP_0030 1 100 0 255 ECU_ADDRESS 0xFFFF1EE4 /begin FUNCTION_LIST /end FUNCTION_LIST /end MEASUREMENT
/begin MEASUREMENT vOSCONf "AFSHOS renewal permission flag" UBYTE COMP_0004 1 100 0 255 ECU_ADDRESS 0xFFFF3054 /begin FUNCTION_LIST /end FUNCTION_LIST /end MEASUREMENT
/begin MEASUREMENT vOSQRSTf "A flag for catalyst diagnosis parameter measuring" UBYTE COMP_0004 1 100 0 255 ECU_ADDRESS 0xFFFF3055 /begin FUNCTION_LIST /end FUNCTION_LIST /end MEASUREMENT
/begin MEASUREMENT vOSREL1f "Lean side O2 storage ability operation flag" UBYTE COMP_0004 1 100 0 255 ECU_ADDRESS 0xFFFF3056 /begin FUNCTION_LIST /end FUNCTION_LIST /end MEASUREMENT
/begin MEASUREMENT vOSRER1f "Rich side O2 storage ability operation flag" UBYTE COMP_0004 1 100 0 255 ECU_ADDRESS 0xFFFF3057 /begin FUNCTION_LIST /end FUNCTION_LIST /end MEASUREMENT
/begin MEASUREMENT vOUTPUTTM "Angle time conversion work data (conversion value)" UWORD COMP_0189 1 100 0 209712 ECU_ADDRESS 0xFFFF1630 /begin FUNCTION_LIST /end FUNCTION_LIST /end MEASUREMENT
/begin MEASUREMENT vPALP "Air-fuel ratio compensation P-gain" UWORD COMP_0031 1 100 0 255.99609375 ECU_ADDRESS 0xFFFF1634 /begin FUNCTION_LIST /end FUNCTION_LIST /end MEASUREMENT
/begin MEASUREMENT vPALP_R#1 "Air-fuel ratio compensation P-gain" UWORD COMP_0031 1 100 0 255.99609375 ECU_ADDRESS 0xFFFF1634 /begin FUNCTION_LIST /end FUNCTION_LIST /end MEASUREMENT
/begin MEASUREMENT vPALP_R#2 "Air-fuel ratio compensation P-gain" UWORD COMP_0031 1 100 0 255.99609375 ECU_ADDRESS 0xFFFF1636 /begin FUNCTION_LIST /end FUNCTION_LIST /end MEASUREMENT
/begin MEASUREMENT vPAMBAT "An atomospheric pressure for the AT communication" UBYTE COMP_0054 1 100 0 5100 ECU_ADDRESS 0xFFFF3E23 /begin FUNCTION_LIST /end FUNCTION_LIST /end MEASUREMENT
/begin MEASUREMENT vPAMLK1 "At the time of the leak-down start, atomospheric pressure" UWORD COMP_0050 1 100 0 5119.921875 ECU_ADDRESS 0xFFFF306A /begin FUNCTION_LIST /end FUNCTION_LIST /end MEASUREMENT
/begin MEASUREMENT vPAMLK2 "The former atomospheric pressure which starts a vapor monitor" UWORD COMP_0050 1 100 0 5119.921875 ECU_ADDRESS 0xFFFF306C /begin FUNCTION_LIST /end FUNCTION_LIST /end MEASUREMENT
/begin MEASUREMENT vPAMVM1 "At the time of the vapor monitor start, atomospheric pressure" UWORD COMP_0050 1 100 0 5119.921875 ECU_ADDRESS 0xFFFF306E /begin FUNCTION_LIST /end FUNCTION_LIST /end MEASUREMENT
/begin MEASUREMENT vPAMVM2 "At the time of the vapor monitor completion, atomospheric pressure" UWORD COMP_0050 1 100 0 5119.921875 ECU_ADDRESS 0xFFFF3070 /begin FUNCTION_LIST /end FUNCTION_LIST /end MEASUREMENT
/begin MEASUREMENT vPANG "The amount of P element compensation" UWORD COMP_0497_S 1 100 -128 127.99609375 ECU_ADDRESS 0xFFFF163A /begin FUNCTION_LIST /end FUNCTION_LIST /end MEASUREMENT
/begin MEASUREMENT vPARAM1 "Validation frame parameter1" UBYTE COMP_0068 1 100 0 255 ECU_ADDRESS 0xFFFF3E26 /begin FUNCTION_LIST /end FUNCTION_LIST /end MEASUREMENT
/begin MEASUREMENT vPARAM2 "Validation frame parameter2" UBYTE COMP_0068 1 100 0 255 ECU_ADDRESS 0xFFFF3E27 /begin FUNCTION_LIST /end FUNCTION_LIST /end MEASUREMENT
/begin MEASUREMENT vPARAMONI "Parameter monitor RAM" UWORD COMP_0283 1 100 0 65535 ECU_ADDRESS 0xFFFF3072 /begin FUNCTION_LIST /end FUNCTION_LIST /end MEASUREMENT
/begin MEASUREMENT vPAS "After the start, P-gain shift assistance" UWORD COMP_0265 1 100 -8.000012288 7.999768147 ECU_ADDRESS 0xFFFF163C /begin FUNCTION_LIST /end FUNCTION_LIST /end MEASUREMENT
/begin MEASUREMENT vPAS_R#1 "After the start, P-gain shift assistance" UWORD COMP_0265 1 100 -8.000012288 7.999768147 ECU_ADDRESS 0xFFFF163C /begin FUNCTION_LIST /end FUNCTION_LIST /end MEASUREMENT
/begin MEASUREMENT vPAS_R#2 "After the start, P-gain shift assistance" UWORD COMP_0265 1 100 -8.000012288 7.999768147 ECU_ADDRESS 0xFFFF163E /begin FUNCTION_LIST /end FUNCTION_LIST /end MEASUREMENT
/begin MEASUREMENT vPASNOK "OK judgement criteria" UBYTE COMP_0022 1 100 0 5100 ECU_ADDRESS 0xFFFF1640 /begin FUNCTION_LIST /end FUNCTION_LIST /end MEASUREMENT
/begin MEASUREMENT vPAT "At the time of the engine stop, a variable for the MIL 100, 10, 1 prize indication" UBYTE COMP_0068 1 100 0 255 ECU_ADDRESS 0xFFFF1EF0 /begin FUNCTION_LIST /end FUNCTION_LIST /end MEASUREMENT
/begin MEASUREMENT vPBAVOLD "PBAV old value table" UWORD COMP_0023 1 100 0 327675 ECU_ADDRESS 0xFFFF1DB0 /begin FUNCTION_LIST /end FUNCTION_LIST /end MEASUREMENT
/begin MEASUREMENT vPBAVOLD_R#1 "PBAV old value table" UWORD COMP_0023 1 100 0 327675 ECU_ADDRESS 0xFFFF1DB0 /begin FUNCTION_LIST /end FUNCTION_LIST /end MEASUREMENT
/begin MEASUREMENT vPBAVOLD_R#2 "PBAV old value table" UWORD COMP_0023 1 100 0 327675 ECU_ADDRESS 0xFFFF1DB2 /begin FUNCTION_LIST /end FUNCTION_LIST /end MEASUREMENT
/begin MEASUREMENT vPBAVOLD_R#3 "PBAV old value table" UWORD COMP_0023 1 100 0 327675 ECU_ADDRESS 0xFFFF1DB4 /begin FUNCTION_LIST /end FUNCTION_LIST /end MEASUREMENT
/begin MEASUREMENT vPBAVOLD_R#4 "PBAV old value table" UWORD COMP_0023 1 100 0 327675 ECU_ADDRESS 0xFFFF1DB6 /begin FUNCTION_LIST /end FUNCTION_LIST /end MEASUREMENT
/begin MEASUREMENT vPBAVOLD_R#5 "PBAV old value table" UWORD COMP_0023 1 100 0 327675 ECU_ADDRESS 0xFFFF1DB8 /begin FUNCTION_LIST /end FUNCTION_LIST /end MEASUREMENT
/begin MEASUREMENT vPBAVOLD_R#6 "PBAV old value table" UWORD COMP_0023 1 100 0 327675 ECU_ADDRESS 0xFFFF1DBA /begin FUNCTION_LIST /end FUNCTION_LIST /end MEASUREMENT
/begin MEASUREMENT vPBAVOLD_R#7 "PBAV old value table" UWORD COMP_0023 1 100 0 327675 ECU_ADDRESS 0xFFFF1DBC /begin FUNCTION_LIST /end FUNCTION_LIST /end MEASUREMENT
/begin MEASUREMENT vPBAVOLD_R#8 "PBAV old value table" UWORD COMP_0023 1 100 0 327675 ECU_ADDRESS 0xFFFF1DBE /begin FUNCTION_LIST /end FUNCTION_LIST /end MEASUREMENT
/begin MEASUREMENT vPCHGV "P terminal A/D value" UBYTE COMP_0033 1 100 0 20400 ECU_ADDRESS 0xFFFF1EF2 /begin FUNCTION_LIST /end FUNCTION_LIST /end MEASUREMENT
/begin MEASUREMENT vPCHGVR "P terminal A/D value" UBYTE COMP_0033 1 100 0 20400 ECU_ADDRESS 0xFFFF1EF3 /begin FUNCTION_LIST /end FUNCTION_LIST /end MEASUREMENT
/begin MEASUREMENT vPCNASN "Drain-cut valve function diagnosis parameter" UBYTE COMP_0054 1 100 0 5100 ECU_ADDRESS 0xFFFF1644 /begin FUNCTION_LIST /end FUNCTION_LIST /end MEASUREMENT
/begin MEASUREMENT vPCYCLCNT "For the POS10 diagnosis cycle number of times judgement" UBYTE COMP_0068 1 100 0 255 ECU_ADDRESS 0xFFFF21E5 /begin FUNCTION_LIST /end FUNCTION_LIST /end MEASUREMENT
/begin MEASUREMENT vPDATA1 "Digital input buffer" ULONG COMP_0004 1 100 0 4294967295 ECU_ADDRESS 0xFFFF3720 /begin FUNCTION_LIST /end FUNCTION_LIST /end MEASUREMENT
/begin MEASUREMENT vPDLFMFAC "Pedal characteristic coefficient" UWORD COMP_0614_S 1 100 0 199.996894995 ECU_ADDRESS 0xFFFF3076 /begin FUNCTION_LIST /end FUNCTION_LIST /end MEASUREMENT
/begin MEASUREMENT vPDLFMF_S "Pedal characteristic coefficient (vice-operation part)" UWORD COMP_0614_S 1 100 0 199.996894995 ECU_ADDRESS 0xFFFF34FA /begin FUNCTION_LIST /end FUNCTION_LIST /end MEASUREMENT
/begin MEASUREMENT vPDMAX "Pd pressure weighted average value MAX value" UWORD COMP_0010 1 100 0 196.605 ECU_ADDRESS 0xFFFF1646 /begin FUNCTION_LIST /end FUNCTION_LIST /end MEASUREMENT
/begin MEASUREMENT vPDMIN "Pd pressure weighted average value MIN value" UWORD COMP_0010 1 100 0 196.605 ECU_ADDRESS 0xFFFF1648 /begin FUNCTION_LIST /end FUNCTION_LIST /end MEASUREMENT
/begin MEASUREMENT vPDOPN "At the time of the pull-down, valve open-degree" UWORD COMP_0269 1 100 0 127.998046875 ECU_ADDRESS 0xFFFF307A /begin FUNCTION_LIST /end FUNCTION_LIST /end MEASUREMENT
/begin MEASUREMENT vPDWALP100 "RAM value vPDWALP100" UBYTE COMP_0004 1 100 0 255 ECU_ADDRESS 0xFFFF307C /begin FUNCTION_LIST /end FUNCTION_LIST /end MEASUREMENT
/begin MEASUREMENT vPEDLHM "Accelerator Pedal" UBYTE COMP_0283 1 100 0 255 ECU_ADDRESS 0xFFFF3E2C /begin FUNCTION_LIST /end FUNCTION_LIST /end MEASUREMENT
/begin MEASUREMENT vPENDPR9 "A service 09hPR transmitting requirement for Pending" UBYTE COMP_0068 1 100 0 255 ECU_ADDRESS 0xFFFF4212 /begin FUNCTION_LIST /end FUNCTION_LIST /end MEASUREMENT
/begin MEASUREMENT vPENDREQ "A NR/ public relations transmitting requirement for Pending" UBYTE COMP_0068 1 100 0 255 ECU_ADDRESS 0xFFFF35BC /begin FUNCTION_LIST /end FUNCTION_LIST /end MEASUREMENT
/begin MEASUREMENT vPENDREQ9 "A service 09hPending transmitting requirement for Pending" UBYTE COMP_0068 1 100 0 255 ECU_ADDRESS 0xFFFF35BD /begin FUNCTION_LIST /end FUNCTION_LIST /end MEASUREMENT
/begin MEASUREMENT vPENDTMP "Data storage for the PendingNR/ public relations transmitting requirement" UBYTE COMP_0068 1 100 0 255 ECU_ADDRESS 0xFFFF35BE /begin FUNCTION_LIST /end FUNCTION_LIST /end MEASUREMENT
/begin MEASUREMENT vPENDTMP_R#1 "Data storage for the PendingNR/ public relations transmitting requirement" UBYTE COMP_0068 1 100 0 255 ECU_ADDRESS 0xFFFF35BE /begin FUNCTION_LIST /end FUNCTION_LIST /end MEASUREMENT
/begin MEASUREMENT vPENDTMP_R#2 "Data storage for the PendingNR/ public relations transmitting requirement" UBYTE COMP_0068 1 100 0 255 ECU_ADDRESS 0xFFFF35BF /begin FUNCTION_LIST /end FUNCTION_LIST /end MEASUREMENT
/begin MEASUREMENT vPENDTMP_R#3 "Data storage for the PendingNR/ public relations transmitting requirement" UBYTE COMP_0068 1 100 0 255 ECU_ADDRESS 0xFFFF35C0 /begin FUNCTION_LIST /end FUNCTION_LIST /end MEASUREMENT
/begin MEASUREMENT vPENDTMP_R#4 "Data storage for the PendingNR/ public relations transmitting requirement" UBYTE COMP_0068 1 100 0 255 ECU_ADDRESS 0xFFFF35C1 /begin FUNCTION_LIST /end FUNCTION_LIST /end MEASUREMENT
/begin MEASUREMENT vPENDTMP_R#5 "Data storage for the PendingNR/ public relations transmitting requirement" UBYTE COMP_0068 1 100 0 255 ECU_ADDRESS 0xFFFF35C2 /begin FUNCTION_LIST /end FUNCTION_LIST /end MEASUREMENT
/begin MEASUREMENT vPENDTMP_R#6 "Data storage for the PendingNR/ public relations transmitting requirement" UBYTE COMP_0068 1 100 0 255 ECU_ADDRESS 0xFFFF35C3 /begin FUNCTION_LIST /end FUNCTION_LIST /end MEASUREMENT
/begin MEASUREMENT vPENDTMP_R#7 "Data storage for the PendingNR/ public relations transmitting requirement" UBYTE COMP_0068 1 100 0 255 ECU_ADDRESS 0xFFFF35C4 /begin FUNCTION_LIST /end FUNCTION_LIST /end MEASUREMENT
/begin MEASUREMENT vPENDTMP_R#8 "Data storage for the PendingNR/ public relations transmitting requirement" UBYTE COMP_0068 1 100 0 255 ECU_ADDRESS 0xFFFF35C5 /begin FUNCTION_LIST /end FUNCTION_LIST /end MEASUREMENT
/begin MEASUREMENT vPERR2 "The amount of operation corner control deviation for the P-gain" UBYTE COMP_0257 1 100 -128 127 ECU_ADDRESS 0xFFFF1025 /begin FUNCTION_LIST /end FUNCTION_LIST /end MEASUREMENT
/begin MEASUREMENT vPERR2_R#1 "The amount of operation corner control deviation for the P-gain" UBYTE COMP_0257 1 100 -128 127 ECU_ADDRESS 0xFFFF1025 /begin FUNCTION_LIST /end FUNCTION_LIST /end MEASUREMENT
/begin MEASUREMENT vPERR2_R#2 "The amount of operation corner control deviation for the P-gain" UBYTE COMP_0257 1 100 -128 127 ECU_ADDRESS 0xFFFF1026 /begin FUNCTION_LIST /end FUNCTION_LIST /end MEASUREMENT
/begin MEASUREMENT vPEVFUL "At the time of the pre-pressure check, the amount of use fuel" ULONG COMP_0616_S 1 100 0 511.998756269655 ECU_ADDRESS 0xFFFF164C /begin FUNCTION_LIST /end FUNCTION_LIST /end MEASUREMENT
/begin MEASUREMENT vPEVPP0 "Diagnosis permission condition number of times monitor" UBYTE COMP_0016 1 100 0 255 ECU_ADDRESS 0xFFFFAE8A /begin FUNCTION_LIST /end FUNCTION_LIST /end MEASUREMENT
/begin MEASUREMENT vPEVPP1 "Pre-pressure check OK number of times monitor" UBYTE COMP_0016 1 100 0 255 ECU_ADDRESS 0xFFFFAE8B /begin FUNCTION_LIST /end FUNCTION_LIST /end MEASUREMENT
/begin MEASUREMENT vPEVPP2 "Stage 1 OK monitor number of times 1" UBYTE COMP_0016 1 100 0 255 ECU_ADDRESS 0xFFFFAE8C /begin FUNCTION_LIST /end FUNCTION_LIST /end MEASUREMENT
/begin MEASUREMENT vPEVPP3 "Pull-down cancellation number of times monitor" UBYTE COMP_0016 1 100 0 255 ECU_ADDRESS 0xFFFFAE8D /begin FUNCTION_LIST /end FUNCTION_LIST /end MEASUREMENT
/begin MEASUREMENT vPEVPP4 "Pull-down cancellation number of times monitor" UBYTE COMP_0016 1 100 0 255 ECU_ADDRESS 0xFFFFAE8E /begin FUNCTION_LIST /end FUNCTION_LIST /end MEASUREMENT
/begin MEASUREMENT vPEVPP5 "Pull-down F/B cancellation number of times monitor" UBYTE COMP_0016 1 100 0 255 ECU_ADDRESS 0xFFFFAE8F /begin FUNCTION_LIST /end FUNCTION_LIST /end MEASUREMENT
/begin MEASUREMENT vPEVPP6 "Pull-down rush number of times monitor" UBYTE COMP_0016 1 100 0 255 ECU_ADDRESS 0xFFFFAE90 /begin FUNCTION_LIST /end FUNCTION_LIST /end MEASUREMENT
/begin MEASUREMENT vPEVPP8 "Leak-down cancellation number of times monitor" UBYTE COMP_0016 1 100 0 255 ECU_ADDRESS 0xFFFFAE91 /begin FUNCTION_LIST /end FUNCTION_LIST /end MEASUREMENT
/begin MEASUREMENT vPEVPP9 "Stage 1 OK monitor number of times 2" UBYTE COMP_0016 1 100 0 255 ECU_ADDRESS 0xFFFFAE92 /begin FUNCTION_LIST /end FUNCTION_LIST /end MEASUREMENT
/begin MEASUREMENT vPEVPPJ "2ND leak-down fuel temperature condition cancellation counter" UWORD COMP_0016 1 100 0 65535 ECU_ADDRESS 0xFFFFAE94 /begin FUNCTION_LIST /end FUNCTION_LIST /end MEASUREMENT
/begin MEASUREMENT vPEVPPK "2ND leak-down space capacity condition cancellation counter" UWORD COMP_0016 1 100 0 65535 ECU_ADDRESS 0xFFFFAE96 /begin FUNCTION_LIST /end FUNCTION_LIST /end MEASUREMENT
/begin MEASUREMENT vPEVPPL "2ND leak-down cold start judgement condition cancellation counter" UWORD COMP_0016 1 100 0 65535 ECU_ADDRESS 0xFFFFAE98 /begin FUNCTION_LIST /end FUNCTION_LIST /end MEASUREMENT
/begin MEASUREMENT vPEVPPM "At the time of the 2ND leak-down start, coolant temperature condition cancellation counter" UWORD COMP_0016 1 100 0 65535 ECU_ADDRESS 0xFFFFAE9A /begin FUNCTION_LIST /end FUNCTION_LIST /end MEASUREMENT
/begin MEASUREMENT vPEVPPN "2ND leak-down accumulation purge quantity condition cancellation counter" UWORD COMP_0016 1 100 0 65535 ECU_ADDRESS 0xFFFFAE9C /begin FUNCTION_LIST /end FUNCTION_LIST /end MEASUREMENT
/begin MEASUREMENT vPEVPPO "Imaginary pull-down region rush counter" UWORD COMP_0016 1 100 0 65535 ECU_ADDRESS 0xFFFFAE9E /begin FUNCTION_LIST /end FUNCTION_LIST /end MEASUREMENT
/begin MEASUREMENT vPEVPPP "Imaginary pull-down formation number of times counter" UWORD COMP_0016 1 100 0 65535 ECU_ADDRESS 0xFFFFAEA0 /begin FUNCTION_LIST /end FUNCTION_LIST /end MEASUREMENT
/begin MEASUREMENT vPEVPPR "Imaginary leak-down formation number of times" UWORD COMP_0016 1 100 0 65535 ECU_ADDRESS 0xFFFFAEA2 /begin FUNCTION_LIST /end FUNCTION_LIST /end MEASUREMENT
/begin MEASUREMENT vPEVPPS "Imaginary diagnosis number of times counter" UWORD COMP_0016 1 100 0 65535 ECU_ADDRESS 0xFFFFAEA4 /begin FUNCTION_LIST /end FUNCTION_LIST /end MEASUREMENT
/begin MEASUREMENT vPEVST "An initial number of times monitor" UWORD COMP_0016 1 100 0 65535 ECU_ADDRESS 0xFFFFAEA6 /begin FUNCTION_LIST /end FUNCTION_LIST /end MEASUREMENT
/begin MEASUREMENT vPFHMIN "Fuel pressure normality judgement upper limit value" SWORD COMP_0488 1 100 -9.99424 9.993935 ECU_ADDRESS 0xFFFFAEA8 /begin FUNCTION_LIST /end FUNCTION_LIST /end MEASUREMENT
/begin MEASUREMENT vPFLMIN "Fuel pressure normality judgement upper limit value" SWORD COMP_0488 1 100 -9.99424 9.993935 ECU_ADDRESS 0xFFFFAEAA /begin FUNCTION_LIST /end FUNCTION_LIST /end MEASUREMENT
/begin MEASUREMENT vPFR "Purge concentration prediction value" UBYTE COMP_0034 1 100 0 63.75 ECU_ADDRESS 0xFFFF1651 /begin FUNCTION_LIST /end FUNCTION_LIST /end MEASUREMENT
/begin MEASUREMENT vPFR_R#1 "Purge concentration prediction value" UBYTE COMP_0034 1 100 0 63.75 ECU_ADDRESS 0xFFFF1651 /begin FUNCTION_LIST /end FUNCTION_LIST /end MEASUREMENT
/begin MEASUREMENT vPFR_R#2 "Purge concentration prediction value" UBYTE COMP_0034 1 100 0 63.75 ECU_ADDRESS 0xFFFF1652 /begin FUNCTION_LIST /end FUNCTION_LIST /end MEASUREMENT
/begin MEASUREMENT vPFRC "Purge concentration cylinder inhalation prediction value" UBYTE COMP_0034 1 100 0 63.75 ECU_ADDRESS 0xFFFF1653 /begin FUNCTION_LIST /end FUNCTION_LIST /end MEASUREMENT
/begin MEASUREMENT vPFRC_R#1 "Purge concentration cylinder inhalation prediction value" UBYTE COMP_0034 1 100 0 63.75 ECU_ADDRESS 0xFFFF1653 /begin FUNCTION_LIST /end FUNCTION_LIST /end MEASUREMENT
/begin MEASUREMENT vPFRC_R#2 "Purge concentration cylinder inhalation prediction value" UBYTE COMP_0034 1 100 0 63.75 ECU_ADDRESS 0xFFFF1654 /begin FUNCTION_LIST /end FUNCTION_LIST /end MEASUREMENT
/begin MEASUREMENT vPFRCZ "Purge concentration cylinder inhalation prediction value (previous value)" UBYTE COMP_0034 1 100 0 63.75 ECU_ADDRESS 0xFFFF1655 /begin FUNCTION_LIST /end FUNCTION_LIST /end MEASUREMENT
/begin MEASUREMENT vPFRCZ_R#1 "Purge concentration cylinder inhalation prediction value (previous value)" UBYTE COMP_0034 1 100 0 63.75 ECU_ADDRESS 0xFFFF1655 /begin FUNCTION_LIST /end FUNCTION_LIST /end MEASUREMENT
/begin MEASUREMENT vPFRCZ_R#2 "Purge concentration cylinder inhalation prediction value (previous value)" UBYTE COMP_0034 1 100 0 63.75 ECU_ADDRESS 0xFFFF1656 /begin FUNCTION_LIST /end FUNCTION_LIST /end MEASUREMENT
/begin MEASUREMENT vPFRDINIf "PFRD computed first flag" UBYTE COMP_0004 1 100 0 255 ECU_ADDRESS 0xFFFF1657 /begin FUNCTION_LIST /end FUNCTION_LIST /end MEASUREMENT
/begin MEASUREMENT vPFRDL "Purge concentration filtering value (the left bank)" UBYTE COMP_0034 1 100 0 63.75 ECU_ADDRESS 0xFFFF1658 /begin FUNCTION_LIST /end FUNCTION_LIST /end MEASUREMENT
/begin MEASUREMENT vPFRDL_R#1 "Purge concentration filtering value (the left bank)" UBYTE COMP_0034 1 100 0 63.75 ECU_ADDRESS 0xFFFF1658 /begin FUNCTION_LIST /end FUNCTION_LIST /end MEASUREMENT
/begin MEASUREMENT vPFRDL_R#2 "Purge concentration filtering value (the left bank)" UBYTE COMP_0034 1 100 0 63.75 ECU_ADDRESS 0xFFFF1659 /begin FUNCTION_LIST /end FUNCTION_LIST /end MEASUREMENT
/begin MEASUREMENT vPFRDL_R#3 "Purge concentration filtering value (the left bank)" UBYTE COMP_0034 1 100 0 63.75 ECU_ADDRESS 0xFFFF165A /begin FUNCTION_LIST /end FUNCTION_LIST /end MEASUREMENT
/begin MEASUREMENT vPFRDL_R#4 "Purge concentration filtering value (the left bank)" UBYTE COMP_0034 1 100 0 63.75 ECU_ADDRESS 0xFFFF165B /begin FUNCTION_LIST /end FUNCTION_LIST /end MEASUREMENT
/begin MEASUREMENT vPFRDL_R#5 "Purge concentration filtering value (the left bank)" UBYTE COMP_0034 1 100 0 63.75 ECU_ADDRESS 0xFFFF165C /begin FUNCTION_LIST /end FUNCTION_LIST /end MEASUREMENT
/begin MEASUREMENT vPFRDL_R#6 "Purge concentration filtering value (the left bank)" UBYTE COMP_0034 1 100 0 63.75 ECU_ADDRESS 0xFFFF165D /begin FUNCTION_LIST /end FUNCTION_LIST /end MEASUREMENT
/begin MEASUREMENT vPFRDL_R#7 "Purge concentration filtering value (the left bank)" UBYTE COMP_0034 1 100 0 63.75 ECU_ADDRESS 0xFFFF165E /begin FUNCTION_LIST /end FUNCTION_LIST /end MEASUREMENT
/begin MEASUREMENT vPFRDR "Purge concentration filtering value (the right bank)" UBYTE COMP_0034 1 100 0 63.75 ECU_ADDRESS 0xFFFF165F /begin FUNCTION_LIST /end FUNCTION_LIST /end MEASUREMENT
/begin MEASUREMENT vPFRDR_R#1 "Purge concentration filtering value (the right bank)" UBYTE COMP_0034 1 100 0 63.75 ECU_ADDRESS 0xFFFF165F /begin FUNCTION_LIST /end FUNCTION_LIST /end MEASUREMENT
/begin MEASUREMENT vPFRDR_R#2 "Purge concentration filtering value (the right bank)" UBYTE COMP_0034 1 100 0 63.75 ECU_ADDRESS 0xFFFF1660 /begin FUNCTION_LIST /end FUNCTION_LIST /end MEASUREMENT
/begin MEASUREMENT vPFRDR_R#3 "Purge concentration filtering value (the right bank)" UBYTE COMP_0034 1 100 0 63.75 ECU_ADDRESS 0xFFFF1661 /begin FUNCTION_LIST /end FUNCTION_LIST /end MEASUREMENT
/begin MEASUREMENT vPFRDR_R#4 "Purge concentration filtering value (the right bank)" UBYTE COMP_0034 1 100 0 63.75 ECU_ADDRESS 0xFFFF1662 /begin FUNCTION_LIST /end FUNCTION_LIST /end MEASUREMENT
/begin MEASUREMENT vPFRDR_R#5 "Purge concentration filtering value (the right bank)" UBYTE COMP_0034 1 100 0 63.75 ECU_ADDRESS 0xFFFF1663 /begin FUNCTION_LIST /end FUNCTION_LIST /end MEASUREMENT
/begin MEASUREMENT vPFRDR_R#6 "Purge concentration filtering value (the right bank)" UBYTE COMP_0034 1 100 0 63.75 ECU_ADDRESS 0xFFFF1664 /begin FUNCTION_LIST /end FUNCTION_LIST /end MEASUREMENT
/begin MEASUREMENT vPFRDR_R#7 "Purge concentration filtering value (the right bank)" UBYTE COMP_0034 1 100 0 63.75 ECU_ADDRESS 0xFFFF1665 /begin FUNCTION_LIST /end FUNCTION_LIST /end MEASUREMENT
/begin MEASUREMENT vPGCUTTM "Purge cut time integration timer" UWORD COMP_0008 1 100 0 6553500 ECU_ADDRESS 0xFFFF3080 /begin FUNCTION_LIST /end FUNCTION_LIST /end MEASUREMENT
/begin MEASUREMENT vPHACEf "At the time of the PHOSAZ learning region, PHOS operation condition judgement" UBYTE COMP_0004 1 100 0 255 ECU_ADDRESS 0xFFFF166C /begin FUNCTION_LIST /end FUNCTION_LIST /end MEASUREMENT
/begin MEASUREMENT vPHAFOT "Former O2/S output reversal judgement time to prohibit PHOSA operation" UBYTE COMP_0008 1 100 0 25500 ECU_ADDRESS 0xFFFF166D /begin FUNCTION_LIST /end FUNCTION_LIST /end MEASUREMENT
/begin COMPU_METHOD COMP_0068 "1-" RAT_FUNC "%8.2" "-" COEFFS 0 1 0 0 0 1 /end COMPU_METHOD
/begin COMPU_METHOD COMP_0004 "1Å|" RAT_FUNC "%8.2" "Å|" COEFFS 0 1 0 0 0 1 /end COMPU_METHOD
/begin COMPU_METHOD COMP_0023 "5mV" RAT_FUNC "%8.2" "mV" COEFFS 0 1 0 0 0 5 /end COMPU_METHOD
/begin COMPU_METHOD COMP_0001 "1/8ms" RAT_FUNC "%8.2" "ms" COEFFS 0 1 0 0 0 0.125 /end COMPU_METHOD
/begin COMPU_METHOD COMP_0020 "50rpm" RAT_FUNC "%8.2" "rpm" COEFFS 0 1 0 0 0 50 /end COMPU_METHOD
/begin COMPU_METHOD COMP_0002 "0.35deg" RAT_FUNC "%8.2" "deg" COEFFS 0 1 0 0 0 0.35 /end COMPU_METHOD
/begin COMPU_METHOD COMP_0003 "1Åé" RAT_FUNC "%8.2" "Åé" COEFFS 0 1 0 0 0 1 /end COMPU_METHOD
/begin COMPU_METHOD COMP_0014 "10ms" RAT_FUNC "%8.2" "ms" COEFFS 0 1 0 0 0 10 /end COMPU_METHOD
/begin COMPU_METHOD COMP_0006 "12.5rpm" RAT_FUNC "%8.2" "rpm" COEFFS 0 1 0 0 0 12.5 /end COMPU_METHOD
/begin COMPU_METHOD COMP_0008 "100ms" RAT_FUNC "%8.2" "ms" COEFFS 0 1 0 0 0 100 /end COMPU_METHOD
/begin COMPU_METHOD COMP_0196 "0.1Nm" RAT_FUNC "%8.2" "Nm" COEFFS 0 1 0 0 0 0.1 /end COMPU_METHOD
/begin COMPU_METHOD COMP_0009 "100/128%" RAT_FUNC "%8.2" "%" COEFFS 0 1 0 0 0 0.78125 /end COMPU_METHOD
/begin COMPU_METHOD COMP_0010 "0.003MPa" RAT_FUNC "%8.4" "MPa" COEFFS 0 1 0 0 0 0.003 /end COMPU_METHOD
/begin COMPU_METHOD COMP_0000 "25rpm" RAT_FUNC "%8.2" "rpm" COEFFS 0 1 0 0 0 25 /end COMPU_METHOD
/begin COMPU_METHOD COMP_0163 "1/16%" RAT_FUNC "%8.3" "%" COEFFS 0 1 0 0 0 0.0625 /end COMPU_METHOD
/begin COMPU_METHOD COMP_0018 "1deg" RAT_FUNC "%8.2" "deg" COEFFS 0 1 0 0 0 1 /end COMPU_METHOD
/begin COMPU_METHOD COMP_0033 "80mV" RAT_FUNC "%8.2" "mV" COEFFS 0 1 0 0 0 80 /end COMPU_METHOD
/begin COMPU_METHOD COMP_0027 "1%" RAT_FUNC "%8.2" "%" COEFFS 0 1 0 0 0 1 /end COMPU_METHOD
/begin COMPU_METHOD COMP_0049 "1sec" RAT_FUNC "%8.2" "sec" COEFFS 0 1 0 0 0 1 /end COMPU_METHOD
/begin COMPU_METHOD COMP_0063 "1/256-" RAT_FUNC "%8.4" "-" COEFFS 0 1 0 0 0 0.00390625 /end COMPU_METHOD
/begin COMPU_METHOD COMP_0015 "0.125Å|" RAT_FUNC "%8.2" "Å|" COEFFS 0 1 0 0 0 0.125 /end COMPU_METHOD
/begin COMPU_METHOD COMP_0030 "1âÒ" RAT_FUNC "%8.2" "âÒ" COEFFS 0 1 0 0 0 1 /end COMPU_METHOD
/begin COMPU_METHOD COMP_0031 "1/256%" RAT_FUNC "%8.4" "%" COEFFS 0 1 0 0 0 0.00390625 /end COMPU_METHOD
/begin COMPU_METHOD COMP_0005 "0.11deg" RAT_FUNC "%8.2" "deg" COEFFS 0 1 0 0 0 0.11 /end COMPU_METHOD
/begin COMPU_METHOD COMP_0362_S "0.125%" RAT_FUNC "%8.2" "%" COEFFS 0 1 0 0 0 0.125 /end COMPU_METHOD
/begin COMPU_METHOD COMP_0035_S "∂≥›ƒ∂≥›ƒ" RAT_FUNC "%8.2" "∂≥›ƒ" COEFFS 0 1 0 0 0 1 /end COMPU_METHOD
/begin COMPU_METHOD COMP_0044 "1/128Å|" RAT_FUNC "%8.4" "Å|" COEFFS 0 1 0 0 0 0.0078125 /end COMPU_METHOD
/begin COMPU_METHOD COMP_0048 "64/128degCA" RAT_FUNC "%8.2" "degCA" COEFFS 0 1 0 0 0 0.5 /end COMPU_METHOD
/begin COMPU_METHOD COMP_0016 "1count" RAT_FUNC "%8.2" "count" COEFFS 0 1 0 0 0 1 /end COMPU_METHOD
/begin COMPU_METHOD COMP_0054 "20mV" RAT_FUNC "%8.2" "mV" COEFFS 0 1 0 0 0 20 /end COMPU_METHOD
/begin COMPU_METHOD COMP_0373 "1/100-" RAT_FUNC "%8.3" "-" COEFFS 0 1 0 0 0 0.01 /end COMPU_METHOD
/begin COMPU_METHOD COMP_0050 "5/64mV" RAT_FUNC "%8.3" "mV" COEFFS 0 1 0 0 0 0.078125 /end COMPU_METHOD
/begin COMPU_METHOD COMP_0035 "X-50Åé" RAT_FUNC "%8.2" "Åé" COEFFS 0 1 50 0 0 1 /end COMPU_METHOD
/begin COMPU_METHOD COMP_0228 "0.1Nm" RAT_FUNC "%8.2" "Nm" COEFFS 0 1 0 0 0 0.1 /end COMPU_METHOD
/begin COMPU_METHOD COMP_0096 "10s" RAT_FUNC "%8.2" "s" COEFFS 0 1 0 0 0 10 /end COMPU_METHOD
/begin COMPU_METHOD COMP_0091_S "--" RAT_FUNC "%8.3" "-" COEFFS 0 1 0 0 0 0.05 /end COMPU_METHOD
/begin COMPU_METHOD COMP_0131 "5/256mV" RAT_FUNC "%8.3" "mV" COEFFS 0 1 0 0 0 0.01953125 /end COMPU_METHOD
/begin COMPU_METHOD COMP_0104 "10mV" RAT_FUNC "%8.2" "mV" COEFFS 0 1 0 0 0 10 /end COMPU_METHOD
/begin COMPU_METHOD COMP_0256 "64/128degCA" RAT_FUNC "%8.2" "degCA" COEFFS 0 1 64 0 0 0.5 /end COMPU_METHOD
/begin COMPU_METHOD COMP_0277 "1L/min" RAT_FUNC "%8.2" "L/min" COEFFS 0 1 0 0 0 1 /end COMPU_METHOD
/begin COMPU_METHOD COMP_0064 "1.5625rpm" RAT_FUNC "%8.2" "rpm" COEFFS 0 1 0 0 0 1.5625 /end COMPU_METHOD
/begin COMPU_METHOD COMP_0425_S "32/256-" RAT_FUNC "%8.2" "-" COEFFS 0 1 1 0 0 0.125 /end COMPU_METHOD
/begin COMPU_METHOD COMP_0062 "4Åé" RAT_FUNC "%8.2" "Åé" COEFFS 0 1 0 0 0 4 /end COMPU_METHOD
/begin COMPU_METHOD COMP_0433_S "0.1%/100ms" RAT_FUNC "%8.2" "%/100ms" COEFFS 0 1 0 0 0 0.1 /end COMPU_METHOD
/begin COMPU_METHOD COMP_0133_S "%%" RAT_FUNC "%8.3" "%" COEFFS 0 1 0 0 0 0.0390625 /end COMPU_METHOD
/begin COMPU_METHOD COMP_0472 "1/64-" RAT_FUNC "%8.3" "-" COEFFS 0 1 0 0 0 0.015625 /end COMPU_METHOD
/begin COMPU_METHOD COMP_0232 "1/128mm^2" RAT_FUNC "%8.4" "mm^2" COEFFS 0 1 0 0 0 0.0078125 /end COMPU_METHOD
/begin COMPU_METHOD COMP_0022 "20mv" RAT_FUNC "%8.2" "mv" COEFFS 0 1 0 0 0 20 /end COMPU_METHOD
/begin COMPU_METHOD COMP_0065 "3.125rpm" RAT_FUNC "%8.2" "rpm" COEFFS 0 1 0 0 0 3.125 /end COMPU_METHOD
/begin COMPU_METHOD COMP_0092 "1bit" RAT_FUNC "%8.2" "bit" COEFFS 0 1 0 0 0 1 /end COMPU_METHOD
/begin COMPU_METHOD COMP_0388 "0.1-" RAT_FUNC "%8.2" "-" COEFFS 0 1 0 0 0 0.1 /end COMPU_METHOD
/begin COMPU_METHOD COMP_0468_S "1time" RAT_FUNC "%8.2" "time" COEFFS 0 1 0 0 0 1 /end COMPU_METHOD
/begin COMPU_METHOD COMP_0293 "2L/min" RAT_FUNC "%8.2" "L/min" COEFFS 0 1 0 0 0 2 /end COMPU_METHOD
/begin COMPU_METHOD COMP_0312 "0.5/256L" RAT_FUNC "%8.4" "L" COEFFS 0 1 0 0 0 0.001953125 /end COMPU_METHOD
/begin COMPU_METHOD COMP_0057 "1/16384Å|" RAT_FUNC "%8.6" "Å|" COEFFS 0 1 0 0 0 0.0000610352 /end COMPU_METHOD
/begin COMPU_METHOD COMP_0144 "1/2048ms" RAT_FUNC "%8.5" "ms" COEFFS 0 1 0 0 0 0.000488281 /end COMPU_METHOD
/begin COMPU_METHOD COMP_0245 "X-64deg" RAT_FUNC "%8.2" "deg" COEFFS 0 1 64 0 0 1 /end COMPU_METHOD
/begin COMPU_METHOD COMP_0053 "1ms" RAT_FUNC "%8.2" "ms" COEFFS 0 1 0 0 0 1 /end COMPU_METHOD
/begin COMPU_METHOD COMP_0123_S "NN" RAT_FUNC "%8.2" "N" COEFFS 0 1 32768 0 0 1 /end COMPU_METHOD
/begin COMPU_METHOD COMP_0253 "16/256X10^-3m^3/sec" RAT_FUNC "%8.6" "m^3/sec" COEFFS 0 1 0 0 0 0.0000625 /end COMPU_METHOD
/begin COMPU_METHOD COMP_0271 "100/128/256%" RAT_FUNC "%8.4" "%" COEFFS 0 1 0 0 0 0.003051758 /end COMPU_METHOD
/begin COMPU_METHOD COMP_0042 "0.0008cm**2" RAT_FUNC "%8.5" "cm**2" COEFFS 0 1 0 0 0 0.0008 /end COMPU_METHOD
/begin COMPU_METHOD COMP_0497_S "1/256deg" RAT_FUNC "%8.4" "deg" COEFFS 0 1 128 0 0 0.00390625 /end COMPU_METHOD
/begin COMPU_METHOD COMP_0246 "100/16%" RAT_FUNC "%8.2" "%" COEFFS 0 1 0 0 0 6.25 /end COMPU_METHOD
/begin COMPU_METHOD COMP_0122_S "msms" RAT_FUNC "%8.2" "ms" COEFFS 0 1 0 0 0 2 /end COMPU_METHOD
/begin COMPU_METHOD COMP_0519_S "100W" RAT_FUNC "%8.2" "W" COEFFS 0 1 0 0 0 100 /end COMPU_METHOD
/begin COMPU_METHOD COMP_0128_S "ÅéÅé" RAT_FUNC "%8.2" "Åé" COEFFS 0 1 30 0 0 5 /end COMPU_METHOD
/begin COMPU_METHOD COMP_0034 "64/256%" RAT_FUNC "%8.2" "%" COEFFS 0 1 0 0 0 0.25 /end COMPU_METHOD
/begin COMPU_METHOD COMP_0476 "12.5/64rpm" RAT_FUNC "%8.2" "rpm" COEFFS 0 1 0 0 0 0.1953125 /end COMPU_METHOD
/begin COMPU_METHOD COMP_0283 "1flag" RAT_FUNC "%8.2" "flag" COEFFS 0 1 0 0 0 1 /end COMPU_METHOD
/begin COMPU_METHOD COMP_0265 "1/4096%" RAT_FUNC "%8.5" "%" COEFFS 0 1 8.000012288 0 0 0.000244141 /end COMPU_METHOD
/begin COMPU_METHOD COMP_0209_S "3.6*2^-22km/h" RAT_FUNC "%8.6" "km/h" COEFFS 0 1 0 0 0 0.000000858307 /end COMPU_METHOD
/begin COMPU_METHOD COMP_0421 "1ãCìõ" RAT_FUNC "%8.2" "ãCìõ" COEFFS 0 1 0 0 0 1 /end COMPU_METHOD
/begin COMPU_METHOD COMP_0458 "10/256É S" RAT_FUNC "%8.3" "É S" COEFFS 0 1 1280 0 0 0.0390625 /end COMPU_METHOD
/begin COMPU_METHOD COMP_0550_S "mm^2mm^2" RAT_FUNC "%8.6" "mm^2" COEFFS 0 1 0 0 0 0.0000305176 /end COMPU_METHOD
/begin COMPU_METHOD COMP_0269 "0.5/256%" RAT_FUNC "%8.4" "%" COEFFS 0 1 0 0 0 0.001953125 /end COMPU_METHOD
/begin COMPU_METHOD COMP_0376 "0.1É S" RAT_FUNC "%8.2" "É S" COEFFS 0 1 0 0 0 0.1 /end COMPU_METHOD
/begin COMPU_METHOD COMP_0021_S "NmNm" RAT_FUNC "%8.2" "Nm" COEFFS 0 1 100 0 0 2 /end COMPU_METHOD
/begin COMPU_METHOD COMP_0164 "0.000305MPa" RAT_FUNC "%8.5" "MPa" COEFFS 0 1 0 0 0 0.000305 /end COMPU_METHOD
/begin COMPU_METHOD COMP_0257 "128/128degCA" RAT_FUNC "%8.2" "degCA" COEFFS 0 1 128 0 0 1 /end COMPU_METHOD
/begin COMPU_METHOD COMP_0189 "3.2É S" RAT_FUNC "%8.2" "É S" COEFFS 0 1 0 0 0 3.2 /end COMPU_METHOD
/begin COMPU_METHOD COMP_0072 "1/16%" RAT_FUNC "%8.3" "%" COEFFS 0 1 8 0 0 0.0625 /end COMPU_METHOD
/begin COMPU_METHOD COMP_0391 "100/256%" RAT_FUNC "%8.2" "%" COEFFS 0 1 0 0 0 0.391 /end COMPU_METHOD
/begin COMPU_METHOD COMP_0567_S "cyl(BITà íu)cyl(BIT" RAT_FUNC "%8.2" "cyl(BIT" COEFFS 0 1 0 0 0 1 /end COMPU_METHOD
/begin COMPU_METHOD COMP_0438 "1/256%" RAT_FUNC "%8.4" "%" COEFFS 0 1 0 0 0 0.00390625 /end COMPU_METHOD
/begin COMPU_METHOD COMP_0583_S "%/80ms%/80ms" RAT_FUNC "%8.2" "%/80ms" COEFFS 0 1 0 0 0 0.125 /end COMPU_METHOD
/begin COMPU_METHOD COMP_0050_S "Åé/mEGRTM1[sec]Åé/mEGRT" RAT_FUNC "%8.2" "Åé/mEGRT" COEFFS 0 1 0 0 0 1 /end COMPU_METHOD
/begin COMPU_METHOD COMP_0415 "1/256Å|" RAT_FUNC "%8.4" "Å|" COEFFS 0 1 0 0 0 0.00390625 /end COMPU_METHOD
/begin COMPU_METHOD COMP_0590_S "ÅéÅé" RAT_FUNC "%8.6" "Åé" COEFFS 0 1 50 0 0 0.0000000596046 /end COMPU_METHOD
/begin COMPU_METHOD COMP_0417 "8us" RAT_FUNC "%8.2" "us" COEFFS 0 1 0 0 0 8 /end COMPU_METHOD
/begin COMPU_METHOD COMP_0077_S "MPaMPa" RAT_FUNC "%8.5" "MPa" COEFFS 0 1 9.99424 0 0 0.000305 /end COMPU_METHOD
/begin COMPU_METHOD COMP_0078_S "ÅéÅé" RAT_FUNC "%8.2" "Åé" COEFFS 0 1 128 0 0 1 /end COMPU_METHOD
/begin COMPU_METHOD COMP_0083_S "GG" RAT_FUNC "%8.5" "G" COEFFS 0 1 4.079616 0 0 0.0001245 /end COMPU_METHOD
/begin COMPU_METHOD COMP_0086_S "mm^2mm^2" RAT_FUNC "%8.3" "mm^2" COEFFS 0 1 0 0 0 0.015625 /end COMPU_METHOD
/begin COMPU_METHOD COMP_0231_S "1/327680m" RAT_FUNC "%8.6" "m" COEFFS 0 1 0 0 0 0.00000305176 /end COMPU_METHOD
/begin COMPU_METHOD COMP_0089_S "Åé/degCAÅé/degCA" RAT_FUNC "%8.4" "Åé/degCA" COEFFS 0 1 0 0 0 0.005 /end COMPU_METHOD
/begin COMPU_METHOD COMP_0598_S "--" RAT_FUNC "%8.5" "-" COEFFS 0 1 0.999999488 0 0 0.000488281 /end COMPU_METHOD
/begin COMPU_METHOD COMP_0383 "X/256-50Åé" RAT_FUNC "%8.4" "Åé" COEFFS 0 1 50 0 0 0.00390625 /end COMPU_METHOD
/begin COMPU_METHOD COMP_0439 "0.25rpm" RAT_FUNC "%8.2" "rpm" COEFFS 0 1 0 0 0 0.25 /end COMPU_METHOD
/begin COMPU_METHOD COMP_0440 "1/128rpm" RAT_FUNC "%8.4" "rpm" COEFFS 0 1 0 0 0 0.0078125 /end COMPU_METHOD
/begin COMPU_METHOD COMP_0178_S "Å|Å|" RAT_FUNC "%8.6" "Å|" COEFFS 0 1 0 0 0 0.000003815 /end COMPU_METHOD
/begin COMPU_METHOD COMP_0600_S "AA" RAT_FUNC "%8.6" "A" COEFFS 0 1 0 0 0 0.000007629 /end COMPU_METHOD
/begin COMPU_METHOD COMP_0601_S "Å|Å|" RAT_FUNC "%8.6" "Å|" COEFFS 0 1 0 0 0 0.000007629 /end COMPU_METHOD
/begin COMPU_METHOD COMP_0106_S "L/minL/min" RAT_FUNC "%8.4" "L/min" COEFFS 0 1 0 0 0 0.00390625 /end COMPU_METHOD
/begin COMPU_METHOD COMP_0602_S "L/minL/min" RAT_FUNC "%8.6" "L/min" COEFFS 0 1 0 0 0 0.0000152588 /end COMPU_METHOD
/begin COMPU_METHOD COMP_0115_S "ppmppm" RAT_FUNC "%8.2" "ppm" COEFFS 0 1 512 0 0 4 /end COMPU_METHOD
/begin COMPU_METHOD COMP_0604_S "Å[Å[" RAT_FUNC "%8.6" "Å[" COEFFS 0 1 0 0 0 0.0000152588 /end COMPU_METHOD
/begin COMPU_METHOD COMP_0103 "4/128rpm" RAT_FUNC "%8.3" "rpm" COEFFS 0 1 0 0 0 0.03125 /end COMPU_METHOD
/begin COMPU_METHOD COMP_0125_S "mm" RAT_FUNC "%8.2" "m" COEFFS 0 1 0 0 0 1 /end COMPU_METHOD
/begin COMPU_METHOD COMP_0478 "16us" RAT_FUNC "%8.2" "us" COEFFS 0 1 0 0 0 16 /end COMPU_METHOD
/begin COMPU_METHOD COMP_0482 "1/256rpm" RAT_FUNC "%8.4" "rpm" COEFFS 0 1 0 0 0 0.00390625 /end COMPU_METHOD
/begin COMPU_METHOD COMP_0483 "8ms" RAT_FUNC "%8.2" "ms" COEFFS 0 1 0 0 0 8 /end COMPU_METHOD
/begin COMPU_METHOD COMP_0423 "100/128%" RAT_FUNC "%8.2" "%" COEFFS 0 1 50 0 0 0.390625 /end COMPU_METHOD
/begin COMPU_METHOD COMP_0614_S "%%" RAT_FUNC "%8.4" "%" COEFFS 0 1 0 0 0 0.003051757 /end COMPU_METHOD
/begin COMPU_METHOD COMP_0616_S "cccc" RAT_FUNC "%8.6" "cc" COEFFS 0 1 0 0 0 0.000000119209 /end COMPU_METHOD
/begin COMPU_METHOD COMP_0488 "0.000305MPa" RAT_FUNC "%8.5" "MPa" COEFFS 0 1 0 0 0 0.000305 /end COMPU_METHOD
/end MODULE
/end PROJECT
