ASAP2_VERSION 1 3_BETA
/begin PROJECT TK_X91_EUR_VC ""
/begin HEADER "" /* key HEADER ++ "comment" Ç… Par.scomment */ PROJECT_NO TK_X91_EUR_VC /* key PROJECT_NO ++ project number Ç… car_eng_desti_lot */ VERSION "7V4YHZEB2" /* key VERSION ++ version number Ç… mProgver */ /end HEADER
/begin MODULE DIM ""
/begin MOD_COMMON "" DEPOSIT ABSOLUTE BYTE_ORDER MSB_FIRST /* ﬁ≤ƒµ∞¿ﬁ∞Ç™ÿÃﬂ⁄∞ΩÇ≥ÇÍÇÈ */ /end MOD_COMMON
/begin FUNCTION R301.21.SafetyLevel2_1_0_2 "Subcalculation Safety Level 2 (RSMn#08)" /end FUNCTION
/begin FUNCTION R301.22.TRHOSI_1_0_2 "TRHOSi limitation (RSMn#28)" /end FUNCTION
/begin FUNCTION R301.23.ADV_calculation_1_1_2 "ADV calculation (RSMn#27)" /end FUNCTION
/begin FUNCTION R301.24.RomDiagnosis_1_0_1 "ROM Diagnosis (RSMn#41)" /end FUNCTION
/begin FUNCTION R301.25.GOV_idle_1_0_2 "Modification of GOV idle calculation (RSMn#41)" /end FUNCTION
/begin FUNCTION R301.26.Dashpot_DandN_1_0_2 "Dashpot in drive and neutral position (RSMn#44)" /end FUNCTION
/begin FUNCTION R301.27.PWST_detection_1_0_2 "Detection of power steering (RSMn#45)" /end FUNCTION
/begin FUNCTION R301.28.StarterSwitch_1_0_2 "Starter Switch flag fSTSW modification (RSMn#47)" /end FUNCTION
/begin FUNCTION R901.1.Diag_on_can_app_1_6_2 "DiagOnCAN" /end FUNCTION
/begin FUNCTION R902.1.SafetyDiagManager_1_3_6 "Safety Diagnostic Manager" /end FUNCTION
/begin FUNCTION R902.2.DiagMiscell_1_3_5 "Miscellaneous concerning Safety Diagnostic Management X91" /end FUNCTION
/begin FUNCTION R903.1.milmgtx_1_0_2 "MUX Control of ÅgMalfunction Indicator LampÅh" /end FUNCTION
/begin FUNCTION R904.1.Gst_on_can_1_0_1 "Emision-related Diagnostic services for EOBD" /end FUNCTION
/begin FUNCTION Rxxx.1.Diagnostic_cycle_1_0_1 "Diagnostic cycle for Catalyst Diagnosis" /end FUNCTION
/begin FUNCTION Rxxx.2.Integration_Diagnostic_cycle_1_1_1 "Integration information for ÅhDiagnostic cycle for Catalyst DiagnosisÅh" /end FUNCTION
/begin CHARACTERISTIC mGSTPID1 "PID that a mode 1 answer is possible" CURVE 0x0000C9A0 REC_UBYTE_C 0 COMP_0068 0 255
 /begin AXIS_DESCR FIX_AXIS NO_INPUT_QUANTITY COMP_0205_S 12 0 11 FIX_AXIS_PAR_DIST 0 1 12 /end AXIS_DESCR
 /begin FUNCTION_LIST R904.1.Gst_on_can_1_0_1 /end FUNCTION_LIST
/end CHARACTERISTIC
/begin CHARACTERISTIC mGSTPID2 "PID that a mode 2 answer is possible" CURVE 0x0000C9AC REC_UBYTE_C 0 COMP_0068 0 255
 /begin AXIS_DESCR FIX_AXIS NO_INPUT_QUANTITY COMP_0205_S 12 0 11 FIX_AXIS_PAR_DIST 0 1 12 /end AXIS_DESCR
 /begin FUNCTION_LIST R904.1.Gst_on_can_1_0_1 /end FUNCTION_LIST
/end CHARACTERISTIC
/begin CHARACTERISTIC mCALID "Ref C of CALID" CURVE 0x0000C8B7 REC_UBYTE_C 0 COMP_0068 0 255
 /begin AXIS_DESCR FIX_AXIS NO_INPUT_QUANTITY COMP_0205_S 16 0 15 FIX_AXIS_PAR_DIST 0 1 16 /end AXIS_DESCR
 /begin FUNCTION_LIST R904.1.Gst_on_can_1_0_1 /end FUNCTION_LIST
/end CHARACTERISTIC
/begin CHARACTERISTIC mECUID "C/U distinction flag" CURVE 0x0000C95E REC_UBYTE_C 0 COMP_0004 0 255
 /begin AXIS_DESCR FIX_AXIS NO_INPUT_QUANTITY COMP_0205_S 2 0 1 FIX_AXIS_PAR_DIST 0 1 2 /end AXIS_DESCR
 /begin FUNCTION_LIST /end FUNCTION_LIST
/end CHARACTERISTIC
/begin CHARACTERISTIC mCCUID "CONSULT2 CUID" CURVE 0x0000C8DD REC_UBYTE_C 0 COMP_0004 0 255
 /begin AXIS_DESCR FIX_AXIS NO_INPUT_QUANTITY COMP_0205_S 20 0 19 FIX_AXIS_PAR_DIST 0 1 20 /end AXIS_DESCR
 /begin FUNCTION_LIST /end FUNCTION_LIST
/end CHARACTERISTIC
/begin CHARACTERISTIC mM6OBDMID "OBDMID that a mode 6 answer is possible" CURVE 0x0000CB37 REC_UBYTE_C 0 COMP_0068 0 255
 /begin AXIS_DESCR FIX_AXIS NO_INPUT_QUANTITY COMP_0205_S 24 0 23 FIX_AXIS_PAR_DIST 0 1 24 /end AXIS_DESCR
 /begin FUNCTION_LIST R904.1.Gst_on_can_1_0_1 /end FUNCTION_LIST
/end CHARACTERISTIC
/begin CHARACTERISTIC mGSM8ID "Control related to OBD" CURVE 0x0000C98C REC_UBYTE_C 0 COMP_0068 0 255
 /begin AXIS_DESCR FIX_AXIS NO_INPUT_QUANTITY COMP_0205_S 4 0 3 FIX_AXIS_PAR_DIST 0 1 4 /end AXIS_DESCR
 /begin FUNCTION_LIST /end FUNCTION_LIST
/end CHARACTERISTIC
/begin CHARACTERISTIC mGSTPI2 "PID that a mode 2 answer is possible" CURVE 0x0000C998 REC_UBYTE_C 0 COMP_0068 0 255
 /begin AXIS_DESCR FIX_AXIS NO_INPUT_QUANTITY COMP_0205_S 4 0 3 FIX_AXIS_PAR_DIST 0 1 4 /end AXIS_DESCR
 /begin FUNCTION_LIST /end FUNCTION_LIST
/end CHARACTERISTIC
/begin CHARACTERISTIC mGSTPI9 "The vehicles information type that it can respond" CURVE 0x0000C99C REC_UBYTE_C 0 COMP_0068 0 255
 /begin AXIS_DESCR FIX_AXIS NO_INPUT_QUANTITY COMP_0205_S 4 0 3 FIX_AXIS_PAR_DIST 0 1 4 /end AXIS_DESCR
 /begin FUNCTION_LIST R904.1.Gst_on_can_1_0_1 /end FUNCTION_LIST
/end CHARACTERISTIC
/begin CHARACTERISTIC mM6TID0 "The test item (01Å`1FH) that it can respond" CURVE 0x0000CB4F REC_UBYTE_C 0 COMP_0068 0 255
 /begin AXIS_DESCR FIX_AXIS NO_INPUT_QUANTITY COMP_0205_S 4 0 3 FIX_AXIS_PAR_DIST 0 1 4 /end AXIS_DESCR
 /begin FUNCTION_LIST /end FUNCTION_LIST
/end CHARACTERISTIC
/begin CHARACTERISTIC mM6TID2 "The test item (21 - 3FH) that it can respond" CURVE 0x0000CB53 REC_UBYTE_C 0 COMP_0068 0 255
 /begin AXIS_DESCR FIX_AXIS NO_INPUT_QUANTITY COMP_0205_S 4 0 3 FIX_AXIS_PAR_DIST 0 1 4 /end AXIS_DESCR
 /begin FUNCTION_LIST /end FUNCTION_LIST
/end CHARACTERISTIC
/begin CHARACTERISTIC mM6TID3 "The test item (41 - 5FH) that it can respond" CURVE 0x0000CB57 REC_UBYTE_C 0 COMP_0068 0 255
 /begin AXIS_DESCR FIX_AXIS NO_INPUT_QUANTITY COMP_0205_S 4 0 3 FIX_AXIS_PAR_DIST 0 1 4 /end AXIS_DESCR
 /begin FUNCTION_LIST /end FUNCTION_LIST
/end CHARACTERISTIC
/begin CHARACTERISTIC mM6TID4 "The test item (61 - 7FH) that it can respond" CURVE 0x0000CB5B REC_UBYTE_C 0 COMP_0068 0 255
 /begin AXIS_DESCR FIX_AXIS NO_INPUT_QUANTITY COMP_0205_S 4 0 3 FIX_AXIS_PAR_DIST 0 1 4 /end AXIS_DESCR
 /begin FUNCTION_LIST /end FUNCTION_LIST
/end CHARACTERISTIC
/begin CHARACTERISTIC mSCID10 "CIDTBL distinction flag 1100H-111FH" CURVE 0x0000CCC5 REC_UBYTE_C 0 COMP_0004 0 255
 /begin AXIS_DESCR FIX_AXIS NO_INPUT_QUANTITY COMP_0205_S 4 0 3 FIX_AXIS_PAR_DIST 0 1 4 /end AXIS_DESCR
 /begin FUNCTION_LIST /end FUNCTION_LIST
/end CHARACTERISTIC
/begin CHARACTERISTIC mSCID114 "CIDTBL distinction flag 1140H-145FH" CURVE 0x0000CCC9 REC_UBYTE_C 0 COMP_0004 0 255
 /begin AXIS_DESCR FIX_AXIS NO_INPUT_QUANTITY COMP_0205_S 4 0 3 FIX_AXIS_PAR_DIST 0 1 4 /end AXIS_DESCR
 /begin FUNCTION_LIST /end FUNCTION_LIST
/end CHARACTERISTIC
/begin CHARACTERISTIC mSCID116 "CIDTBL distinction flag 1160H-117FH" CURVE 0x0000CCCD REC_UBYTE_C 0 COMP_0004 0 255
 /begin AXIS_DESCR FIX_AXIS NO_INPUT_QUANTITY COMP_0205_S 4 0 3 FIX_AXIS_PAR_DIST 0 1 4 /end AXIS_DESCR
 /begin FUNCTION_LIST /end FUNCTION_LIST
/end CHARACTERISTIC
/begin CHARACTERISTIC mSCID12 "CIDTBL distinction flag 1120H-113FH" CURVE 0x0000CCD1 REC_UBYTE_C 0 COMP_0004 0 255
 /begin AXIS_DESCR FIX_AXIS NO_INPUT_QUANTITY COMP_0205_S 4 0 3 FIX_AXIS_PAR_DIST 0 1 4 /end AXIS_DESCR
 /begin FUNCTION_LIST /end FUNCTION_LIST
/end CHARACTERISTIC
/begin CHARACTERISTIC mSCID14 "CIDTBL distinction flag 1401H-1420H" CURVE 0x0000CCD5 REC_UBYTE_C 0 COMP_0004 0 255
 /begin AXIS_DESCR FIX_AXIS NO_INPUT_QUANTITY COMP_0205_S 4 0 3 FIX_AXIS_PAR_DIST 0 1 4 /end AXIS_DESCR
 /begin FUNCTION_LIST /end FUNCTION_LIST
/end CHARACTERISTIC
/begin CHARACTERISTIC mSCID16 "CIDTBL distinction flag 1421H-143FH" CURVE 0x0000CCD9 REC_UBYTE_C 0 COMP_0004 0 255
 /begin AXIS_DESCR FIX_AXIS NO_INPUT_QUANTITY COMP_0205_S 4 0 3 FIX_AXIS_PAR_DIST 0 1 4 /end AXIS_DESCR
 /begin FUNCTION_LIST /end FUNCTION_LIST
/end CHARACTERISTIC
/begin CHARACTERISTIC mSCID20 "CIDTBL distinction flag 1200H-121FH" CURVE 0x0000CCDD REC_UBYTE_C 0 COMP_0004 0 255
 /begin AXIS_DESCR FIX_AXIS NO_INPUT_QUANTITY COMP_0205_S 4 0 3 FIX_AXIS_PAR_DIST 0 1 4 /end AXIS_DESCR
 /begin FUNCTION_LIST /end FUNCTION_LIST
/end CHARACTERISTIC
/begin CHARACTERISTIC mSCID22 "CIDTBL distinction flag 1220H-123FH" CURVE 0x0000CCE1 REC_UBYTE_C 0 COMP_0004 0 255
 /begin AXIS_DESCR FIX_AXIS NO_INPUT_QUANTITY COMP_0205_S 4 0 3 FIX_AXIS_PAR_DIST 0 1 4 /end AXIS_DESCR
 /begin FUNCTION_LIST /end FUNCTION_LIST
/end CHARACTERISTIC
/begin CHARACTERISTIC mSCID24 "CIDTBL distinction flag 1241H-1260H" CURVE 0x0000CCE5 REC_UBYTE_C 0 COMP_0004 0 255
 /begin AXIS_DESCR FIX_AXIS NO_INPUT_QUANTITY COMP_0205_S 4 0 3 FIX_AXIS_PAR_DIST 0 1 4 /end AXIS_DESCR
 /begin FUNCTION_LIST /end FUNCTION_LIST
/end CHARACTERISTIC
/begin CHARACTERISTIC mSCID30 "CIDTBL distinction flag 1300H-131FH" CURVE 0x0000CCE9 REC_UBYTE_C 0 COMP_0004 0 255
 /begin AXIS_DESCR FIX_AXIS NO_INPUT_QUANTITY COMP_0205_S 4 0 3 FIX_AXIS_PAR_DIST 0 1 4 /end AXIS_DESCR
 /begin FUNCTION_LIST /end FUNCTION_LIST
/end CHARACTERISTIC
/begin CHARACTERISTIC mSCID50 "CIDTBL distinction flag 1500H-151FH" CURVE 0x0000CCED REC_UBYTE_C 0 COMP_0004 0 255
 /begin AXIS_DESCR FIX_AXIS NO_INPUT_QUANTITY COMP_0205_S 4 0 3 FIX_AXIS_PAR_DIST 0 1 4 /end AXIS_DESCR
 /begin FUNCTION_LIST /end FUNCTION_LIST
/end CHARACTERISTIC
/begin CHARACTERISTIC mSIOID0 "I/O control distinction flag 00H-1FH" CURVE 0x0000CCF9 REC_UBYTE_C 0 COMP_0004 0 255
 /begin AXIS_DESCR FIX_AXIS NO_INPUT_QUANTITY COMP_0205_S 4 0 3 FIX_AXIS_PAR_DIST 0 1 4 /end AXIS_DESCR
 /begin FUNCTION_LIST /end FUNCTION_LIST
/end CHARACTERISTIC
/begin CHARACTERISTIC mSIOID2 "I/O control distinction flag 20H-3FH" CURVE 0x0000CCFD REC_UBYTE_C 0 COMP_0004 0 255
 /begin AXIS_DESCR FIX_AXIS NO_INPUT_QUANTITY COMP_0205_S 4 0 3 FIX_AXIS_PAR_DIST 0 1 4 /end AXIS_DESCR
 /begin FUNCTION_LIST /end FUNCTION_LIST
/end CHARACTERISTIC
/begin CHARACTERISTIC mSIOID4 "I/O control distinction flag 40H-5FH" CURVE 0x0000CD01 REC_UBYTE_C 0 COMP_0004 0 255
 /begin AXIS_DESCR FIX_AXIS NO_INPUT_QUANTITY COMP_0205_S 4 0 3 FIX_AXIS_PAR_DIST 0 1 4 /end AXIS_DESCR
 /begin FUNCTION_LIST /end FUNCTION_LIST
/end CHARACTERISTIC
/begin CHARACTERISTIC mSIOID6 "I/O control distinction flag 60H-7FH" CURVE 0x0000CD05 REC_UBYTE_C 0 COMP_0004 0 255
 /begin AXIS_DESCR FIX_AXIS NO_INPUT_QUANTITY COMP_0205_S 4 0 3 FIX_AXIS_PAR_DIST 0 1 4 /end AXIS_DESCR
 /begin FUNCTION_LIST /end FUNCTION_LIST
/end CHARACTERISTIC
/begin CHARACTERISTIC mSPLID0 "LID distinction flag" CURVE 0x0000CD5D REC_UBYTE_C 0 COMP_0004 0 255
 /begin AXIS_DESCR FIX_AXIS NO_INPUT_QUANTITY COMP_0205_S 4 0 3 FIX_AXIS_PAR_DIST 0 1 4 /end AXIS_DESCR
 /begin FUNCTION_LIST /end FUNCTION_LIST
/end CHARACTERISTIC
/begin CHARACTERISTIC mSWDLID0 "WDLID distinction flag 01H-20H" CURVE 0x0000CD7D REC_UBYTE_C 0 COMP_0004 0 255
 /begin AXIS_DESCR FIX_AXIS NO_INPUT_QUANTITY COMP_0205_S 4 0 3 FIX_AXIS_PAR_DIST 0 1 4 /end AXIS_DESCR
 /begin FUNCTION_LIST /end FUNCTION_LIST
/end CHARACTERISTIC
/begin CHARACTERISTIC mAPPRNO "Approval Number" CURVE 0x0000C8B2 REC_UBYTE_C 0 COMP_0004 0 255
 /begin AXIS_DESCR FIX_AXIS NO_INPUT_QUANTITY COMP_0205_S 5 0 4 FIX_AXIS_PAR_DIST 0 1 5 /end AXIS_DESCR
 /begin FUNCTION_LIST R904.1.Gst_on_can_1_0_1 /end FUNCTION_LIST
/end CHARACTERISTIC
/begin CHARACTERISTIC mECUNO "Part number" CURVE 0x0000C960 REC_UBYTE_C 0 COMP_0004 0 255
 /begin AXIS_DESCR FIX_AXIS NO_INPUT_QUANTITY COMP_0205_S 6 0 5 FIX_AXIS_PAR_DIST 0 1 6 /end AXIS_DESCR
 /begin FUNCTION_LIST /end FUNCTION_LIST
/end CHARACTERISTIC
/begin CHARACTERISTIC mHARDNO "A hard distinction number" CURVE 0x0000CA03 REC_UBYTE_C 0 COMP_0004 0 255
 /begin AXIS_DESCR FIX_AXIS NO_INPUT_QUANTITY COMP_0205_S 6 0 5 FIX_AXIS_PAR_DIST 0 1 6 /end AXIS_DESCR
 /begin FUNCTION_LIST /end FUNCTION_LIST
/end CHARACTERISTIC
/begin CHARACTERISTIC mGSTPI1 "PID that a mode 1 answer is possible" CURVE 0x0000C990 REC_UBYTE_C 0 COMP_0068 0 255
 /begin AXIS_DESCR FIX_AXIS NO_INPUT_QUANTITY COMP_0205_S 8 0 7 FIX_AXIS_PAR_DIST 0 1 8 /end AXIS_DESCR
 /begin FUNCTION_LIST /end FUNCTION_LIST
/end CHARACTERISTIC
/begin CHARACTERISTIC mA0QA22 "Coefficient a0 (Qa region #2) (bank 2)" VALUE 0x00008EAA REC_SWORD_C 0 COMP_0336_S -3.2768 3.2767 /begin FUNCTION_LIST /end FUNCTION_LIST /end CHARACTERISTIC
/begin CHARACTERISTIC mA0QA32 "Coefficient a0 (Qa region #3) (bank 2)" VALUE 0x00008EAE REC_SWORD_C 0 COMP_0336_S -3.2768 3.2767 /begin FUNCTION_LIST /end FUNCTION_LIST /end CHARACTERISTIC
/begin CHARACTERISTIC mA1QA22 "Coefficient a1 (Qa region #2) (bank 2)" VALUE 0x00008EB6 REC_SWORD_C 0 COMP_0336_S -3.2768 3.2767 /begin FUNCTION_LIST /end FUNCTION_LIST /end CHARACTERISTIC
/begin CHARACTERISTIC mA1QA32 "Coefficient a1 (Qa region #3) (bank 2)" VALUE 0x00008EBA REC_SWORD_C 0 COMP_0336_S -3.2768 3.2767 /begin FUNCTION_LIST /end FUNCTION_LIST /end CHARACTERISTIC
/begin CHARACTERISTIC mABFESL "Air-fuel ratio deviation upper limit value" VALUE 0x00008F92 REC_UWORD_C 0 COMP_0453 0 131.07 /begin FUNCTION_LIST /end FUNCTION_LIST /end CHARACTERISTIC
/begin CHARACTERISTIC mACONRD "After air-conditioning on, delay" VALUE 0x000081D8 REC_UBYTE_C 0 COMP_0013 0 255 /begin FUNCTION_LIST /end FUNCTION_LIST /end CHARACTERISTIC
/begin CHARACTERISTIC mADVLMT21 "The retard side maximum change width" VALUE 0x00008FA8 REC_UWORD_C 0 COMP_0081 0 255.99609375 /begin FUNCTION_LIST R301.23.ADV_calculation_1_1_2 /end FUNCTION_LIST /end CHARACTERISTIC
/begin CHARACTERISTIC mAGBFRMNG "Maximum permitted time without frame before fault detection" VALUE 0x00008244 REC_UBYTE_C 0 COMP_0344_S 0 2.55 DISPLAY_IDENTIFIER Cxx_agb_abst_dly /begin FUNCTION_LIST /end FUNCTION_LIST /end CHARACTERISTIC
/begin CHARACTERISTIC mAGBSIPNG "AGB SIP continuation time check NG judgement time" VALUE 0x00008249 REC_UBYTE_C 0 COMP_0008 0 25500 /begin FUNCTION_LIST /end FUNCTION_LIST /end CHARACTERISTIC
/begin CHARACTERISTIC mAGBSLNEG "Negative torque slew rate calibration    in case of protocol error" VALUE 0x00008FFA REC_UWORD_C 0 COMP_0346_S -32765 294910 DISPLAY_IDENTIFIER Cxx_agb_slwr_neg /begin FUNCTION_LIST /end FUNCTION_LIST /end CHARACTERISTIC
/begin CHARACTERISTIC mAGBTUPDL "AGB torque rise integral value clear delay time" VALUE 0x0000824B REC_UBYTE_C 0 COMP_0008 0 25500 /begin FUNCTION_LIST /end FUNCTION_LIST /end CHARACTERISTIC
/begin CHARACTERISTIC mAPBYDT "DUTY area conversion coefficient" VALUE 0x00008279 REC_UBYTE_C 0 COMP_0037 0 0.000796875 /begin FUNCTION_LIST /end FUNCTION_LIST /end CHARACTERISTIC
/begin CHARACTERISTIC mAPLHDFCF "Configuration of the downgraded mode" VALUE 0x0000827C REC_UBYTE_C 0 COMP_0068 0 255 DISPLAY_IDENTIFIER Cxx_acel_pdl_lih_dft_conf /begin FUNCTION_LIST R902.2.DiagMiscell_1_3_5 /end FUNCTION_LIST /end CHARACTERISTIC
/begin CHARACTERISTIC mAVEALP "MALPHA weighted average rate" VALUE 0x00008298 REC_UBYTE_C 0 COMP_0032 0 0.99609375 /begin FUNCTION_LIST /end FUNCTION_LIST /end CHARACTERISTIC
/begin CHARACTERISTIC mAVETP "TP weighted average coefficient" VALUE 0x00008299 REC_UBYTE_C 0 COMP_0043 0 0.249023565 /begin FUNCTION_LIST /end FUNCTION_LIST /end CHARACTERISTIC
/begin CHARACTERISTIC mAVEVAP "PEAVP weighted average index number" VALUE 0x0000829A REC_UBYTE_C 0 COMP_0044 0 1.9921875 /begin FUNCTION_LIST /end FUNCTION_LIST /end CHARACTERISTIC
/begin CHARACTERISTIC mAVEVAP2 "PEAVP weighted average index number 2" VALUE 0x0000829B REC_UBYTE_C 0 COMP_0044 0 1.9921875 /begin FUNCTION_LIST /end FUNCTION_LIST /end CHARACTERISTIC
/begin CHARACTERISTIC mAVEVP02 "A weighted average coefficient for the 0.02 slosh judgement" VALUE 0x0000829C REC_UBYTE_C 0 COMP_0063 0 0.99609375 /begin FUNCTION_LIST /end FUNCTION_LIST /end CHARACTERISTIC
/begin CHARACTERISTIC mAVFLN1 "FGAGE1 weighted average-ization index number 1" VALUE 0x0000829D REC_UBYTE_C 0 COMP_0032 0 0.99609375 /begin FUNCTION_LIST /end FUNCTION_LIST /end CHARACTERISTIC
/begin CHARACTERISTIC mAVFLN2 "FGAGE2 weighted average-ization index number 2" VALUE 0x0000829E REC_UBYTE_C 0 COMP_0032 0 0.99609375 /begin FUNCTION_LIST /end FUNCTION_LIST /end CHARACTERISTIC
/begin CHARACTERISTIC mAVFLN3 "FGAGE3 weighted average-ization index number 3" VALUE 0x0000829F REC_UBYTE_C 0 COMP_0032 0 0.99609375 /begin FUNCTION_LIST /end FUNCTION_LIST /end CHARACTERISTIC
/begin CHARACTERISTIC mAVTFA "AVETF average coefficient" VALUE 0x000082A1 REC_UBYTE_C 0 COMP_0044 0 1.9921875 /begin FUNCTION_LIST /end FUNCTION_LIST /end CHARACTERISTIC
/begin CHARACTERISTIC mB0QA22 "Coefficient b0 (Qa region #2) (bank 2)" VALUE 0x00008ED8 REC_SWORD_C 0 COMP_0336_S -3.2768 3.2767 /begin FUNCTION_LIST /end FUNCTION_LIST /end CHARACTERISTIC
/begin CHARACTERISTIC mB0QA32 "Coefficient b0 (Qa region #3) (bank 2)" VALUE 0x00008EDC REC_SWORD_C 0 COMP_0336_S -3.2768 3.2767 /begin FUNCTION_LIST /end FUNCTION_LIST /end CHARACTERISTIC
/begin CHARACTERISTIC mB1QA22 "Coefficient b1 (Qa region #2) (bank 2)" VALUE 0x00008EE4 REC_SWORD_C 0 COMP_0336_S -3.2768 3.2767 /begin FUNCTION_LIST /end FUNCTION_LIST /end CHARACTERISTIC
/begin CHARACTERISTIC mB1QA32 "Coefficient b1 (Qa region #3) (bank 2)" VALUE 0x00008EE8 REC_SWORD_C 0 COMP_0336_S -3.2768 3.2767 /begin FUNCTION_LIST /end FUNCTION_LIST /end CHARACTERISTIC
/begin CHARACTERISTIC mBETACOV "Knock control maximum value" VALUE 0x000082B8 REC_UBYTE_C 0 COMP_0017 0 255 /begin FUNCTION_LIST R901.1.Diag_on_can_app_1_6_2 /end FUNCTION_LIST /end CHARACTERISTIC
/begin CHARACTERISTIC mBGSLSH "A speed difference threshold for the 0.04inch diagnosis slosh judgement" VALUE 0x00008EEA REC_SWORD_C 0 COMP_0370_S -2560 2559.921875 /begin FUNCTION_LIST /end FUNCTION_LIST /end CHARACTERISTIC
/begin CHARACTERISTIC mCDEVPS "Pull-down F/B convergent judgement criteria" VALUE 0x0000830D REC_UBYTE_C 0 COMP_0059 0 127.5 /begin FUNCTION_LIST /end FUNCTION_LIST /end CHARACTERISTIC
/begin CHARACTERISTIC mCDPAMB "Leak-down cancellation atomospheric pressure change rate" VALUE 0x000090A4 REC_UWORD_C 0 COMP_0050 0 5119.921875 /begin FUNCTION_LIST /end FUNCTION_LIST /end CHARACTERISTIC
/begin CHARACTERISTIC mCETPCT "Purge cut judgement condition" VALUE 0x0000830E REC_UBYTE_C 0 COMP_0047 0 127.5 /begin FUNCTION_LIST /end FUNCTION_LIST /end CHARACTERISTIC
/begin CHARACTERISTIC mCLD0 "Vehicle speed low pass filter constant" VALUE 0x000090AC REC_UWORD_C 0 COMP_0290 0 0.999985458 /begin FUNCTION_LIST /end FUNCTION_LIST /end CHARACTERISTIC
/begin CHARACTERISTIC mCNMNT "Heat resisting purge monitor clamp number of times" VALUE 0x00008344 REC_UBYTE_C 0 COMP_0016 0 255 /begin FUNCTION_LIST /end FUNCTION_LIST /end CHARACTERISTIC
/begin CHARACTERISTIC mCNRZTVL "Max number of resets for Immobilizer strategy" VALUE 0x00008348 REC_UBYTE_C 0 COMP_0068 0 255 /begin FUNCTION_LIST /end FUNCTION_LIST /end CHARACTERISTIC
/begin CHARACTERISTIC mDADLTAPH "deltaVAPO deadband high side" VALUE 0x00008EF2 REC_SWORD_C 0 COMP_0377 -3604.48 3604.37 /begin FUNCTION_LIST R301.23.ADV_calculation_1_1_2 /end FUNCTION_LIST /end CHARACTERISTIC
/begin CHARACTERISTIC mDADLTAPL "deltaVAPO deadband low side" VALUE 0x00008EF4 REC_SWORD_C 0 COMP_0377 -3604.48 3604.37 /begin FUNCTION_LIST R301.23.ADV_calculation_1_1_2 /end FUNCTION_LIST /end CHARACTERISTIC
/begin CHARACTERISTIC mDADLTNEH "deltaNRPM deadband high side" VALUE 0x00008EF6 REC_SWORD_C 0 COMP_0262 -409600 409587.5 /begin FUNCTION_LIST R301.23.ADV_calculation_1_1_2 /end FUNCTION_LIST /end CHARACTERISTIC
/begin CHARACTERISTIC mDADLTNEL "deltaNRPM deadband low side" VALUE 0x00008EF8 REC_SWORD_C 0 COMP_0262 -409600 409587.5 /begin FUNCTION_LIST R301.23.ADV_calculation_1_1_2 /end FUNCTION_LIST /end CHARACTERISTIC
/begin CHARACTERISTIC mDAPXLH "At the time of the APS un-adjustment, limphome start delay" VALUE 0x000090E2 REC_UWORD_C 0 COMP_0014 0 655350 /begin FUNCTION_LIST /end FUNCTION_LIST /end CHARACTERISTIC
/begin CHARACTERISTIC mDASTDL "Delay for DLTADV from transient to steady state" VALUE 0x000090E4 REC_UWORD_C 0 COMP_0014 0 655350 /begin FUNCTION_LIST R301.23.ADV_calculation_1_1_2 /end FUNCTION_LIST /end CHARACTERISTIC
/begin CHARACTERISTIC mDCAGBCLK "Failure counter decrease amount of Agb clock error" VALUE 0x000083BA REC_UBYTE_C 0 COMP_0068 0 255 DISPLAY_IDENTIFIER Cxx_dfdec_agb_clck /begin FUNCTION_LIST R902.1.SafetyDiagManager_1_3_6 /end FUNCTION_LIST /end CHARACTERISTIC
/begin CHARACTERISTIC mDCAGBDLY "Failure counter decrease amount of Maximum delay which can be used by agb for a toque request" VALUE 0x000083BB REC_UBYTE_C 0 COMP_0068 0 255 DISPLAY_IDENTIFIER Cxx_dfdec_agb_dly_out /begin FUNCTION_LIST R902.1.SafetyDiagManager_1_3_6 /end FUNCTION_LIST /end CHARACTERISTIC
/begin CHARACTERISTIC mDCAGBINT "Failure counter decrease amount of the threshold    for integration of gearbox fast-acting torque value has been exceeded" VALUE 0x000083BC REC_UBYTE_C 0 COMP_0068 0 255 DISPLAY_IDENTIFIER Cxx_dfdec_int_agb_tq_max /begin FUNCTION_LIST R902.1.SafetyDiagManager_1_3_6 /end FUNCTION_LIST /end CHARACTERISTIC
/begin CHARACTERISTIC mDCAGBLNK "Failure counter decrease amount of AGB link" VALUE 0x000083BD REC_UBYTE_C 0 COMP_0068 0 255 DISPLAY_IDENTIFIER Cxx_dfdec_agb_lk /begin FUNCTION_LIST R902.1.SafetyDiagManager_1_3_6 /end FUNCTION_LIST /end CHARACTERISTIC
/begin CHARACTERISTIC mDCAP12 "Failure counter decrease amount of accelerator pedal (loss of the TWO tracks)" VALUE 0x000083BE REC_UBYTE_C 0 COMP_0068 0 255 DISPLAY_IDENTIFIER Cxx_dfdec_acel_pdl_tot /begin FUNCTION_LIST R902.1.SafetyDiagManager_1_3_6 /end FUNCTION_LIST /end CHARACTERISTIC
/begin CHARACTERISTIC mDCAPCHR "Failure counter decrease amount of accelerator pedal consistency" VALUE 0x000083BF REC_UBYTE_C 0 COMP_0068 0 255 DISPLAY_IDENTIFIER Cxx_dfdec_acel_pdl_chr /begin FUNCTION_LIST R902.1.SafetyDiagManager_1_3_6 /end FUNCTION_LIST /end CHARACTERISTIC
/begin CHARACTERISTIC mDCAPMUX "Failure counter decrease amount of invalid value of the alternator power transmitted by the USM" VALUE 0x000083C0 REC_UBYTE_C 0 COMP_0068 0 255 DISPLAY_IDENTIFIER Cxx_dfdec_usm_alt_pow_nok /begin FUNCTION_LIST R902.1.SafetyDiagManager_1_3_6 /end FUNCTION_LIST /end CHARACTERISTIC
/begin CHARACTERISTIC mDCAPSC "Failure counter decrease amount of accelerator pedal safety case (N Åã 2) (irreversible downgraded mode)" VALUE 0x000083C1 REC_UBYTE_C 0 COMP_0068 0 255 DISPLAY_IDENTIFIER Cxx_dfdec_acel_pdl_secu /begin FUNCTION_LIST R902.1.SafetyDiagManager_1_3_6 /end FUNCTION_LIST /end CHARACTERISTIC
/begin CHARACTERISTIC mDCAPSC1 "Failure counter decrease amount of accelerator pedal safety case N Åã 1 (reversible downgraded mode)" VALUE 0x000083C2 REC_UBYTE_C 0 COMP_0068 0 255 DISPLAY_IDENTIFIER Cxx_dfdec_acel_pdl_secu_1 /begin FUNCTION_LIST R902.1.SafetyDiagManager_1_3_6 /end FUNCTION_LIST /end CHARACTERISTIC
/begin CHARACTERISTIC mDCAPSOC1 "Failure counter decrease amount of accelerator pedal track 1 open circuit" VALUE 0x000083C3 REC_UBYTE_C 0 COMP_0068 0 255 DISPLAY_IDENTIFIER Cxx_dfdec_acel_pdl_oc_v1 /begin FUNCTION_LIST R902.1.SafetyDiagManager_1_3_6 /end FUNCTION_LIST /end CHARACTERISTIC
/begin CHARACTERISTIC mDCAPSOC2 "Failure counter decrease amount of accelerator pedal track 2 open circuit" VALUE 0x000083C4 REC_UBYTE_C 0 COMP_0068 0 255 DISPLAY_IDENTIFIER Cxx_dfdec_acel_pdl_oc_v2 /begin FUNCTION_LIST R902.1.SafetyDiagManager_1_3_6 /end FUNCTION_LIST /end CHARACTERISTIC
/begin CHARACTERISTIC mDCAPSSC1 "Failure counter decrease amount of accelerator pedal track 1 short circuit" VALUE 0x000083C5 REC_UBYTE_C 0 COMP_0068 0 255 DISPLAY_IDENTIFIER Cxx_dfdec_acel_pdl_sc_v1 /begin FUNCTION_LIST R902.1.SafetyDiagManager_1_3_6 /end FUNCTION_LIST /end CHARACTERISTIC
/begin CHARACTERISTIC mDCAPSSC2 "Failure counter decrease amount of accelerator pedal track 2 short circuit" VALUE 0x000083C6 REC_UBYTE_C 0 COMP_0068 0 255 DISPLAY_IDENTIFIER Cxx_dfdec_acel_pdl_sc_v2 /begin FUNCTION_LIST R902.1.SafetyDiagManager_1_3_6 /end FUNCTION_LIST /end CHARACTERISTIC
/begin CHARACTERISTIC mDCATCPN "Idle feedback ready threshold for diagnostic cycle termination" VALUE 0x000083C7 REC_UBYTE_C 0 COMP_0337_S 0 255 /begin FUNCTION_LIST Rxxx.1.Diagnostic_cycle_1_0_1 /end FUNCTION_LIST /end CHARACTERISTIC
/begin CHARACTERISTIC mDCATIG "Integral gain of speed regulator" VALUE 0x000083C8 REC_UBYTE_C 0 COMP_0352_S 0 24.9023565 /begin FUNCTION_LIST Rxxx.1.Diagnostic_cycle_1_0_1 /end FUNCTION_LIST /end CHARACTERISTIC
/begin CHARACTERISTIC mDCATMXP "Max power for Diagnostic cycle setpoint" VALUE 0x000083C9 REC_UBYTE_C 0 COMP_0351_S 0 510000 /begin FUNCTION_LIST Rxxx.1.Diagnostic_cycle_1_0_1 /end FUNCTION_LIST /end CHARACTERISTIC
/begin CHARACTERISTIC mDCATPG "Proportional gain of speed regulator" VALUE 0x000083CA REC_UBYTE_C 0 COMP_0386_S 0 0.99609375 /begin FUNCTION_LIST Rxxx.1.Diagnostic_cycle_1_0_1 /end FUNCTION_LIST /end CHARACTERISTIC
/begin CHARACTERISTIC mDCATTQM "Maximum torque setpoint allowed for the diagnostic cycle" VALUE 0x000090E8 REC_UWORD_C 0 COMP_0345_S -400 1647.96875 /begin FUNCTION_LIST Rxxx.1.Diagnostic_cycle_1_0_1 /end FUNCTION_LIST /end CHARACTERISTIC
/begin CHARACTERISTIC mDCAVCC1 "Failure counter decrease amount of power supply 1 (accelerator pedal track 1)" VALUE 0x000083CB REC_UBYTE_C 0 COMP_0068 0 255 DISPLAY_IDENTIFIER Cxx_dfdec_pws_1 /begin FUNCTION_LIST R902.1.SafetyDiagManager_1_3_6 /end FUNCTION_LIST /end CHARACTERISTIC
/begin CHARACTERISTIC mDCAVCC2 "Failure counter decrease amount of power supply 2 (accelerator pedal track 2)" VALUE 0x000083CC REC_UBYTE_C 0 COMP_0068 0 255 DISPLAY_IDENTIFIER Cxx_dfdec_pws_2 /begin FUNCTION_LIST R902.1.SafetyDiagManager_1_3_6 /end FUNCTION_LIST /end CHARACTERISTIC
/begin CHARACTERISTIC mDCBRKCMP "Failure counter decrease amount of Incoherence between brake information" VALUE 0x000083CD REC_UBYTE_C 0 COMP_0068 0 255 DISPLAY_IDENTIFIER Cxx_dfdec_brk_pdl_cmp /begin FUNCTION_LIST R902.1.SafetyDiagManager_1_3_6 /end FUNCTION_LIST /end CHARACTERISTIC
/begin CHARACTERISTIC mDCCLSW "Failure counter decrease amount of clutch switch" VALUE 0x000083CE REC_UBYTE_C 0 COMP_0068 0 255 /begin FUNCTION_LIST R902.1.SafetyDiagManager_1_3_6 /end FUNCTION_LIST /end CHARACTERISTIC
/begin CHARACTERISTIC mDCCLUCMP "Failure counter decrease amount of Incoherence between clutch information" VALUE 0x000083CF REC_UBYTE_C 0 COMP_0068 0 255 DISPLAY_IDENTIFIER Cxx_dfdec_bgin_clu_cmp /begin FUNCTION_LIST R902.1.SafetyDiagManager_1_3_6 /end FUNCTION_LIST /end CHARACTERISTIC
/begin CHARACTERISTIC mDCCRUCMP "Failure counter decrease amount of CC safety" VALUE 0x000083D0 REC_UBYTE_C 0 COMP_0068 0 255 DISPLAY_IDENTIFIER Cxx_dfdec_cru_cmp /begin FUNCTION_LIST R902.1.SafetyDiagManager_1_3_6 /end FUNCTION_LIST /end CHARACTERISTIC
/begin CHARACTERISTIC mDCCSCHR "Failure counter decrease amount of CCSL main switch coherence" VALUE 0x000083D1 REC_UBYTE_C 0 COMP_0068 0 255 DISPLAY_IDENTIFIER Cxx_dfdec_cru_sl_swi_chr /begin FUNCTION_LIST R902.1.SafetyDiagManager_1_3_6 /end FUNCTION_LIST /end CHARACTERISTIC
/begin CHARACTERISTIC mDCCSNOK "Failure counter decrease amount of CCSL Steering Wheel Command Switch blocked button" VALUE 0x000083D2 REC_UBYTE_C 0 COMP_0068 0 255 DISPLAY_IDENTIFIER Cxx_dfdec_cru_whl_cmd_nok /begin FUNCTION_LIST R902.1.SafetyDiagManager_1_3_6 /end FUNCTION_LIST /end CHARACTERISTIC
/begin CHARACTERISTIC mDCCSOCS "Failure counter decrease amount of CCSL Steering Wheel Command Switch open circuit" VALUE 0x000083D3 REC_UBYTE_C 0 COMP_0068 0 255 DISPLAY_IDENTIFIER Cxx_dfdec_cru_whl_cmd_oc_scw /begin FUNCTION_LIST R902.1.SafetyDiagManager_1_3_6 /end FUNCTION_LIST /end CHARACTERISTIC
/begin CHARACTERISTIC mDCCSOOR "Failure counter decrease amount of CCSL Steering Wheel Command Switch invalid value" VALUE 0x000083D4 REC_UBYTE_C 0 COMP_0068 0 255 DISPLAY_IDENTIFIER Cxx_dfdec_cru_whl_cmd_oor /begin FUNCTION_LIST R902.1.SafetyDiagManager_1_3_6 /end FUNCTION_LIST /end CHARACTERISTIC
/begin CHARACTERISTIC mDCCSTOT "Failure counter decrease amount of CC/SL not available" VALUE 0x000083D5 REC_UBYTE_C 0 COMP_0068 0 255 DISPLAY_IDENTIFIER Cxx_dfdec_cru_sl_tot /begin FUNCTION_LIST R902.1.SafetyDiagManager_1_3_6 /end FUNCTION_LIST /end CHARACTERISTIC
/begin CHARACTERISTIC mDCESPCLK "Failure counter decrease amount of ESP clock error" VALUE 0x000083D6 REC_UBYTE_C 0 COMP_0068 0 255 DISPLAY_IDENTIFIER Cxx_dfdec_asr_msr_clck /begin FUNCTION_LIST R902.1.SafetyDiagManager_1_3_6 /end FUNCTION_LIST /end CHARACTERISTIC
/begin CHARACTERISTIC mDCESPCPL "Failure counter decrease amount of ESP complement error detected between ASR and MSR data" VALUE 0x000083D7 REC_UBYTE_C 0 COMP_0068 0 255 DISPLAY_IDENTIFIER Cxx_dfdec_asr_msr_cpl /begin FUNCTION_LIST R902.1.SafetyDiagManager_1_3_6 /end FUNCTION_LIST /end CHARACTERISTIC
/begin CHARACTERISTIC mDCESPLNK "Failure counter decrease amount of ASR/MSR link" VALUE 0x000083D8 REC_UBYTE_C 0 COMP_0068 0 255 DISPLAY_IDENTIFIER Cxx_dfdec_asr_msr_lk /begin FUNCTION_LIST R902.1.SafetyDiagManager_1_3_6 /end FUNCTION_LIST /end CHARACTERISTIC
/begin CHARACTERISTIC mDCNTRZVL "nbre tentative reset" VALUE 0x000083DB REC_UBYTE_C 0 COMP_0068 0 255 /begin FUNCTION_LIST /end FUNCTION_LIST /end CHARACTERISTIC
/begin CHARACTERISTIC mDCPRSOC "Failure counter decrease amount of Air conditioning pressure sensor open circuit" VALUE 0x000083DC REC_UBYTE_C 0 COMP_0068 0 255 DISPLAY_IDENTIFIER Cxx_dfdec_ac_prs_oc /begin FUNCTION_LIST R902.1.SafetyDiagManager_1_3_6 /end FUNCTION_LIST /end CHARACTERISTIC
/begin CHARACTERISTIC mDCPRSSC "Failure counter decrease amount of Air conditioning pressure sensor short circuit" VALUE 0x000083DD REC_UBYTE_C 0 COMP_0068 0 255 DISPLAY_IDENTIFIER Cxx_dfdec_ac_prs_sc /begin FUNCTION_LIST R902.1.SafetyDiagManager_1_3_6 /end FUNCTION_LIST /end CHARACTERISTIC
/begin CHARACTERISTIC mDCUPCRCV "Failure counter decrease amount of USM fast frame reception" VALUE 0x000083DF REC_UBYTE_C 0 COMP_0068 0 255 DISPLAY_IDENTIFIER Cxx_dfdec_usm_rcpt /begin FUNCTION_LIST R902.1.SafetyDiagManager_1_3_6 /end FUNCTION_LIST /end CHARACTERISTIC
/begin CHARACTERISTIC mDCVOPN "Drain-cut valve compulsory release pressure" VALUE 0x000083E3 REC_UBYTE_C 0 COMP_0054 0 5100 /begin FUNCTION_LIST /end FUNCTION_LIST /end CHARACTERISTIC
/begin CHARACTERISTIC mDCVSCMP "Failure counter decrease amount of NO. coherence between displayed speed and real speed" VALUE 0x000083E6 REC_UBYTE_C 0 COMP_0068 0 255 DISPLAY_IDENTIFIER Cxx_dfdec_cru_vs_cmp /begin FUNCTION_LIST R902.1.SafetyDiagManager_1_3_6 /end FUNCTION_LIST /end CHARACTERISTIC
/begin CHARACTERISTIC mDDSHPTD "QDSPT reduction rate (Drive)" VALUE 0x000083EB REC_UBYTE_C 0 COMP_0211_S 0 1.9921875 /begin FUNCTION_LIST R301.26.Dashpot_DandN_1_0_2 /end FUNCTION_LIST /end CHARACTERISTIC
/begin CHARACTERISTIC mDDSHPTN "QDSPT reduction rate (Neutral)" VALUE 0x000083EC REC_UBYTE_C 0 COMP_0211_S 0 1.9921875 /begin FUNCTION_LIST R301.26.Dashpot_DandN_1_0_2 /end FUNCTION_LIST /end CHARACTERISTIC
/begin CHARACTERISTIC mDDVP "In front of the leak-down, pressure offset" VALUE 0x000083EF REC_UBYTE_C 0 COMP_0054 0 5100 /begin FUNCTION_LIST /end FUNCTION_LIST /end CHARACTERISTIC
/begin CHARACTERISTIC mDDVP45 "Leak-down judgement pressure" VALUE 0x000083F1 REC_UBYTE_C 0 COMP_0054 0 5100 /begin FUNCTION_LIST /end FUNCTION_LIST /end CHARACTERISTIC
/begin CHARACTERISTIC mDDVP6 "Leak-down start pressure" VALUE 0x000083F2 REC_UBYTE_C 0 COMP_0054 0 5100 /begin FUNCTION_LIST /end FUNCTION_LIST /end CHARACTERISTIC
/begin CHARACTERISTIC mDDVP7 "Leak-down start pressure" VALUE 0x000083F3 REC_UBYTE_C 0 COMP_0054 0 5100 /begin FUNCTION_LIST /end FUNCTION_LIST /end CHARACTERISTIC
/begin CHARACTERISTIC mDEADTM12 "A waste time (Qa region #1) (bank 2) without an interpolation" VALUE 0x000083F5 REC_UBYTE_C 0 COMP_0388_S 0 255 /begin FUNCTION_LIST /end FUNCTION_LIST /end CHARACTERISTIC
/begin CHARACTERISTIC mDEADTM22 "A waste time (Qa region #2) (bank 2) without an interpolation" VALUE 0x000083F7 REC_UBYTE_C 0 COMP_0388_S 0 255 /begin FUNCTION_LIST /end FUNCTION_LIST /end CHARACTERISTIC
/begin CHARACTERISTIC mDEADTM32 "A waste time (Qa region #3) (bank 2) without an interpolation" VALUE 0x000083F9 REC_UBYTE_C 0 COMP_0388_S 0 255 /begin FUNCTION_LIST /end FUNCTION_LIST /end CHARACTERISTIC
/begin CHARACTERISTIC mDECDOCF "Target speed wave slew rate (decrement)" VALUE 0x000090EE REC_UWORD_C 0 COMP_0389_S -65535 0 /begin FUNCTION_LIST Rxxx.1.Diagnostic_cycle_1_0_1 /end FUNCTION_LIST /end CHARACTERISTIC
/begin CHARACTERISTIC mDEGOK1 "É¢EGRT (for EGRTM1#) OK judgement value" VALUE 0x00008421 REC_UBYTE_C 0 COMP_0003 0 255 /begin FUNCTION_LIST R904.1.Gst_on_can_1_0_1 /end FUNCTION_LIST /end CHARACTERISTIC
/begin CHARACTERISTIC mDEGOK2 "É¢EGRT (for EGRTM2#) OK judgement value" VALUE 0x00008422 REC_UBYTE_C 0 COMP_0003 0 255 /begin FUNCTION_LIST R904.1.Gst_on_can_1_0_1 /end FUNCTION_LIST /end CHARACTERISTIC
/begin CHARACTERISTIC mDEGOK3 "DTEGR3- OK judgement value" VALUE 0x00008423 REC_UBYTE_C 0 COMP_0003 0 255 /begin FUNCTION_LIST R904.1.Gst_on_can_1_0_1 /end FUNCTION_LIST /end CHARACTERISTIC
/begin CHARACTERISTIC mDIAGDLY "Minimum delay for availability of Immobilizer diagnosis" VALUE 0x00008431 REC_UBYTE_C 0 COMP_0366_S 0 5.1 /begin FUNCTION_LIST /end FUNCTION_LIST /end CHARACTERISTIC
/begin CHARACTERISTIC mDIRE11 "Reference pressure measuring delay" VALUE 0x00008435 REC_UBYTE_C 0 COMP_0008 0 25500 /begin FUNCTION_LIST /end FUNCTION_LIST /end CHARACTERISTIC
/begin CHARACTERISTIC mDIRE12 "BSVP12 measuring delay" VALUE 0x000090F6 REC_UWORD_C 0 COMP_0008 0 6553500 /begin FUNCTION_LIST /end FUNCTION_LIST /end CHARACTERISTIC
/begin CHARACTERISTIC mDIRE13 "DVP8 measuring delay" VALUE 0x000090F8 REC_UWORD_C 0 COMP_0008 0 6553500 /begin FUNCTION_LIST /end FUNCTION_LIST /end CHARACTERISTIC
/begin CHARACTERISTIC mDIRE14 "Vapor monitor control completion delay" VALUE 0x00008436 REC_UBYTE_C 0 COMP_0008 0 25500 /begin FUNCTION_LIST /end FUNCTION_LIST /end CHARACTERISTIC
/begin CHARACTERISTIC mDIRE15 "A delay for the leak-down diagnosis" VALUE 0x00008437 REC_UBYTE_C 0 COMP_0008 0 25500 /begin FUNCTION_LIST /end FUNCTION_LIST /end CHARACTERISTIC
/begin CHARACTERISTIC mDIRE15B "At the time of the 0.02inch leak-down, a delay for the diagnosis" VALUE 0x00008438 REC_UBYTE_C 0 COMP_0008 0 25500 /begin FUNCTION_LIST /end FUNCTION_LIST /end CHARACTERISTIC
/begin CHARACTERISTIC mDIRE16 "Leak-down start waiting time" VALUE 0x00008439 REC_UBYTE_C 0 COMP_0008 0 25500 /begin FUNCTION_LIST /end FUNCTION_LIST /end CHARACTERISTIC
/begin CHARACTERISTIC mDIRE17 "Pull-down switchover cancellation time" VALUE 0x0000843A REC_UBYTE_C 0 COMP_0096 0 2550 /begin FUNCTION_LIST /end FUNCTION_LIST /end CHARACTERISTIC
/begin CHARACTERISTIC mDIRE18 "Atomospheric pressure re-measuring delay" VALUE 0x0000843B REC_UBYTE_C 0 COMP_0008 0 25500 /begin FUNCTION_LIST /end FUNCTION_LIST /end CHARACTERISTIC
/begin CHARACTERISTIC mDIRE19 "DVP4 re-measuring delay" VALUE 0x000090FA REC_UWORD_C 0 COMP_0008 0 6553500 /begin FUNCTION_LIST /end FUNCTION_LIST /end CHARACTERISTIC
/begin CHARACTERISTIC mDIREDC "Drain-cut valve close delay" VALUE 0x0000843C REC_UBYTE_C 0 COMP_0008 0 25500 /begin FUNCTION_LIST /end FUNCTION_LIST /end CHARACTERISTIC
/begin CHARACTERISTIC mDIREI1 "Reference pressure measuring delay" VALUE 0x0000843D REC_UBYTE_C 0 COMP_0008 0 25500 /begin FUNCTION_LIST /end FUNCTION_LIST /end CHARACTERISTIC
/begin CHARACTERISTIC mDIREI5 "A delay for the leak-down diagnosis" VALUE 0x00008440 REC_UBYTE_C 0 COMP_0008 0 25500 /begin FUNCTION_LIST /end FUNCTION_LIST /end CHARACTERISTIC
/begin CHARACTERISTIC mDIREI9 "BSVP12 measuring delay" VALUE 0x000090FC REC_UWORD_C 0 COMP_0008 0 6553500 /begin FUNCTION_LIST /end FUNCTION_LIST /end CHARACTERISTIC
/begin CHARACTERISTIC mDLTRTOH "CVT maximum gear shift speed" VALUE 0x00009120 REC_UWORD_C 0 COMP_0220_S 0 63.999056205 /begin FUNCTION_LIST /end FUNCTION_LIST /end CHARACTERISTIC
/begin CHARACTERISTIC mDLTRTOL "CVT minimum gear shift speed" VALUE 0x00009122 REC_UWORD_C 0 COMP_0220_S 0 63.999056205 /begin FUNCTION_LIST /end FUNCTION_LIST /end CHARACTERISTIC
/begin CHARACTERISTIC mDLYPA "Pressure measuring delay" VALUE 0x00008482 REC_UBYTE_C 0 COMP_0008 0 25500 /begin FUNCTION_LIST /end FUNCTION_LIST /end CHARACTERISTIC
/begin CHARACTERISTIC mDPAMBC "A change in a vapor monitor switchover atomospheric pressure" VALUE 0x0000912E REC_UWORD_C 0 COMP_0050 0 5119.921875 /begin FUNCTION_LIST /end FUNCTION_LIST /end CHARACTERISTIC
/begin CHARACTERISTIC mDPSLSH "Slosh judgement value for 0.02" VALUE 0x00009130 REC_UWORD_C 0 COMP_0296_S 0 5119.921875 /begin FUNCTION_LIST /end FUNCTION_LIST /end CHARACTERISTIC
/begin CHARACTERISTIC mDPSLSH04 "Slosh judgement value for 0.04-inch judgement" VALUE 0x00009132 REC_UWORD_C 0 COMP_0050 0 5119.921875 /begin FUNCTION_LIST /end FUNCTION_LIST /end CHARACTERISTIC
/begin CHARACTERISTIC mDQCK "(CK) Load change compensation quantity change rate (middle QCK2)" VALUE 0x000084AD REC_UBYTE_C 0 COMP_0014 0 2550 /begin FUNCTION_LIST /end FUNCTION_LIST /end CHARACTERISTIC
/begin CHARACTERISTIC mDQCK0 "(CK) Load change compensation quantity change rate (middle QCK1)" VALUE 0x000084AE REC_UBYTE_C 0 COMP_0014 0 2550 /begin FUNCTION_LIST /end FUNCTION_LIST /end CHARACTERISTIC
/begin CHARACTERISTIC mDTFNG1 "Judgement delay 1" VALUE 0x000084DE REC_UBYTE_C 0 COMP_0013 0 255 /begin FUNCTION_LIST /end FUNCTION_LIST /end CHARACTERISTIC
/begin CHARACTERISTIC mDTFNG2 "Judgement delay 2" VALUE 0x000084DF REC_UBYTE_C 0 COMP_0013 0 255 /begin FUNCTION_LIST /end FUNCTION_LIST /end CHARACTERISTIC
/begin CHARACTERISTIC mDURAPOX "Duration to detect APOXNG" VALUE 0x00008504 REC_UBYTE_C 0 COMP_0014 0 2550 /begin FUNCTION_LIST R301.21.SafetyLevel2_1_0_2 /end FUNCTION_LIST /end CHARACTERISTIC
/begin CHARACTERISTIC mDURASTR "Duration to detect ASTRNG" VALUE 0x00008505 REC_UBYTE_C 0 COMP_0014 0 2550 /begin FUNCTION_LIST R301.21.SafetyLevel2_1_0_2 /end FUNCTION_LIST /end CHARACTERISTIC
/begin CHARACTERISTIC mDURDTSP "Duration to detect DTSPNG" VALUE 0x00008506 REC_UBYTE_C 0 COMP_0014 0 2550 /begin FUNCTION_LIST R301.21.SafetyLevel2_1_0_2 /end FUNCTION_LIST /end CHARACTERISTIC
/begin CHARACTERISTIC mDURQHAP "Duration to detect QHAPNG" VALUE 0x00008508 REC_UBYTE_C 0 COMP_0014 0 2550 /begin FUNCTION_LIST R301.21.SafetyLevel2_1_0_2 /end FUNCTION_LIST /end CHARACTERISTIC
/begin CHARACTERISTIC mDURTATE "Duration to detect TATENG" VALUE 0x00008509 REC_UBYTE_C 0 COMP_0014 0 2550 /begin FUNCTION_LIST R301.21.SafetyLevel2_1_0_2 /end FUNCTION_LIST /end CHARACTERISTIC
/begin CHARACTERISTIC mDURTGTX "Duration to detect TGTXNG" VALUE 0x0000850A REC_UBYTE_C 0 COMP_0014 0 2550 /begin FUNCTION_LIST R301.21.SafetyLevel2_1_0_2 /end FUNCTION_LIST /end CHARACTERISTIC
/begin CHARACTERISTIC mDURTTEP "Duration to detect TTEPNG" VALUE 0x0000850B REC_UBYTE_C 0 COMP_0014 0 2550 /begin FUNCTION_LIST R301.21.SafetyLevel2_1_0_2 /end FUNCTION_LIST /end CHARACTERISTIC
/begin CHARACTERISTIC mDURVAPX "Duration to detect VAPXNG" VALUE 0x0000850C REC_UBYTE_C 0 COMP_0014 0 2550 /begin FUNCTION_LIST R301.21.SafetyLevel2_1_0_2 /end FUNCTION_LIST /end CHARACTERISTIC
/begin CHARACTERISTIC mECNINHT "Electrical consumer inhibition time" VALUE 0x00008525 REC_UBYTE_C 0 COMP_0013 0 255 /begin FUNCTION_LIST R901.1.Diag_on_can_app_1_6_2 /end FUNCTION_LIST /end CHARACTERISTIC
/begin CHARACTERISTIC mEGROPD "An open diagnosis diagnosis timing" VALUE 0x00008535 REC_UBYTE_C 0 COMP_0013 0 255 /begin FUNCTION_LIST /end FUNCTION_LIST /end CHARACTERISTIC
/begin CHARACTERISTIC mENRPH2 "Rotation condition upper limit 2" VALUE 0x00008540 REC_UBYTE_C 0 COMP_0000 0 6375 /begin FUNCTION_LIST /end FUNCTION_LIST /end CHARACTERISTIC
/begin CHARACTERISTIC mENRPH3 "Pull-down start rotation upper limit" VALUE 0x00008541 REC_UBYTE_C 0 COMP_0000 0 6375 /begin FUNCTION_LIST /end FUNCTION_LIST /end CHARACTERISTIC
/begin CHARACTERISTIC mENRPL2 "Rotation condition lower limit 2" VALUE 0x00008543 REC_UBYTE_C 0 COMP_0000 0 6375 /begin FUNCTION_LIST /end FUNCTION_LIST /end CHARACTERISTIC
/begin CHARACTERISTIC mENRPL3 "Pull-down start rotation lower limit" VALUE 0x00008544 REC_UBYTE_C 0 COMP_0000 0 6375 /begin FUNCTION_LIST /end FUNCTION_LIST /end CHARACTERISTIC
/begin CHARACTERISTIC mETCSTT "During the cranking, control prohibition time" VALUE 0x0000855E REC_UBYTE_C 0 COMP_0008 0 25500 /begin FUNCTION_LIST /end FUNCTION_LIST /end CHARACTERISTIC
/begin CHARACTERISTIC mETHSJDE "At the time of the hot restart closed-diagnosis TEGR decline, diagnosis permission delay" VALUE 0x00008563 REC_UBYTE_C 0 COMP_0013 0 255 /begin FUNCTION_LIST /end FUNCTION_LIST /end CHARACTERISTIC
/begin CHARACTERISTIC mETVOH3 "Pull-down start throttle open-degree upper limit" VALUE 0x00008565 REC_UBYTE_C 0 COMP_0002 0 89.25 /begin FUNCTION_LIST /end FUNCTION_LIST /end CHARACTERISTIC
/begin CHARACTERISTIC mETVOL3 "Pull-down start throttle open-degree lower limit" VALUE 0x00008566 REC_UBYTE_C 0 COMP_0002 0 89.25 /begin FUNCTION_LIST /end FUNCTION_LIST /end CHARACTERISTIC
/begin CHARACTERISTIC mETWIH3 "At the time of the start, coolant temperature condition upper limit" VALUE 0x00008567 REC_UBYTE_C 0 COMP_0035 -50 205 /begin FUNCTION_LIST /end FUNCTION_LIST /end CHARACTERISTIC
/begin CHARACTERISTIC mETWIH4 "At the time of the start, coolant temperature condition upper limit 2" VALUE 0x00008568 REC_UBYTE_C 0 COMP_0035 -50 205 /begin FUNCTION_LIST /end FUNCTION_LIST /end CHARACTERISTIC
/begin CHARACTERISTIC mETWIL3 "At the time of the start, coolant temperature condition lower limit" VALUE 0x0000856A REC_UBYTE_C 0 COMP_0035 -50 205 /begin FUNCTION_LIST /end FUNCTION_LIST /end CHARACTERISTIC
/begin CHARACTERISTIC mETWIL4 "At the time of the start, coolant temperature condition lower limit 2" VALUE 0x0000856B REC_UBYTE_C 0 COMP_0035 -50 205 /begin FUNCTION_LIST /end FUNCTION_LIST /end CHARACTERISTIC
/begin CHARACTERISTIC mETWJD "Coolant temperature condition judgement delay" VALUE 0x0000856C REC_UBYTE_C 0 COMP_0013 0 255 /begin FUNCTION_LIST /end FUNCTION_LIST /end CHARACTERISTIC
/begin CHARACTERISTIC mEVALP2 "Pull-down permission alpha change value" VALUE 0x00008571 REC_UBYTE_C 0 COMP_0027 0 255 /begin FUNCTION_LIST /end FUNCTION_LIST /end CHARACTERISTIC
/begin CHARACTERISTIC mEVCLD2 "KDUTY UP EVPTR condition 2" VALUE 0x00008573 REC_UBYTE_C 0 COMP_0013 0 255 /begin FUNCTION_LIST /end FUNCTION_LIST /end CHARACTERISTIC
/begin CHARACTERISTIC mEVFGAH "Space capacity condition upper limit" VALUE 0x0000857E REC_UBYTE_C 0 COMP_0150 0 127.5 /begin FUNCTION_LIST /end FUNCTION_LIST /end CHARACTERISTIC
/begin CHARACTERISTIC mEVFGAH2 "Diagnosis permission space capacity upper limit" VALUE 0x0000857F REC_UBYTE_C 0 COMP_0150 0 127.5 /begin FUNCTION_LIST /end FUNCTION_LIST /end CHARACTERISTIC
/begin CHARACTERISTIC mEVFGAL "Space capacity condition lower limit" VALUE 0x00008580 REC_UBYTE_C 0 COMP_0150 0 127.5 /begin FUNCTION_LIST /end FUNCTION_LIST /end CHARACTERISTIC
/begin CHARACTERISTIC mEVKBLH "Heat resisting purge learning value" VALUE 0x00008582 REC_UBYTE_C 0 COMP_0027 0 255 /begin FUNCTION_LIST /end FUNCTION_LIST /end CHARACTERISTIC
/begin CHARACTERISTIC mEVKBLL "Heat resisting purge learning value" VALUE 0x00008583 REC_UBYTE_C 0 COMP_0027 0 255 /begin FUNCTION_LIST /end FUNCTION_LIST /end CHARACTERISTIC
/begin CHARACTERISTIC mEVLKSL "Slosh judgement criteria" VALUE 0x0000918A REC_UWORD_C 0 COMP_0050 0 5119.921875 /begin FUNCTION_LIST /end FUNCTION_LIST /end CHARACTERISTIC
/begin CHARACTERISTIC mEVNGSL "Lean-shift judgement level upper limit value" VALUE 0x00008589 REC_UBYTE_C 0 COMP_0104 0 2550 /begin FUNCTION_LIST R901.1.Diag_on_can_app_1_6_2 R904.1.Gst_on_can_1_0_1 /end FUNCTION_LIST /end CHARACTERISTIC
/begin CHARACTERISTIC mEVPAH3 "Diagnosis permission atomospheric pressure upper limit" VALUE 0x0000858E REC_UBYTE_C 0 COMP_0054 0 5100 /begin FUNCTION_LIST /end FUNCTION_LIST /end CHARACTERISTIC
/begin CHARACTERISTIC mEVPAL3 "Diagnosis permission atomospheric pressure lower limit" VALUE 0x0000858F REC_UBYTE_C 0 COMP_0054 0 5100 /begin FUNCTION_LIST /end FUNCTION_LIST /end CHARACTERISTIC
/begin CHARACTERISTIC mEVPCTT "Purge cut Éømin time" VALUE 0x00008591 REC_UBYTE_C 0 COMP_0008 0 25500 /begin FUNCTION_LIST /end FUNCTION_LIST /end CHARACTERISTIC
/begin CHARACTERISTIC mEVPSLM2 "Purge /V open-degree decrease rate" VALUE 0x00009190 REC_UWORD_C 0 COMP_0456 0 1.999970916 /begin FUNCTION_LIST /end FUNCTION_LIST /end CHARACTERISTIC
/begin CHARACTERISTIC mEVSTRY "Reference pressure measuring delay" VALUE 0x000085AE REC_UBYTE_C 0 COMP_0008 0 25500 /begin FUNCTION_LIST /end FUNCTION_LIST /end CHARACTERISTIC
/begin CHARACTERISTIC mEVTAH2 "At least, intake air temperature judgement condition upper limit" VALUE 0x000085AF REC_UBYTE_C 0 COMP_0035 -50 205 /begin FUNCTION_LIST /end FUNCTION_LIST /end CHARACTERISTIC
/begin CHARACTERISTIC mEVTAL2 "At least, intake air temperature judgement condition lower limit" VALUE 0x000085B0 REC_UBYTE_C 0 COMP_0035 -50 205 /begin FUNCTION_LIST /end FUNCTION_LIST /end CHARACTERISTIC
/begin CHARACTERISTIC mEVTFH3 "Fuel temperature condition upper limit" VALUE 0x000085B3 REC_UBYTE_C 0 COMP_0035 -50 205 /begin FUNCTION_LIST /end FUNCTION_LIST /end CHARACTERISTIC
/begin CHARACTERISTIC mEVTFH4 "Diagnosis permission fuel temperature upper limit" VALUE 0x000085B4 REC_UBYTE_C 0 COMP_0035 -50 205 /begin FUNCTION_LIST /end FUNCTION_LIST /end CHARACTERISTIC
/begin CHARACTERISTIC mEVTFL2 "Fuel temperature condition lower limit 2" VALUE 0x000085B5 REC_UBYTE_C 0 COMP_0035 -50 205 /begin FUNCTION_LIST /end FUNCTION_LIST /end CHARACTERISTIC
/begin CHARACTERISTIC mEVTFL3 "Fuel temperature condition lower limit" VALUE 0x000085B6 REC_UBYTE_C 0 COMP_0035 -50 205 /begin FUNCTION_LIST /end FUNCTION_LIST /end CHARACTERISTIC
/begin CHARACTERISTIC mEVTFM "Compensation coefficient switching fuel temperature" VALUE 0x000085B7 REC_UBYTE_C 0 COMP_0035 -50 205 /begin FUNCTION_LIST /end FUNCTION_LIST /end CHARACTERISTIC
/begin CHARACTERISTIC mEVTPH4 "TPUL increment permission TP upper limit" VALUE 0x000085C2 REC_UBYTE_C 0 COMP_0001 0 31.875 /begin FUNCTION_LIST /end FUNCTION_LIST /end CHARACTERISTIC
/begin CHARACTERISTIC mEVTVOH "TVO condition upper limit" VALUE 0x000085CB REC_UBYTE_C 0 COMP_0002 0 89.25 /begin FUNCTION_LIST /end FUNCTION_LIST /end CHARACTERISTIC
/begin CHARACTERISTIC mEVTVOL "TVO condition lower limit" VALUE 0x000085CC REC_UBYTE_C 0 COMP_0002 0 89.25 /begin FUNCTION_LIST /end FUNCTION_LIST /end CHARACTERISTIC
/begin CHARACTERISTIC mEVTWIH "At the time of the start, coolant temperature condition upper limit" VALUE 0x000085CD REC_UBYTE_C 0 COMP_0035 -50 205 /begin FUNCTION_LIST /end FUNCTION_LIST /end CHARACTERISTIC
/begin CHARACTERISTIC mEVTWIL "At the time of the start, coolant temperature condition lower limit" VALUE 0x000085CE REC_UBYTE_C 0 COMP_0035 -50 205 /begin FUNCTION_LIST /end FUNCTION_LIST /end CHARACTERISTIC
/begin CHARACTERISTIC mFBKI2 "Pull-down F/B I-gain gain 2" VALUE 0x000085D9 REC_UBYTE_C 0 COMP_0450 0 0.249023565 /begin FUNCTION_LIST /end FUNCTION_LIST /end CHARACTERISTIC
/begin CHARACTERISTIC mFBKP2 "Pull-down F/B P-gain gain 2" VALUE 0x000085DB REC_UBYTE_C 0 COMP_0032 0 0.99609375 /begin FUNCTION_LIST /end FUNCTION_LIST /end CHARACTERISTIC
/begin CHARACTERISTIC mFBKSH "F/B coefficient upper limit value" VALUE 0x000085DC REC_UBYTE_C 0 COMP_0044 0 1.9921875 /begin FUNCTION_LIST /end FUNCTION_LIST /end CHARACTERISTIC
/begin CHARACTERISTIC mFBKSL "F/B coefficient lower limit value" VALUE 0x000085DD REC_UBYTE_C 0 COMP_0044 0 1.9921875 /begin FUNCTION_LIST /end FUNCTION_LIST /end CHARACTERISTIC
/begin CHARACTERISTIC mFCRADVE "FCRADV terminate err ADV" VALUE 0x00009196 REC_UWORD_C 0 COMP_0081 0 255.99609375 /begin FUNCTION_LIST R301.23.ADV_calculation_1_1_2 /end FUNCTION_LIST /end CHARACTERISTIC
/begin CHARACTERISTIC mFCRADVT "FCRADV set duration" VALUE 0x00009198 REC_UWORD_C 0 COMP_0014 0 655350 /begin FUNCTION_LIST R301.23.ADV_calculation_1_1_2 /end FUNCTION_LIST /end CHARACTERISTIC
/begin CHARACTERISTIC mFCRAVTH "FCRADV set FCADV condition" VALUE 0x0000919A REC_UWORD_C 0 COMP_0081 0 255.99609375 /begin FUNCTION_LIST R301.23.ADV_calculation_1_1_2 /end FUNCTION_LIST /end CHARACTERISTIC
/begin CHARACTERISTIC mFCTIM1 "A high air quantity fuel cut delay" VALUE 0x000085F0 REC_UBYTE_C 0 COMP_0008 0 25500 /begin FUNCTION_LIST /end FUNCTION_LIST /end CHARACTERISTIC
/begin CHARACTERISTIC mFGNLM "Fuel level gauge unusual value cut cut criteria" VALUE 0x000091AE REC_UWORD_C 0 COMP_0050 0 5119.921875 /begin FUNCTION_LIST /end FUNCTION_LIST /end CHARACTERISTIC
/begin CHARACTERISTIC mFLRDV8 "Gross leak judgement permission DVP8" VALUE 0x000091B2 REC_UWORD_C 0 COMP_0050 0 5119.921875 /begin FUNCTION_LIST /end FUNCTION_LIST /end CHARACTERISTIC
/begin CHARACTERISTIC mFO2V5S "Front unusual voltage 2 judgement voltage" VALUE 0x00008614 REC_UBYTE_C 0 COMP_0104 0 2550 /begin FUNCTION_LIST R904.1.Gst_on_can_1_0_1 /end FUNCTION_LIST /end CHARACTERISTIC
/begin CHARACTERISTIC mFRCAP2 "After the pull-down, pressure minimum value" VALUE 0x0000862E REC_UBYTE_C 0 COMP_0054 0 5100 /begin FUNCTION_LIST /end FUNCTION_LIST /end CHARACTERISTIC
/begin CHARACTERISTIC mFSLOPE "Slope judgement criteria" VALUE 0x000091BE REC_UWORD_C 0 COMP_0050 0 5119.921875 /begin FUNCTION_LIST /end FUNCTION_LIST /end CHARACTERISTIC
/begin CHARACTERISTIC mFSLOSH "Slosh judgement criteria" VALUE 0x000091C0 REC_UWORD_C 0 COMP_0050 0 5119.921875 /begin FUNCTION_LIST /end FUNCTION_LIST /end CHARACTERISTIC
/begin CHARACTERISTIC mFTIME1 "Slosh judgement judgement delay" VALUE 0x00008649 REC_UBYTE_C 0 COMP_0008 0 25500 /begin FUNCTION_LIST /end FUNCTION_LIST /end CHARACTERISTIC
/begin CHARACTERISTIC mFTIME2 "Slope judgement judgement delay" VALUE 0x0000864A REC_UBYTE_C 0 COMP_0008 0 25500 /begin FUNCTION_LIST /end FUNCTION_LIST /end CHARACTERISTIC
/begin CHARACTERISTIC mFTIME3 "Slope judgement release judgement delay" VALUE 0x0000864B REC_UBYTE_C 0 COMP_0008 0 25500 /begin FUNCTION_LIST /end FUNCTION_LIST /end CHARACTERISTIC
/begin CHARACTERISTIC mFTSNGDLY "Fuel temperature sensor judgement time" VALUE 0x0000864C REC_UBYTE_C 0 COMP_0013 0 255 /begin FUNCTION_LIST /end FUNCTION_LIST /end CHARACTERISTIC
/begin CHARACTERISTIC mGM1P1C "Adaptation OBD system setup value" VALUE 0x0000866D REC_UBYTE_C 0 COMP_0068 0 255 /begin FUNCTION_LIST R904.1.Gst_on_can_1_0_1 /end FUNCTION_LIST /end CHARACTERISTIC
/begin CHARACTERISTIC mGM8EPH "Mode 8 evapo test permission line pressure upper limit value" VALUE 0x0000866E REC_UBYTE_C 0 COMP_0054 0 5100 /begin FUNCTION_LIST /end FUNCTION_LIST /end CHARACTERISTIC
/begin CHARACTERISTIC mGM8EPL "Mode 8 evapo test permission line pressure lower limit value" VALUE 0x0000866F REC_UBYTE_C 0 COMP_0054 0 5100 /begin FUNCTION_LIST /end FUNCTION_LIST /end CHARACTERISTIC
/begin CHARACTERISTIC mGM8ETA "Mode 8 evapo test permission intake air temperature" VALUE 0x00008670 REC_UBYTE_C 0 COMP_0035 -50 205 /begin FUNCTION_LIST /end FUNCTION_LIST /end CHARACTERISTIC
/begin CHARACTERISTIC mGM8ETF "Mode 8 evapo test permission fuel temperature" VALUE 0x00008671 REC_UBYTE_C 0 COMP_0035 -50 205 /begin FUNCTION_LIST /end FUNCTION_LIST /end CHARACTERISTIC
/begin CHARACTERISTIC mGM8EVB "Mode 8 evapo test permission battery voltage" VALUE 0x00008672 REC_UBYTE_C 0 COMP_0033 0 20400 /begin FUNCTION_LIST /end FUNCTION_LIST /end CHARACTERISTIC
/begin CHARACTERISTIC mGVCC "Power supply voltage compensation coefficient" VALUE 0x00008683 REC_UBYTE_C 0 COMP_0009 0 199.21875 /begin FUNCTION_LIST /end FUNCTION_LIST /end CHARACTERISTIC
/begin CHARACTERISTIC mHTWLMTMX "A high coolant temperature limiter upper limit coolant temperature" VALUE 0x000086A8 REC_UBYTE_C 0 COMP_0035 -50 205 /begin FUNCTION_LIST /end FUNCTION_LIST /end CHARACTERISTIC
/begin CHARACTERISTIC mHTWLMTST "A high coolant temperature limiter control start coolant temperature" VALUE 0x000086A9 REC_UBYTE_C 0 COMP_0035 -50 205 /begin FUNCTION_LIST /end FUNCTION_LIST /end CHARACTERISTIC
/begin CHARACTERISTIC mHTWTEDLD "A high coolant temperature limiter torque decrease rate" VALUE 0x000086AA REC_UBYTE_C 0 COMP_0213_S 0 25.5 /begin FUNCTION_LIST /end FUNCTION_LIST /end CHARACTERISTIC
/begin CHARACTERISTIC mHTWTEDLU "The high coolant temperature limiter torque rate of increase" VALUE 0x000086AB REC_UBYTE_C 0 COMP_0213_S 0 25.5 /begin FUNCTION_LIST /end FUNCTION_LIST /end CHARACTERISTIC
/begin CHARACTERISTIC mHTWTWDLD "A high coolant temperature limiter coolant temperature decrease rate" VALUE 0x00009248 REC_UWORD_C 0 COMP_0419_S 0 255.99609375 /begin FUNCTION_LIST /end FUNCTION_LIST /end CHARACTERISTIC
/begin CHARACTERISTIC mHTWTWDLU "The high coolant temperature limiter coolant temperature rate of increase" VALUE 0x0000924A REC_UWORD_C 0 COMP_0419_S 0 255.99609375 /begin FUNCTION_LIST /end FUNCTION_LIST /end CHARACTERISTIC
/begin CHARACTERISTIC mHVNGSH "The judgement level that rich output is unusual" VALUE 0x000086AD REC_UBYTE_C 0 COMP_0104 0 2550 /begin FUNCTION_LIST R901.1.Diag_on_can_app_1_6_2 R904.1.Gst_on_can_1_0_1 /end FUNCTION_LIST /end CHARACTERISTIC
/begin CHARACTERISTIC mICAGBCLK "Failure counter increase amount of Agb clock error" VALUE 0x000086C4 REC_UBYTE_C 0 COMP_0068 0 255 DISPLAY_IDENTIFIER Cxx_dfinc_agb_clck /begin FUNCTION_LIST R902.1.SafetyDiagManager_1_3_6 /end FUNCTION_LIST /end CHARACTERISTIC
/begin CHARACTERISTIC mICAGBDLY "Failure counter increase amount of Maximum delay which can be used by agb for a toque request" VALUE 0x000086C5 REC_UBYTE_C 0 COMP_0068 0 255 DISPLAY_IDENTIFIER Cxx_dfinc_agb_dly_out /begin FUNCTION_LIST R902.1.SafetyDiagManager_1_3_6 /end FUNCTION_LIST /end CHARACTERISTIC
/begin CHARACTERISTIC mICAGBINT "Failure counter increase amount of the threshold    for integration of gearbox fast-acting torque value has been exceeded" VALUE 0x000086C6 REC_UBYTE_C 0 COMP_0068 0 255 DISPLAY_IDENTIFIER Cxx_dfinc_int_agb_tq_max /begin FUNCTION_LIST R902.1.SafetyDiagManager_1_3_6 /end FUNCTION_LIST /end CHARACTERISTIC
/begin CHARACTERISTIC mICAGBLNK "Failure counter increase amount of AGB link" VALUE 0x000086C7 REC_UBYTE_C 0 COMP_0068 0 255 DISPLAY_IDENTIFIER Cxx_dfinc_agb_lk /begin FUNCTION_LIST R902.1.SafetyDiagManager_1_3_6 /end FUNCTION_LIST /end CHARACTERISTIC
/begin CHARACTERISTIC mICAP12 "Failure counter increase amount of accelerator pedal (loss of the TWO tracks)" VALUE 0x000086C8 REC_UBYTE_C 0 COMP_0068 0 255 DISPLAY_IDENTIFIER Cxx_dfinc_acel_pdl_tot /begin FUNCTION_LIST R902.1.SafetyDiagManager_1_3_6 /end FUNCTION_LIST /end CHARACTERISTIC
/begin CHARACTERISTIC mICAPCHR "Failure counter increase amount of accelerator pedal consistency" VALUE 0x000086C9 REC_UBYTE_C 0 COMP_0068 0 255 DISPLAY_IDENTIFIER Cxx_dfinc_acel_pdl_chr /begin FUNCTION_LIST R902.1.SafetyDiagManager_1_3_6 /end FUNCTION_LIST /end CHARACTERISTIC
/begin CHARACTERISTIC mICAPMUX "Failure counter increase amount of invalid value of the alternator power transmitted by the USM" VALUE 0x000086CA REC_UBYTE_C 0 COMP_0068 0 255 DISPLAY_IDENTIFIER Cxx_dfinc_usm_alt_pow_nok /begin FUNCTION_LIST R902.1.SafetyDiagManager_1_3_6 /end FUNCTION_LIST /end CHARACTERISTIC
/begin CHARACTERISTIC mICAPSC "Failure counter increase amount of accelerator pedal safety case (N Åã 2) (irreversible downgraded mode)" VALUE 0x000086CB REC_UBYTE_C 0 COMP_0068 0 255 DISPLAY_IDENTIFIER Cxx_dfinc_acel_pdl_secu /begin FUNCTION_LIST R902.1.SafetyDiagManager_1_3_6 /end FUNCTION_LIST /end CHARACTERISTIC
/begin CHARACTERISTIC mICAPSC1 "Failure counter increase amount of accelerator pedal safety case N Åã 1 (reversible downgraded mode)" VALUE 0x000086CC REC_UBYTE_C 0 COMP_0068 0 255 DISPLAY_IDENTIFIER Cxx_dfinc_acel_pdl_secu_1 /begin FUNCTION_LIST R902.1.SafetyDiagManager_1_3_6 /end FUNCTION_LIST /end CHARACTERISTIC
/begin CHARACTERISTIC mICAPSOC1 "Failure counter increase amount of accelerator pedal track 1 open circuit" VALUE 0x000086CD REC_UBYTE_C 0 COMP_0068 0 255 DISPLAY_IDENTIFIER Cxx_dfinc_acel_pdl_oc_v1 /begin FUNCTION_LIST R902.1.SafetyDiagManager_1_3_6 /end FUNCTION_LIST /end CHARACTERISTIC
/begin CHARACTERISTIC mICAPSOC2 "Failure counter increase amount of accelerator pedal track 2 open circuit" VALUE 0x000086CE REC_UBYTE_C 0 COMP_0068 0 255 DISPLAY_IDENTIFIER Cxx_dfinc_acel_pdl_oc_v2 /begin FUNCTION_LIST R902.1.SafetyDiagManager_1_3_6 /end FUNCTION_LIST /end CHARACTERISTIC
/begin CHARACTERISTIC mICAPSSC1 "Failure counter increase amount of accelerator pedal track 1 short circuit" VALUE 0x000086CF REC_UBYTE_C 0 COMP_0068 0 255 DISPLAY_IDENTIFIER Cxx_dfinc_acel_pdl_sc_v1 /begin FUNCTION_LIST R902.1.SafetyDiagManager_1_3_6 /end FUNCTION_LIST /end CHARACTERISTIC
/begin CHARACTERISTIC mICAPSSC2 "Failure counter increase amount of accelerator pedal track 2 short circuit" VALUE 0x000086D0 REC_UBYTE_C 0 COMP_0068 0 255 DISPLAY_IDENTIFIER Cxx_dfinc_acel_pdl_sc_v2 /begin FUNCTION_LIST R902.1.SafetyDiagManager_1_3_6 /end FUNCTION_LIST /end CHARACTERISTIC
/begin CHARACTERISTIC mICAVCC1 "Failure counter increase amount of power supply 1 (accelerator pedal track 1)" VALUE 0x000086D4 REC_UBYTE_C 0 COMP_0068 0 255 DISPLAY_IDENTIFIER Cxx_dfinc_pws_1 /begin FUNCTION_LIST R902.1.SafetyDiagManager_1_3_6 /end FUNCTION_LIST /end CHARACTERISTIC
/begin CHARACTERISTIC mICAVCC2 "Failure counter increase amount of power supply 2 (accelerator pedal track 2)" VALUE 0x000086D5 REC_UBYTE_C 0 COMP_0068 0 255 DISPLAY_IDENTIFIER Cxx_dfinc_pws_2 /begin FUNCTION_LIST R902.1.SafetyDiagManager_1_3_6 /end FUNCTION_LIST /end CHARACTERISTIC
/begin CHARACTERISTIC mICBRKCMP "Failure counter increase amount of Incoherence between brake information" VALUE 0x000086D6 REC_UBYTE_C 0 COMP_0068 0 255 DISPLAY_IDENTIFIER Cxx_dfinc_brk_pdl_cmp /begin FUNCTION_LIST R902.1.SafetyDiagManager_1_3_6 /end FUNCTION_LIST /end CHARACTERISTIC
/begin CHARACTERISTIC mICCLSW "Failure counter increase amount of clutch switch" VALUE 0x000086D7 REC_UBYTE_C 0 COMP_0068 0 255 /begin FUNCTION_LIST R902.1.SafetyDiagManager_1_3_6 /end FUNCTION_LIST /end CHARACTERISTIC
/begin CHARACTERISTIC mICCLUCMP "Failure counter increase amount of Incoherence between clutch information" VALUE 0x000086D8 REC_UBYTE_C 0 COMP_0068 0 255 DISPLAY_IDENTIFIER Cxx_dfinc_bgin_clu_cmp /begin FUNCTION_LIST R902.1.SafetyDiagManager_1_3_6 /end FUNCTION_LIST /end CHARACTERISTIC
/begin CHARACTERISTIC mICCRUCMP "Failure counter increase amount of CC safety" VALUE 0x000086D9 REC_UBYTE_C 0 COMP_0068 0 255 DISPLAY_IDENTIFIER Cxx_dfinc_cru_cmp /begin FUNCTION_LIST R902.1.SafetyDiagManager_1_3_6 /end FUNCTION_LIST /end CHARACTERISTIC
/begin CHARACTERISTIC mICCSCHR "Failure counter increase amount of CCSL main switch coherence" VALUE 0x000086DA REC_UBYTE_C 0 COMP_0068 0 255 DISPLAY_IDENTIFIER Cxx_dfinc_cru_sl_swi_chr /begin FUNCTION_LIST R902.1.SafetyDiagManager_1_3_6 /end FUNCTION_LIST /end CHARACTERISTIC
/begin CHARACTERISTIC mICCSNOK "Failure counter increase amount of CCSL Steering Wheel Command Switch blocked button" VALUE 0x000086DB REC_UBYTE_C 0 COMP_0068 0 255 DISPLAY_IDENTIFIER Cxx_dfinc_cru_whl_cmd_nok /begin FUNCTION_LIST R902.1.SafetyDiagManager_1_3_6 /end FUNCTION_LIST /end CHARACTERISTIC
/begin CHARACTERISTIC mICCSOCS "Failure counter increase amount of CCSL Steering Wheel Command Switch open circuit" VALUE 0x000086DC REC_UBYTE_C 0 COMP_0068 0 255 DISPLAY_IDENTIFIER Cxx_dfinc_cru_whl_cmd_oc_scw /begin FUNCTION_LIST R902.1.SafetyDiagManager_1_3_6 /end FUNCTION_LIST /end CHARACTERISTIC
/begin CHARACTERISTIC mICCSOOR "Failure counter increase amount of CCSL Steering Wheel Command Switch invalid value" VALUE 0x000086DD REC_UBYTE_C 0 COMP_0068 0 255 DISPLAY_IDENTIFIER Cxx_dfinc_cru_whl_cmd_oor /begin FUNCTION_LIST R902.1.SafetyDiagManager_1_3_6 /end FUNCTION_LIST /end CHARACTERISTIC
/begin CHARACTERISTIC mICCSTOT "Failure counter increase amount of CC/SL not available" VALUE 0x000086DE REC_UBYTE_C 0 COMP_0068 0 255 DISPLAY_IDENTIFIER Cxx_dfinc_cru_sl_tot /begin FUNCTION_LIST R902.1.SafetyDiagManager_1_3_6 /end FUNCTION_LIST /end CHARACTERISTIC
/begin CHARACTERISTIC mICESPCLK "Failure counter increase amount of ESP clock error" VALUE 0x000086DF REC_UBYTE_C 0 COMP_0068 0 255 DISPLAY_IDENTIFIER Cxx_dfinc_asr_msr_clck /begin FUNCTION_LIST R902.1.SafetyDiagManager_1_3_6 /end FUNCTION_LIST /end CHARACTERISTIC
/begin CHARACTERISTIC mICESPCPL "Failure counter increase amount of ESP complement error detected between ASR and MSR data" VALUE 0x000086E0 REC_UBYTE_C 0 COMP_0068 0 255 DISPLAY_IDENTIFIER Cxx_dfinc_asr_msr_cpl /begin FUNCTION_LIST R902.1.SafetyDiagManager_1_3_6 /end FUNCTION_LIST /end CHARACTERISTIC
/begin CHARACTERISTIC mICESPLNK "Failure counter increase amount of ASR/MSR link" VALUE 0x000086E1 REC_UBYTE_C 0 COMP_0068 0 255 DISPLAY_IDENTIFIER Cxx_dfinc_asr_msr_lk /begin FUNCTION_LIST R902.1.SafetyDiagManager_1_3_6 /end FUNCTION_LIST /end CHARACTERISTIC
/begin CHARACTERISTIC mICPRSOC "Failure counter increase amount of Air conditioning pressure sensor open circuit" VALUE 0x000086E3 REC_UBYTE_C 0 COMP_0068 0 255 DISPLAY_IDENTIFIER Cxx_dfinc_ac_prs_oc /begin FUNCTION_LIST R902.1.SafetyDiagManager_1_3_6 /end FUNCTION_LIST /end CHARACTERISTIC
/begin CHARACTERISTIC mICPRSSC "Failure counter increase amount of Air conditioning pressure sensor short circuit" VALUE 0x000086E4 REC_UBYTE_C 0 COMP_0068 0 255 DISPLAY_IDENTIFIER Cxx_dfinc_ac_prs_sc /begin FUNCTION_LIST R902.1.SafetyDiagManager_1_3_6 /end FUNCTION_LIST /end CHARACTERISTIC
/begin CHARACTERISTIC mICUPCRCV "Failure counter increase amount of USM fast frame reception" VALUE 0x000086E5 REC_UBYTE_C 0 COMP_0068 0 255 DISPLAY_IDENTIFIER Cxx_dfinc_usm_rcpt /begin FUNCTION_LIST R902.1.SafetyDiagManager_1_3_6 /end FUNCTION_LIST /end CHARACTERISTIC
/begin CHARACTERISTIC mICVSCMP "Failure counter increase amount of NO. coherence between displayed speed and real speed" VALUE 0x000086E6 REC_UBYTE_C 0 COMP_0068 0 255 DISPLAY_IDENTIFIER Cxx_dfinc_cru_vs_cmp /begin FUNCTION_LIST R902.1.SafetyDiagManager_1_3_6 /end FUNCTION_LIST /end CHARACTERISTIC
/begin CHARACTERISTIC mIDLDLY "IDLESW delay" VALUE 0x000086EC REC_UBYTE_C 0 COMP_0013 0 255 /begin FUNCTION_LIST /end FUNCTION_LIST /end CHARACTERISTIC
/begin CHARACTERISTIC mIGAD "Meter electric potential conversion coefficient" VALUE 0x000092DE REC_UWORD_C 0 COMP_0050 0 5119.921875 /begin FUNCTION_LIST /end FUNCTION_LIST /end CHARACTERISTIC
/begin CHARACTERISTIC mINCDOCF "Target speed wave slew rate (increment)" VALUE 0x000092E4 REC_UWORD_C 0 COMP_0424_S 0 65535 /begin FUNCTION_LIST Rxxx.1.Diagnostic_cycle_1_0_1 /end FUNCTION_LIST /end CHARACTERISTIC
/begin CHARACTERISTIC mINGALP "Purge gain learning value initialization" VALUE 0x0000872F REC_UBYTE_C 0 COMP_0015 0 31.875 /begin FUNCTION_LIST /end FUNCTION_LIST /end CHARACTERISTIC
/begin CHARACTERISTIC mINGALPN "Purge gain learning value initial value" VALUE 0x00008730 REC_UBYTE_C 0 COMP_0425_S -1 30.875 /begin FUNCTION_LIST /end FUNCTION_LIST /end CHARACTERISTIC
/begin CHARACTERISTIC mITAADJH "Ignition adjustment value upper limit filling up efficiency" VALUE 0x00008775 REC_UBYTE_C 0 COMP_0009 0 199.21875 /begin FUNCTION_LIST R301.23.ADV_calculation_1_1_2 /end FUNCTION_LIST /end CHARACTERISTIC
/begin CHARACTERISTIC mITAADJL "Ignition adjustment value lower limit filling up efficiency" VALUE 0x00008776 REC_UBYTE_C 0 COMP_0009 0 199.21875 /begin FUNCTION_LIST R301.23.ADV_calculation_1_1_2 /end FUNCTION_LIST /end CHARACTERISTIC
/begin CHARACTERISTIC mKAIVFT "VO2 compensation release delay" VALUE 0x0000877E REC_UBYTE_C 0 COMP_0008 0 25500 /begin FUNCTION_LIST /end FUNCTION_LIST /end CHARACTERISTIC
/begin CHARACTERISTIC mKAJYUU "MALPHA value weighted average coefficient" VALUE 0x00008780 REC_UBYTE_C 0 COMP_0004 0 255 /begin FUNCTION_LIST /end FUNCTION_LIST /end CHARACTERISTIC
/begin CHARACTERISTIC mKAVEVP "Pull-down F/B" VALUE 0x00008782 REC_UBYTE_C 0 COMP_0207 0 1.9921875 /begin FUNCTION_LIST /end FUNCTION_LIST /end CHARACTERISTIC
/begin CHARACTERISTIC mKQCKP "(CK) The amount of load change compensation assistant air" VALUE 0x000087DB REC_UBYTE_C 0 COMP_0220 0 255 /begin FUNCTION_LIST /end FUNCTION_LIST /end CHARACTERISTIC
/begin CHARACTERISTIC mKVMON1 "At the time of the 0.04inch diagnosis, vapor monitor value compensation coefficient" VALUE 0x000087F3 REC_UBYTE_C 0 COMP_0186 0 3.984375 /begin FUNCTION_LIST /end FUNCTION_LIST /end CHARACTERISTIC
/begin CHARACTERISTIC mKVMON2 "At the time of the 0.02inch diagnosis, vapor monitor value compensation coefficient" VALUE 0x000087F4 REC_UBYTE_C 0 COMP_0186 0 3.984375 /begin FUNCTION_LIST /end FUNCTION_LIST /end CHARACTERISTIC
/begin CHARACTERISTIC mKYUYU2 "In the key off, lubrication judgement criteria (for the 1st leak-down)" VALUE 0x0000935C REC_UWORD_C 0 COMP_0050 0 5119.921875 /begin FUNCTION_LIST /end FUNCTION_LIST /end CHARACTERISTIC
/begin CHARACTERISTIC mLANGE "Pulse periodic measuring switch setup value (head)" VALUE 0x00009768 REC_ULONG_C 0 COMP_0139_S 0 107374182.375 /begin FUNCTION_LIST /end FUNCTION_LIST /end CHARACTERISTIC
/begin CHARACTERISTIC mLDDVP1 "Leak-down start permission line pressure lower limit" VALUE 0x0000935E REC_UWORD_C 0 COMP_0050 0 5119.921875 /begin FUNCTION_LIST /end FUNCTION_LIST /end CHARACTERISTIC
/begin CHARACTERISTIC mLDDVP2 "Leak-down start permission line pressure upper limit" VALUE 0x00009360 REC_UWORD_C 0 COMP_0050 0 5119.921875 /begin FUNCTION_LIST /end FUNCTION_LIST /end CHARACTERISTIC
/begin CHARACTERISTIC mLDPSET "Pull-down F/B control switchover pull-down pressure" VALUE 0x00009362 REC_UWORD_C 0 COMP_0050 0 5119.921875 /begin FUNCTION_LIST /end FUNCTION_LIST /end CHARACTERISTIC
/begin CHARACTERISTIC mLDPSET2 "Pull-down F/B control switchover pull-down pressure (a high vehicle speed side)" VALUE 0x00009364 REC_UWORD_C 0 COMP_0050 0 5119.921875 /begin FUNCTION_LIST /end FUNCTION_LIST /end CHARACTERISTIC
/begin CHARACTERISTIC mLDPST2 "Pull-down F/B cancellation pressure" VALUE 0x000087FD REC_UBYTE_C 0 COMP_0054 0 5100 /begin FUNCTION_LIST /end FUNCTION_LIST /end CHARACTERISTIC
/begin CHARACTERISTIC mLDPST3 "Target pull-down pressure" VALUE 0x00009366 REC_UWORD_C 0 COMP_0050 0 5119.921875 /begin FUNCTION_LIST /end FUNCTION_LIST /end CHARACTERISTIC
/begin CHARACTERISTIC mLDPST32 "Pull-down F/B control switchover pull-down pressure (a low vehicle speed side)" VALUE 0x00009368 REC_UWORD_C 0 COMP_0050 0 5119.921875 /begin FUNCTION_LIST /end FUNCTION_LIST /end CHARACTERISTIC
/begin CHARACTERISTIC mLDSVS "Leak-down start vehicle speed" VALUE 0x000087FE REC_UBYTE_C 0 COMP_0007 0 510 /begin FUNCTION_LIST /end FUNCTION_LIST /end CHARACTERISTIC
/begin CHARACTERISTIC mLDSVS2 "Leak-down control cancellation vehicle speed" VALUE 0x000087FF REC_UBYTE_C 0 COMP_0007 0 510 /begin FUNCTION_LIST /end FUNCTION_LIST /end CHARACTERISTIC
/begin CHARACTERISTIC mLDVSPH "Leak-down switchover vehicle speed upper limit" VALUE 0x00008802 REC_UBYTE_C 0 COMP_0229 -256 254 /begin FUNCTION_LIST /end FUNCTION_LIST /end CHARACTERISTIC
/begin CHARACTERISTIC mLEK1F2 "1 leak hole equivalent opening area 2" VALUE 0x00008805 REC_UBYTE_C 0 COMP_0232 0 1.9921875 /begin FUNCTION_LIST /end FUNCTION_LIST /end CHARACTERISTIC
/begin CHARACTERISTIC mLEK1F3 "0.02inch leak equivalent opening area" VALUE 0x00008807 REC_UBYTE_C 0 COMP_0232 0 1.9921875 /begin FUNCTION_LIST /end FUNCTION_LIST /end CHARACTERISTIC
/begin CHARACTERISTIC mLEK2F2 "0.04inch leak OK judgement criteria" VALUE 0x00008808 REC_UBYTE_C 0 COMP_0232 0 1.9921875 /begin FUNCTION_LIST /end FUNCTION_LIST /end CHARACTERISTIC
/begin CHARACTERISTIC mLEK3F3 "0.02inch leak OK judgement criteria" VALUE 0x00008809 REC_UBYTE_C 0 COMP_0232 0 1.9921875 /begin FUNCTION_LIST /end FUNCTION_LIST /end CHARACTERISTIC
/begin CHARACTERISTIC mLEKF3 "0.02inch leak judgement" VALUE 0x0000880A REC_UBYTE_C 0 COMP_0232 0 1.9921875 /begin FUNCTION_LIST /end FUNCTION_LIST /end CHARACTERISTIC
/begin CHARACTERISTIC mLEKF3H "0.025inch leak judgement" VALUE 0x0000880B REC_UBYTE_C 0 COMP_0232 0 1.9921875 /begin FUNCTION_LIST /end FUNCTION_LIST /end CHARACTERISTIC
/begin CHARACTERISTIC mLEKK "Leak diagnosis compensation coefficient" VALUE 0x0000880C REC_UBYTE_C 0 COMP_0233 0 0.2805 /begin FUNCTION_LIST /end FUNCTION_LIST /end CHARACTERISTIC
/begin CHARACTERISTIC mLEKMX2 "For the 0.02inch leak diagnosis" VALUE 0x00009374 REC_UWORD_C 0 COMP_0008 0 6553500 /begin FUNCTION_LIST /end FUNCTION_LIST /end CHARACTERISTIC
/begin CHARACTERISTIC mLEKMX3 "DVP5 measuring permission leak-down time lower limit" VALUE 0x00009376 REC_UWORD_C 0 COMP_0008 0 6553500 /begin FUNCTION_LIST /end FUNCTION_LIST /end CHARACTERISTIC
/begin CHARACTERISTIC mLEKMX4 "0.04inch leak diagnosis DVP5 measuring permission leak-down time lower limit" VALUE 0x00009378 REC_UWORD_C 0 COMP_0008 0 6553500 /begin FUNCTION_LIST /end FUNCTION_LIST /end CHARACTERISTIC
/begin CHARACTERISTIC mLNDLY "After VS activation is judged, timer (for LMD)" VALUE 0x00008821 REC_UBYTE_C 0 COMP_0008 0 25500 /begin FUNCTION_LIST /end FUNCTION_LIST /end CHARACTERISTIC
/begin CHARACTERISTIC mLSDPRS "SDPRES upper limit limiter" VALUE 0x00008831 REC_UBYTE_C 0 COMP_0054 0 5100 /begin FUNCTION_LIST /end FUNCTION_LIST /end CHARACTERISTIC
/begin CHARACTERISTIC mMFLOAD "A TINT compensation coefficient learning weighted average coefficient by the cylinder" VALUE 0x00008847 REC_UBYTE_C 0 COMP_0004 0 255 /begin FUNCTION_LIST /end FUNCTION_LIST /end CHARACTERISTIC
/begin CHARACTERISTIC mMTFAP1 "MTFDFK map APOST lattice point" VALUE 0x000093B6 REC_UWORD_C 0 COMP_0005 0 7208.85 /begin FUNCTION_LIST /end FUNCTION_LIST /end CHARACTERISTIC
/begin CHARACTERISTIC mMTFAP2 "MTFDFK map APOST lattice point" VALUE 0x000093B8 REC_UWORD_C 0 COMP_0005 0 7208.85 /begin FUNCTION_LIST /end FUNCTION_LIST /end CHARACTERISTIC
/begin CHARACTERISTIC mMTFVS1 "MTFDFK map VEL lattice point" VALUE 0x000093BA REC_UWORD_C 0 COMP_0436 0 6553.5 /begin FUNCTION_LIST /end FUNCTION_LIST /end CHARACTERISTIC
/begin CHARACTERISTIC mMTFVS2 "MTFDFK map VEL lattice point" VALUE 0x000093BC REC_UWORD_C 0 COMP_0436 0 6553.5 /begin FUNCTION_LIST /end FUNCTION_LIST /end CHARACTERISTIC
/begin CHARACTERISTIC mNCIDL "Diagnosis cancellation purge cut number of times" VALUE 0x0000888B REC_UBYTE_C 0 COMP_0030 0 255 /begin FUNCTION_LIST /end FUNCTION_LIST /end CHARACTERISTIC
/begin CHARACTERISTIC mNEADC "Final target speed diagnostic cycle" VALUE 0x000093C2 REC_UWORD_C 0 COMP_0337_S 0 65535 /begin FUNCTION_LIST Rxxx.1.Diagnostic_cycle_1_0_1 /end FUNCTION_LIST /end CHARACTERISTIC
/begin CHARACTERISTIC mNEADCH "Engine speed upper limit for CAT-diag permission" VALUE 0x000093C4 REC_UWORD_C 0 COMP_0337_S 0 65535 /begin FUNCTION_LIST Rxxx.2.Integration_Diagnostic_cycle_1_1_1 /end FUNCTION_LIST /end CHARACTERISTIC
/begin CHARACTERISTIC mNLGAIN2 "Non-line shape gain É≈ (bank 2)" VALUE 0x000088BF REC_UBYTE_C 0 COMP_0373 0 2.55 /begin FUNCTION_LIST /end FUNCTION_LIST /end CHARACTERISTIC
/begin CHARACTERISTIC mNOI1 "Value used to calculate the first noise byte of the ECM_VERLOG frame" VALUE 0x000088CB REC_UBYTE_C 0 COMP_0068 0 255 /begin FUNCTION_LIST /end FUNCTION_LIST /end CHARACTERISTIC
/begin CHARACTERISTIC mNOI2 "Value used to calculate the second noise byte of the ECM_VERLOG frame" VALUE 0x000088CC REC_UBYTE_C 0 COMP_0068 0 255 /begin FUNCTION_LIST /end FUNCTION_LIST /end CHARACTERISTIC
/begin CHARACTERISTIC mNOI3 "Value used to calculate the third noise byte of the ECM_VERLOG frame" VALUE 0x000088CD REC_UBYTE_C 0 COMP_0068 0 255 /begin FUNCTION_LIST /end FUNCTION_LIST /end CHARACTERISTIC
/begin CHARACTERISTIC mNOI4 "Value used to calculate the forth noise byte of the ECM_VERLOG frame" VALUE 0x000088CE REC_UBYTE_C 0 COMP_0068 0 255 /begin FUNCTION_LIST /end FUNCTION_LIST /end CHARACTERISTIC
/begin CHARACTERISTIC mNOI5 "Value used to calculate the fifth noise byte of the ECM_VERLOG frame" VALUE 0x000088CF REC_UBYTE_C 0 COMP_0068 0 255 /begin FUNCTION_LIST /end FUNCTION_LIST /end CHARACTERISTIC
/begin CHARACTERISTIC mNOI6 "Value used to calculate the sixth noise byte of the ECM_VERLOG frame" VALUE 0x000088D0 REC_UBYTE_C 0 COMP_0068 0 255 /begin FUNCTION_LIST /end FUNCTION_LIST /end CHARACTERISTIC
/begin CHARACTERISTIC mNQCKHOJ "(CK) Load change compensation prohibition lower limit rotation" VALUE 0x000088DD REC_UBYTE_C 0 COMP_0000 0 6375 /begin FUNCTION_LIST /end FUNCTION_LIST /end CHARACTERISTIC
/begin CHARACTERISTIC mNTDGTAG "Neutral switch diagnosis delay (AGB)" VALUE 0x000088FD REC_UBYTE_C 0 COMP_0008 0 25500 /begin FUNCTION_LIST /end FUNCTION_LIST /end CHARACTERISTIC
/begin CHARACTERISTIC mNTDGTMG "Neutral switch diagnosis delay (MGB)" VALUE 0x000088FE REC_UBYTE_C 0 COMP_0008 0 25500 /begin FUNCTION_LIST /end FUNCTION_LIST /end CHARACTERISTIC
/begin CHARACTERISTIC mNWTOFI "For engine stall room" VALUE 0x00008902 REC_UBYTE_C 0 COMP_0051 0 255 /begin FUNCTION_LIST /end FUNCTION_LIST /end CHARACTERISTIC
/begin CHARACTERISTIC mO2HCMN "O2 heater diagnosis breakage judgement voltage" VALUE 0x00008908 REC_UBYTE_C 0 COMP_0054 0 5100 /begin FUNCTION_LIST /end FUNCTION_LIST /end CHARACTERISTIC
/begin CHARACTERISTIC mO2HCMNA "A judgement MIN for the O2H self-diagnosis" VALUE 0x00008909 REC_UBYTE_C 0 COMP_0022 0 5100 /begin FUNCTION_LIST /end FUNCTION_LIST /end CHARACTERISTIC
/begin CHARACTERISTIC mO2HCMX "O2 heater diagnosis short judgement voltage" VALUE 0x0000890A REC_UBYTE_C 0 COMP_0054 0 5100 /begin FUNCTION_LIST /end FUNCTION_LIST /end CHARACTERISTIC
/begin CHARACTERISTIC mO2HCMXA "A judgement MAX for the O2H self-diagnosis" VALUE 0x0000890B REC_UBYTE_C 0 COMP_0022 0 5100 /begin FUNCTION_LIST /end FUNCTION_LIST /end CHARACTERISTIC
/begin CHARACTERISTIC mO2JDNG "O2 sensor breakage diagnosis NG judgement delay time" VALUE 0x0000891E REC_UBYTE_C 0 COMP_0049 0 255 /begin FUNCTION_LIST R904.1.Gst_on_can_1_0_1 /end FUNCTION_LIST /end CHARACTERISTIC
/begin CHARACTERISTIC mO2NGTMA "A timer for the O2H self-diagnosis" VALUE 0x00008921 REC_UBYTE_C 0 COMP_0014 0 2550 /begin FUNCTION_LIST /end FUNCTION_LIST /end CHARACTERISTIC
/begin CHARACTERISTIC mOBDFCTM "The number of middle water temperature retard addition decision rotation" VALUE 0x0000892A REC_UBYTE_C 0 COMP_0049 0 255 /begin FUNCTION_LIST R901.1.Diag_on_can_app_1_6_2 /end FUNCTION_LIST /end CHARACTERISTIC
/begin CHARACTERISTIC mOFST2 "At the time of the first time leak-down, an offset for the slosh compensation final value computation" VALUE 0x000093F2 REC_UWORD_C 0 COMP_0050 0 5119.921875 /begin FUNCTION_LIST /end FUNCTION_LIST /end CHARACTERISTIC
/begin CHARACTERISTIC mOFSTX "At the time of the second time leak-down, an offset for the slosh compensation final value computation" VALUE 0x000093F4 REC_UWORD_C 0 COMP_0050 0 5119.921875 /begin FUNCTION_LIST /end FUNCTION_LIST /end CHARACTERISTIC
/begin CHARACTERISTIC mOWCOFDL "#FOWOFDL clear delay" VALUE 0x0000896F REC_UBYTE_C 0 COMP_0014 0 2550 /begin FUNCTION_LIST R301.23.ADV_calculation_1_1_2 /end FUNCTION_LIST /end CHARACTERISTIC
/begin CHARACTERISTIC mPAMCAL "Atomospheric pressure compensation coefficient" VALUE 0x00008978 REC_UBYTE_C 0 COMP_0009 0 199.21875 /begin FUNCTION_LIST /end FUNCTION_LIST /end CHARACTERISTIC
/begin CHARACTERISTIC mPAMCAN "Atomospheric pressure change cancellation value" VALUE 0x0000940E REC_UWORD_C 0 COMP_0050 0 5119.921875 /begin FUNCTION_LIST /end FUNCTION_LIST /end CHARACTERISTIC
/begin CHARACTERISTIC mPAMCL2 "Atomospheric pressure compensation coefficient 2" VALUE 0x00008979 REC_UBYTE_C 0 COMP_0009 0 199.21875 /begin FUNCTION_LIST /end FUNCTION_LIST /end CHARACTERISTIC
/begin CHARACTERISTIC mPCVST1 "Purge control valve target open-degree 1 for the evapo leak diagnosis" VALUE 0x00008984 REC_UBYTE_C 0 COMP_0047 0 127.5 /begin FUNCTION_LIST /end FUNCTION_LIST /end CHARACTERISTIC
/begin CHARACTERISTIC mPCVST2 "Purge control valve target open-degree 2 for the evapo leak diagnosis" VALUE 0x00008985 REC_UBYTE_C 0 COMP_0047 0 127.5 /begin FUNCTION_LIST /end FUNCTION_LIST /end CHARACTERISTIC
/begin CHARACTERISTIC mPCVST3 "Purge control valve target open-degree 3 for the evapo leak diagnosis" VALUE 0x00008986 REC_UBYTE_C 0 COMP_0047 0 127.5 /begin FUNCTION_LIST /end FUNCTION_LIST /end CHARACTERISTIC
/begin CHARACTERISTIC mPCVST4 "Purge control valve target open-degree 4 for the evapo leak diagnosis" VALUE 0x00008987 REC_UBYTE_C 0 COMP_0047 0 127.5 /begin FUNCTION_LIST /end FUNCTION_LIST /end CHARACTERISTIC
/begin CHARACTERISTIC mPCVST5 "Purge control valve target open-degree 5 for the evapo leak diagnosis" VALUE 0x00008988 REC_UBYTE_C 0 COMP_0047 0 127.5 /begin FUNCTION_LIST /end FUNCTION_LIST /end CHARACTERISTIC
/begin CHARACTERISTIC mPCVST6 "At the time of the pull-down F/B, valve open-degree MAX" VALUE 0x00008989 REC_UBYTE_C 0 COMP_0047 0 127.5 /begin FUNCTION_LIST /end FUNCTION_LIST /end CHARACTERISTIC
/begin CHARACTERISTIC mPDFBM2 "Leak-down switchover permission pull-down continuance F/B time" VALUE 0x0000898E REC_UBYTE_C 0 COMP_0013 0 255 /begin FUNCTION_LIST /end FUNCTION_LIST /end CHARACTERISTIC
/begin CHARACTERISTIC mPDFBM3 "0.04inch leak-down switchover permission pull-down F/B time" VALUE 0x0000898F REC_UBYTE_C 0 COMP_0013 0 255 /begin FUNCTION_LIST /end FUNCTION_LIST /end CHARACTERISTIC
/begin CHARACTERISTIC mPDFBMN "Leak-down switchover permission pull-down F/B time" VALUE 0x00008990 REC_UBYTE_C 0 COMP_0013 0 255 /begin FUNCTION_LIST /end FUNCTION_LIST /end CHARACTERISTIC
/begin CHARACTERISTIC mPDOPU "At the time of the pull-down, valve open-degree rise rate" VALUE 0x00008998 REC_UBYTE_C 0 COMP_0437_S 0 0.49804815 /begin FUNCTION_LIST /end FUNCTION_LIST /end CHARACTERISTIC
/begin CHARACTERISTIC mPDSPD1 "Pull-down control time for 0.04inch" VALUE 0x0000941A REC_UWORD_C 0 COMP_0008 0 6553500 /begin FUNCTION_LIST /end FUNCTION_LIST /end CHARACTERISTIC
/begin CHARACTERISTIC mPDSPD2 "Pull-down control time for 0.02inch" VALUE 0x0000941C REC_UWORD_C 0 COMP_0008 0 6553500 /begin FUNCTION_LIST /end FUNCTION_LIST /end CHARACTERISTIC
/begin CHARACTERISTIC mPDWMX "At the time of the pull-down, maximum valve open-degree" VALUE 0x000089A1 REC_UBYTE_C 0 COMP_0047 0 127.5 /begin FUNCTION_LIST /end FUNCTION_LIST /end CHARACTERISTIC
/begin CHARACTERISTIC mPEVCCL "CVBV, OPEN timing" VALUE 0x000089A2 REC_UBYTE_C 0 COMP_0008 0 25500 /begin FUNCTION_LIST /end FUNCTION_LIST /end CHARACTERISTIC
/begin CHARACTERISTIC mPEVSTD "Pre-pressure check start delay" VALUE 0x000089A3 REC_UBYTE_C 0 COMP_0008 0 25500 /begin FUNCTION_LIST /end FUNCTION_LIST /end CHARACTERISTIC
/begin CHARACTERISTIC mPFRLF "Filler relief cancellation pressure" VALUE 0x00009426 REC_UWORD_C 0 COMP_0050 0 5119.921875 /begin FUNCTION_LIST /end FUNCTION_LIST /end CHARACTERISTIC
/begin CHARACTERISTIC mPMDOFFDL "POWER mode off judgement delay" VALUE 0x000089AD REC_UBYTE_C 0 COMP_0008 0 25500 /begin FUNCTION_LIST /end FUNCTION_LIST /end CHARACTERISTIC
/begin CHARACTERISTIC mPRATE "A basic purge quantity unit conversion coefficient" VALUE 0x000089B7 REC_UBYTE_C 0 COMP_0272 0 0.03112785 /begin FUNCTION_LIST /end FUNCTION_LIST /end CHARACTERISTIC
/begin CHARACTERISTIC mPSEVCN "Accumulation purge lower limit value" VALUE 0x000089CF REC_UBYTE_C 0 COMP_0152 0 510 /begin FUNCTION_LIST /end FUNCTION_LIST /end CHARACTERISTIC
/begin CHARACTERISTIC mPSEVPH "Diagnosis permission condition basic duty value" VALUE 0x000089D0 REC_UBYTE_C 0 COMP_0047 0 127.5 /begin FUNCTION_LIST /end FUNCTION_LIST /end CHARACTERISTIC
/begin CHARACTERISTIC mPSEVPL "Diagnosis permission condition basic duty value" VALUE 0x000089D1 REC_UBYTE_C 0 COMP_0047 0 127.5 /begin FUNCTION_LIST /end FUNCTION_LIST /end CHARACTERISTIC
/begin CHARACTERISTIC mPSITM "PWST SW After ONOFF, delay" VALUE 0x000089D4 REC_UBYTE_C 0 COMP_0008 0 25500 /begin FUNCTION_LIST /end FUNCTION_LIST /end CHARACTERISTIC
/begin CHARACTERISTIC mPSL2SL "The first time leak-down pressure ceremony slosh judgement slice level" VALUE 0x00009444 REC_UWORD_C 0 COMP_0050 0 5119.921875 /begin FUNCTION_LIST /end FUNCTION_LIST /end CHARACTERISTIC
/begin CHARACTERISTIC mPSLXSL "The second time leak-down pressure ceremony slosh judgement slice level" VALUE 0x00009446 REC_UWORD_C 0 COMP_0050 0 5119.921875 /begin FUNCTION_LIST /end FUNCTION_LIST /end CHARACTERISTIC
/begin CHARACTERISTIC mPSNMH1 "Engine speed upper limit value" VALUE 0x000089D6 REC_UBYTE_C 0 COMP_0000 0 6375 /begin FUNCTION_LIST /end FUNCTION_LIST /end CHARACTERISTIC
/begin CHARACTERISTIC mPSNMH2 "Engine speed upper limit value" VALUE 0x000089D7 REC_UBYTE_C 0 COMP_0000 0 6375 /begin FUNCTION_LIST /end FUNCTION_LIST /end CHARACTERISTIC
/begin CHARACTERISTIC mPSNML1 "Engine speed lower limit value" VALUE 0x000089D9 REC_UBYTE_C 0 COMP_0000 0 6375 /begin FUNCTION_LIST /end FUNCTION_LIST /end CHARACTERISTIC
/begin CHARACTERISTIC mPSNML2 "Engine speed lower limit value" VALUE 0x000089DA REC_UBYTE_C 0 COMP_0000 0 6375 /begin FUNCTION_LIST /end FUNCTION_LIST /end CHARACTERISTIC
/begin CHARACTERISTIC mPSNSPC "Atomospheric pressure sensor characteristic coefficient" VALUE 0x000089DB REC_UBYTE_C 0 COMP_0435 0 7.96875 /begin FUNCTION_LIST /end FUNCTION_LIST /end CHARACTERISTIC
/begin CHARACTERISTIC mPSTPH1 "TP condition upper limit" VALUE 0x000089DD REC_UBYTE_C 0 COMP_0001 0 31.875 /begin FUNCTION_LIST /end FUNCTION_LIST /end CHARACTERISTIC
/begin CHARACTERISTIC mPSTPH2 "TP condition upper limit" VALUE 0x000089DE REC_UBYTE_C 0 COMP_0001 0 31.875 /begin FUNCTION_LIST /end FUNCTION_LIST /end CHARACTERISTIC
/begin CHARACTERISTIC mPSTPL1 "TP condition lower limit" VALUE 0x000089DF REC_UBYTE_C 0 COMP_0001 0 31.875 /begin FUNCTION_LIST /end FUNCTION_LIST /end CHARACTERISTIC
/begin CHARACTERISTIC mPSTPL2 "TP condition lower limit" VALUE 0x000089E0 REC_UBYTE_C 0 COMP_0001 0 31.875 /begin FUNCTION_LIST /end FUNCTION_LIST /end CHARACTERISTIC
/begin CHARACTERISTIC mPSVSH1 "Vehicle speed condition upper limit value" VALUE 0x000089E1 REC_UBYTE_C 0 COMP_0007 0 510 /begin FUNCTION_LIST /end FUNCTION_LIST /end CHARACTERISTIC
/begin CHARACTERISTIC mPSVSH2 "Vehicle speed condition upper limit value" VALUE 0x000089E2 REC_UBYTE_C 0 COMP_0007 0 510 /begin FUNCTION_LIST /end FUNCTION_LIST /end CHARACTERISTIC
/begin CHARACTERISTIC mPSVSL1 "Vehicle speed condition lower limit value" VALUE 0x000089E3 REC_UBYTE_C 0 COMP_0007 0 510 /begin FUNCTION_LIST /end FUNCTION_LIST /end CHARACTERISTIC
/begin CHARACTERISTIC mPSVSL2 "Vehicle speed condition lower limit value" VALUE 0x000089E4 REC_UBYTE_C 0 COMP_0007 0 510 /begin FUNCTION_LIST /end FUNCTION_LIST /end CHARACTERISTIC
/begin CHARACTERISTIC mPSYDG1 "Diagnosis permission condition judgement time" VALUE 0x000089E9 REC_UBYTE_C 0 COMP_0008 0 25500 /begin FUNCTION_LIST /end FUNCTION_LIST /end CHARACTERISTIC
/begin CHARACTERISTIC mPSYDG2 "EPRS11 monitor condition judgement time" VALUE 0x000089EA REC_UBYTE_C 0 COMP_0008 0 25500 /begin FUNCTION_LIST /end FUNCTION_LIST /end CHARACTERISTIC
/begin CHARACTERISTIC mPSYDG3 "EPRS12 monitor condition judgement time" VALUE 0x000089EB REC_UBYTE_C 0 COMP_0008 0 25500 /begin FUNCTION_LIST /end FUNCTION_LIST /end CHARACTERISTIC
/begin CHARACTERISTIC mPSYDG4 "Stage 2 diagnosis permission condition time" VALUE 0x000089EC REC_UBYTE_C 0 COMP_0008 0 25500 /begin FUNCTION_LIST /end FUNCTION_LIST /end CHARACTERISTIC
/begin CHARACTERISTIC mPSYEV1R "Purge system judgement pressure 1" VALUE 0x00009448 REC_UWORD_C 0 COMP_0050 0 5119.921875 /begin FUNCTION_LIST /end FUNCTION_LIST /end CHARACTERISTIC
/begin CHARACTERISTIC mPSYEV2 "Purge system judgement pressure 2" VALUE 0x000089EE REC_UBYTE_C 0 COMP_0054 0 5100 /begin FUNCTION_LIST /end FUNCTION_LIST /end CHARACTERISTIC
/begin CHARACTERISTIC mPSYSNG "The value which a purge system unusually judges" VALUE 0x000089EF REC_UBYTE_C 0 COMP_0016 0 255 /begin FUNCTION_LIST /end FUNCTION_LIST /end CHARACTERISTIC
/begin CHARACTERISTIC mPTYCHK "ROM region parity value" VALUE 0x00009770 REC_ULONG_C 0 COMP_0068 0 4294967295 /begin FUNCTION_LIST /end FUNCTION_LIST /end CHARACTERISTIC
/begin CHARACTERISTIC mQCKND "At the time of the ND select, (CK) load change compensation air flow-quantity" VALUE 0x000089FF REC_UBYTE_C 0 COMP_0220 0 255 /begin FUNCTION_LIST /end FUNCTION_LIST /end CHARACTERISTIC
/begin CHARACTERISTIC mQFUNCOV "Specific gravity of fuel" VALUE 0x00008A02 REC_UBYTE_C 0 COMP_0373 0 2.55 /begin FUNCTION_LIST R901.1.Diag_on_can_app_1_6_2 /end FUNCTION_LIST /end CHARACTERISTIC
/begin CHARACTERISTIC mREFMESAG "messaging version number ID" VALUE 0x00009492 REC_UWORD_C 0 COMP_0068 0 65535 /begin FUNCTION_LIST R901.1.Diag_on_can_app_1_6_2 /end FUNCTION_LIST /end CHARACTERISTIC
/begin CHARACTERISTIC mREGOFMAX "Minimum Idle Speed tuning target from Diagnostic tool" VALUE 0x000081AD REC_SBYTE_C 0 COMP_0263 -128 127 DISPLAY_IDENTIFIER regofmax /begin FUNCTION_LIST R901.1.Diag_on_can_app_1_6_2 /end FUNCTION_LIST /end CHARACTERISTIC
/begin CHARACTERISTIC mREGOFMIN "Maximum Idle Speed tuning target from Diagnostic tool" VALUE 0x000081AE REC_SBYTE_C 0 COMP_0263 -128 127 DISPLAY_IDENTIFIER regofmin /begin FUNCTION_LIST R901.1.Diag_on_can_app_1_6_2 /end FUNCTION_LIST /end CHARACTERISTIC
/begin CHARACTERISTIC mRETLMT21 "The retard side maximum change width" VALUE 0x0000949E REC_UWORD_C 0 COMP_0081 0 255.99609375 /begin FUNCTION_LIST R301.23.ADV_calculation_1_1_2 /end FUNCTION_LIST /end CHARACTERISTIC
/begin CHARACTERISTIC mRINLDST "3RDO2 Initialization start delay" VALUE 0x00008A9B REC_UBYTE_C 0 COMP_0014 0 2550 /begin FUNCTION_LIST /end FUNCTION_LIST /end CHARACTERISTIC
/begin CHARACTERISTIC mROMNG_S "ROM diagnosis SW" VALUE 0x0000F6AC REC_UBYTE_C 0 COMP_0068 0 255 /begin FUNCTION_LIST R301.24.RomDiagnosis_1_0_1 /end FUNCTION_LIST /end CHARACTERISTIC
/begin CHARACTERISTIC mSCKGP1 "Gear position compensation coefficient 1" VALUE 0x00008AE9 REC_UBYTE_C 0 COMP_0388 0 25.5 /begin FUNCTION_LIST R301.23.ADV_calculation_1_1_2 /end FUNCTION_LIST /end CHARACTERISTIC
/begin CHARACTERISTIC mSCKGP2 "Gear position compensation coefficient 2" VALUE 0x00008AEA REC_UBYTE_C 0 COMP_0388 0 25.5 /begin FUNCTION_LIST R301.23.ADV_calculation_1_1_2 /end FUNCTION_LIST /end CHARACTERISTIC
/begin CHARACTERISTIC mSCKGP3 "Gear position compensation coefficient 3" VALUE 0x00008AEB REC_UBYTE_C 0 COMP_0388 0 25.5 /begin FUNCTION_LIST R301.23.ADV_calculation_1_1_2 /end FUNCTION_LIST /end CHARACTERISTIC
/begin CHARACTERISTIC mSCKGP4 "Gear position compensation coefficient 4" VALUE 0x00008AEC REC_UBYTE_C 0 COMP_0388 0 25.5 /begin FUNCTION_LIST R301.23.ADV_calculation_1_1_2 /end FUNCTION_LIST /end CHARACTERISTIC
/begin CHARACTERISTIC mSCKGP5 "Gear position compensation coefficient 5" VALUE 0x00008AED REC_UBYTE_C 0 COMP_0388 0 25.5 /begin FUNCTION_LIST R301.23.ADV_calculation_1_1_2 /end FUNCTION_LIST /end CHARACTERISTIC
/begin CHARACTERISTIC mSCKGP6 "Gear position coefficient #6" VALUE 0x00008AEE REC_UBYTE_C 0 COMP_0388 0 25.5 /begin FUNCTION_LIST R301.23.ADV_calculation_1_1_2 /end FUNCTION_LIST /end CHARACTERISTIC
/begin CHARACTERISTIC mSCKGP7 "Gear position coefficient #7" VALUE 0x00008AEF REC_UBYTE_C 0 COMP_0388 0 25.5 /begin FUNCTION_LIST R301.23.ADV_calculation_1_1_2 /end FUNCTION_LIST /end CHARACTERISTIC
/begin CHARACTERISTIC mSCKGP8 "Gear position coefficient #8" VALUE 0x00008AF0 REC_UBYTE_C 0 COMP_0388 0 25.5 /begin FUNCTION_LIST R301.23.ADV_calculation_1_1_2 /end FUNCTION_LIST /end CHARACTERISTIC
/begin CHARACTERISTIC mSCKGP9 "Gear position coefficient #9" VALUE 0x00008AF1 REC_UBYTE_C 0 COMP_0388 0 25.5 /begin FUNCTION_LIST R301.23.ADV_calculation_1_1_2 /end FUNCTION_LIST /end CHARACTERISTIC
/begin CHARACTERISTIC mSCVDTM "SCV Close judgement delay" VALUE 0x00008AFC REC_UBYTE_C 0 COMP_0008 0 25500 /begin FUNCTION_LIST /end FUNCTION_LIST /end CHARACTERISTIC
/begin CHARACTERISTIC mSLNTHP2 "Switching function inclination (bank 2)" VALUE 0x00008B0B REC_UBYTE_C 0 COMP_0373 0 2.55 /begin FUNCTION_LIST /end FUNCTION_LIST /end CHARACTERISTIC
/begin CHARACTERISTIC mSSAD "Dlay to confirm the Setting of fSADOC" VALUE 0x00008B27 REC_UBYTE_C 0 COMP_0013 0 255 /begin FUNCTION_LIST Rxxx.2.Integration_Diagnostic_cycle_1_1_1 /end FUNCTION_LIST /end CHARACTERISTIC
/begin CHARACTERISTIC mSTEVPCY "Purge valve 1cycle duration" VALUE 0x00008B2D REC_UBYTE_C 0 COMP_0014 0 2550 /begin FUNCTION_LIST R901.1.Diag_on_can_app_1_6_2 /end FUNCTION_LIST /end CHARACTERISTIC
/begin CHARACTERISTIC mSTEVPNO "Number of cycle for purge valve" VALUE 0x00008B2E REC_UBYTE_C 0 COMP_0468_S 0 255 /begin FUNCTION_LIST R901.1.Diag_on_can_app_1_6_2 /end FUNCTION_LIST /end CHARACTERISTIC
/begin CHARACTERISTIC mSTEVPON "Purge valve on duration" VALUE 0x00008B2F REC_UBYTE_C 0 COMP_0014 0 2550 /begin FUNCTION_LIST R901.1.Diag_on_can_app_1_6_2 /end FUNCTION_LIST /end CHARACTERISTIC
/begin CHARACTERISTIC mSTFPRNO "Number of cycle for fuel pump" VALUE 0x00008B31 REC_UBYTE_C 0 COMP_0468_S 0 255 /begin FUNCTION_LIST R901.1.Diag_on_can_app_1_6_2 /end FUNCTION_LIST /end CHARACTERISTIC
/begin CHARACTERISTIC mSTFPROF "Fuel pump off duration" VALUE 0x00008B32 REC_UBYTE_C 0 COMP_0014 0 2550 /begin FUNCTION_LIST R901.1.Diag_on_can_app_1_6_2 /end FUNCTION_LIST /end CHARACTERISTIC
/begin CHARACTERISTIC mSTFPRON "Fuel pump on duration" VALUE 0x00008B33 REC_UBYTE_C 0 COMP_0014 0 2550 /begin FUNCTION_LIST R901.1.Diag_on_can_app_1_6_2 /end FUNCTION_LIST /end CHARACTERISTIC
/begin CHARACTERISTIC mSTPPNTQ "STEP/M character : break point" VALUE 0x00008B41 REC_UBYTE_C 0 COMP_0293 0 510 /begin FUNCTION_LIST /end FUNCTION_LIST /end CHARACTERISTIC
/begin CHARACTERISTIC mSTPSLP1 "STEP/M character : inclination" VALUE 0x00008B42 REC_UBYTE_C 0 COMP_0469_S 0 0.49804815 /begin FUNCTION_LIST /end FUNCTION_LIST /end CHARACTERISTIC
/begin CHARACTERISTIC mSTPSLP2 "STEP/M character : inclination" VALUE 0x00008B43 REC_UBYTE_C 0 COMP_0469_S 0 0.49804815 /begin FUNCTION_LIST /end FUNCTION_LIST /end CHARACTERISTIC
/begin CHARACTERISTIC mSTSPCV "Reference space capacity" VALUE 0x0000956A REC_UWORD_C 0 COMP_0312 0 127.998046875 /begin FUNCTION_LIST /end FUNCTION_LIST /end CHARACTERISTIC
/begin CHARACTERISTIC mSUMCHK "ROM region SUM value" VALUE 0x00009778 REC_ULONG_C 0 COMP_0068 0 4294967295 /begin FUNCTION_LIST /end FUNCTION_LIST /end CHARACTERISTIC
/begin CHARACTERISTIC mSYSDL1 "EPRS11 monitor cancellation judgement time" VALUE 0x00008B5C REC_UBYTE_C 0 COMP_0096 0 2550 /begin FUNCTION_LIST /end FUNCTION_LIST /end CHARACTERISTIC
/begin CHARACTERISTIC mSYSDL2 "EPRS12 monitor cancellation judgement time" VALUE 0x00008B5D REC_UBYTE_C 0 COMP_0096 0 2550 /begin FUNCTION_LIST /end FUNCTION_LIST /end CHARACTERISTIC
/begin CHARACTERISTIC mSYSDL3 "EPRS21 monitor condition time" VALUE 0x00008B5E REC_UBYTE_C 0 COMP_0008 0 25500 /begin FUNCTION_LIST /end FUNCTION_LIST /end CHARACTERISTIC
/begin CHARACTERISTIC mSYSDL4 "NG judgement time" VALUE 0x00008B5F REC_UBYTE_C 0 COMP_0008 0 25500 /begin FUNCTION_LIST /end FUNCTION_LIST /end CHARACTERISTIC
/begin CHARACTERISTIC mTEGONG "An open diagnosis EGR judgement reference" VALUE 0x00008BA9 REC_UBYTE_C 0 COMP_0003 0 255 /begin FUNCTION_LIST /end FUNCTION_LIST /end CHARACTERISTIC
/begin CHARACTERISTIC mTEGRA "EGR diagnosis region formation time" VALUE 0x00008BAA REC_UBYTE_C 0 COMP_0008 0 25500 /begin FUNCTION_LIST /end FUNCTION_LIST /end CHARACTERISTIC
/begin CHARACTERISTIC mTEIDLE "Diagnosis prohibition purge cut time" VALUE 0x00008BB1 REC_UBYTE_C 0 COMP_0008 0 25500 /begin FUNCTION_LIST /end FUNCTION_LIST /end CHARACTERISTIC
/begin CHARACTERISTIC mTEVDY4 "Leak-down start delay" VALUE 0x00008BB7 REC_UBYTE_C 0 COMP_0008 0 25500 /begin FUNCTION_LIST /end FUNCTION_LIST /end CHARACTERISTIC
/begin CHARACTERISTIC mTGIGN2 "An integral gain (bank 2)" VALUE 0x00008BD5 REC_UBYTE_C 0 COMP_0361_S 0 0.255 /begin FUNCTION_LIST /end FUNCTION_LIST /end CHARACTERISTIC
/begin CHARACTERISTIC mTGM8ET "Mode 8 evapo test permission executive time-out time" VALUE 0x00008BD8 REC_UBYTE_C 0 COMP_0096 0 2550 /begin FUNCTION_LIST /end FUNCTION_LIST /end CHARACTERISTIC
/begin CHARACTERISTIC mTHO2S "Trouble judgement level (for the GST parameter)" VALUE 0x00008BE5 REC_UBYTE_C 0 COMP_0317 0 4080 /begin FUNCTION_LIST R901.1.Diag_on_can_app_1_6_2 R904.1.Gst_on_can_1_0_1 /end FUNCTION_LIST /end CHARACTERISTIC
/begin CHARACTERISTIC mTHRAPOX "Threshold to detect APOXNG" VALUE 0x00009594 REC_UWORD_C 0 COMP_0451_S 0 81.91875 /begin FUNCTION_LIST R301.21.SafetyLevel2_1_0_2 /end FUNCTION_LIST /end CHARACTERISTIC
/begin CHARACTERISTIC mTHRASTR "Threshold to detect ASTRNG" VALUE 0x00009596 REC_UWORD_C 0 COMP_0451_S 0 81.91875 /begin FUNCTION_LIST R301.21.SafetyLevel2_1_0_2 /end FUNCTION_LIST /end CHARACTERISTIC
/begin CHARACTERISTIC mTHRDTSP "Threshold to detect DTSPNG" VALUE 0x00009598 REC_UWORD_C 0 COMP_0470_S 0 2047.96875 /begin FUNCTION_LIST R301.21.SafetyLevel2_1_0_2 /end FUNCTION_LIST /end CHARACTERISTIC
/begin CHARACTERISTIC mTHRQHAP "Threshold to detect QHAPNG" VALUE 0x0000959A REC_UWORD_C 0 COMP_0410 0 99.9985458 /begin FUNCTION_LIST R301.21.SafetyLevel2_1_0_2 /end FUNCTION_LIST /end CHARACTERISTIC
/begin CHARACTERISTIC mTHRTATE "Threshold to detect TATENG" VALUE 0x0000959C REC_UWORD_C 0 COMP_0372 0 52.428 /begin FUNCTION_LIST R301.21.SafetyLevel2_1_0_2 /end FUNCTION_LIST /end CHARACTERISTIC
/begin CHARACTERISTIC mTHRTGTX "Threshold to detect TGTXNG" VALUE 0x0000959E REC_UWORD_C 0 COMP_0130 0 1802.2125 /begin FUNCTION_LIST R301.21.SafetyLevel2_1_0_2 /end FUNCTION_LIST /end CHARACTERISTIC
/begin CHARACTERISTIC mTHRTTEP "Threshold to detect TTEPNG" VALUE 0x000095A0 REC_UWORD_C 0 COMP_0470_S 0 2047.96875 /begin FUNCTION_LIST R301.21.SafetyLevel2_1_0_2 /end FUNCTION_LIST /end CHARACTERISTIC
/begin CHARACTERISTIC mTHRVAPX "Threshold to detect VAPXNG" VALUE 0x000095A2 REC_UWORD_C 0 COMP_0005 0 7208.85 /begin FUNCTION_LIST R301.21.SafetyLevel2_1_0_2 /end FUNCTION_LIST /end CHARACTERISTIC
/begin CHARACTERISTIC mTMATSCAR "max delay during which both engine running and exchanges with BCM are forbidden" VALUE 0x00008C17 REC_UBYTE_C 0 COMP_0105 0 25.5 /begin FUNCTION_LIST /end FUNCTION_LIST /end CHARACTERISTIC
/begin CHARACTERISTIC mTMATTRPR "max delay for waiting the response to the challenge" VALUE 0x00008C18 REC_UBYTE_C 0 COMP_0366_S 0 5.1 /begin FUNCTION_LIST /end FUNCTION_LIST /end CHARACTERISTIC
/begin CHARACTERISTIC mTMATTSKR "max waiting time for receiving secret key" VALUE 0x00008C1B REC_UBYTE_C 0 COMP_0366_S 0 5.1 /begin FUNCTION_LIST /end FUNCTION_LIST /end CHARACTERISTIC
/begin CHARACTERISTIC mTMCLEARR "max time where clearing the secret key is allowed" VALUE 0x00008C26 REC_UBYTE_C 0 COMP_0366_S 0 5.1 /begin FUNCTION_LIST /end FUNCTION_LIST /end CHARACTERISTIC
/begin CHARACTERISTIC mTMCNX "Delay value to wait connection detection authorization" VALUE 0x00008C2A REC_UBYTE_C 0 COMP_0008 0 25500 /begin FUNCTION_LIST /end FUNCTION_LIST /end CHARACTERISTIC
/begin CHARACTERISTIC mTMEVC3 "Pull-down region cancellation delay" VALUE 0x00008C3C REC_UBYTE_C 0 COMP_0013 0 255 /begin FUNCTION_LIST /end FUNCTION_LIST /end CHARACTERISTIC
/begin CHARACTERISTIC mTMEVC4 "Pull-down region disconnection delay" VALUE 0x00008C3D REC_UBYTE_C 0 COMP_0008 0 25500 /begin FUNCTION_LIST /end FUNCTION_LIST /end CHARACTERISTIC
/begin CHARACTERISTIC mTMEVCD "Diagnosis prohibition delay time" VALUE 0x00008C3E REC_UBYTE_C 0 COMP_0008 0 25500 /begin FUNCTION_LIST /end FUNCTION_LIST /end CHARACTERISTIC
/begin CHARACTERISTIC mTMEVPC "Purge stop condition time" VALUE 0x00008C44 REC_UBYTE_C 0 COMP_0013 0 255 /begin FUNCTION_LIST /end FUNCTION_LIST /end CHARACTERISTIC
/begin CHARACTERISTIC mTMO2H "O2H energizing control timer" VALUE 0x00008C66 REC_UBYTE_C 0 COMP_0008 0 25500 /begin FUNCTION_LIST /end FUNCTION_LIST /end CHARACTERISTIC
/begin CHARACTERISTIC mTMONITAT "AT receptioni supervisory delay value when diag CAN is off" VALUE 0x000095BA REC_UWORD_C 0 COMP_0014 0 655350 /begin FUNCTION_LIST /end FUNCTION_LIST /end CHARACTERISTIC
/begin CHARACTERISTIC mTMSLSH "Leak-down time for the 0.04inch diagnosis slosh judgement" VALUE 0x000095C6 REC_UWORD_C 0 COMP_0008 0 6553500 /begin FUNCTION_LIST /end FUNCTION_LIST /end CHARACTERISTIC
/begin CHARACTERISTIC mTMSLSH02 "Leak-down time for the 0.02inch diagnosis slosh judgement" VALUE 0x00008C8D REC_UBYTE_C 0 COMP_0008 0 25500 /begin FUNCTION_LIST /end FUNCTION_LIST /end CHARACTERISTIC
/begin CHARACTERISTIC mTMSLSH04 "Leak-down time for 0.04-inch judgement slosh judgement" VALUE 0x00008C8E REC_UBYTE_C 0 COMP_0008 0 25500 /begin FUNCTION_LIST /end FUNCTION_LIST /end CHARACTERISTIC
/begin CHARACTERISTIC mTMWLVLR "temps max pwl vl" VALUE 0x00008CB2 REC_UBYTE_C 0 COMP_0105 0 25.5 /begin FUNCTION_LIST /end FUNCTION_LIST /end CHARACTERISTIC
/begin CHARACTERISTIC mTPDIVL "TPUL2 decrement interval" VALUE 0x00008CCC REC_UBYTE_C 0 COMP_0008 0 25500 /begin FUNCTION_LIST /end FUNCTION_LIST /end CHARACTERISTIC
/begin CHARACTERISTIC mTPGCK "Purge check continuation time" VALUE 0x00008CCE REC_UBYTE_C 0 COMP_0013 0 255 /begin FUNCTION_LIST /end FUNCTION_LIST /end CHARACTERISTIC
/begin CHARACTERISTIC mTPGCK3 "Empty purge judgement continuation time" VALUE 0x00008CCF REC_UBYTE_C 0 COMP_0013 0 255 /begin FUNCTION_LIST /end FUNCTION_LIST /end CHARACTERISTIC
/begin CHARACTERISTIC mTPLMX2 "Pull-down time upper limit value" VALUE 0x000095EE REC_UWORD_C 0 COMP_0008 0 6553500 /begin FUNCTION_LIST /end FUNCTION_LIST /end CHARACTERISTIC
/begin CHARACTERISTIC mTPO1COV "Throttle valve relative maximum position - track1" VALUE 0x000095F0 REC_UWORD_C 0 COMP_0005 0 7208.85 /begin FUNCTION_LIST R901.1.Diag_on_can_app_1_6_2 /end FUNCTION_LIST /end CHARACTERISTIC
/begin CHARACTERISTIC mTPO2COV "Throttle valve relative maximum position - track2" VALUE 0x000095F2 REC_UWORD_C 0 COMP_0005 0 7208.85 /begin FUNCTION_LIST R901.1.Diag_on_can_app_1_6_2 /end FUNCTION_LIST /end CHARACTERISTIC
/begin CHARACTERISTIC mTPS1CCOV "Throttle valve offset maximum position - track1" VALUE 0x000095FC REC_UWORD_C 0 COMP_0023 0 327675 /begin FUNCTION_LIST R901.1.Diag_on_can_app_1_6_2 /end FUNCTION_LIST /end CHARACTERISTIC
/begin CHARACTERISTIC mTPS2CCOV "Throttle valve offset maximum position - track2" VALUE 0x000095FE REC_UWORD_C 0 COMP_0023 0 327675 /begin FUNCTION_LIST R901.1.Diag_on_can_app_1_6_2 /end FUNCTION_LIST /end CHARACTERISTIC
/begin CHARACTERISTIC mTPULCM "Imaginary stage 3 region formation time" VALUE 0x00009608 REC_UWORD_C 0 COMP_0295 0 6553500 /begin FUNCTION_LIST /end FUNCTION_LIST /end CHARACTERISTIC
/begin CHARACTERISTIC mTPULMX "Pull-down time maximum value" VALUE 0x0000960C REC_UWORD_C 0 COMP_0008 0 6553500 /begin FUNCTION_LIST /end FUNCTION_LIST /end CHARACTERISTIC
/begin CHARACTERISTIC mTQGP1 "N/V threshold 1" VALUE 0x00009610 REC_UWORD_C 0 COMP_0474_S 0 5000.3205 /begin FUNCTION_LIST R301.23.ADV_calculation_1_1_2 /end FUNCTION_LIST /end CHARACTERISTIC
/begin CHARACTERISTIC mTQGP2 "N/V threshold 2" VALUE 0x00009612 REC_UWORD_C 0 COMP_0474_S 0 5000.3205 /begin FUNCTION_LIST R301.23.ADV_calculation_1_1_2 /end FUNCTION_LIST /end CHARACTERISTIC
/begin CHARACTERISTIC mTQGP3 "N/V threshold 3" VALUE 0x00009614 REC_UWORD_C 0 COMP_0474_S 0 5000.3205 /begin FUNCTION_LIST R301.23.ADV_calculation_1_1_2 /end FUNCTION_LIST /end CHARACTERISTIC
/begin CHARACTERISTIC mTQGP4 "N/V threshold 4" VALUE 0x00009616 REC_UWORD_C 0 COMP_0474_S 0 5000.3205 /begin FUNCTION_LIST R301.23.ADV_calculation_1_1_2 /end FUNCTION_LIST /end CHARACTERISTIC
/begin CHARACTERISTIC mTQGP5 "N/V threshold 5" VALUE 0x00009618 REC_UWORD_C 0 COMP_0474_S 0 5000.3205 /begin FUNCTION_LIST R301.23.ADV_calculation_1_1_2 /end FUNCTION_LIST /end CHARACTERISTIC
/begin CHARACTERISTIC mTQGP6 "N/V threshold 6" VALUE 0x0000961A REC_UWORD_C 0 COMP_0474_S 0 5000.3205 /begin FUNCTION_LIST R301.23.ADV_calculation_1_1_2 /end FUNCTION_LIST /end CHARACTERISTIC
/begin CHARACTERISTIC mTSTMILDY "Delay before readiness status check" VALUE 0x00008CF1 REC_UBYTE_C 0 COMP_0105 0 25.5 DISPLAY_IDENTIFIER Cxx_mux_test_mil_dly /begin FUNCTION_LIST R903.1.milmgtx_1_0_2 /end FUNCTION_LIST /end CHARACTERISTIC
/begin CHARACTERISTIC mTSTRDNDY "MIL flashing delay when readiness are not completed" VALUE 0x00008CF3 REC_UBYTE_C 0 COMP_0105 0 25.5 DISPLAY_IDENTIFIER Cxx_mux_test_rdn_mil_dly /begin FUNCTION_LIST R903.1.milmgtx_1_0_2 /end FUNCTION_LIST /end CHARACTERISTIC
/begin CHARACTERISTIC mTTWINTF "At least, coolant temperature judgement time" VALUE 0x00008CFB REC_UBYTE_C 0 COMP_0013 0 255 /begin FUNCTION_LIST /end FUNCTION_LIST /end CHARACTERISTIC
/begin CHARACTERISTIC mTUSAD "Maximum Allowed Duration for Catalyst static test" VALUE 0x00009634 REC_UWORD_C 0 COMP_0013 0 65535 /begin FUNCTION_LIST R901.1.Diag_on_can_app_1_6_2 /end FUNCTION_LIST /end CHARACTERISTIC
/begin CHARACTERISTIC mTWCPC "Canister purge control region coolant temperature condition" VALUE 0x00008D21 REC_UBYTE_C 0 COMP_0035 -50 205 /begin FUNCTION_LIST /end FUNCTION_LIST /end CHARACTERISTIC
/begin CHARACTERISTIC mTWEVCD "KDUTY UP EVPTR condition" VALUE 0x00008D28 REC_UBYTE_C 0 COMP_0035 -50 205 /begin FUNCTION_LIST /end FUNCTION_LIST /end CHARACTERISTIC
/begin CHARACTERISTIC mTWIMN "An ISC I-gain is saved, control permission coolant temperature lower limit" VALUE 0x00008D33 REC_UBYTE_C 0 COMP_0035 -50 205 /begin FUNCTION_LIST /end FUNCTION_LIST /end CHARACTERISTIC
/begin CHARACTERISTIC mTWIMX "An ISC I-gain is saved, control permission coolant temperature upper limit" VALUE 0x00008D34 REC_UBYTE_C 0 COMP_0035 -50 205 /begin FUNCTION_LIST /end FUNCTION_LIST /end CHARACTERISTIC
/begin CHARACTERISTIC mVAPOUT "The amount of diagnosis prohibition vapor occurrence" VALUE 0x0000964E REC_UWORD_C 0 COMP_0050 0 5119.921875 /begin FUNCTION_LIST /end FUNCTION_LIST /end CHARACTERISTIC
/begin CHARACTERISTIC mVHOSH "VO2 compensation start voltage (Rich side)" VALUE 0x00008DC6 REC_UBYTE_C 0 COMP_0104 0 2550 /begin FUNCTION_LIST /end FUNCTION_LIST /end CHARACTERISTIC
/begin CHARACTERISTIC mVHOSL "VO2 compensation start voltage (Lean side)" VALUE 0x00008DC7 REC_UBYTE_C 0 COMP_0104 0 2550 /begin FUNCTION_LIST /end FUNCTION_LIST /end CHARACTERISTIC
/begin CHARACTERISTIC mVPAMBC "Paper monitor switchover atomospheric pressure change rate" VALUE 0x00008DE3 REC_UBYTE_C 0 COMP_0476_S 0 19.921875 /begin FUNCTION_LIST /end FUNCTION_LIST /end CHARACTERISTIC
/begin CHARACTERISTIC mVSABDLY "Frame absence duration to declare invalid vehicle speed" VALUE 0x00008DF3 REC_UBYTE_C 0 COMP_0477_S 0 10.2 /begin FUNCTION_LIST /end FUNCTION_LIST /end CHARACTERISTIC
/begin CHARACTERISTIC mVSINVDL "Vehicle speed invalid detection duration" VALUE 0x00009660 REC_UWORD_C 0 COMP_0014 0 655350 /begin FUNCTION_LIST R301.23.ADV_calculation_1_1_2 /end FUNCTION_LIST /end CHARACTERISTIC
/begin CHARACTERISTIC mVSNKDLY "Invalid value duration to declare invalid vehicle speed" VALUE 0x00008E00 REC_UBYTE_C 0 COMP_0477_S 0 10.2 /begin FUNCTION_LIST /end FUNCTION_LIST /end CHARACTERISTIC
/begin CHARACTERISTIC mVSPOFST "A/C At the time of on, offset vehicle speed" VALUE 0x000081BB REC_SBYTE_C 0 COMP_0364 -256 254 /begin FUNCTION_LIST /end FUNCTION_LIST /end CHARACTERISTIC
/begin CHARACTERISTIC mZHADAPO "High speed APS limiter starting point" VALUE 0x00009674 REC_UWORD_C 0 COMP_0005 0 7208.85 /begin FUNCTION_LIST /end FUNCTION_LIST /end CHARACTERISTIC
/begin CHARACTERISTIC mZLADAPO "Alley APS limiter starting point" VALUE 0x00009678 REC_UWORD_C 0 COMP_0005 0 7208.85 /begin FUNCTION_LIST /end FUNCTION_LIST /end CHARACTERISTIC
/begin CHARACTERISTIC mZLADVSO "The end of the alley VSP" VALUE 0x0000967C REC_UWORD_C 0 COMP_0436 0 6553.5 /begin FUNCTION_LIST /end FUNCTION_LIST /end CHARACTERISTIC
/begin CHARACTERISTIC mZLVSPLM0 "Alley VSP fulcrum" VALUE 0x0000967E REC_UWORD_C 0 COMP_0195 0 6553.5 /begin FUNCTION_LIST /end FUNCTION_LIST /end CHARACTERISTIC
/begin CHARACTERISTIC mTDSHPTD "QDSPT basic value table (Drive)" CURVE 0x0000CFDA REC_UBYTE_C 0 COMP_0293 0 510
 /begin AXIS_DESCR FIX_AXIS NO_INPUT_QUANTITY COMP_0271_S 16 0 6000 FIX_AXIS_PAR_DIST 0 1 16 /end AXIS_DESCR
 /begin FUNCTION_LIST R301.26.Dashpot_DandN_1_0_2 /end FUNCTION_LIST
/end CHARACTERISTIC
/begin CHARACTERISTIC mTDSHPTN "QDSPT basic value table (Neutral)" CURVE 0x0000CFEA REC_UBYTE_C 0 COMP_0293 0 510
 /begin AXIS_DESCR FIX_AXIS NO_INPUT_QUANTITY COMP_0271_S 16 0 6000 FIX_AXIS_PAR_DIST 0 1 16 /end AXIS_DESCR
 /begin FUNCTION_LIST R301.26.Dashpot_DandN_1_0_2 /end FUNCTION_LIST
/end CHARACTERISTIC
/begin CHARACTERISTIC mTEQMP2 "A low vehicle speed pull-down permission QM lower limit table" CURVE 0x0000E98A REC_UWORD_C 0 COMP_0068 0 65535
 /begin AXIS_DESCR COM_AXIS NO_INPUT_QUANTITY COMP_0152 16 0 131070 AXIS_PTS_REF mTEVQCNT /end AXIS_DESCR
 /begin FUNCTION_LIST /end FUNCTION_LIST
/end CHARACTERISTIC
/begin CHARACTERISTIC mTETFNL "Fuel temperature condition lower limit table" CURVE 0x0000D05E REC_UBYTE_C 0 COMP_0035 -50 205
 /begin AXIS_DESCR FIX_AXIS NO_INPUT_QUANTITY COMP_0280_S 16 -40 110 FIX_AXIS_PAR_DIST 0 1 16 /end AXIS_DESCR
 /begin FUNCTION_LIST /end FUNCTION_LIST
/end CHARACTERISTIC
/begin CHARACTERISTIC mTFGAGE "Space capacity conversion table" CURVE 0x0000EA0A REC_UWORD_C 0 COMP_0496_S 0 127.99837455
 /begin AXIS_DESCR COM_AXIS NO_INPUT_QUANTITY COMP_0050 16 0 5119.921875 AXIS_PTS_REF mLFGAGE /end AXIS_DESCR
 /begin FUNCTION_LIST /end FUNCTION_LIST
/end CHARACTERISTIC
/begin CHARACTERISTIC mTHOSTF "Fuel temperature compensation coefficient table" CURVE 0x0000D212 REC_UBYTE_C 0 COMP_0044 0 1.9921875
 /begin AXIS_DESCR FIX_AXIS NO_INPUT_QUANTITY COMP_0280_S 16 -40 110 FIX_AXIS_PAR_DIST 0 1 16 /end AXIS_DESCR
 /begin FUNCTION_LIST /end FUNCTION_LIST
/end CHARACTERISTIC
/begin CHARACTERISTIC mTHSTF2 "Fuel temperature compensation coefficient table" CURVE 0x0000D242 REC_UBYTE_C 0 COMP_0044 0 1.9921875
 /begin AXIS_DESCR FIX_AXIS NO_INPUT_QUANTITY COMP_0280_S 16 -40 110 FIX_AXIS_PAR_DIST 0 1 16 /end AXIS_DESCR
 /begin FUNCTION_LIST /end FUNCTION_LIST
/end CHARACTERISTIC
/begin CHARACTERISTIC mTHTWLMT "A high coolant temperature limit torque table" CURVE 0x0000EA7A REC_UWORD_C 0 COMP_0226 -3276.8 3276.7
 /begin AXIS_DESCR FIX_AXIS NO_INPUT_QUANTITY COMP_0273_S 16 400 6400 FIX_AXIS_PAR_DIST 0 1 16 /end AXIS_DESCR
 /begin FUNCTION_LIST /end FUNCTION_LIST
/end CHARACTERISTIC
/begin CHARACTERISTIC mTROUTE "RDVPn reference table" CURVE 0x0000F056 REC_UWORD_C 0 COMP_0050 0 5119.921875
 /begin AXIS_DESCR COM_AXIS NO_INPUT_QUANTITY COMP_0050 16 0 5119.921875 AXIS_PTS_REF mLROUTE /end AXIS_DESCR
 /begin FUNCTION_LIST /end FUNCTION_LIST
/end CHARACTERISTIC
/begin CHARACTERISTIC mTTMEVP "After the start, diagnosis prohibition time" CURVE 0x0000DAA2 REC_UBYTE_C 0 COMP_0096 0 2550
 /begin AXIS_DESCR FIX_AXIS NO_INPUT_QUANTITY COMP_0280_S 16 -40 110 FIX_AXIS_PAR_DIST 0 1 16 /end AXIS_DESCR
 /begin FUNCTION_LIST /end FUNCTION_LIST
/end CHARACTERISTIC
/begin CHARACTERISTIC mTKPIPL "Atomospheric pressure compensation coefficient VIP>=0 table" CURVE 0x0000D472 REC_UBYTE_C 0 COMP_0027 0 255
 /begin AXIS_DESCR FIX_AXIS NO_INPUT_QUANTITY COMP_0507_S 4 2.08 4 FIX_AXIS_PAR_DIST 0 1 4 /end AXIS_DESCR
 /begin FUNCTION_LIST /end FUNCTION_LIST
/end CHARACTERISTIC
/begin CHARACTERISTIC mTKPIPR "Atomospheric pressure compensation coefficient VIP<0 table" CURVE 0x0000D476 REC_UBYTE_C 0 COMP_0027 0 255
 /begin AXIS_DESCR FIX_AXIS NO_INPUT_QUANTITY COMP_0507_S 4 2.08 4 FIX_AXIS_PAR_DIST 0 1 4 /end AXIS_DESCR
 /begin FUNCTION_LIST /end FUNCTION_LIST
/end CHARACTERISTIC
/begin CHARACTERISTIC mTQCK0 "(CK) Load change compensation air flow-quantity basic table" CURVE 0x0000D7A8 REC_UBYTE_C 0 COMP_0220 0 255
 /begin AXIS_DESCR FIX_AXIS NO_INPUT_QUANTITY COMP_0276_S 4 1 4 FIX_AXIS_PAR_DIST 0 1 4 /end AXIS_DESCR
 /begin FUNCTION_LIST /end FUNCTION_LIST
/end CHARACTERISTIC
/begin CHARACTERISTIC mTTEGOK "TEGROK reference table" CURVE 0x0000DA1E REC_UBYTE_C 0 COMP_0035 -50 205
 /begin AXIS_DESCR FIX_AXIS NO_INPUT_QUANTITY COMP_0278_S 4 -40 20 FIX_AXIS_PAR_DIST 0 1 4 /end AXIS_DESCR
 /begin FUNCTION_LIST /end FUNCTION_LIST
/end CHARACTERISTIC
/begin CHARACTERISTIC mTSCKDRTR "SCKDRET decreasing rate table" CURVE 0x0000F110 REC_UWORD_C 0 COMP_0083 0 255.99609375
 /begin AXIS_DESCR FIX_AXIS NO_INPUT_QUANTITY COMP_0276_S 7 1 7 FIX_AXIS_PAR_DIST 0 1 7 /end AXIS_DESCR
 /begin FUNCTION_LIST R301.23.ADV_calculation_1_1_2 /end FUNCTION_LIST
/end CHARACTERISTIC
/begin CHARACTERISTIC mTADLM21 "Advance side maximum change with 1" CURVE 0x0000E47A REC_UWORD_C 0 COMP_0081 0 255.99609375
 /begin AXIS_DESCR FIX_AXIS NO_INPUT_QUANTITY COMP_0068 8 0 7 FIX_AXIS_PAR_DIST 0 1 8 /end AXIS_DESCR
 /begin FUNCTION_LIST R301.23.ADV_calculation_1_1_2 /end FUNCTION_LIST
/end CHARACTERISTIC
/begin CHARACTERISTIC mTADLM22 "Advance side maximum change with 2" CURVE 0x0000E48A REC_UWORD_C 0 COMP_0081 0 255.99609375
 /begin AXIS_DESCR FIX_AXIS NO_INPUT_QUANTITY COMP_0068 8 0 7 FIX_AXIS_PAR_DIST 0 1 8 /end AXIS_DESCR
 /begin FUNCTION_LIST R301.23.ADV_calculation_1_1_2 /end FUNCTION_LIST
/end CHARACTERISTIC
/begin CHARACTERISTIC mTLDTS2 "A leak area compensation table for the 2nd leak-down" CURVE 0x0000D4F2 REC_UBYTE_C 0 COMP_0045 0 1.9921875
 /begin AXIS_DESCR COM_AXIS NO_INPUT_QUANTITY COMP_0150 8 0 127.5 AXIS_PTS_REF mTSPCV /end AXIS_DESCR
 /begin FUNCTION_LIST /end FUNCTION_LIST
/end CHARACTERISTIC
/begin CHARACTERISTIC mTLDTS2H "A leak area compensation table (at the time of the high fuel temperature) for the 2nd leak-down" CURVE 0x0000D4FA REC_UBYTE_C 0 COMP_0045 0 1.9921875
 /begin AXIS_DESCR COM_AXIS NO_INPUT_QUANTITY COMP_0150 8 0 127.5 AXIS_PTS_REF mTSPCV /end AXIS_DESCR
 /begin FUNCTION_LIST /end FUNCTION_LIST
/end CHARACTERISTIC
/begin CHARACTERISTIC mTLDTSP "A leak area compensation table for the 1st leak-down" CURVE 0x0000D502 REC_UBYTE_C 0 COMP_0045 0 1.9921875
 /begin AXIS_DESCR COM_AXIS NO_INPUT_QUANTITY COMP_0150 8 0 127.5 AXIS_PTS_REF mTSPCV /end AXIS_DESCR
 /begin FUNCTION_LIST /end FUNCTION_LIST
/end CHARACTERISTIC
/begin CHARACTERISTIC mTQAIGN2 "An integral gain QA compensation table (bank 2)" CURVE 0x0000ED62 REC_UWORD_C 0 COMP_0388 0 6553.5
 /begin AXIS_DESCR COM_AXIS NO_INPUT_QUANTITY COMP_0220 8 0 65535 AXIS_PTS_REF mLQARANGE /end AXIS_DESCR
 /begin FUNCTION_LIST /end FUNCTION_LIST
/end CHARACTERISTIC
/begin CHARACTERISTIC mTRELM21 "Retard side maximum change with 1" CURVE 0x0000EF76 REC_UWORD_C 0 COMP_0081 0 255.99609375
 /begin AXIS_DESCR FIX_AXIS NO_INPUT_QUANTITY COMP_0068 8 0 7 FIX_AXIS_PAR_DIST 0 1 8 /end AXIS_DESCR
 /begin FUNCTION_LIST R301.23.ADV_calculation_1_1_2 /end FUNCTION_LIST
/end CHARACTERISTIC
/begin CHARACTERISTIC mTRELM22 "Retard side maximum change with 2" CURVE 0x0000EF86 REC_UWORD_C 0 COMP_0081 0 255.99609375
 /begin AXIS_DESCR FIX_AXIS NO_INPUT_QUANTITY COMP_0068 8 0 7 FIX_AXIS_PAR_DIST 0 1 8 /end AXIS_DESCR
 /begin FUNCTION_LIST R301.23.ADV_calculation_1_1_2 /end FUNCTION_LIST
/end CHARACTERISTIC
/begin CHARACTERISTIC mTRHOSILM "TRHOSi Limitation value table" CURVE 0x0000D848 REC_UBYTE_C 0 COMP_0517_S -128 127
 /begin AXIS_DESCR FIX_AXIS NO_INPUT_QUANTITY COMP_0278_S 8 -40 100 FIX_AXIS_PAR_DIST 0 1 8 /end AXIS_DESCR
 /begin FUNCTION_LIST R301.22.TRHOSI_1_0_2 /end FUNCTION_LIST
/end CHARACTERISTIC
/begin CHARACTERISTIC mTSCKFAC "Speed compensation coefficient table" CURVE 0x0000F11E REC_UWORD_C 0 COMP_0388 0 6553.5
 /begin AXIS_DESCR COM_AXIS NO_INPUT_QUANTITY COMP_0065 8 0 204796.875 AXIS_PTS_REF mLSCKFAC /end AXIS_DESCR
 /begin FUNCTION_LIST R301.23.ADV_calculation_1_1_2 /end FUNCTION_LIST
/end CHARACTERISTIC
/begin CHARACTERISTIC mTSCKONC "Retard timing adjustment table" CURVE 0x0000F12E REC_UWORD_C 0 COMP_0525_S -102400 102396.875
 /begin AXIS_DESCR COM_AXIS NO_INPUT_QUANTITY COMP_0065 8 0 204796.875 AXIS_PTS_REF mLSCKONC /end AXIS_DESCR
 /begin FUNCTION_LIST R301.23.ADV_calculation_1_1_2 /end FUNCTION_LIST
/end CHARACTERISTIC
/begin CHARACTERISTIC mAGBROM "ROM inclusion byte" VALUE 0x00008247 REC_UBYTE_C 0 COMP_0283 0 255 /begin FUNCTION_LIST /end FUNCTION_LIST /end CHARACTERISTIC
/begin CHARACTERISTIC mfQAGBCOR "Boolean that indicates wether QAGBCOR is added to QISC or to QLD1N" VALUE 0x00008247 REC_UBYTE_C 0 COMP_0283 0 1 BIT_MASK 0x0001 /begin FUNCTION_LIST /end FUNCTION_LIST /end CHARACTERISTIC
/begin CHARACTERISTIC mCSIGNS "The energizing prevention switching flag which it is simultaneous with" VALUE 0x00008375 REC_UBYTE_C 0 COMP_0283 0 255 /begin FUNCTION_LIST /end FUNCTION_LIST /end CHARACTERISTIC
/begin CHARACTERISTIC mDIAGCAT "mfDCATON inclusion byte" VALUE 0x00008430 REC_UBYTE_C 0 COMP_0283 0 255 /begin FUNCTION_LIST Rxxx.1.Diagnostic_cycle_1_0_1 /end FUNCTION_LIST /end CHARACTERISTIC
/begin CHARACTERISTIC mfDCATON "Calibration flag for diagnostic cycle" VALUE 0x00008430 REC_UBYTE_C 0 COMP_0283 0 1 BIT_MASK 0x0080 /begin FUNCTION_LIST Rxxx.1.Diagnostic_cycle_1_0_1 /end FUNCTION_LIST /end CHARACTERISTIC
/begin CHARACTERISTIC mIMBSWR "ROM Flags are included in this ROM for Immobilizer strategy" VALUE 0x0000870A REC_UBYTE_C 0 COMP_0283 0 255 /begin FUNCTION_LIST /end FUNCTION_LIST /end CHARACTERISTIC
/begin CHARACTERISTIC mfSPECREQ "Indicates a specific request to learn Skey without security tool" VALUE 0x0000870A REC_UBYTE_C 0 COMP_0283 0 1 BIT_MASK 0x0008 /begin FUNCTION_LIST /end FUNCTION_LIST /end CHARACTERISTIC
/begin CHARACTERISTIC mfSERIEVLR "Set if Immobilizer strategy is a base equipment" VALUE 0x0000870A REC_UBYTE_C 0 COMP_0283 0 1 BIT_MASK 0x0004 /begin FUNCTION_LIST /end FUNCTION_LIST /end CHARACTERISTIC
/begin CHARACTERISTIC mfINHIBVLR "Completely inhibiits the Immobilizer strategy for development purpose (development mode only)" VALUE 0x0000870A REC_UBYTE_C 0 COMP_0283 0 1 BIT_MASK 0x0002 /begin FUNCTION_LIST /end FUNCTION_LIST /end CHARACTERISTIC
/begin CHARACTERISTIC mfFEVAP4 "Space capacity compensation excuse" VALUE 0x0000892C REC_UBYTE_C 0 COMP_0283 0 1 BIT_MASK 0x0040 /begin FUNCTION_LIST /end FUNCTION_LIST /end CHARACTERISTIC
/begin CHARACTERISTIC mCVSPNG "ROM Const mCVSPNG" VALUE 0x00010834 REC_ULONG_C 0 COMP_0068 0 4294967295 /begin FUNCTION_LIST R901.1.Diag_on_can_app_1_6_2 /end FUNCTION_LIST /end CHARACTERISTIC
/begin CHARACTERISTIC mCOVHEAT "ROM Const mCOVHEAT" VALUE 0x00010838 REC_ULONG_C 0 COMP_0068 0 4294967295 /begin FUNCTION_LIST /end FUNCTION_LIST /end CHARACTERISTIC
/begin CHARACTERISTIC mCCUNG "ROM Const mCCUNG" VALUE 0x0001083C REC_ULONG_C 0 COMP_0068 0 4294967295 /begin FUNCTION_LIST /end FUNCTION_LIST /end CHARACTERISTIC
/begin CHARACTERISTIC mCO2CLB1 "ROM Const mCO2CLB1" VALUE 0x00010840 REC_ULONG_C 0 COMP_0068 0 4294967295 /begin FUNCTION_LIST /end FUNCTION_LIST /end CHARACTERISTIC
/begin CHARACTERISTIC mCO2CLB2 "ROM Const mCO2CLB2" VALUE 0x00010844 REC_ULONG_C 0 COMP_0068 0 4294967295 /begin FUNCTION_LIST /end FUNCTION_LIST /end CHARACTERISTIC
/begin CHARACTERISTIC mCMF6NG "ROM Const mCMF6NG" VALUE 0x00010848 REC_ULONG_C 0 COMP_0068 0 4294967295 /begin FUNCTION_LIST /end FUNCTION_LIST /end CHARACTERISTIC
/begin CHARACTERISTIC mCMF5NG "ROM Const mCMF5NG" VALUE 0x0001084C REC_ULONG_C 0 COMP_0068 0 4294967295 /begin FUNCTION_LIST /end FUNCTION_LIST /end CHARACTERISTIC
/begin CHARACTERISTIC mCMF4NG "ROM Const mCMF4NG" VALUE 0x00010850 REC_ULONG_C 0 COMP_0068 0 4294967295 /begin FUNCTION_LIST /end FUNCTION_LIST /end CHARACTERISTIC
/begin CHARACTERISTIC mCMF3NG "ROM Const mCMF3NG" VALUE 0x00010854 REC_ULONG_C 0 COMP_0068 0 4294967295 /begin FUNCTION_LIST /end FUNCTION_LIST /end CHARACTERISTIC
/begin CHARACTERISTIC mCMF2NG "ROM Const mCMF2NG" VALUE 0x00010858 REC_ULONG_C 0 COMP_0068 0 4294967295 /begin FUNCTION_LIST /end FUNCTION_LIST /end CHARACTERISTIC
/begin CHARACTERISTIC mCMF1NG "ROM Const mCMF1NG" VALUE 0x0001085C REC_ULONG_C 0 COMP_0068 0 4294967295 /begin FUNCTION_LIST /end FUNCTION_LIST /end CHARACTERISTIC
/begin CHARACTERISTIC mCMFMCNG "ROM Const mCMFMCNG" VALUE 0x00010860 REC_ULONG_C 0 COMP_0068 0 4294967295 /begin FUNCTION_LIST /end FUNCTION_LIST /end CHARACTERISTIC
/begin CHARACTERISTIC mCCAT1NG "ROM Const mCCAT1NG" VALUE 0x00010864 REC_ULONG_C 0 COMP_0068 0 4294967295 /begin FUNCTION_LIST /end FUNCTION_LIST /end CHARACTERISTIC
/begin CHARACTERISTIC mCCAT2NG "ROM Const mCCAT2NG" VALUE 0x00010868 REC_ULONG_C 0 COMP_0068 0 4294967295 /begin FUNCTION_LIST /end FUNCTION_LIST /end CHARACTERISTIC
/begin CHARACTERISTIC mCMRNG "ROM Const mCMRNG" VALUE 0x0001086C REC_ULONG_C 0 COMP_0068 0 4294967295 /begin FUNCTION_LIST /end FUNCTION_LIST /end CHARACTERISTIC
/begin CHARACTERISTIC mCMRNG2 "ROM Const mCMRNG2" VALUE 0x00010870 REC_ULONG_C 0 COMP_0068 0 4294967295 /begin FUNCTION_LIST /end FUNCTION_LIST /end CHARACTERISTIC
/begin CHARACTERISTIC mCTWCLNG "ROM Const mCTWCLNG" VALUE 0x00010874 REC_ULONG_C 0 COMP_0068 0 4294967295 /begin FUNCTION_LIST /end FUNCTION_LIST /end CHARACTERISTIC
/begin CHARACTERISTIC mCNSNG "ROM Const mCNSNG" VALUE 0x00010878 REC_ULONG_C 0 COMP_0068 0 4294967295 /begin FUNCTION_LIST /end FUNCTION_LIST /end CHARACTERISTIC
/begin CHARACTERISTIC mCVTCSV1 "ROM Const mCVTCSV1" VALUE 0x0001087C REC_ULONG_C 0 COMP_0068 0 4294967295 /begin FUNCTION_LIST /end FUNCTION_LIST /end CHARACTERISTIC
/begin CHARACTERISTIC mCVTCSV2 "ROM Const mCVTCSV2" VALUE 0x00010880 REC_ULONG_C 0 COMP_0068 0 4294967295 /begin FUNCTION_LIST /end FUNCTION_LIST /end CHARACTERISTIC
/begin CHARACTERISTIC mCVIASDN "ROM Const mCVIASDN" VALUE 0x00010884 REC_ULONG_C 0 COMP_0068 0 4294967295 /begin FUNCTION_LIST /end FUNCTION_LIST /end CHARACTERISTIC
/begin CHARACTERISTIC mCDCS1NG "ROM Const mCDCS1NG" VALUE 0x00010888 REC_ULONG_C 0 COMP_0068 0 4294967295 /begin FUNCTION_LIST /end FUNCTION_LIST /end CHARACTERISTIC
/begin CHARACTERISTIC mCDCS2NG "ROM Const mCDCS2NG" VALUE 0x0001088C REC_ULONG_C 0 COMP_0068 0 4294967295 /begin FUNCTION_LIST /end FUNCTION_LIST /end CHARACTERISTIC
/begin CHARACTERISTIC mCDCS3NG "ROM Const mCDCS3NG" VALUE 0x00010890 REC_ULONG_C 0 COMP_0068 0 4294967295 /begin FUNCTION_LIST /end FUNCTION_LIST /end CHARACTERISTIC
/begin CHARACTERISTIC mCDPS1NG "ROM Const mCDPS1NG" VALUE 0x00010894 REC_ULONG_C 0 COMP_0068 0 4294967295 /begin FUNCTION_LIST /end FUNCTION_LIST /end CHARACTERISTIC
/begin CHARACTERISTIC mCDPS2NG "ROM Const mCDPS2NG" VALUE 0x00010898 REC_ULONG_C 0 COMP_0068 0 4294967295 /begin FUNCTION_LIST /end FUNCTION_LIST /end CHARACTERISTIC
/begin CHARACTERISTIC mCDPS3NG "ROM Const mCDPS3NG" VALUE 0x0001089C REC_ULONG_C 0 COMP_0068 0 4294967295 /begin FUNCTION_LIST /end FUNCTION_LIST /end CHARACTERISTIC
/begin CHARACTERISTIC mCPPSNG "ROM Const mCPPSNG" VALUE 0x000108A0 REC_ULONG_C 0 COMP_0068 0 4294967295 /begin FUNCTION_LIST /end FUNCTION_LIST /end CHARACTERISTIC
/begin CHARACTERISTIC mCSYNCNG "ROM Const mCSYNCNG" VALUE 0x000108A4 REC_ULONG_C 0 COMP_0068 0 4294967295 /begin FUNCTION_LIST /end FUNCTION_LIST /end CHARACTERISTIC
/begin CHARACTERISTIC mCALUNG "ROM Const mCALUNG" VALUE 0x000108A8 REC_ULONG_C 0 COMP_0068 0 4294967295 /begin FUNCTION_LIST /end FUNCTION_LIST /end CHARACTERISTIC
/begin CHARACTERISTIC mCQCKNG "ROM Const mCQCKNG" VALUE 0x000108AC REC_ULONG_C 0 COMP_0068 0 4294967295 /begin FUNCTION_LIST /end FUNCTION_LIST /end CHARACTERISTIC
/begin CHARACTERISTIC mCCALCNG "ROM Const mCCALCNG" VALUE 0x000108B0 REC_ULONG_C 0 COMP_0068 0 4294967295 /begin FUNCTION_LIST /end FUNCTION_LIST /end CHARACTERISTIC
/begin CHARACTERISTIC mCADNG "ROM Const mCADNG" VALUE 0x000108B4 REC_ULONG_C 0 COMP_0068 0 4294967295 /begin FUNCTION_LIST /end FUNCTION_LIST /end CHARACTERISTIC
/begin CHARACTERISTIC mCIC3NG "ROM Const mCIC3NG" VALUE 0x000108B8 REC_ULONG_C 0 COMP_0068 0 4294967295 /begin FUNCTION_LIST /end FUNCTION_LIST /end CHARACTERISTIC
/begin CHARACTERISTIC mCTPS4NG "ROM Const mCTPS4NG" VALUE 0x000108BC REC_ULONG_C 0 COMP_0068 0 4294967295 /begin FUNCTION_LIST /end FUNCTION_LIST /end CHARACTERISTIC
/begin CHARACTERISTIC mCTHFBNG "ROM Const mCTHFBNG" VALUE 0x000108C0 REC_ULONG_C 0 COMP_0068 0 4294967295 /begin FUNCTION_LIST /end FUNCTION_LIST /end CHARACTERISTIC
/begin CHARACTERISTIC mCVAPXNG "ROM Const mCVAPXNG" VALUE 0x000108C4 REC_ULONG_C 0 COMP_0068 0 4294967295 /begin FUNCTION_LIST /end FUNCTION_LIST /end CHARACTERISTIC
/begin CHARACTERISTIC mCAPOXNG "ROM Const mCAPOXNG" VALUE 0x000108C8 REC_ULONG_C 0 COMP_0068 0 4294967295 /begin FUNCTION_LIST /end FUNCTION_LIST /end CHARACTERISTIC
/begin CHARACTERISTIC mCTGTXNG "ROM Const mCTGTXNG" VALUE 0x000108CC REC_ULONG_C 0 COMP_0068 0 4294967295 /begin FUNCTION_LIST /end FUNCTION_LIST /end CHARACTERISTIC
/begin CHARACTERISTIC mCSERVNG "ROM Const mCSERVNG" VALUE 0x000108D0 REC_ULONG_C 0 COMP_0068 0 4294967295 /begin FUNCTION_LIST /end FUNCTION_LIST /end CHARACTERISTIC
/begin CHARACTERISTIC mCASTRNG "ROM Const mCASTRNG" VALUE 0x000108D4 REC_ULONG_C 0 COMP_0068 0 4294967295 /begin FUNCTION_LIST /end FUNCTION_LIST /end CHARACTERISTIC
/begin CHARACTERISTIC mCQHAPNG "ROM Const mCQHAPNG" VALUE 0x000108D8 REC_ULONG_C 0 COMP_0068 0 4294967295 /begin FUNCTION_LIST /end FUNCTION_LIST /end CHARACTERISTIC
/begin CHARACTERISTIC mCTEPDNG "ROM Const mCTEPDNG" VALUE 0x000108DC REC_ULONG_C 0 COMP_0068 0 4294967295 /begin FUNCTION_LIST /end FUNCTION_LIST /end CHARACTERISTIC
/begin CHARACTERISTIC mCTATENG "ROM Const mCTATENG" VALUE 0x000108E0 REC_ULONG_C 0 COMP_0068 0 4294967295 /begin FUNCTION_LIST /end FUNCTION_LIST /end CHARACTERISTIC
/begin CHARACTERISTIC mCTTEPNG "ROM Const mCTTEPNG" VALUE 0x000108E4 REC_ULONG_C 0 COMP_0068 0 4294967295 /begin FUNCTION_LIST /end FUNCTION_LIST /end CHARACTERISTIC
/begin CHARACTERISTIC mCRLONNG "ROM Const mCRLONNG" VALUE 0x000108E8 REC_ULONG_C 0 COMP_0068 0 4294967295 /begin FUNCTION_LIST /end FUNCTION_LIST /end CHARACTERISTIC
/begin CHARACTERISTIC mCRLOFNG "ROM Const mCRLOFNG" VALUE 0x000108EC REC_ULONG_C 0 COMP_0068 0 4294967295 /begin FUNCTION_LIST /end FUNCTION_LIST /end CHARACTERISTIC
/begin CHARACTERISTIC mCDTSPNG "ROM Const mCDTSPNG" VALUE 0x000108F0 REC_ULONG_C 0 COMP_0068 0 4294967295 /begin FUNCTION_LIST /end FUNCTION_LIST /end CHARACTERISTIC
/begin CHARACTERISTIC mCVSPRNG "ROM Const mCVSPRNG" VALUE 0x000108F4 REC_ULONG_C 0 COMP_0068 0 4294967295 /begin FUNCTION_LIST /end FUNCTION_LIST /end CHARACTERISTIC
/begin CHARACTERISTIC mCBSOFNG "ROM Const mCBSOFNG" VALUE 0x000108F8 REC_ULONG_C 0 COMP_0068 0 4294967295 /begin FUNCTION_LIST /end FUNCTION_LIST /end CHARACTERISTIC
/begin CHARACTERISTIC mCRTSPNG "ROM Const mCRTSPNG" VALUE 0x000108FC REC_ULONG_C 0 COMP_0068 0 4294967295 /begin FUNCTION_LIST /end FUNCTION_LIST /end CHARACTERISTIC
/begin CHARACTERISTIC mCDFLTNG "ROM Const mCDFLTNG" VALUE 0x00010900 REC_ULONG_C 0 COMP_0068 0 4294967295 /begin FUNCTION_LIST /end FUNCTION_LIST /end CHARACTERISTIC
/begin CHARACTERISTIC mCTHOPNG "ROM Const mCTHOPNG" VALUE 0x00010904 REC_ULONG_C 0 COMP_0068 0 4294967295 /begin FUNCTION_LIST /end FUNCTION_LIST /end CHARACTERISTIC
/begin CHARACTERISTIC mCBURNG "ROM Const mCBURNG" VALUE 0x00010908 REC_ULONG_C 0 COMP_0068 0 4294967295 /begin FUNCTION_LIST /end FUNCTION_LIST /end CHARACTERISTIC
/begin CHARACTERISTIC mCSSOFNG "ROM Const mCSSOFNG" VALUE 0x0001090C REC_ULONG_C 0 COMP_0068 0 4294967295 /begin FUNCTION_LIST /end FUNCTION_LIST /end CHARACTERISTIC
/begin CHARACTERISTIC mCTSKNGM "ROM Const mCTSKNGM" VALUE 0x00010910 REC_ULONG_C 0 COMP_0068 0 4294967295 /begin FUNCTION_LIST /end FUNCTION_LIST /end CHARACTERISTIC
/begin CHARACTERISTIC mCROMNGM "ROM Const mCROMNGM" VALUE 0x00010914 REC_ULONG_C 0 COMP_0068 0 4294967295 /begin FUNCTION_LIST /end FUNCTION_LIST /end CHARACTERISTIC
/begin CHARACTERISTIC mCRAMNGM "ROM Const mCRAMNGM" VALUE 0x00010918 REC_ULONG_C 0 COMP_0068 0 4294967295 /begin FUNCTION_LIST /end FUNCTION_LIST /end CHARACTERISTIC
/begin CHARACTERISTIC mCWDTNGM "ROM Const mCWDTNGM" VALUE 0x0001091C REC_ULONG_C 0 COMP_0068 0 4294967295 /begin FUNCTION_LIST /end FUNCTION_LIST /end CHARACTERISTIC
/begin CHARACTERISTIC mCTIMNGM "ROM Const mCTIMNGM" VALUE 0x00010920 REC_ULONG_C 0 COMP_0068 0 4294967295 /begin FUNCTION_LIST /end FUNCTION_LIST /end CHARACTERISTIC
/begin CHARACTERISTIC mCEPWNGM "ROM Const mCEPWNGM" VALUE 0x00010924 REC_ULONG_C 0 COMP_0068 0 4294967295 /begin FUNCTION_LIST /end FUNCTION_LIST /end CHARACTERISTIC
/begin CHARACTERISTIC mCEPRNGM "ROM Const mCEPRNGM" VALUE 0x00010928 REC_ULONG_C 0 COMP_0068 0 4294967295 /begin FUNCTION_LIST /end FUNCTION_LIST /end CHARACTERISTIC
/begin CHARACTERISTIC mCRANGM2 "ROM Const mCRANGM2" VALUE 0x0001092C REC_ULONG_C 0 COMP_0068 0 4294967295 /begin FUNCTION_LIST /end FUNCTION_LIST /end CHARACTERISTIC
/begin CHARACTERISTIC mCDC21NG "ROM Const mCDC21NG" VALUE 0x00010930 REC_ULONG_C 0 COMP_0068 0 4294967295 /begin FUNCTION_LIST /end FUNCTION_LIST /end CHARACTERISTIC
/begin CHARACTERISTIC mCDC22NG "ROM Const mCDC22NG" VALUE 0x00010934 REC_ULONG_C 0 COMP_0068 0 4294967295 /begin FUNCTION_LIST /end FUNCTION_LIST /end CHARACTERISTIC
/begin CHARACTERISTIC mCDC23NG "ROM Const mCDC23NG" VALUE 0x00010938 REC_ULONG_C 0 COMP_0068 0 4294967295 /begin FUNCTION_LIST /end FUNCTION_LIST /end CHARACTERISTIC
/begin CHARACTERISTIC mCAFLNG1 "ROM Const mCAFLNG1" VALUE 0x0001093C REC_ULONG_C 0 COMP_0068 0 4294967295 /begin FUNCTION_LIST /end FUNCTION_LIST /end CHARACTERISTIC
/begin CHARACTERISTIC mCAFLNG2 "ROM Const mCAFLNG2" VALUE 0x00010940 REC_ULONG_C 0 COMP_0068 0 4294967295 /begin FUNCTION_LIST /end FUNCTION_LIST /end CHARACTERISTIC
/begin CHARACTERISTIC mCAFLLS "ROM Const mCAFLLS" VALUE 0x00010944 REC_ULONG_C 0 COMP_0068 0 4294967295 /begin FUNCTION_LIST /end FUNCTION_LIST /end CHARACTERISTIC
/begin CHARACTERISTIC mCAFLRS "ROM Const mCAFLRS" VALUE 0x00010948 REC_ULONG_C 0 COMP_0068 0 4294967295 /begin FUNCTION_LIST /end FUNCTION_LIST /end CHARACTERISTIC
/begin CHARACTERISTIC mCAFLAV "ROM Const mCAFLAV" VALUE 0x0001094C REC_ULONG_C 0 COMP_0068 0 4294967295 /begin FUNCTION_LIST /end FUNCTION_LIST /end CHARACTERISTIC
/begin CHARACTERISTIC mCAFRNG1 "ROM Const mCAFRNG1" VALUE 0x00010950 REC_ULONG_C 0 COMP_0068 0 4294967295 /begin FUNCTION_LIST /end FUNCTION_LIST /end CHARACTERISTIC
/begin CHARACTERISTIC mCAFRNG2 "ROM Const mCAFRNG2" VALUE 0x00010954 REC_ULONG_C 0 COMP_0068 0 4294967295 /begin FUNCTION_LIST /end FUNCTION_LIST /end CHARACTERISTIC
/begin CHARACTERISTIC mCAFRLS "ROM Const mCAFRLS" VALUE 0x00010958 REC_ULONG_C 0 COMP_0068 0 4294967295 /begin FUNCTION_LIST /end FUNCTION_LIST /end CHARACTERISTIC
/begin CHARACTERISTIC mCAFRRS "ROM Const mCAFRRS" VALUE 0x0001095C REC_ULONG_C 0 COMP_0068 0 4294967295 /begin FUNCTION_LIST /end FUNCTION_LIST /end CHARACTERISTIC
/begin CHARACTERISTIC mCAFRAV "ROM Const mCAFRAV" VALUE 0x00010960 REC_ULONG_C 0 COMP_0068 0 4294967295 /begin FUNCTION_LIST /end FUNCTION_LIST /end CHARACTERISTIC
/begin CHARACTERISTIC mCISCNGL "ROM Const mCISCNGL" VALUE 0x00010964 REC_ULONG_C 0 COMP_0068 0 4294967295 /begin FUNCTION_LIST /end FUNCTION_LIST /end CHARACTERISTIC
/begin CHARACTERISTIC mCISCNGH "ROM Const mCISCNGH" VALUE 0x00010968 REC_ULONG_C 0 COMP_0068 0 4294967295 /begin FUNCTION_LIST /end FUNCTION_LIST /end CHARACTERISTIC
/begin CHARACTERISTIC mCO2R1O "ROM Const mCO2R1O" VALUE 0x0001096C REC_ULONG_C 0 COMP_0068 0 4294967295 /begin FUNCTION_LIST /end FUNCTION_LIST /end CHARACTERISTIC
/begin CHARACTERISTIC mCO2R2O "ROM Const mCO2R2O" VALUE 0x00010970 REC_ULONG_C 0 COMP_0068 0 4294967295 /begin FUNCTION_LIST /end FUNCTION_LIST /end CHARACTERISTIC
/begin CHARACTERISTIC mCO2R1L "ROM Const mCO2R1L" VALUE 0x00010974 REC_ULONG_C 0 COMP_0068 0 4294967295 /begin FUNCTION_LIST /end FUNCTION_LIST /end CHARACTERISTIC
/begin CHARACTERISTIC mCO2R2L "ROM Const mCO2R2L" VALUE 0x00010978 REC_ULONG_C 0 COMP_0068 0 4294967295 /begin FUNCTION_LIST /end FUNCTION_LIST /end CHARACTERISTIC
/begin CHARACTERISTIC mCO2R1R "ROM Const mCO2R1R" VALUE 0x0001097C REC_ULONG_C 0 COMP_0068 0 4294967295 /begin FUNCTION_LIST /end FUNCTION_LIST /end CHARACTERISTIC
/begin CHARACTERISTIC mCO2R2R "ROM Const mCO2R2R" VALUE 0x00010980 REC_ULONG_C 0 COMP_0068 0 4294967295 /begin FUNCTION_LIST /end FUNCTION_LIST /end CHARACTERISTIC
/begin CHARACTERISTIC mCO2R1H "ROM Const mCO2R1H" VALUE 0x00010984 REC_ULONG_C 0 COMP_0068 0 4294967295 /begin FUNCTION_LIST /end FUNCTION_LIST /end CHARACTERISTIC
/begin CHARACTERISTIC mCO2R2H "ROM Const mCO2R2H" VALUE 0x00010988 REC_ULONG_C 0 COMP_0068 0 4294967295 /begin FUNCTION_LIST /end FUNCTION_LIST /end CHARACTERISTIC
/begin CHARACTERISTIC mCRO2HH1 "ROM Const mCRO2HH1" VALUE 0x0001098C REC_ULONG_C 0 COMP_0068 0 4294967295 /begin FUNCTION_LIST /end FUNCTION_LIST /end CHARACTERISTIC
/begin CHARACTERISTIC mCRO2HH2 "ROM Const mCRO2HH2" VALUE 0x00010990 REC_ULONG_C 0 COMP_0068 0 4294967295 /begin FUNCTION_LIST /end FUNCTION_LIST /end CHARACTERISTIC
/begin CHARACTERISTIC mCRO2HL1 "ROM Const mCRO2HL1" VALUE 0x00010994 REC_ULONG_C 0 COMP_0068 0 4294967295 /begin FUNCTION_LIST /end FUNCTION_LIST /end CHARACTERISTIC
/begin CHARACTERISTIC mCRO2HL2 "ROM Const mCRO2HL2" VALUE 0x00010998 REC_ULONG_C 0 COMP_0068 0 4294967295 /begin FUNCTION_LIST /end FUNCTION_LIST /end CHARACTERISTIC
/begin CHARACTERISTIC mCKN1NGL "ROM Const mCKN1NGL" VALUE 0x0001099C REC_ULONG_C 0 COMP_0068 0 4294967295 /begin FUNCTION_LIST /end FUNCTION_LIST /end CHARACTERISTIC
/begin CHARACTERISTIC mCKN1NGH "ROM Const mCKN1NGH" VALUE 0x000109A0 REC_ULONG_C 0 COMP_0068 0 4294967295 /begin FUNCTION_LIST /end FUNCTION_LIST /end CHARACTERISTIC
/begin CHARACTERISTIC mCKN2NGL "ROM Const mCKN2NGL" VALUE 0x000109A4 REC_ULONG_C 0 COMP_0068 0 4294967295 /begin FUNCTION_LIST /end FUNCTION_LIST /end CHARACTERISTIC
/begin CHARACTERISTIC mCKN2NGH "ROM Const mCKN2NGH" VALUE 0x000109A8 REC_ULONG_C 0 COMP_0068 0 4294967295 /begin FUNCTION_LIST /end FUNCTION_LIST /end CHARACTERISTIC
/begin CHARACTERISTIC mCAFMNGR "ROM Const mCAFMNGR" VALUE 0x000109AC REC_ULONG_C 0 COMP_0068 0 4294967295 /begin FUNCTION_LIST /end FUNCTION_LIST /end CHARACTERISTIC
/begin CHARACTERISTIC mCAFMNGL "ROM Const mCAFMNGL" VALUE 0x000109B0 REC_ULONG_C 0 COMP_0068 0 4294967295 /begin FUNCTION_LIST /end FUNCTION_LIST /end CHARACTERISTIC
/begin CHARACTERISTIC mCAFMNGH "ROM Const mCAFMNGH" VALUE 0x000109B4 REC_ULONG_C 0 COMP_0068 0 4294967295 /begin FUNCTION_LIST /end FUNCTION_LIST /end CHARACTERISTIC
/begin CHARACTERISTIC mCIGNGR "ROM Const mCIGNGR" VALUE 0x000109B8 REC_ULONG_C 0 COMP_0068 0 4294967295 /begin FUNCTION_LIST /end FUNCTION_LIST /end CHARACTERISTIC
/begin CHARACTERISTIC mCTWNGL "ROM Const mCTWNGL" VALUE 0x000109BC REC_ULONG_C 0 COMP_0068 0 4294967295 /begin FUNCTION_LIST /end FUNCTION_LIST /end CHARACTERISTIC
/begin CHARACTERISTIC mCTWNGH "ROM Const mCTWNGH" VALUE 0x000109C0 REC_ULONG_C 0 COMP_0068 0 4294967295 /begin FUNCTION_LIST /end FUNCTION_LIST /end CHARACTERISTIC
/begin CHARACTERISTIC mCTANGL "ROM Const mCTANGL" VALUE 0x000109C4 REC_ULONG_C 0 COMP_0068 0 4294967295 /begin FUNCTION_LIST /end FUNCTION_LIST /end CHARACTERISTIC
/begin CHARACTERISTIC mCTANGH "ROM Const mCTANGH" VALUE 0x000109C8 REC_ULONG_C 0 COMP_0068 0 4294967295 /begin FUNCTION_LIST /end FUNCTION_LIST /end CHARACTERISTIC
/begin CHARACTERISTIC mCTANGR "ROM Const mCTANGR" VALUE 0x000109CC REC_ULONG_C 0 COMP_0068 0 4294967295 /begin FUNCTION_LIST /end FUNCTION_LIST /end CHARACTERISTIC
/begin CHARACTERISTIC mCEVCNGO "ROM Const mCEVCNGO" VALUE 0x000109D0 REC_ULONG_C 0 COMP_0068 0 4294967295 /begin FUNCTION_LIST /end FUNCTION_LIST /end CHARACTERISTIC
/begin CHARACTERISTIC mCEVCNGS "ROM Const mCEVCNGS" VALUE 0x000109D4 REC_ULONG_C 0 COMP_0068 0 4294967295 /begin FUNCTION_LIST /end FUNCTION_LIST /end CHARACTERISTIC
/begin CHARACTERISTIC mCTHMNGR "ROM Const mCTHMNGR" VALUE 0x000109D8 REC_ULONG_C 0 COMP_0068 0 4294967295 /begin FUNCTION_LIST /end FUNCTION_LIST /end CHARACTERISTIC
/begin CHARACTERISTIC mCMRNR "ROM Const mCMRNR" VALUE 0x000109DC REC_ULONG_C 0 COMP_0068 0 4294967295 /begin FUNCTION_LIST /end FUNCTION_LIST /end CHARACTERISTIC
/begin CHARACTERISTIC mCMRNL "ROM Const mCMRNL" VALUE 0x000109E0 REC_ULONG_C 0 COMP_0068 0 4294967295 /begin FUNCTION_LIST /end FUNCTION_LIST /end CHARACTERISTIC
/begin CHARACTERISTIC mCMRNR2 "ROM Const mCMRNR2" VALUE 0x000109E4 REC_ULONG_C 0 COMP_0068 0 4294967295 /begin FUNCTION_LIST /end FUNCTION_LIST /end CHARACTERISTIC
/begin CHARACTERISTIC mCMRNL2 "ROM Const mCMRNL2" VALUE 0x000109E8 REC_ULONG_C 0 COMP_0068 0 4294967295 /begin FUNCTION_LIST /end FUNCTION_LIST /end CHARACTERISTIC
/begin CHARACTERISTIC mCVTCI1R "ROM Const mCVTCI1R" VALUE 0x000109EC REC_ULONG_C 0 COMP_0068 0 4294967295 /begin FUNCTION_LIST /end FUNCTION_LIST /end CHARACTERISTIC
/begin CHARACTERISTIC mCVTCI2R "ROM Const mCVTCI2R" VALUE 0x000109F0 REC_ULONG_C 0 COMP_0068 0 4294967295 /begin FUNCTION_LIST /end FUNCTION_LIST /end CHARACTERISTIC
/begin CHARACTERISTIC mCPRSNGL "ROM Const mCPRSNGL" VALUE 0x000109F4 REC_ULONG_C 0 COMP_0068 0 4294967295 /begin FUNCTION_LIST /end FUNCTION_LIST /end CHARACTERISTIC
/begin CHARACTERISTIC mCPRSNGH "ROM Const mCPRSNGH" VALUE 0x000109F8 REC_ULONG_C 0 COMP_0068 0 4294967295 /begin FUNCTION_LIST /end FUNCTION_LIST /end CHARACTERISTIC
/begin CHARACTERISTIC mCAVCCSH "ROM Const mCAVCCSH" VALUE 0x000109FC REC_ULONG_C 0 COMP_0068 0 4294967295 /begin FUNCTION_LIST /end FUNCTION_LIST /end CHARACTERISTIC
/begin CHARACTERISTIC mCTP1NGH "ROM Const mCTP1NGH" VALUE 0x00010A00 REC_ULONG_C 0 COMP_0068 0 4294967295 /begin FUNCTION_LIST /end FUNCTION_LIST /end CHARACTERISTIC
/begin CHARACTERISTIC mCTP1NGL "ROM Const mCTP1NGL" VALUE 0x00010A04 REC_ULONG_C 0 COMP_0068 0 4294967295 /begin FUNCTION_LIST /end FUNCTION_LIST /end CHARACTERISTIC
/begin CHARACTERISTIC mCTP2NGH "ROM Const mCTP2NGH" VALUE 0x00010A08 REC_ULONG_C 0 COMP_0068 0 4294967295 /begin FUNCTION_LIST /end FUNCTION_LIST /end CHARACTERISTIC
/begin CHARACTERISTIC mCTP2NGL "ROM Const mCTP2NGL" VALUE 0x00010A0C REC_ULONG_C 0 COMP_0068 0 4294967295 /begin FUNCTION_LIST /end FUNCTION_LIST /end CHARACTERISTIC
/begin CHARACTERISTIC mCTP12NG "ROM Const mCTP12NG" VALUE 0x00010A10 REC_ULONG_C 0 COMP_0068 0 4294967295 /begin FUNCTION_LIST /end FUNCTION_LIST /end CHARACTERISTIC
/begin CHARACTERISTIC mCTPLRLO "ROM Const mCTPLRLO" VALUE 0x00010A14 REC_ULONG_C 0 COMP_0068 0 4294967295 /begin FUNCTION_LIST /end FUNCTION_LIST /end CHARACTERISTIC
/begin CHARACTERISTIC mCTPLRNO "ROM Const mCTPLRNO" VALUE 0x00010A18 REC_ULONG_C 0 COMP_0068 0 4294967295 /begin FUNCTION_LIST /end FUNCTION_LIST /end CHARACTERISTIC
/begin CHARACTERISTIC mCVMOOPN "ROM Const mCVMOOPN" VALUE 0x00010A1C REC_ULONG_C 0 COMP_0068 0 4294967295 /begin FUNCTION_LIST /end FUNCTION_LIST /end CHARACTERISTIC
/begin CHARACTERISTIC mCVMOSHT "ROM Const mCVMOSHT" VALUE 0x00010A20 REC_ULONG_C 0 COMP_0068 0 4294967295 /begin FUNCTION_LIST /end FUNCTION_LIST /end CHARACTERISTIC
/begin CHARACTERISTIC mCMOTSHT "ROM Const mCMOTSHT" VALUE 0x00010A24 REC_ULONG_C 0 COMP_0068 0 4294967295 /begin FUNCTION_LIST /end FUNCTION_LIST /end CHARACTERISTIC
/begin CHARACTERISTIC mDGNSW[32] "Flag mDGNSW[32]" VALUE 0x0001022C REC_UBYTE_C 0 COMP_0283 0 255 /begin FUNCTION_LIST R301.21.SafetyLevel2_1_0_2 /end FUNCTION_LIST /end CHARACTERISTIC
/begin CHARACTERISTIC mDGNSW[33] "Flag mDGNSW[33]" VALUE 0x0001022D REC_UBYTE_C 0 COMP_0283 0 255 /begin FUNCTION_LIST R301.21.SafetyLevel2_1_0_2 /end FUNCTION_LIST /end CHARACTERISTIC
/begin CHARACTERISTIC mDGNSW[34] "Flag mDGNSW[34]" VALUE 0x0001022E REC_UBYTE_C 0 COMP_0283 0 255 /begin FUNCTION_LIST R301.21.SafetyLevel2_1_0_2 /end FUNCTION_LIST /end CHARACTERISTIC
/begin AXIS_PTS mTEVQCNT "2L" 0x0000E9CA NO_INPUT_QUANTITY REC_AXIS_UWORD 0 COMP_0152 16 0 131070 /end AXIS_PTS
/begin AXIS_PTS mLFGAGE "20/256mV" 0x0000E100 NO_INPUT_QUANTITY REC_AXIS_UWORD 0 COMP_0050 16 0 5119.921875 /end AXIS_PTS
/begin AXIS_PTS mLROUTE "20/256mV" 0x0000E1A0 NO_INPUT_QUANTITY REC_AXIS_UWORD 0 COMP_0050 16 0 5119.921875 /end AXIS_PTS
/begin AXIS_PTS mTSPCV "0.5L" 0x0000D8CA NO_INPUT_QUANTITY REC_AXIS_UBYTE 0 COMP_0150 8 0 127.5 /end AXIS_PTS
/begin AXIS_PTS mLQARANGE "1l/min" 0x0000E190 NO_INPUT_QUANTITY REC_AXIS_UWORD 0 COMP_0220 8 0 65535 /end AXIS_PTS
/begin AXIS_PTS mLSCKFAC "3.125rpm" 0x0000E1C0 NO_INPUT_QUANTITY REC_AXIS_UWORD 0 COMP_0065 8 0 204796.875 /end AXIS_PTS
/begin AXIS_PTS mLSCKONC "3.125rpm" 0x0000E1D0 NO_INPUT_QUANTITY REC_AXIS_UWORD 0 COMP_0065 8 0 204796.875 /end AXIS_PTS
/begin MEASUREMENT fOBDSAV02 "OBD After-Sales tests - Catalyzer test flag" UBYTE COMP_0283 1 100 0 1 BIT_MASK 0x0010 ECU_ADDRESS 0xFFFF49E2 /begin FUNCTION_LIST R901.1.Diag_on_can_app_1_6_2 Rxxx.1.Diagnostic_cycle_1_0_1 /end FUNCTION_LIST /end MEASUREMENT
/begin MEASUREMENT fSIPFULL "AGB FULL control request flag" UBYTE COMP_0283 1 100 0 1 BIT_MASK 0x0008 ECU_ADDRESS 0xFFFF49E3 DISPLAY_IDENTIFIER Vbx_agb_tq_req_full_ctl /begin FUNCTION_LIST R901.1.Diag_on_can_app_1_6_2 /end FUNCTION_LIST /end MEASUREMENT
/begin MEASUREMENT fCFAGBCLK "Agb clock error confirmed failure" UBYTE COMP_0283 1 100 0 1 BIT_MASK 0x0002 ECU_ADDRESS 0xFFFF4288 DISPLAY_IDENTIFIER Vbx_cf_agb_clck /begin FUNCTION_LIST R902.1.SafetyDiagManager_1_3_6 /end FUNCTION_LIST /end MEASUREMENT
/begin MEASUREMENT fCFAGBDLY "Maximum delay which can be used by agb for a toque request : confirmed failure" UBYTE COMP_0283 1 100 0 1 BIT_MASK 0x0001 ECU_ADDRESS 0xFFFF4288 DISPLAY_IDENTIFIER Vbx_cf_agb_dly_out /begin FUNCTION_LIST R902.1.SafetyDiagManager_1_3_6 /end FUNCTION_LIST /end MEASUREMENT
/begin MEASUREMENT fCFAGBINT "Memorized failure : integrator threshold of gearbox fast-acting torque value has been crossed" UBYTE COMP_0283 1 100 0 1 BIT_MASK 0x0080 ECU_ADDRESS 0xFFFF4289 DISPLAY_IDENTIFIER Vbx_cf_int_agb_tq_max /begin FUNCTION_LIST R902.1.SafetyDiagManager_1_3_6 /end FUNCTION_LIST /end MEASUREMENT
/begin MEASUREMENT fCFAGBLNK "Boolean indicating if the failure lost of communication is memorized" UBYTE COMP_0283 1 100 0 1 BIT_MASK 0x0040 ECU_ADDRESS 0xFFFF4289 DISPLAY_IDENTIFIER Vbx_cf_agb_lk /begin FUNCTION_LIST R902.1.SafetyDiagManager_1_3_6 R902.2.DiagMiscell_1_3_5 /end FUNCTION_LIST /end MEASUREMENT
/begin MEASUREMENT fCFAPSC1 "Confirmed failure of accelerator pedal safety case (N Åã 1) (reversible downgraded mode)" UBYTE COMP_0283 1 100 0 1 BIT_MASK 0x0010 ECU_ADDRESS 0xFFFF4289 DISPLAY_IDENTIFIER Vbx_cf_acel_pdl_secu_1 /begin FUNCTION_LIST R902.1.SafetyDiagManager_1_3_6 /end FUNCTION_LIST /end MEASUREMENT
/begin MEASUREMENT fCFBRKCMP "Incoherence between brake informations confirmed failure" UBYTE COMP_0283 1 100 0 1 BIT_MASK 0x0008 ECU_ADDRESS 0xFFFF4289 DISPLAY_IDENTIFIER Vbx_cf_brk_pdl_cmp /begin FUNCTION_LIST R902.1.SafetyDiagManager_1_3_6 /end FUNCTION_LIST /end MEASUREMENT
/begin MEASUREMENT fCFCLSW "Confirmed failure of clutch switch" UBYTE COMP_0283 1 100 0 1 BIT_MASK 0x0004 ECU_ADDRESS 0xFFFF4289 /begin FUNCTION_LIST R902.1.SafetyDiagManager_1_3_6 /end FUNCTION_LIST /end MEASUREMENT
/begin MEASUREMENT fCFCLUCMP "Incoherence between clutch information confirmed failure" UBYTE COMP_0283 1 100 0 1 BIT_MASK 0x0002 ECU_ADDRESS 0xFFFF4289 DISPLAY_IDENTIFIER Vbx_cf_bgin_clu_cmp /begin FUNCTION_LIST R902.1.SafetyDiagManager_1_3_6 /end FUNCTION_LIST /end MEASUREMENT
/begin MEASUREMENT fCFCRUCMP "Incoherence between braking and cruise control activation confirmed failure" UBYTE COMP_0283 1 100 0 1 BIT_MASK 0x0001 ECU_ADDRESS 0xFFFF4289 DISPLAY_IDENTIFIER Sbx_cf_cru_cmp /begin FUNCTION_LIST R902.1.SafetyDiagManager_1_3_6 /end FUNCTION_LIST /end MEASUREMENT
/begin MEASUREMENT fCFCSTOT "CC/SL not available : confirmed failure" UBYTE COMP_0283 1 100 0 1 BIT_MASK 0x0080 ECU_ADDRESS 0xFFFF428A DISPLAY_IDENTIFIER Sbx_cf_cru_sl_tot /begin FUNCTION_LIST R902.1.SafetyDiagManager_1_3_6 /end FUNCTION_LIST /end MEASUREMENT
/begin MEASUREMENT fCFESPCLK "ESP clock error confirmed failure" UBYTE COMP_0283 1 100 0 1 BIT_MASK 0x0040 ECU_ADDRESS 0xFFFF428A DISPLAY_IDENTIFIER Vbx_cf_asr_msr_clck /begin FUNCTION_LIST R902.1.SafetyDiagManager_1_3_6 /end FUNCTION_LIST /end MEASUREMENT
/begin MEASUREMENT fCFESPCPL "ESP complement error confirmed between ASR and MSR data" UBYTE COMP_0283 1 100 0 1 BIT_MASK 0x0020 ECU_ADDRESS 0xFFFF428A DISPLAY_IDENTIFIER Vbx_cf_asr_msr_cpl /begin FUNCTION_LIST R902.1.SafetyDiagManager_1_3_6 /end FUNCTION_LIST /end MEASUREMENT
/begin MEASUREMENT fCFESPLNK "ASR/MSR link confirmed failure" UBYTE COMP_0283 1 100 0 1 BIT_MASK 0x0010 ECU_ADDRESS 0xFFFF428A DISPLAY_IDENTIFIER Vbx_cf_asr_msr_lk /begin FUNCTION_LIST R902.1.SafetyDiagManager_1_3_6 /end FUNCTION_LIST /end MEASUREMENT
/begin MEASUREMENT fCFVSCMP "NO. coherence between displayed speed and real speed : confirmed failure" UBYTE COMP_0283 1 100 0 1 BIT_MASK 0x0001 ECU_ADDRESS 0xFFFF428A DISPLAY_IDENTIFIER Sbx_cf_cru_vs_cmp /begin FUNCTION_LIST R902.1.SafetyDiagManager_1_3_6 /end FUNCTION_LIST /end MEASUREMENT
/begin MEASUREMENT fDCATIF "Integral freeze flag for diagnostic cycle" UBYTE COMP_0283 1 100 0 1 BIT_MASK 0x0010 ECU_ADDRESS 0xFFFF4292 /begin FUNCTION_LIST Rxxx.1.Diagnostic_cycle_1_0_1 /end FUNCTION_LIST /end MEASUREMENT
/begin MEASUREMENT fDCATIR "Integral reset flag for diagnostic cycle" UBYTE COMP_0283 1 100 0 1 BIT_MASK 0x0008 ECU_ADDRESS 0xFFFF4292 /begin FUNCTION_LIST Rxxx.1.Diagnostic_cycle_1_0_1 /end FUNCTION_LIST /end MEASUREMENT
/begin MEASUREMENT fDCATTQH "Diagnostic cycle target torque too high" UBYTE COMP_0283 1 100 0 1 BIT_MASK 0x0004 ECU_ADDRESS 0xFFFF4292 /begin FUNCTION_LIST Rxxx.1.Diagnostic_cycle_1_0_1 /end FUNCTION_LIST /end MEASUREMENT
/begin MEASUREMENT fDCATTQL "Diagnostic cycle target torque too low" UBYTE COMP_0283 1 100 0 1 BIT_MASK 0x0002 ECU_ADDRESS 0xFFFF4292 /begin FUNCTION_LIST Rxxx.1.Diagnostic_cycle_1_0_1 /end FUNCTION_LIST /end MEASUREMENT
/begin MEASUREMENT fENGAUTML "Boolean indicating that the engine is in autonomous functioning" UBYTE COMP_0283 1 100 0 1 BIT_MASK 0x0010 ECU_ADDRESS 0xFFFF429D DISPLAY_IDENTIFIER Vbx_aut_eng_mil /begin FUNCTION_LIST R903.1.milmgtx_1_0_2 /end FUNCTION_LIST /end MEASUREMENT
/begin MEASUREMENT fFOWOFDL "After #FOWCOF=10, delay flag" UBYTE COMP_0283 1 100 0 1 BIT_MASK 0x0040 ECU_ADDRESS 0xFFFF42BC /begin FUNCTION_LIST R301.23.ADV_calculation_1_1_2 /end FUNCTION_LIST /end MEASUREMENT
/begin MEASUREMENT fGOVSW "MGOV map select flag" UBYTE COMP_0283 1 100 0 1 BIT_MASK 0x0010 ECU_ADDRESS 0xFFFF42C5 /begin FUNCTION_LIST R301.25.GOV_idle_1_0_2 /end FUNCTION_LIST /end MEASUREMENT
/begin MEASUREMENT fLEDONREQ "MIL Engine illumination gobal request status" UBYTE COMP_0283 1 100 0 1 BIT_MASK 0x0001 ECU_ADDRESS 0xFFFF42CB DISPLAY_IDENTIFIER Vbx_mil_ecu_req /begin FUNCTION_LIST R902.2.DiagMiscell_1_3_5 /end FUNCTION_LIST /end MEASUREMENT
/begin MEASUREMENT fMFAGBCLK "Agb clock error memorized" UBYTE COMP_0283 1 100 0 1 BIT_MASK 0x0002 ECU_ADDRESS 0xFFFF42CF DISPLAY_IDENTIFIER Vbx_mf_agb_clck /begin FUNCTION_LIST R902.1.SafetyDiagManager_1_3_6 /end FUNCTION_LIST /end MEASUREMENT
/begin MEASUREMENT fMFAGBDLY "Maximum delay which can be used by agb for a toque request : memorized failure" UBYTE COMP_0283 1 100 0 1 BIT_MASK 0x0001 ECU_ADDRESS 0xFFFF42CF DISPLAY_IDENTIFIER Vbx_mf_agb_dly_out /begin FUNCTION_LIST R902.1.SafetyDiagManager_1_3_6 /end FUNCTION_LIST /end MEASUREMENT
/begin MEASUREMENT fMFAGBINT "the threshold    for integration of gearbox fast-acting torque value has been memorized as exceeded" UBYTE COMP_0283 1 100 0 1 BIT_MASK 0x0080 ECU_ADDRESS 0xFFFF42D0 DISPLAY_IDENTIFIER Vbx_mf_int_agb_tq_max /begin FUNCTION_LIST R902.1.SafetyDiagManager_1_3_6 /end FUNCTION_LIST /end MEASUREMENT
/begin MEASUREMENT fMFAGBLNK "AGB link memorized failure" UBYTE COMP_0283 1 100 0 1 BIT_MASK 0x0040 ECU_ADDRESS 0xFFFF42D0 DISPLAY_IDENTIFIER Vbx_mf_agb_lk /begin FUNCTION_LIST R902.1.SafetyDiagManager_1_3_6 /end FUNCTION_LIST /end MEASUREMENT
/begin MEASUREMENT fMFAP12 "Memorized failure of accelerator pedal (loss of the TWO tracks)" UBYTE COMP_0283 1 100 0 1 BIT_MASK 0x0010 ECU_ADDRESS 0xFFFF42D0 DISPLAY_IDENTIFIER Vbx_mf_acel_pdl_tot /begin FUNCTION_LIST R902.1.SafetyDiagManager_1_3_6 /end FUNCTION_LIST /end MEASUREMENT
/begin MEASUREMENT fMFAPCHR "Memorized failure of accelerator pedal consistency" UBYTE COMP_0283 1 100 0 1 BIT_MASK 0x0008 ECU_ADDRESS 0xFFFF42D0 DISPLAY_IDENTIFIER Vbx_mf_acel_pdl_chr /begin FUNCTION_LIST R902.1.SafetyDiagManager_1_3_6 /end FUNCTION_LIST /end MEASUREMENT
/begin MEASUREMENT fMFAPMUX "Memorized failure : invalid value of    the alternator power transmitted by the USM." UBYTE COMP_0283 1 100 0 1 BIT_MASK 0x0004 ECU_ADDRESS 0xFFFF42D0 DISPLAY_IDENTIFIER Vbx_mf_usm_alt_pow_nok /begin FUNCTION_LIST R902.1.SafetyDiagManager_1_3_6 /end FUNCTION_LIST /end MEASUREMENT
/begin MEASUREMENT fMFAPSC "Memorized failure of accelerator pedal safety case (N Åã 2) (irreversible downgraded mode)" UBYTE COMP_0283 1 100 0 1 BIT_MASK 0x0002 ECU_ADDRESS 0xFFFF42D0 DISPLAY_IDENTIFIER Vbx_mf_acel_pdl_secu /begin FUNCTION_LIST R902.1.SafetyDiagManager_1_3_6 /end FUNCTION_LIST /end MEASUREMENT
/begin MEASUREMENT fMFAPSC1 "Memorized failure of accelerator pedal safety case N Åã 1 (reversible downgraded mode)" UBYTE COMP_0283 1 100 0 1 BIT_MASK 0x0001 ECU_ADDRESS 0xFFFF42D0 DISPLAY_IDENTIFIER Vbx_mf_acel_pdl_secu_1 /begin FUNCTION_LIST R902.1.SafetyDiagManager_1_3_6 /end FUNCTION_LIST /end MEASUREMENT
/begin MEASUREMENT fMFAPSOC1 "Memorized failure of accelerator pedal track 1 open circuit" UBYTE COMP_0283 1 100 0 1 BIT_MASK 0x0080 ECU_ADDRESS 0xFFFF42D1 DISPLAY_IDENTIFIER Vbx_mf_acel_pdl_oc_v1 /begin FUNCTION_LIST R902.1.SafetyDiagManager_1_3_6 /end FUNCTION_LIST /end MEASUREMENT
/begin MEASUREMENT fMFAPSOC2 "Memorized failure of accelerator pedal track 2 open circuit" UBYTE COMP_0283 1 100 0 1 BIT_MASK 0x0040 ECU_ADDRESS 0xFFFF42D1 DISPLAY_IDENTIFIER Vbx_mf_acel_pdl_oc_v2 /begin FUNCTION_LIST R902.1.SafetyDiagManager_1_3_6 /end FUNCTION_LIST /end MEASUREMENT
/begin MEASUREMENT fMFAPSSC1 "Memorized failure of accelerator pedal track 1 short circuit" UBYTE COMP_0283 1 100 0 1 BIT_MASK 0x0020 ECU_ADDRESS 0xFFFF42D1 DISPLAY_IDENTIFIER Vbx_mf_acel_pdl_sc_v1 /begin FUNCTION_LIST R902.1.SafetyDiagManager_1_3_6 /end FUNCTION_LIST /end MEASUREMENT
/begin MEASUREMENT fMFAPSSC2 "Memorized failure of accelerator pedal track 2 short circuit" UBYTE COMP_0283 1 100 0 1 BIT_MASK 0x0010 ECU_ADDRESS 0xFFFF42D1 DISPLAY_IDENTIFIER Vbx_mf_acel_pdl_sc_v2 /begin FUNCTION_LIST R902.1.SafetyDiagManager_1_3_6 /end FUNCTION_LIST /end MEASUREMENT
/begin MEASUREMENT fMFAVCC1 "Confirmed failure of power supply 1 (accelerator pedal track 1)" UBYTE COMP_0283 1 100 0 1 BIT_MASK 0x0008 ECU_ADDRESS 0xFFFF42D1 DISPLAY_IDENTIFIER Vbx_mf_pws_1 /begin FUNCTION_LIST R902.1.SafetyDiagManager_1_3_6 /end FUNCTION_LIST /end MEASUREMENT
/begin MEASUREMENT fMFAVCC2 "Memorized failure of power supply 2 (accelerator pedal track 2)" UBYTE COMP_0283 1 100 0 1 BIT_MASK 0x0004 ECU_ADDRESS 0xFFFF42D1 DISPLAY_IDENTIFIER Vbx_mf_pws_2 /begin FUNCTION_LIST R902.1.SafetyDiagManager_1_3_6 /end FUNCTION_LIST /end MEASUREMENT
/begin MEASUREMENT fMFBRKCMP "Incoherence between brake informations memorized failure" UBYTE COMP_0283 1 100 0 1 BIT_MASK 0x0002 ECU_ADDRESS 0xFFFF42D1 DISPLAY_IDENTIFIER Vbx_mf_brk_pdl_cmp /begin FUNCTION_LIST R902.1.SafetyDiagManager_1_3_6 /end FUNCTION_LIST /end MEASUREMENT
/begin MEASUREMENT fMFCLSW "Memorized failure : clutch switch" UBYTE COMP_0283 1 100 0 1 BIT_MASK 0x0040 ECU_ADDRESS 0xFFFF42D2 /begin FUNCTION_LIST R902.1.SafetyDiagManager_1_3_6 /end FUNCTION_LIST /end MEASUREMENT
/begin MEASUREMENT fMFCLUCMP "Incoherence between clutch information memorized failure" UBYTE COMP_0283 1 100 0 1 BIT_MASK 0x0020 ECU_ADDRESS 0xFFFF42D2 DISPLAY_IDENTIFIER Vbx_mf_bgin_clu_cmp /begin FUNCTION_LIST R902.1.SafetyDiagManager_1_3_6 /end FUNCTION_LIST /end MEASUREMENT
/begin MEASUREMENT fMFCRUCMP "Incoherence between braking and cruise control activation memorized failure" UBYTE COMP_0283 1 100 0 1 BIT_MASK 0x0010 ECU_ADDRESS 0xFFFF42D2 DISPLAY_IDENTIFIER Sbx_mf_cru_cmp /begin FUNCTION_LIST R902.1.SafetyDiagManager_1_3_6 /end FUNCTION_LIST /end MEASUREMENT
/begin MEASUREMENT fMFCSCHR "CCSL main switch coherence stored memorized failure" UBYTE COMP_0283 1 100 0 1 BIT_MASK 0x0008 ECU_ADDRESS 0xFFFF42D2 DISPLAY_IDENTIFIER Sbx_mf_cru_sl_swi_chr /begin FUNCTION_LIST R902.1.SafetyDiagManager_1_3_6 /end FUNCTION_LIST /end MEASUREMENT
/begin MEASUREMENT fMFCSNOK "CCSL steering wheel switches blocked button stored memorized failure" UBYTE COMP_0283 1 100 0 1 BIT_MASK 0x0004 ECU_ADDRESS 0xFFFF42D2 DISPLAY_IDENTIFIER Sbx_mf_cru_whl_cmd_nok /begin FUNCTION_LIST R902.1.SafetyDiagManager_1_3_6 /end FUNCTION_LIST /end MEASUREMENT
/begin MEASUREMENT fMFCSOCS "CCSL steering wheel switches open circuit stored memorized failure" UBYTE COMP_0283 1 100 0 1 BIT_MASK 0x0002 ECU_ADDRESS 0xFFFF42D2 DISPLAY_IDENTIFIER Sbx_mf_cru_whl_cmd_oc_scw /begin FUNCTION_LIST R902.1.SafetyDiagManager_1_3_6 /end FUNCTION_LIST /end MEASUREMENT
/begin MEASUREMENT fMFCSOOR "CCSL steering wheel switches invalid value stored memorized failure" UBYTE COMP_0283 1 100 0 1 BIT_MASK 0x0001 ECU_ADDRESS 0xFFFF42D2 DISPLAY_IDENTIFIER Sbx_mf_cru_whl_cmd_oor /begin FUNCTION_LIST R902.1.SafetyDiagManager_1_3_6 /end FUNCTION_LIST /end MEASUREMENT
/begin MEASUREMENT fMFCSTOT "CC/SL not available : memorized failure" UBYTE COMP_0283 1 100 0 1 BIT_MASK 0x0080 ECU_ADDRESS 0xFFFF42D3 DISPLAY_IDENTIFIER Sbx_mf_cru_sl_tot /begin FUNCTION_LIST R902.1.SafetyDiagManager_1_3_6 /end FUNCTION_LIST /end MEASUREMENT
/begin MEASUREMENT fMFESPCLK "ESP clock error memorized" UBYTE COMP_0283 1 100 0 1 BIT_MASK 0x0040 ECU_ADDRESS 0xFFFF42D3 DISPLAY_IDENTIFIER Vbx_mf_asr_msr_clck /begin FUNCTION_LIST R902.1.SafetyDiagManager_1_3_6 /end FUNCTION_LIST /end MEASUREMENT
/begin MEASUREMENT fMFESPCPL "ESP complement error memorized between ASR and MSR data" UBYTE COMP_0283 1 100 0 1 BIT_MASK 0x0020 ECU_ADDRESS 0xFFFF42D3 DISPLAY_IDENTIFIER Vbx_mf_asr_msr_cpl /begin FUNCTION_LIST R902.1.SafetyDiagManager_1_3_6 /end FUNCTION_LIST /end MEASUREMENT
/begin MEASUREMENT fMFESPLNK "ASR/MSR link memorized failure" UBYTE COMP_0283 1 100 0 1 BIT_MASK 0x0010 ECU_ADDRESS 0xFFFF42D3 DISPLAY_IDENTIFIER Vbx_mf_asr_msr_lk /begin FUNCTION_LIST R902.1.SafetyDiagManager_1_3_6 /end FUNCTION_LIST /end MEASUREMENT
/begin MEASUREMENT fMFUPCRCV "Memorized failure : USM fast frame reception" UBYTE COMP_0283 1 100 0 1 BIT_MASK 0x0010 ECU_ADDRESS 0xFFFF42D4 DISPLAY_IDENTIFIER Vbx_mf_usm_rcpt /begin FUNCTION_LIST R902.1.SafetyDiagManager_1_3_6 /end FUNCTION_LIST /end MEASUREMENT
/begin MEASUREMENT fMILFLSH "MIL flashing request status" UBYTE COMP_0283 1 100 0 1 BIT_MASK 0x0080 ECU_ADDRESS 0xFFFF42D5 DISPLAY_IDENTIFIER Vbx_mil_flsh_req /begin FUNCTION_LIST R902.2.DiagMiscell_1_3_5 R903.1.milmgtx_1_0_2 /end FUNCTION_LIST /end MEASUREMENT
/begin MEASUREMENT fMILPRMT "MIL illumination gobal request status" UBYTE COMP_0283 1 100 0 1 BIT_MASK 0x0020 ECU_ADDRESS 0xFFFF42D5 DISPLAY_IDENTIFIER Vbx_mil_prmt_req /begin FUNCTION_LIST R902.2.DiagMiscell_1_3_5 R903.1.milmgtx_1_0_2 /end FUNCTION_LIST /end MEASUREMENT
/begin MEASUREMENT fOBDRDN "All readiness codes completion status flag" UBYTE COMP_0283 1 100 0 1 BIT_MASK 0x0004 ECU_ADDRESS 0xFFFF42DA DISPLAY_IDENTIFIER Vbx_obd_rdn_full /begin FUNCTION_LIST R902.2.DiagMiscell_1_3_5 R903.1.milmgtx_1_0_2 /end FUNCTION_LIST /end MEASUREMENT
/begin MEASUREMENT fROMNGF "ROM diagnosis the first time NG flag" UBYTE COMP_0283 1 100 0 1 BIT_MASK 0x0004 ECU_ADDRESS 0xFFFF42EA /begin FUNCTION_LIST R301.24.RomDiagnosis_1_0_1 /end FUNCTION_LIST /end MEASUREMENT
/begin MEASUREMENT fSADOC "Authorization flag to start the Static Automatic Diagnosis Of the Catalyst" UBYTE COMP_0283 1 100 0 1 BIT_MASK 0x0020 ECU_ADDRESS 0xFFFF42EC
 /begin FUNCTION_LIST Rxxx.1.Diagnostic_cycle_1_0_1 Rxxx.2.Integration_Diagnostic_cycle_1_1_1 /end FUNCTION_LIST
/end MEASUREMENT
/begin MEASUREMENT fSSAPSC "Accelerator pedal safety case N Åã 2 detected failure counter saturation state" UBYTE COMP_0283 1 100 0 1 BIT_MASK 0x0020 ECU_ADDRESS 0xFFFF42EE DISPLAY_IDENTIFIER Vbx_dfctr_sat_acel_pdl_secu /begin FUNCTION_LIST R902.1.SafetyDiagManager_1_3_6 /end FUNCTION_LIST /end MEASUREMENT
/begin MEASUREMENT fSSAPSC1 "Accelerator pedal safety case N Åã 1 detected failure counter saturation state" UBYTE COMP_0283 1 100 0 1 BIT_MASK 0x0010 ECU_ADDRESS 0xFFFF42EE DISPLAY_IDENTIFIER Vbx_dfctr_sat_acel_pdl_secu_1 /begin FUNCTION_LIST R902.1.SafetyDiagManager_1_3_6 /end FUNCTION_LIST /end MEASUREMENT
/begin MEASUREMENT fSSBRKCMP "Saturating boolean for failure manager call in case of brake incoherence failure" UBYTE COMP_0283 1 100 0 1 BIT_MASK 0x0008 ECU_ADDRESS 0xFFFF42EE DISPLAY_IDENTIFIER Vbx_dfctr_sat_brk_pdl_cmp /begin FUNCTION_LIST R902.1.SafetyDiagManager_1_3_6 /end FUNCTION_LIST /end MEASUREMENT
/begin MEASUREMENT fSSCLUCMP "Saturating boolean for failure manager call in case of clutch incoherence failure" UBYTE COMP_0283 1 100 0 1 BIT_MASK 0x0004 ECU_ADDRESS 0xFFFF42EE DISPLAY_IDENTIFIER Vbx_dfctr_sat_bgin_clu_cmp /begin FUNCTION_LIST R902.1.SafetyDiagManager_1_3_6 /end FUNCTION_LIST /end MEASUREMENT
/begin MEASUREMENT fSSCRUCMP "Saturating boolean for failure manager call in case of cruise control safety failure" UBYTE COMP_0283 1 100 0 1 BIT_MASK 0x0002 ECU_ADDRESS 0xFFFF42EE DISPLAY_IDENTIFIER Vbx_dfctr_sat_cru_cmp /begin FUNCTION_LIST R902.1.SafetyDiagManager_1_3_6 /end FUNCTION_LIST /end MEASUREMENT
/begin MEASUREMENT fSSCSCHR "CCSL main switch coherence detected failure counter saturation state" UBYTE COMP_0283 1 100 0 1 BIT_MASK 0x0001 ECU_ADDRESS 0xFFFF42EE DISPLAY_IDENTIFIER Vbx_dfctr_sat_cru_sl_swi_chr /begin FUNCTION_LIST R902.1.SafetyDiagManager_1_3_6 /end FUNCTION_LIST /end MEASUREMENT
/begin MEASUREMENT fSSCSNOK "CCSL steering wheel switches blocked button detected failure counter saturation state" UBYTE COMP_0283 1 100 0 1 BIT_MASK 0x0080 ECU_ADDRESS 0xFFFF42EF DISPLAY_IDENTIFIER Vbx_dfctr_sat_cru_whl_cmd_nok /begin FUNCTION_LIST R902.1.SafetyDiagManager_1_3_6 /end FUNCTION_LIST /end MEASUREMENT
/begin MEASUREMENT fSSCSOCS "CCSL steering switches open circuit detected failure counter saturation state" UBYTE COMP_0283 1 100 0 1 BIT_MASK 0x0040 ECU_ADDRESS 0xFFFF42EF DISPLAY_IDENTIFIER Vbx_dfctr_sat_cru_whl_cmd_oc_scw /begin FUNCTION_LIST R902.1.SafetyDiagManager_1_3_6 /end FUNCTION_LIST /end MEASUREMENT
/begin MEASUREMENT fSSCSOOR "CCSL steering switches invalid value detected failure counter saturation state" UBYTE COMP_0283 1 100 0 1 BIT_MASK 0x0020 ECU_ADDRESS 0xFFFF42EF DISPLAY_IDENTIFIER Vbx_dfctr_sat_cru_whl_cmd_oor /begin FUNCTION_LIST R902.1.SafetyDiagManager_1_3_6 /end FUNCTION_LIST /end MEASUREMENT
/begin MEASUREMENT fSSCSTOT "CCSL common failure counter saturation state" UBYTE COMP_0283 1 100 0 1 BIT_MASK 0x0010 ECU_ADDRESS 0xFFFF42EF DISPLAY_IDENTIFIER Vbx_dfctr_sat_cru_sl_tot /begin FUNCTION_LIST R902.1.SafetyDiagManager_1_3_6 /end FUNCTION_LIST /end MEASUREMENT
/begin MEASUREMENT fSSPRSOC "Air conditioning pressure sensor open circuit detected failure counter saturation state" UBYTE COMP_0283 1 100 0 1 BIT_MASK 0x0002 ECU_ADDRESS 0xFFFF42EF DISPLAY_IDENTIFIER Vbx_dfctr_sat_ac_prs_oc /begin FUNCTION_LIST R902.1.SafetyDiagManager_1_3_6 /end FUNCTION_LIST /end MEASUREMENT
/begin MEASUREMENT fSSPRSSC "Air conditioning pressure sensor short circuit detected failure counter saturation state" UBYTE COMP_0283 1 100 0 1 BIT_MASK 0x0001 ECU_ADDRESS 0xFFFF42EF DISPLAY_IDENTIFIER Vbx_dfctr_sat_ac_prs_sc /begin FUNCTION_LIST R902.1.SafetyDiagManager_1_3_6 /end FUNCTION_LIST /end MEASUREMENT
/begin MEASUREMENT fSSVSCMP "CCSL mux vehicle speed Coherence detected failure counter saturation state" UBYTE COMP_0283 1 100 0 1 BIT_MASK 0x0080 ECU_ADDRESS 0xFFFF42F0 DISPLAY_IDENTIFIER Vbx_dfctr_sat_cru_vs_cmp /begin FUNCTION_LIST R902.1.SafetyDiagManager_1_3_6 /end FUNCTION_LIST /end MEASUREMENT
/begin MEASUREMENT fTQREQS01 "Torque request status set to 01b" UBYTE COMP_0283 1 100 0 1 BIT_MASK 0x0080 ECU_ADDRESS 0xFFFF42F5 DISPLAY_IDENTIFIER Vbx_tq_req_stt_01 /begin FUNCTION_LIST R902.2.DiagMiscell_1_3_5 /end FUNCTION_LIST /end MEASUREMENT
/begin MEASUREMENT fTQREQS10 "Torque request status set to 10b" UBYTE COMP_0283 1 100 0 1 BIT_MASK 0x0040 ECU_ADDRESS 0xFFFF42F5 DISPLAY_IDENTIFIER Vbx_tq_req_stt_10 /begin FUNCTION_LIST R902.2.DiagMiscell_1_3_5 /end FUNCTION_LIST /end MEASUREMENT
/begin MEASUREMENT fTQREQS11 "Torque request status set to 11b" UBYTE COMP_0283 1 100 0 1 BIT_MASK 0x0020 ECU_ADDRESS 0xFFFF42F5 DISPLAY_IDENTIFIER Vbx_tq_req_stt_11 /begin FUNCTION_LIST R902.2.DiagMiscell_1_3_5 /end FUNCTION_LIST /end MEASUREMENT
/begin MEASUREMENT fCLROBDDI "MODE4 service applicative flag" UBYTE COMP_0283 1 100 0 1 BIT_MASK 0x0040 ECU_ADDRESS 0xFFFF4316 DISPLAY_IDENTIFIER Event_obd_tool_cdi
 /begin FUNCTION_LIST R901.1.Diag_on_can_app_1_6_2 R902.1.SafetyDiagManager_1_3_6 R904.1.Gst_on_can_1_0_1 /end FUNCTION_LIST
/end MEASUREMENT
/begin MEASUREMENT fDFAGBDLY "Maximum delay which can be used by agb for a toque request" UBYTE COMP_0283 1 100 0 1 BIT_MASK 0x0080 ECU_ADDRESS 0xFFFF431A DISPLAY_IDENTIFIER Vbx_df_agb_dly_out /begin FUNCTION_LIST R902.1.SafetyDiagManager_1_3_6 /end FUNCTION_LIST /end MEASUREMENT
/begin MEASUREMENT fDFAGBINT "the threshold    for integration of gearbox fast-acting torque value has been exceeded" UBYTE COMP_0283 1 100 0 1 BIT_MASK 0x0040 ECU_ADDRESS 0xFFFF431A DISPLAY_IDENTIFIER Vbx_df_int_agb_tq_max /begin FUNCTION_LIST R902.1.SafetyDiagManager_1_3_6 /end FUNCTION_LIST /end MEASUREMENT
/begin MEASUREMENT fETAPROK "etat protege" UBYTE COMP_0283 1 100 0 1 BIT_MASK 0x0008 ECU_ADDRESS 0xFFFF4321 DISPLAY_IDENTIFIER Etapro /begin FUNCTION_LIST R901.1.Diag_on_can_app_1_6_2 /end FUNCTION_LIST /end MEASUREMENT
/begin MEASUREMENT fFTDIVAVL "Bit indicating that the Immobiliser diagnosis is available" UBYTE COMP_0283 1 100 0 1 BIT_MASK 0x0008 ECU_ADDRESS 0xFFFF4329 DISPLAY_IDENTIFIER Vbx_swlk_diag_avl /begin FUNCTION_LIST R901.1.Diag_on_can_app_1_6_2 /end FUNCTION_LIST /end MEASUREMENT
/begin MEASUREMENT fFTDIVCCU "Immobiliser diagnosis bit indicating that the engine isn' t running due to no BCM authorization" UBYTE COMP_0283 1 100 0 1 BIT_MASK 0x0004 ECU_ADDRESS 0xFFFF4329 DISPLAY_IDENTIFIER Vbx_swlk_diag_ccu /begin FUNCTION_LIST R901.1.Diag_on_can_app_1_6_2 /end FUNCTION_LIST /end MEASUREMENT
/begin MEASUREMENT fFTDIVECM "Immobiliser diagnosis bit indicating that the engine isn' t running due to ECM" UBYTE COMP_0283 1 100 0 1 BIT_MASK 0x0002 ECU_ADDRESS 0xFFFF4329 DISPLAY_IDENTIFIER Vbx_swlk_diag_ecm /begin FUNCTION_LIST R901.1.Diag_on_can_app_1_6_2 /end FUNCTION_LIST /end MEASUREMENT
/begin MEASUREMENT fFTDIVMUX "Immobiliser diagnosis bit indicating that the engine isn' t running due to a CAN network problem with BCM" UBYTE COMP_0283 1 100 0 1 BIT_MASK 0x0001 ECU_ADDRESS 0xFFFF4329 DISPLAY_IDENTIFIER Vbx_swlk_diag_mux /begin FUNCTION_LIST R901.1.Diag_on_can_app_1_6_2 /end FUNCTION_LIST /end MEASUREMENT
/begin MEASUREMENT fFTDIVTOL "Immobiliser diagnosis bit indicating that the engine isn' t running due to BCM secure mode" UBYTE COMP_0283 1 100 0 1 BIT_MASK 0x0080 ECU_ADDRESS 0xFFFF432A DISPLAY_IDENTIFIER Vbx_swlk_diag_tool /begin FUNCTION_LIST R901.1.Diag_on_can_app_1_6_2 /end FUNCTION_LIST /end MEASUREMENT
/begin MEASUREMENT fCATDGPM "Catalyst diagnosis permission flag" UBYTE COMP_0283 1 100 0 1 BIT_MASK 0x0080 ECU_ADDRESS 0xFFFF435E
 /begin FUNCTION_LIST R901.1.Diag_on_can_app_1_6_2 Rxxx.1.Diagnostic_cycle_1_0_1 Rxxx.2.Integration_Diagnostic_cycle_1_1_1 /end FUNCTION_LIST
/end MEASUREMENT
/begin MEASUREMENT fCATDGSC "Diagnostic cycle safety condition flag" UBYTE COMP_0283 1 100 0 1 BIT_MASK 0x0040 ECU_ADDRESS 0xFFFF435E
 /begin FUNCTION_LIST R901.1.Diag_on_can_app_1_6_2 Rxxx.1.Diagnostic_cycle_1_0_1 Rxxx.2.Integration_Diagnostic_cycle_1_1_1 /end FUNCTION_LIST
/end MEASUREMENT
/begin MEASUREMENT fGRAVITY1 "Engine default gravity 1" UBYTE COMP_0283 1 100 0 1 BIT_MASK 0x0004 ECU_ADDRESS 0xFFFF4366 /begin FUNCTION_LIST R902.2.DiagMiscell_1_3_5 /end FUNCTION_LIST /end MEASUREMENT
/begin MEASUREMENT fGRAVITY2 "Engine default gravity 2" UBYTE COMP_0283 1 100 0 1 BIT_MASK 0x0002 ECU_ADDRESS 0xFFFF4366 /begin FUNCTION_LIST R902.2.DiagMiscell_1_3_5 /end FUNCTION_LIST /end MEASUREMENT
/begin MEASUREMENT fLEDONR "MIL operation requirement" UBYTE COMP_0283 1 100 0 1 BIT_MASK 0x0080 ECU_ADDRESS 0xFFFF4367 /begin FUNCTION_LIST R902.2.DiagMiscell_1_3_5 /end FUNCTION_LIST /end MEASUREMENT
/begin MEASUREMENT fMFPRSOC "Air conditioning pressure sensor open circuit memorized failure" UBYTE COMP_0283 1 100 0 1 BIT_MASK 0x0008 ECU_ADDRESS 0xFFFF4367 DISPLAY_IDENTIFIER Sbx_mf_ac_prs_oc
 /begin FUNCTION_LIST R901.1.Diag_on_can_app_1_6_2 R902.1.SafetyDiagManager_1_3_6 /end FUNCTION_LIST
/end MEASUREMENT
/begin MEASUREMENT fMFPRSSC "Air conditioning pressure sensor short circuit memorized failure" UBYTE COMP_0283 1 100 0 1 BIT_MASK 0x0004 ECU_ADDRESS 0xFFFF4367 DISPLAY_IDENTIFIER Sbx_mf_ac_prs_sc
 /begin FUNCTION_LIST R901.1.Diag_on_can_app_1_6_2 R902.1.SafetyDiagManager_1_3_6 /end FUNCTION_LIST
/end MEASUREMENT
/begin MEASUREMENT fDATRANS "Steady/Transient detection control flag" UBYTE COMP_0283 1 100 0 1 BIT_MASK 0x0040 ECU_ADDRESS 0xFFFF246C /begin FUNCTION_LIST R301.23.ADV_calculation_1_1_2 /end FUNCTION_LIST /end MEASUREMENT
/begin MEASUREMENT fFCRADV "FCRADV flag" UBYTE COMP_0283 1 100 0 1 BIT_MASK 0x0010 ECU_ADDRESS 0xFFFF2478 /begin FUNCTION_LIST R301.23.ADV_calculation_1_1_2 /end FUNCTION_LIST /end MEASUREMENT
/begin MEASUREMENT fFPRON "Fuel pump relay flag" UBYTE COMP_0283 1 100 0 1 BIT_MASK 0x0080 ECU_ADDRESS 0xFFFF24D7 /begin FUNCTION_LIST R901.1.Diag_on_can_app_1_6_2 /end FUNCTION_LIST /end MEASUREMENT
/begin MEASUREMENT fFCNXPWST "-" UBYTE COMP_0283 1 100 0 1 BIT_MASK 0x0020 ECU_ADDRESS 0xFFFFB7EC /begin FUNCTION_LIST R301.27.PWST_detection_1_0_2 R901.1.Diag_on_can_app_1_6_2 /end FUNCTION_LIST /end MEASUREMENT
/begin MEASUREMENT vADAFHF "A/F H Front-AD" UWORD COMP_0023 1 100 0 327675 ECU_ADDRESS 0xFFFF1CBA /begin FUNCTION_LIST R901.1.Diag_on_can_app_1_6_2 /end FUNCTION_LIST /end MEASUREMENT
/begin MEASUREMENT vADAFHFL "A/F H Front-AD" UWORD COMP_0023 1 100 0 327675 ECU_ADDRESS 0xFFFF1CBC /begin FUNCTION_LIST R901.1.Diag_on_can_app_1_6_2 /end FUNCTION_LIST /end MEASUREMENT
/begin MEASUREMENT vADVBF "The ignition timing before addition of DLTADV" SWORD COMP_0078 1 100 -128 127.99609375 ECU_ADDRESS 0xFFFF10FE /begin FUNCTION_LIST R301.23.ADV_calculation_1_1_2 /end FUNCTION_LIST /end MEASUREMENT
/begin MEASUREMENT vADVBL2 "The ignition timing before a limiter 2" SWORD COMP_0078 1 100 -128 127.99609375 ECU_ADDRESS 0xFFFF1102 /begin FUNCTION_LIST R301.23.ADV_calculation_1_1_2 /end FUNCTION_LIST /end MEASUREMENT
/begin MEASUREMENT vADVLMT22 "The retard side maximum change width" UWORD COMP_0081 1 100 0 255.99609375 ECU_ADDRESS 0xFFFF1108 /begin FUNCTION_LIST R301.23.ADV_calculation_1_1_2 /end FUNCTION_LIST /end MEASUREMENT
/begin MEASUREMENT vAVTO "TO2M mean" UWORD COMP_0250 1 100 0 262140 ECU_ADDRESS 0xFFFF37CA /begin FUNCTION_LIST R901.1.Diag_on_can_app_1_6_2 /end FUNCTION_LIST /end MEASUREMENT
/begin MEASUREMENT vCKDWRE "The amount of ignition timing retard" UBYTE COMP_0017 1 100 0 255 ECU_ADDRESS 0xFFFF11E8 /begin FUNCTION_LIST R301.23.ADV_calculation_1_1_2 /end FUNCTION_LIST /end MEASUREMENT
/begin MEASUREMENT vCNTCAT "Catalyst diagnosis completion number of times counter" UBYTE COMP_0016 1 100 0 255 ECU_ADDRESS 0xFFFFB738 /begin FUNCTION_LIST R901.1.Diag_on_can_app_1_6_2 /end FUNCTION_LIST /end MEASUREMENT
/begin MEASUREMENT vCONFMUX1 "Carrier mux connection detection 1" UBYTE COMP_0004 1 100 0 255 ECU_ADDRESS 0xFFFF3AB9 /begin FUNCTION_LIST R901.1.Diag_on_can_app_1_6_2 /end FUNCTION_LIST /end MEASUREMENT
/begin MEASUREMENT vCONFMUX2 "Carrier mux connection detection 2" UBYTE COMP_0004 1 100 0 255 ECU_ADDRESS 0xFFFF3ABA /begin FUNCTION_LIST R901.1.Diag_on_can_app_1_6_2 /end FUNCTION_LIST /end MEASUREMENT
/begin MEASUREMENT vCONFMUX3 "Carrier mux connection detection 3" UBYTE COMP_0004 1 100 0 255 ECU_ADDRESS 0xFFFF3ABB /begin FUNCTION_LIST R901.1.Diag_on_can_app_1_6_2 /end FUNCTION_LIST /end MEASUREMENT
/begin MEASUREMENT vDCATI "Integral factor of speed regulator" UWORD COMP_0345_S 1 100 -400 1647.96875 ECU_ADDRESS 0xFFFF2A16 /begin FUNCTION_LIST Rxxx.1.Diagnostic_cycle_1_0_1 /end FUNCTION_LIST /end MEASUREMENT
/begin MEASUREMENT vDCATND "Difference factor of engine speed" SWORD COMP_0551_S 1 100 -32768 32767 ECU_ADDRESS 0xFFFF2A18 /begin FUNCTION_LIST Rxxx.1.Diagnostic_cycle_1_0_1 /end FUNCTION_LIST /end MEASUREMENT
/begin MEASUREMENT vDCATP "Proportional factor of speed regulator" UWORD COMP_0345_S 1 100 -400 1647.96875 ECU_ADDRESS 0xFFFF2A1A /begin FUNCTION_LIST Rxxx.1.Diagnostic_cycle_1_0_1 /end FUNCTION_LIST /end MEASUREMENT
/begin MEASUREMENT vDCATTQ "Diagnostic cycle target torque" UWORD COMP_0345_S 1 100 -400 1647.96875 ECU_ADDRESS 0xFFFF2A1E /begin FUNCTION_LIST Rxxx.1.Diagnostic_cycle_1_0_1 /end FUNCTION_LIST /end MEASUREMENT
/begin MEASUREMENT vDCATTQ0 "Diagnostic cycle basic target torque" UWORD COMP_0345_S 1 100 -400 1647.96875 ECU_ADDRESS 0xFFFF2A20 /begin FUNCTION_LIST Rxxx.1.Diagnostic_cycle_1_0_1 /end FUNCTION_LIST /end MEASUREMENT
/begin MEASUREMENT vDLRAPOX "Delta of main and sub calculation (APOXNG)" UWORD COMP_0451_S 1 100 0 81.91875 ECU_ADDRESS 0xFFFF2A56 /begin FUNCTION_LIST R301.21.SafetyLevel2_1_0_2 /end FUNCTION_LIST /end MEASUREMENT
/begin MEASUREMENT vDLRASTR "Delta of main and sub calculation (ASTRNG)" UWORD COMP_0451_S 1 100 0 81.91875 ECU_ADDRESS 0xFFFF2A58 /begin FUNCTION_LIST R301.21.SafetyLevel2_1_0_2 /end FUNCTION_LIST /end MEASUREMENT
/begin MEASUREMENT vDLRDTSP "Delta of main and sub calculation (DTSPNG)" UWORD COMP_0470_S 1 100 0 2047.96875 ECU_ADDRESS 0xFFFF2A5A /begin FUNCTION_LIST R301.21.SafetyLevel2_1_0_2 /end FUNCTION_LIST /end MEASUREMENT
/begin MEASUREMENT vDLRTTEP "Delta of main and sub calculation (TTEPNG)" UWORD COMP_0470_S 1 100 0 2047.96875 ECU_ADDRESS 0xFFFF2A5C /begin FUNCTION_LIST R301.21.SafetyLevel2_1_0_2 /end FUNCTION_LIST /end MEASUREMENT
/begin MEASUREMENT vETADGCY "Diagnostic cycle status" UBYTE COMP_0068 1 100 0 255 ECU_ADDRESS 0xFFFF41EF /begin FUNCTION_LIST R901.1.Diag_on_can_app_1_6_2 Rxxx.1.Diagnostic_cycle_1_0_1 /end FUNCTION_LIST /end MEASUREMENT
/begin MEASUREMENT vFCAGBCLK "Failure confirmation counter of lost of communication" UBYTE COMP_0068 1 100 0 255 ECU_ADDRESS 0xFFFF2CFB /begin FUNCTION_LIST R902.1.SafetyDiagManager_1_3_6 /end FUNCTION_LIST /end MEASUREMENT
/begin MEASUREMENT vFCAGBDLY "Failure confirmation counter of Maximum delay which can be used by agb for a toque request has been crossed" UBYTE COMP_0068 1 100 0 255 ECU_ADDRESS 0xFFFF2CFC /begin FUNCTION_LIST R902.1.SafetyDiagManager_1_3_6 /end FUNCTION_LIST /end MEASUREMENT
/begin MEASUREMENT vFCAGBINT "Failure confirmation counter of the threshold for integration of gearbox fast-acting torque value has been exceeded" UBYTE COMP_0068 1 100 0 255 ECU_ADDRESS 0xFFFF2CFD /begin FUNCTION_LIST R902.1.SafetyDiagManager_1_3_6 /end FUNCTION_LIST /end MEASUREMENT
/begin MEASUREMENT vFCAGBLNK "Failure confirmation counter of ESP conplement failure" UBYTE COMP_0068 1 100 0 255 ECU_ADDRESS 0xFFFF2CFE /begin FUNCTION_LIST R902.1.SafetyDiagManager_1_3_6 /end FUNCTION_LIST /end MEASUREMENT
/begin MEASUREMENT vFCAP12 "Failure confirmation counter of accelerator pedal" UBYTE COMP_0068 1 100 0 255 ECU_ADDRESS 0xFFFF2D01 /begin FUNCTION_LIST R902.1.SafetyDiagManager_1_3_6 /end FUNCTION_LIST /end MEASUREMENT
/begin MEASUREMENT vFCAPCHR "Failure confirmation counter of accelerator pedal consistency" UBYTE COMP_0068 1 100 0 255 ECU_ADDRESS 0xFFFF2D02 /begin FUNCTION_LIST R902.1.SafetyDiagManager_1_3_6 /end FUNCTION_LIST /end MEASUREMENT
/begin MEASUREMENT vFCAPMUX "Failure confirmation counter of invalid value of the alternator power transmitted by the USM" UBYTE COMP_0068 1 100 0 255 ECU_ADDRESS 0xFFFF2D03 /begin FUNCTION_LIST R902.1.SafetyDiagManager_1_3_6 /end FUNCTION_LIST /end MEASUREMENT
/begin MEASUREMENT vFCAPSC "Failure confirmation counter of accelerator pedal safety case (N Åã 2) (irreversible downgraded mode)" UBYTE COMP_0068 1 100 0 255 ECU_ADDRESS 0xFFFF2D04 /begin FUNCTION_LIST R902.1.SafetyDiagManager_1_3_6 /end FUNCTION_LIST /end MEASUREMENT
/begin MEASUREMENT vFCAPSC1 "Accelerator pedal safety case N Åã 1" UBYTE COMP_0068 1 100 0 255 ECU_ADDRESS 0xFFFF2D05 /begin FUNCTION_LIST R902.1.SafetyDiagManager_1_3_6 /end FUNCTION_LIST /end MEASUREMENT
/begin MEASUREMENT vFCAPSOC1 "Failure confirmation counter of accelerator pedal track 1 open circuit" UBYTE COMP_0068 1 100 0 255 ECU_ADDRESS 0xFFFF2D06 /begin FUNCTION_LIST R902.1.SafetyDiagManager_1_3_6 /end FUNCTION_LIST /end MEASUREMENT
/begin MEASUREMENT vFCAPSOC2 "Failure confirmation counter of accelerator pedal track 1 short circuit" UBYTE COMP_0068 1 100 0 255 ECU_ADDRESS 0xFFFF2D07 /begin FUNCTION_LIST R902.1.SafetyDiagManager_1_3_6 /end FUNCTION_LIST /end MEASUREMENT
/begin MEASUREMENT vFCAPSSC1 "Failure confirmation counter of accelerator pedal track 2 open circuit" UBYTE COMP_0068 1 100 0 255 ECU_ADDRESS 0xFFFF2D08 /begin FUNCTION_LIST R902.1.SafetyDiagManager_1_3_6 /end FUNCTION_LIST /end MEASUREMENT
/begin MEASUREMENT vFCAPSSC2 "Failure confirmation counter of accelerator pedal track 2 short circuit" UBYTE COMP_0068 1 100 0 255 ECU_ADDRESS 0xFFFF2D09 /begin FUNCTION_LIST R902.1.SafetyDiagManager_1_3_6 /end FUNCTION_LIST /end MEASUREMENT
/begin MEASUREMENT vFCAVCC1 "Failure confirmation counter of power supply 1 (accelerator pedal track 1)" UBYTE COMP_0068 1 100 0 255 ECU_ADDRESS 0xFFFF2D14 /begin FUNCTION_LIST R902.1.SafetyDiagManager_1_3_6 /end FUNCTION_LIST /end MEASUREMENT
/begin MEASUREMENT vFCAVCC2 "Failure confirmation counter of power supply 2 (accelerator pedal track 2)" UBYTE COMP_0068 1 100 0 255 ECU_ADDRESS 0xFFFF2D15 /begin FUNCTION_LIST R902.1.SafetyDiagManager_1_3_6 /end FUNCTION_LIST /end MEASUREMENT
/begin MEASUREMENT vFCBRKCMP "Failure confirmation counter of Incoherence between brake information" UBYTE COMP_0068 1 100 0 255 ECU_ADDRESS 0xFFFF2D16 /begin FUNCTION_LIST R902.1.SafetyDiagManager_1_3_6 /end FUNCTION_LIST /end MEASUREMENT
/begin MEASUREMENT vFCCLSW "Failure confirmation counter of clutch switch" UBYTE COMP_0068 1 100 0 255 ECU_ADDRESS 0xFFFF2D17 /begin FUNCTION_LIST R902.1.SafetyDiagManager_1_3_6 /end FUNCTION_LIST /end MEASUREMENT
/begin MEASUREMENT vFCCLUCMP "Failure confirmation counter of Incoherence between clutch information" UBYTE COMP_0068 1 100 0 255 ECU_ADDRESS 0xFFFF2D18 /begin FUNCTION_LIST R902.1.SafetyDiagManager_1_3_6 /end FUNCTION_LIST /end MEASUREMENT
/begin MEASUREMENT vFCCRUCMP "Failure confirmation counter of CC safety" UBYTE COMP_0068 1 100 0 255 ECU_ADDRESS 0xFFFF2D19 /begin FUNCTION_LIST R902.1.SafetyDiagManager_1_3_6 /end FUNCTION_LIST /end MEASUREMENT
/begin MEASUREMENT vFCCSCHR "counter of Cruise Control Main Switch Coherence" UBYTE COMP_0068 1 100 0 255 ECU_ADDRESS 0xFFFF2D1A /begin FUNCTION_LIST R902.1.SafetyDiagManager_1_3_6 /end FUNCTION_LIST /end MEASUREMENT
/begin MEASUREMENT vFCCSNOK "Failure confirmation counter of CCSL Steering Wheel Command Switch blocked button" UBYTE COMP_0068 1 100 0 255 ECU_ADDRESS 0xFFFF2D1B /begin FUNCTION_LIST R902.1.SafetyDiagManager_1_3_6 /end FUNCTION_LIST /end MEASUREMENT
/begin MEASUREMENT vFCCSOCS "Failure confirmation counter of CCSL Steering Wheel Command Switch open circuit" UBYTE COMP_0068 1 100 0 255 ECU_ADDRESS 0xFFFF2D1C /begin FUNCTION_LIST R902.1.SafetyDiagManager_1_3_6 /end FUNCTION_LIST /end MEASUREMENT
/begin MEASUREMENT vFCCSOOR "Failure confirmation counter of CCSL Steering Wheel Command Switch invalid value" UBYTE COMP_0068 1 100 0 255 ECU_ADDRESS 0xFFFF2D1D /begin FUNCTION_LIST R902.1.SafetyDiagManager_1_3_6 /end FUNCTION_LIST /end MEASUREMENT
/begin MEASUREMENT vFCCSTOT "Failure confirmation counter of CC/SL not available" UBYTE COMP_0068 1 100 0 255 ECU_ADDRESS 0xFFFF2D1E /begin FUNCTION_LIST R902.1.SafetyDiagManager_1_3_6 /end FUNCTION_LIST /end MEASUREMENT
/begin MEASUREMENT vFCESPCLK "Failure confirmation counter of Agb clock error" UBYTE COMP_0068 1 100 0 255 ECU_ADDRESS 0xFFFF2D20 /begin FUNCTION_LIST R902.1.SafetyDiagManager_1_3_6 /end FUNCTION_LIST /end MEASUREMENT
/begin MEASUREMENT vFCESPCPL "Failure confirmation counter of lost of communication" UBYTE COMP_0068 1 100 0 255 ECU_ADDRESS 0xFFFF2D21 /begin FUNCTION_LIST R902.1.SafetyDiagManager_1_3_6 /end FUNCTION_LIST /end MEASUREMENT
/begin MEASUREMENT vFCESPLNK "Failure confirmation counter of ESP clock error" UBYTE COMP_0068 1 100 0 255 ECU_ADDRESS 0xFFFF2D22 /begin FUNCTION_LIST R902.1.SafetyDiagManager_1_3_6 /end FUNCTION_LIST /end MEASUREMENT
/begin MEASUREMENT vFCPRSOC "Failure confirmation counter of Air conditioning pressure sensor open circuit confirmed failure" UBYTE COMP_0068 1 100 0 255 ECU_ADDRESS 0xFFFF2D2C /begin FUNCTION_LIST R902.1.SafetyDiagManager_1_3_6 /end FUNCTION_LIST /end MEASUREMENT
/begin MEASUREMENT vFCPRSSC "Failure confirmation counter of Air conditioning pressure sensor short circuit confirmed failure" UBYTE COMP_0068 1 100 0 255 ECU_ADDRESS 0xFFFF2D2D /begin FUNCTION_LIST R902.1.SafetyDiagManager_1_3_6 /end FUNCTION_LIST /end MEASUREMENT
/begin MEASUREMENT vFCUPCRCV "Failure confirmation counter of invalide value of the alternator    power transmited by the USM" UBYTE COMP_0068 1 100 0 255 ECU_ADDRESS 0xFFFF2D2F /begin FUNCTION_LIST R902.1.SafetyDiagManager_1_3_6 /end FUNCTION_LIST /end MEASUREMENT
/begin MEASUREMENT vFCVSCMP "Failure confirmation counter of NO. coherence between displayed speed and real speed" UBYTE COMP_0068 1 100 0 255 ECU_ADDRESS 0xFFFF2D31 /begin FUNCTION_LIST R902.1.SafetyDiagManager_1_3_6 /end FUNCTION_LIST /end MEASUREMENT
/begin MEASUREMENT vFLAGCNX "Carrier connexion" UBYTE COMP_0004 1 100 0 255 ECU_ADDRESS 0xFFFF3CD0 /begin FUNCTION_LIST R901.1.Diag_on_can_app_1_6_2 /end FUNCTION_LIST /end MEASUREMENT
/begin MEASUREMENT vFLAGDET "Carrier information" UBYTE COMP_0004 1 100 0 255 ECU_ADDRESS 0xFFFF3CD1 /begin FUNCTION_LIST R901.1.Diag_on_can_app_1_6_2 /end FUNCTION_LIST /end MEASUREMENT
/begin MEASUREMENT vFLAGFAIL "Carrier failures" UBYTE COMP_0004 1 100 0 255 ECU_ADDRESS 0xFFFF3CD2 /begin FUNCTION_LIST R901.1.Diag_on_can_app_1_6_2 /end FUNCTION_LIST /end MEASUREMENT
/begin MEASUREMENT vFLAGFAN "Carrier of FAN information" UBYTE COMP_0068 1 100 0 255 ECU_ADDRESS 0xFFFF3CD3 /begin FUNCTION_LIST R901.1.Diag_on_can_app_1_6_2 /end FUNCTION_LIST /end MEASUREMENT
/begin MEASUREMENT vFLAGIMX1 "Carrier input mux 1" UBYTE COMP_0004 1 100 0 255 ECU_ADDRESS 0xFFFF3CD4 /begin FUNCTION_LIST R901.1.Diag_on_can_app_1_6_2 /end FUNCTION_LIST /end MEASUREMENT
/begin MEASUREMENT vFLAGIMX2 "Carrier input mux 2" UBYTE COMP_0004 1 100 0 255 ECU_ADDRESS 0xFFFF3CD5 /begin FUNCTION_LIST R901.1.Diag_on_can_app_1_6_2 /end FUNCTION_LIST /end MEASUREMENT
/begin MEASUREMENT vFLAGIMX3 "Carrier input mux 3" UBYTE COMP_0004 1 100 0 255 ECU_ADDRESS 0xFFFF3CD6 /begin FUNCTION_LIST R901.1.Diag_on_can_app_1_6_2 /end FUNCTION_LIST /end MEASUREMENT
/begin MEASUREMENT vFLAGPRS "Carrier of Pressure information" UBYTE COMP_0068 1 100 0 255 ECU_ADDRESS 0xFFFF3CD7 /begin FUNCTION_LIST R901.1.Diag_on_can_app_1_6_2 /end FUNCTION_LIST /end MEASUREMENT
/begin MEASUREMENT vFLAGSWI "Carrier switch" UBYTE COMP_0004 1 100 0 255 ECU_ADDRESS 0xFFFF3CD8 /begin FUNCTION_LIST R901.1.Diag_on_can_app_1_6_2 /end FUNCTION_LIST /end MEASUREMENT
/begin MEASUREMENT vFLAGWFIN "Carrier wired switch" UBYTE COMP_0004 1 100 0 255 ECU_ADDRESS 0xFFFF3CD9 /begin FUNCTION_LIST R901.1.Diag_on_can_app_1_6_2 /end FUNCTION_LIST /end MEASUREMENT
/begin MEASUREMENT vFLGCRKI "Carrier of inputs" UBYTE COMP_0068 1 100 0 255 ECU_ADDRESS 0xFFFF3D60 /begin FUNCTION_LIST R901.1.Diag_on_can_app_1_6_2 /end FUNCTION_LIST /end MEASUREMENT
/begin MEASUREMENT vFLGCRKO "Carrier of outputs" UBYTE COMP_0068 1 100 0 255 ECU_ADDRESS 0xFFFF3D61 /begin FUNCTION_LIST R901.1.Diag_on_can_app_1_6_2 /end FUNCTION_LIST /end MEASUREMENT
/begin MEASUREMENT vFLGSWLK "Carrier for Immobiliser function" UBYTE COMP_0572_S 1 100 0 255 ECU_ADDRESS 0xFFFF3D6B /begin FUNCTION_LIST R901.1.Diag_on_can_app_1_6_2 /end FUNCTION_LIST /end MEASUREMENT
/begin MEASUREMENT vFOXMN "O2 sensor unusual voltage diagnosis voltage monitor period output minimum value" UBYTE COMP_0104 1 100 0 2550 ECU_ADDRESS 0xFFFF3D85 /begin FUNCTION_LIST R901.1.Diag_on_can_app_1_6_2 /end FUNCTION_LIST /end MEASUREMENT
/begin MEASUREMENT vFOXMX "O2 sensor unusual voltage diagnosis voltage monitor period output maximum value" UBYTE COMP_0104 1 100 0 2550 ECU_ADDRESS 0xFFFF3D87 /begin FUNCTION_LIST R901.1.Diag_on_can_app_1_6_2 /end FUNCTION_LIST /end MEASUREMENT
/begin MEASUREMENT vFTDIVST1 "Byte used to allow Immobilizer diagnosis" UBYTE COMP_0068 1 100 0 255 ECU_ADDRESS 0xFFFF3D8D DISPLAY_IDENTIFIER FTDIVST1 /begin FUNCTION_LIST R901.1.Diag_on_can_app_1_6_2 /end FUNCTION_LIST /end MEASUREMENT
/begin MEASUREMENT vFTDIVST2 "Byte used to allow Immobilizer diagnosis" UBYTE COMP_0068 1 100 0 255 ECU_ADDRESS 0xFFFF3D8E DISPLAY_IDENTIFIER FTDIVST2 /begin FUNCTION_LIST R901.1.Diag_on_can_app_1_6_2 /end FUNCTION_LIST /end MEASUREMENT
/begin MEASUREMENT vFTDIVST3 "Byte used to allow immobilizer diagnosis" UBYTE COMP_0068 1 100 0 255 ECU_ADDRESS 0xFFFF3D8F DISPLAY_IDENTIFIER Vxx_swlk_diag_3 /begin FUNCTION_LIST R901.1.Diag_on_can_app_1_6_2 /end FUNCTION_LIST /end MEASUREMENT
/begin MEASUREMENT vGEARDIAG "Gear engaged (0 1 2 3 4 5 6 7)" UBYTE COMP_0004 1 100 0 255 ECU_ADDRESS 0xFFFF3DA0 DISPLAY_IDENTIFIER Vxx_gear_diag /begin FUNCTION_LIST R901.1.Diag_on_can_app_1_6_2 /end FUNCTION_LIST /end MEASUREMENT
/begin MEASUREMENT vGFO2 "A former O2 sensor unusual voltage diagnosis parameter for GST" UBYTE COMP_0104 1 100 0 2550 ECU_ADDRESS 0xFFFFA472 /begin FUNCTION_LIST R904.1.Gst_on_can_1_0_1 /end FUNCTION_LIST /end MEASUREMENT
/begin MEASUREMENT vGFO2N "Former O2 sensor unusual voltage diagnosis voltage minimum value for GST" UBYTE COMP_0104 1 100 0 2550 ECU_ADDRESS 0xFFFFB78D /begin FUNCTION_LIST R901.1.Diag_on_can_app_1_6_2 R904.1.Gst_on_can_1_0_1 /end FUNCTION_LIST /end MEASUREMENT
/begin MEASUREMENT vGFO2R "A former O2 sensor diagnosis response sex parameter for GST" UBYTE COMP_0317 1 100 0 4080 ECU_ADDRESS 0xFFFFB54F /begin FUNCTION_LIST R901.1.Diag_on_can_app_1_6_2 R904.1.Gst_on_can_1_0_1 /end FUNCTION_LIST /end MEASUREMENT
/begin MEASUREMENT vGFO2X "Former O2 sensor unusual voltage diagnosis voltage maximum value for GST" UBYTE COMP_0104 1 100 0 2550 ECU_ADDRESS 0xFFFFB78F /begin FUNCTION_LIST R901.1.Diag_on_can_app_1_6_2 R904.1.Gst_on_can_1_0_1 /end FUNCTION_LIST /end MEASUREMENT
/begin MEASUREMENT vGFODT "A former O sensor breakage diagnosis parameter for GST" UBYTE COMP_0013 1 100 0 255 ECU_ADDRESS 0xFFFFA476 /begin FUNCTION_LIST R904.1.Gst_on_can_1_0_1 /end FUNCTION_LIST /end MEASUREMENT
/begin MEASUREMENT vMILREQ1 "MIL ignition state requested by MUX encoding" UBYTE COMP_0068 1 100 0 255 ECU_ADDRESS 0xFFFF4209 DISPLAY_IDENTIFIER Vxx_mux_mil_req_1
 /begin FUNCTION_LIST R901.1.Diag_on_can_app_1_6_2 R902.2.DiagMiscell_1_3_5 R903.1.milmgtx_1_0_2 /end FUNCTION_LIST
/end MEASUREMENT
/begin MEASUREMENT vMILREQ2 "Readiness state indication by MIL" UBYTE COMP_0068 1 100 0 255 ECU_ADDRESS 0xFFFF420A DISPLAY_IDENTIFIER Vxx_mux_mil_req_2
 /begin FUNCTION_LIST R901.1.Diag_on_can_app_1_6_2 R902.2.DiagMiscell_1_3_5 R903.1.milmgtx_1_0_2 /end FUNCTION_LIST
/end MEASUREMENT
/begin MEASUREMENT vNEDOCF "Calculated target speed wave" UWORD COMP_0337_S 1 100 0 65535 ECU_ADDRESS 0xFFFF3006 /begin FUNCTION_LIST Rxxx.1.Diagnostic_cycle_1_0_1 /end FUNCTION_LIST /end MEASUREMENT
/begin MEASUREMENT vO2HCUR "Former O sensor heater voltage conversion value" UBYTE COMP_0054 1 100 0 5100 ECU_ADDRESS 0xFFFF4953 /begin FUNCTION_LIST R901.1.Diag_on_can_app_1_6_2 /end FUNCTION_LIST /end MEASUREMENT
/begin MEASUREMENT vO2HDTY "O2 sensor heater duty" UWORD COMP_0133_S 1 100 0 2559.9609375 ECU_ADDRESS 0xFFFF23EA /begin FUNCTION_LIST R901.1.Diag_on_can_app_1_6_2 /end FUNCTION_LIST /end MEASUREMENT
/begin MEASUREMENT vRETLMT22 "The retard side maximum change width" UWORD COMP_0081 1 100 0 255.99609375 ECU_ADDRESS 0xFFFF173E /begin FUNCTION_LIST R301.23.ADV_calculation_1_1_2 /end FUNCTION_LIST /end MEASUREMENT
/begin MEASUREMENT vSCKFACT "Speed compensation coefficient" UWORD COMP_0388 1 100 0 6553.5 ECU_ADDRESS 0xFFFF31BA /begin FUNCTION_LIST R301.23.ADV_calculation_1_1_2 /end FUNCTION_LIST /end MEASUREMENT
/begin MEASUREMENT vSCKGP "Gear position compensation coefficient" UBYTE COMP_0388 1 100 0 25.5 ECU_ADDRESS 0xFFFF31BC /begin FUNCTION_LIST R301.23.ADV_calculation_1_1_2 /end FUNCTION_LIST /end MEASUREMENT
/begin MEASUREMENT vSCKONC "Speed for retard timing adjustment" SWORD COMP_0623_S 1 100 -102400 102396.875 ECU_ADDRESS 0xFFFF31BE /begin FUNCTION_LIST R301.23.ADV_calculation_1_1_2 /end FUNCTION_LIST /end MEASUREMENT
/begin MEASUREMENT vTRCCNT "The number of trouble codes" UBYTE COMP_0068 1 100 0 255 ECU_ADDRESS 0xFFFF3F98 /begin FUNCTION_LIST R904.1.Gst_on_can_1_0_1 /end FUNCTION_LIST /end MEASUREMENT
/begin MEASUREMENT vTRHOSIMX "TRHOSi maximum value" UBYTE COMP_0517_S 1 100 -128 127 ECU_ADDRESS 0xFFFF4086 /begin FUNCTION_LIST R301.22.TRHOSI_1_0_2 /end FUNCTION_LIST /end MEASUREMENT
/begin MEASUREMENT vTRQGP "Gear position for torque control" UBYTE COMP_0068 1 100 0 255 ECU_ADDRESS 0xFFFF19C2 /begin FUNCTION_LIST R301.23.ADV_calculation_1_1_2 /end FUNCTION_LIST /end MEASUREMENT
/begin MEASUREMENT vTSTMILDY "Current delay before readiness status check" UBYTE COMP_0105 1 100 0 25.5 ECU_ADDRESS 0xFFFF33FE DISPLAY_IDENTIFIER Vxx_mux_test_mil_dly /begin FUNCTION_LIST R903.1.milmgtx_1_0_2 /end FUNCTION_LIST /end MEASUREMENT
/begin MEASUREMENT vTSTRDNDY "MIL flashing current delay when readiness are not completed" UBYTE COMP_0105 1 100 0 25.5 ECU_ADDRESS 0xFFFF33FF DISPLAY_IDENTIFIER Vxx_mux_test_rdn_mil_dly /begin FUNCTION_LIST R903.1.milmgtx_1_0_2 /end FUNCTION_LIST /end MEASUREMENT
/begin MEASUREMENT vVINRX "Veicle Identifire Number" UBYTE COMP_0068 1 100 0 255 ECU_ADDRESS 0xFFFF3FC0 /begin FUNCTION_LIST R904.1.Gst_on_can_1_0_1 /end FUNCTION_LIST /end MEASUREMENT
/begin MEASUREMENT vVINRX_R#1 "Veicle Identifire Number" UBYTE COMP_0068 1 100 0 255 ECU_ADDRESS 0xFFFF3FC0 /begin FUNCTION_LIST R904.1.Gst_on_can_1_0_1 /end FUNCTION_LIST /end MEASUREMENT
/begin MEASUREMENT vVINRX_R#2 "Veicle Identifire Number" UBYTE COMP_0068 1 100 0 255 ECU_ADDRESS 0xFFFF3FC1 /begin FUNCTION_LIST R904.1.Gst_on_can_1_0_1 /end FUNCTION_LIST /end MEASUREMENT
/begin MEASUREMENT vVINRX_R#3 "Veicle Identifire Number" UBYTE COMP_0068 1 100 0 255 ECU_ADDRESS 0xFFFF3FC2 /begin FUNCTION_LIST R904.1.Gst_on_can_1_0_1 /end FUNCTION_LIST /end MEASUREMENT
/begin MEASUREMENT vVINRX_R#4 "Veicle Identifire Number" UBYTE COMP_0068 1 100 0 255 ECU_ADDRESS 0xFFFF3FC3 /begin FUNCTION_LIST R904.1.Gst_on_can_1_0_1 /end FUNCTION_LIST /end MEASUREMENT
/begin MEASUREMENT vVINRX_R#5 "Veicle Identifire Number" UBYTE COMP_0068 1 100 0 255 ECU_ADDRESS 0xFFFF3FC4 /begin FUNCTION_LIST R904.1.Gst_on_can_1_0_1 /end FUNCTION_LIST /end MEASUREMENT
/begin MEASUREMENT vVINRX_R#6 "Veicle Identifire Number" UBYTE COMP_0068 1 100 0 255 ECU_ADDRESS 0xFFFF3FC5 /begin FUNCTION_LIST R904.1.Gst_on_can_1_0_1 /end FUNCTION_LIST /end MEASUREMENT
/begin MEASUREMENT vVINRX_R#7 "Veicle Identifire Number" UBYTE COMP_0068 1 100 0 255 ECU_ADDRESS 0xFFFF3FC6 /begin FUNCTION_LIST R904.1.Gst_on_can_1_0_1 /end FUNCTION_LIST /end MEASUREMENT
/begin MEASUREMENT vVINRX_R#8 "Veicle Identifire Number" UBYTE COMP_0068 1 100 0 255 ECU_ADDRESS 0xFFFF3FC7 /begin FUNCTION_LIST R904.1.Gst_on_can_1_0_1 /end FUNCTION_LIST /end MEASUREMENT
/begin MEASUREMENT vVINRX_R#9 "Veicle Identifire Number" UBYTE COMP_0068 1 100 0 255 ECU_ADDRESS 0xFFFF3FC8 /begin FUNCTION_LIST R904.1.Gst_on_can_1_0_1 /end FUNCTION_LIST /end MEASUREMENT
/begin MEASUREMENT vVINRX_R#10 "Veicle Identifire Number" UBYTE COMP_0068 1 100 0 255 ECU_ADDRESS 0xFFFF3FC9 /begin FUNCTION_LIST R904.1.Gst_on_can_1_0_1 /end FUNCTION_LIST /end MEASUREMENT
/begin MEASUREMENT vVINRX_R#11 "Veicle Identifire Number" UBYTE COMP_0068 1 100 0 255 ECU_ADDRESS 0xFFFF3FCA /begin FUNCTION_LIST R904.1.Gst_on_can_1_0_1 /end FUNCTION_LIST /end MEASUREMENT
/begin MEASUREMENT vVINRX_R#12 "Veicle Identifire Number" UBYTE COMP_0068 1 100 0 255 ECU_ADDRESS 0xFFFF3FCB /begin FUNCTION_LIST R904.1.Gst_on_can_1_0_1 /end FUNCTION_LIST /end MEASUREMENT
/begin MEASUREMENT vVINRX_R#13 "Veicle Identifire Number" UBYTE COMP_0068 1 100 0 255 ECU_ADDRESS 0xFFFF3FCC /begin FUNCTION_LIST R904.1.Gst_on_can_1_0_1 /end FUNCTION_LIST /end MEASUREMENT
/begin MEASUREMENT vVINRX_R#14 "Veicle Identifire Number" UBYTE COMP_0068 1 100 0 255 ECU_ADDRESS 0xFFFF3FCD /begin FUNCTION_LIST R904.1.Gst_on_can_1_0_1 /end FUNCTION_LIST /end MEASUREMENT
/begin MEASUREMENT vVINRX_R#15 "Veicle Identifire Number" UBYTE COMP_0068 1 100 0 255 ECU_ADDRESS 0xFFFF3FCE /begin FUNCTION_LIST R904.1.Gst_on_can_1_0_1 /end FUNCTION_LIST /end MEASUREMENT
/begin MEASUREMENT vVINRX_R#16 "Veicle Identifire Number" UBYTE COMP_0068 1 100 0 255 ECU_ADDRESS 0xFFFF3FCF /begin FUNCTION_LIST R904.1.Gst_on_can_1_0_1 /end FUNCTION_LIST /end MEASUREMENT
/begin MEASUREMENT vVINRX_R#17 "Veicle Identifire Number" UBYTE COMP_0068 1 100 0 255 ECU_ADDRESS 0xFFFF3FD0 /begin FUNCTION_LIST R904.1.Gst_on_can_1_0_1 /end FUNCTION_LIST /end MEASUREMENT
/begin MEASUREMENT vVINRX_R#18 "Veicle Identifire Number" UBYTE COMP_0068 1 100 0 255 ECU_ADDRESS 0xFFFF3FD1 /begin FUNCTION_LIST R904.1.Gst_on_can_1_0_1 /end FUNCTION_LIST /end MEASUREMENT
/begin MEASUREMENT vVINRX_R#19 "Veicle Identifire Number" UBYTE COMP_0068 1 100 0 255 ECU_ADDRESS 0xFFFF3FD2 /begin FUNCTION_LIST R904.1.Gst_on_can_1_0_1 /end FUNCTION_LIST /end MEASUREMENT
/* COMPU_METHOD --------------------------------------------------------- */
/begin COMPU_METHOD COMP_0017 "1deg" RAT_FUNC "%8.2" "deg" COEFFS 0 1 0 0 0 1 /end COMPU_METHOD
/begin COMPU_METHOD COMP_0205_S "fixed axis Long" RAT_FUNC "%8.2" "Long" COEFFS 0 1 0 0 0 1 /end COMPU_METHOD
/begin COMPU_METHOD COMP_0290 "1/65536-" RAT_FUNC "%8.6" "-" COEFFS 0 1 0 0 0 0.0000152588 /end COMPU_METHOD
/begin COMPU_METHOD COMP_0068 "1-" RAT_FUNC "%8.2" "-" COEFFS 0 1 0 0 0 1 /end COMPU_METHOD
/begin COMPU_METHOD COMP_0004 "1Å|" RAT_FUNC "%8.2" "Å|" COEFFS 0 1 0 0 0 1 /end COMPU_METHOD
/begin COMPU_METHOD COMP_0023 "5mV" RAT_FUNC "%8.2" "mV" COEFFS 0 1 0 0 0 5 /end COMPU_METHOD
/begin COMPU_METHOD COMP_0045 "1/128-" RAT_FUNC "%8.4" "-" COEFFS 0 1 0 0 0 0.0078125 /end COMPU_METHOD
/begin COMPU_METHOD COMP_0186 "1/64-" RAT_FUNC "%8.3" "-" COEFFS 0 1 0 0 0 0.015625 /end COMPU_METHOD
/begin COMPU_METHOD COMP_0001 "1/8ms" RAT_FUNC "%8.2" "ms" COEFFS 0 1 0 0 0 0.125 /end COMPU_METHOD
/begin COMPU_METHOD COMP_0336_S "0.0001-" RAT_FUNC "%8.5" "-" COEFFS 0 1 0 0 0 0.0001 /end COMPU_METHOD
/begin COMPU_METHOD COMP_0002 "0.35deg" RAT_FUNC "%8.2" "deg" COEFFS 0 1 0 0 0 0.35 /end COMPU_METHOD
/begin COMPU_METHOD COMP_0003 "1Åé" RAT_FUNC "%8.2" "Åé" COEFFS 0 1 0 0 0 1 /end COMPU_METHOD
/begin COMPU_METHOD COMP_0453 "0.002-" RAT_FUNC "%8.4" "-" COEFFS 0 1 0 0 0 0.002 /end COMPU_METHOD
/begin COMPU_METHOD COMP_0014 "10ms" RAT_FUNC "%8.2" "ms" COEFFS 0 1 0 0 0 10 /end COMPU_METHOD
/begin COMPU_METHOD COMP_0008 "100ms" RAT_FUNC "%8.2" "ms" COEFFS 0 1 0 0 0 100 /end COMPU_METHOD
/begin COMPU_METHOD COMP_0337_S "1r/min" RAT_FUNC "%8.2" "r/min" COEFFS 0 1 0 0 0 1 /end COMPU_METHOD
/begin COMPU_METHOD COMP_0009 "100/128%" RAT_FUNC "%8.2" "%" COEFFS 0 1 0 0 0 0.78125 /end COMPU_METHOD
/begin COMPU_METHOD COMP_0013 "1s" RAT_FUNC "%8.2" "s" COEFFS 0 1 0 0 0 1 /end COMPU_METHOD
/begin COMPU_METHOD COMP_0000 "25rpm" RAT_FUNC "%8.2" "rpm" COEFFS 0 1 0 0 0 25 /end COMPU_METHOD
/begin COMPU_METHOD COMP_0047 "0.5%" RAT_FUNC "%8.2" "%" COEFFS 0 1 0 0 0 0.5 /end COMPU_METHOD
/begin COMPU_METHOD COMP_0436 "0.1km/h" RAT_FUNC "%8.2" "km/h" COEFFS 0 1 0 0 0 0.1 /end COMPU_METHOD
/begin COMPU_METHOD COMP_0081 "1/256deg" RAT_FUNC "%8.4" "deg" COEFFS 0 1 0 0 0 0.00390625 /end COMPU_METHOD
/begin COMPU_METHOD COMP_0007 "2km/h" RAT_FUNC "%8.2" "km/h" COEFFS 0 1 0 0 0 2 /end COMPU_METHOD
/begin COMPU_METHOD COMP_0250 "4ms" RAT_FUNC "%8.2" "ms" COEFFS 0 1 0 0 0 4 /end COMPU_METHOD
/begin COMPU_METHOD COMP_0033 "80mV" RAT_FUNC "%8.2" "mV" COEFFS 0 1 0 0 0 80 /end COMPU_METHOD
/begin COMPU_METHOD COMP_0027 "1%" RAT_FUNC "%8.2" "%" COEFFS 0 1 0 0 0 1 /end COMPU_METHOD
/begin COMPU_METHOD COMP_0049 "1sec" RAT_FUNC "%8.2" "sec" COEFFS 0 1 0 0 0 1 /end COMPU_METHOD
/begin COMPU_METHOD COMP_0032 "1/256Å|" RAT_FUNC "%8.4" "Å|" COEFFS 0 1 0 0 0 0.00390625 /end COMPU_METHOD
/begin COMPU_METHOD COMP_0063 "1/256-" RAT_FUNC "%8.4" "-" COEFFS 0 1 0 0 0 0.00390625 /end COMPU_METHOD
/begin COMPU_METHOD COMP_0130 "0.0275deg" RAT_FUNC "%8.3" "deg" COEFFS 0 1 0 0 0 0.0275 /end COMPU_METHOD
/begin COMPU_METHOD COMP_0015 "0.125Å|" RAT_FUNC "%8.2" "Å|" COEFFS 0 1 0 0 0 0.125 /end COMPU_METHOD
/begin COMPU_METHOD COMP_0030 "1âÒ" RAT_FUNC "%8.2" "âÒ" COEFFS 0 1 0 0 0 1 /end COMPU_METHOD
/begin COMPU_METHOD COMP_0344_S "0.01s" RAT_FUNC "%8.3" "s" COEFFS 0 1 0 0 0 0.01 /end COMPU_METHOD
/begin COMPU_METHOD COMP_0345_S "1/32Nm" RAT_FUNC "%8.3" "Nm" COEFFS 0 1 400 0 0 0.03125 /end COMPU_METHOD
/begin COMPU_METHOD COMP_0346_S "5Nm/s" RAT_FUNC "%8.2" "Nm/s" COEFFS 0 1 32765 0 0 5 /end COMPU_METHOD
/begin COMPU_METHOD COMP_0351_S "2000W" RAT_FUNC "%8.2" "W" COEFFS 0 1 0 0 0 2000 /end COMPU_METHOD
/begin COMPU_METHOD COMP_0352_S "25/256s" RAT_FUNC "%8.3" "s" COEFFS 0 1 0 0 0 0.0976563 /end COMPU_METHOD
/begin COMPU_METHOD COMP_0005 "0.11deg" RAT_FUNC "%8.2" "deg" COEFFS 0 1 0 0 0 0.11 /end COMPU_METHOD
/begin COMPU_METHOD COMP_0037 "3.125*10ÅO-6cm^2/%" RAT_FUNC "%8.6" "cm^2/%" COEFFS 0 1 0 0 0 0.000003125 /end COMPU_METHOD
/begin COMPU_METHOD COMP_0361_S "0.001-" RAT_FUNC "%8.4" "-" COEFFS 0 1 0 0 0 0.001 /end COMPU_METHOD
/begin COMPU_METHOD COMP_0366_S "0.02s" RAT_FUNC "%8.3" "s" COEFFS 0 1 0 0 0 0.02 /end COMPU_METHOD
/begin COMPU_METHOD COMP_0043 "1/(256*4)Å|" RAT_FUNC "%8.5" "Å|" COEFFS 0 1 0 0 0 0.000976563 /end COMPU_METHOD
/begin COMPU_METHOD COMP_0044 "1/128Å|" RAT_FUNC "%8.4" "Å|" COEFFS 0 1 0 0 0 0.0078125 /end COMPU_METHOD
/begin COMPU_METHOD COMP_0370_S "20/256mV/100ms" RAT_FUNC "%8.3" "mV/100ms" COEFFS 0 1 0 0 0 0.078125 /end COMPU_METHOD
/begin COMPU_METHOD COMP_0016 "1count" RAT_FUNC "%8.2" "count" COEFFS 0 1 0 0 0 1 /end COMPU_METHOD
/begin COMPU_METHOD COMP_0054 "20mV" RAT_FUNC "%8.2" "mV" COEFFS 0 1 0 0 0 20 /end COMPU_METHOD
/begin COMPU_METHOD COMP_0373 "1/100-" RAT_FUNC "%8.3" "-" COEFFS 0 1 0 0 0 0.01 /end COMPU_METHOD
/begin COMPU_METHOD COMP_0105 "0.1s" RAT_FUNC "%8.2" "s" COEFFS 0 1 0 0 0 0.1 /end COMPU_METHOD
/begin COMPU_METHOD COMP_0059 "0.5%/s" RAT_FUNC "%8.2" "%/s" COEFFS 0 1 0 0 0 0.5 /end COMPU_METHOD
/begin COMPU_METHOD COMP_0050 "5/64mV" RAT_FUNC "%8.3" "mV" COEFFS 0 1 0 0 0 0.078125 /end COMPU_METHOD
/begin COMPU_METHOD COMP_0035 "X-50Åé" RAT_FUNC "%8.2" "Åé" COEFFS 0 1 50 0 0 1 /end COMPU_METHOD
/begin COMPU_METHOD COMP_0377 "0.11deg" RAT_FUNC "%8.2" "deg" COEFFS 0 1 0 0 0 0.11 /end COMPU_METHOD
/begin COMPU_METHOD COMP_0262 "12.5rpm" RAT_FUNC "%8.2" "rpm" COEFFS 0 1 0 0 0 12.5 /end COMPU_METHOD
/begin COMPU_METHOD COMP_0078 "1/256deg" RAT_FUNC "%8.4" "deg" COEFFS 0 1 0 0 0 0.00390625 /end COMPU_METHOD
/begin COMPU_METHOD COMP_0386_S "1/256Nm/rpm" RAT_FUNC "%8.4" "Nm/rpm" COEFFS 0 1 0 0 0 0.00390625 /end COMPU_METHOD
/begin COMPU_METHOD COMP_0211_S "2/2561/min/10" RAT_FUNC "%8.4" "1/min/10" COEFFS 0 1 0 0 0 0.0078125 /end COMPU_METHOD
/begin COMPU_METHOD COMP_0388_S "1x10ms" RAT_FUNC "%8.2" "x10ms" COEFFS 0 1 0 0 0 1 /end COMPU_METHOD
/begin COMPU_METHOD COMP_0389_S "1r/min/s" RAT_FUNC "%8.2" "r/min/s" COEFFS 0 1 65535 0 0 1 /end COMPU_METHOD
/begin COMPU_METHOD COMP_0096 "10s" RAT_FUNC "%8.2" "s" COEFFS 0 1 0 0 0 10 /end COMPU_METHOD
/begin COMPU_METHOD COMP_0051 "1L/min" RAT_FUNC "%8.2" "L/min" COEFFS 0 1 0 0 0 1 /end COMPU_METHOD
/begin COMPU_METHOD COMP_0410 "100/256/256%" RAT_FUNC "%8.4" "%" COEFFS 0 1 0 0 0 0.00152588 /end COMPU_METHOD
/begin COMPU_METHOD COMP_0220_S "1/10241/10ms" RAT_FUNC "%8.5" "1/10ms" COEFFS 0 1 0 0 0 0.000976563 /end COMPU_METHOD
/begin COMPU_METHOD COMP_0296_S "20/256-" RAT_FUNC "%8.3" "-" COEFFS 0 1 0 0 0 0.078125 /end COMPU_METHOD
/begin COMPU_METHOD COMP_0083 "1/256deg/10ms" RAT_FUNC "%8.4" "deg/10ms" COEFFS 0 1 0 0 0 0.00390625 /end COMPU_METHOD
/begin COMPU_METHOD COMP_0456 "1/(256Å~128)-" RAT_FUNC "%8.6" "-" COEFFS 0 1 0 0 0 0.0000305176 /end COMPU_METHOD
/begin COMPU_METHOD COMP_0104 "10mV" RAT_FUNC "%8.2" "mV" COEFFS 0 1 0 0 0 10 /end COMPU_METHOD
/begin COMPU_METHOD COMP_0150 "0.5L" RAT_FUNC "%8.2" "L" COEFFS 0 1 0 0 0 0.5 /end COMPU_METHOD
/begin COMPU_METHOD COMP_0450 "1/1024-" RAT_FUNC "%8.5" "-" COEFFS 0 1 0 0 0 0.000976563 /end COMPU_METHOD
/begin COMPU_METHOD COMP_0213_S "0.1Nm/100ms" RAT_FUNC "%8.2" "Nm/100ms" COEFFS 0 1 0 0 0 0.1 /end COMPU_METHOD
/begin COMPU_METHOD COMP_0419_S "1/256Åé/100ms" RAT_FUNC "%8.4" "Åé/100ms" COEFFS 0 1 0 0 0 0.00390625 /end COMPU_METHOD
/begin COMPU_METHOD COMP_0424_S "1r/min/s" RAT_FUNC "%8.2" "r/min/s" COEFFS 0 1 0 0 0 1 /end COMPU_METHOD
/begin COMPU_METHOD COMP_0425_S "32/256-" RAT_FUNC "%8.2" "-" COEFFS 0 1 1 0 0 0.125 /end COMPU_METHOD
/begin COMPU_METHOD COMP_0207 "1/128bit" RAT_FUNC "%8.4" "bit" COEFFS 0 1 0 0 0 0.0078125 /end COMPU_METHOD
/begin COMPU_METHOD COMP_0220 "1l/min" RAT_FUNC "%8.2" "l/min" COEFFS 0 1 0 0 0 1 /end COMPU_METHOD
/begin COMPU_METHOD COMP_0435 "1/32-" RAT_FUNC "%8.3" "-" COEFFS 0 1 0 0 0 0.03125 /end COMPU_METHOD
/begin COMPU_METHOD COMP_0139_S "É sÉ s" RAT_FUNC "%8.3" "É s" COEFFS 0 1 0 0 0 0.025 /end COMPU_METHOD
/begin COMPU_METHOD COMP_0133_S "%%" RAT_FUNC "%8.3" "%" COEFFS 0 1 0 0 0 0.0390625 /end COMPU_METHOD
/begin COMPU_METHOD COMP_0229 "2km/h" RAT_FUNC "%8.2" "km/h" COEFFS 0 1 256 0 0 2 /end COMPU_METHOD
/begin COMPU_METHOD COMP_0232 "1/128mm^2" RAT_FUNC "%8.4" "mm^2" COEFFS 0 1 0 0 0 0.0078125 /end COMPU_METHOD
/begin COMPU_METHOD COMP_0233 "0.0011Å|" RAT_FUNC "%8.4" "Å|" COEFFS 0 1 0 0 0 0.0011 /end COMPU_METHOD
/begin COMPU_METHOD COMP_0263 "1-" RAT_FUNC "%8.2" "-" COEFFS 0 1 0 0 0 1 /end COMPU_METHOD
/begin COMPU_METHOD COMP_0022 "20mv" RAT_FUNC "%8.2" "mv" COEFFS 0 1 0 0 0 20 /end COMPU_METHOD
/begin COMPU_METHOD COMP_0437_S "0.5/256%" RAT_FUNC "%8.4" "%" COEFFS 0 1 0 0 0 0.00195313 /end COMPU_METHOD
/begin COMPU_METHOD COMP_0152 "2L" RAT_FUNC "%8.2" "L" COEFFS 0 1 0 0 0 2 /end COMPU_METHOD
/begin COMPU_METHOD COMP_0272 "1/256*32%" RAT_FUNC "%8.5" "%" COEFFS 0 1 0 0 0 0.00012207 /end COMPU_METHOD
/begin COMPU_METHOD COMP_0065 "3.125rpm" RAT_FUNC "%8.2" "rpm" COEFFS 0 1 0 0 0 3.125 /end COMPU_METHOD
/begin COMPU_METHOD COMP_0451_S "0.00125ratio" RAT_FUNC "%8.4" "ratio" COEFFS 0 1 0 0 0 0.00125 /end COMPU_METHOD
/begin COMPU_METHOD COMP_0388 "0.1-" RAT_FUNC "%8.2" "-" COEFFS 0 1 0 0 0 0.1 /end COMPU_METHOD
/begin COMPU_METHOD COMP_0468_S "1time" RAT_FUNC "%8.2" "time" COEFFS 0 1 0 0 0 1 /end COMPU_METHOD
/begin COMPU_METHOD COMP_0293 "2L/min" RAT_FUNC "%8.2" "L/min" COEFFS 0 1 0 0 0 2 /end COMPU_METHOD
/begin COMPU_METHOD COMP_0469_S "1/256*0.5step/(L/" RAT_FUNC "%8.4" "step/(L/" COEFFS 0 1 0 0 0 0.00195313 /end COMPU_METHOD
/begin COMPU_METHOD COMP_0312 "0.5/256L" RAT_FUNC "%8.4" "L" COEFFS 0 1 0 0 0 0.001953125 /end COMPU_METHOD
/begin COMPU_METHOD COMP_0317 "16ms" RAT_FUNC "%8.2" "ms" COEFFS 0 1 0 0 0 16 /end COMPU_METHOD
/begin COMPU_METHOD COMP_0470_S "1/32Nm" RAT_FUNC "%8.3" "Nm" COEFFS 0 1 0 0 0 0.03125 /end COMPU_METHOD
/begin COMPU_METHOD COMP_0372 "0.0008cm2" RAT_FUNC "%8.5" "cm2" COEFFS 0 1 0 0 0 0.0008 /end COMPU_METHOD
/begin COMPU_METHOD COMP_0295 "100msec" RAT_FUNC "%8.2" "msec" COEFFS 0 1 0 0 0 100 /end COMPU_METHOD
/begin COMPU_METHOD COMP_0474_S "0.0763rpm/km/h" RAT_FUNC "%8.3" "rpm/km/h" COEFFS 0 1 0 0 0 0.0763 /end COMPU_METHOD
/begin COMPU_METHOD COMP_0476_S "20/256mV/100ms" RAT_FUNC "%8.3" "mV/100ms" COEFFS 0 1 0 0 0 0.078125 /end COMPU_METHOD
/begin COMPU_METHOD COMP_0477_S "0.04sec" RAT_FUNC "%8.3" "sec" COEFFS 0 1 0 0 0 0.04 /end COMPU_METHOD
/begin COMPU_METHOD COMP_0364 "2km/h" RAT_FUNC "%8.2" "km/h" COEFFS 0 1 0 0 0 2 /end COMPU_METHOD
/begin COMPU_METHOD COMP_0195 "0.1Km/h" RAT_FUNC "%8.2" "Km/h" COEFFS 0 1 0 0 0 0.1 /end COMPU_METHOD
/begin COMPU_METHOD COMP_0226 "0.1Nm" RAT_FUNC "%8.2" "Nm" COEFFS 0 1 3276.8 0 0 0.1 /end COMPU_METHOD
/begin COMPU_METHOD COMP_0273_S "fixed axis rpm" RAT_FUNC "%8.2" "rpm" COEFFS 0 1 -400 0 0 400 /end COMPU_METHOD
/begin COMPU_METHOD COMP_0276_S "fixed axis -" RAT_FUNC "%8.2" "-" COEFFS 0 1 -1 0 0 1 /end COMPU_METHOD
/begin COMPU_METHOD COMP_0278_S "fixed axis Åé" RAT_FUNC "%8.2" "Åé" COEFFS 0 1 40 0 0 20 /end COMPU_METHOD
/begin COMPU_METHOD COMP_0271_S "fixed axis rpm" RAT_FUNC "%8.2" "rpm" COEFFS 0 1 0 0 0 400 /end COMPU_METHOD
/begin COMPU_METHOD COMP_0280_S "fixed axis Åé" RAT_FUNC "%8.2" "Åé" COEFFS 0 1 40 0 0 10 /end COMPU_METHOD
/begin COMPU_METHOD COMP_0496_S "0.5/256L" RAT_FUNC "%8.4" "L" COEFFS 0 1 0 0 0 0.00195313 /end COMPU_METHOD
/begin COMPU_METHOD COMP_0507_S "fixed axis V" RAT_FUNC "%8.2" "V" COEFFS 0 1 -2.08 0 0 0.64 /end COMPU_METHOD
/begin COMPU_METHOD COMP_0517_S "X-128deg" RAT_FUNC "%8.2" "deg" COEFFS 0 1 128 0 0 1 /end COMPU_METHOD
/begin COMPU_METHOD COMP_0525_S "3.125rpm" RAT_FUNC "%8.2" "rpm" COEFFS 0 1 102400 0 0 3.125 /end COMPU_METHOD
/begin COMPU_METHOD COMP_0283 "1flag" RAT_FUNC "%8.2" "flag" COEFFS 0 1 0 0 0 1 /end COMPU_METHOD
/begin COMPU_METHOD COMP_0551_S "r/minr/min" RAT_FUNC "%8.2" "r/min" COEFFS 0 1 0 0 0 1 /end COMPU_METHOD
/begin COMPU_METHOD COMP_0572_S "FlagFlag" RAT_FUNC "%8.2" "Flag" COEFFS 0 1 0 0 0 1 /end COMPU_METHOD
/begin COMPU_METHOD COMP_0623_S "rpmrpm" RAT_FUNC "%8.2" "rpm" COEFFS 0 1 0 0 0 3.125 /end COMPU_METHOD
/* RECORD_LAYOUT ------------------------------------------------------ */
/begin RECORD_LAYOUT REC_UBYTE_C FNC_VALUES 1 UBYTE COLUMN_DIR DIRECT /end RECORD_LAYOUT
/begin RECORD_LAYOUT REC_UWORD_C FNC_VALUES 1 UWORD COLUMN_DIR DIRECT /end RECORD_LAYOUT
/begin RECORD_LAYOUT REC_SWORD_C FNC_VALUES 1 SWORD COLUMN_DIR DIRECT /end RECORD_LAYOUT
/begin RECORD_LAYOUT REC_SBYTE_C FNC_VALUES 1 SBYTE COLUMN_DIR DIRECT /end RECORD_LAYOUT
/begin RECORD_LAYOUT REC_ULONG_C FNC_VALUES 1 ULONG COLUMN_DIR DIRECT /end RECORD_LAYOUT
/begin RECORD_LAYOUT REC_AXIS_UBYTE AXIS_PTS_X 1 UBYTE INDEX_INCR DIRECT /end RECORD_LAYOUT
/begin RECORD_LAYOUT REC_AXIS_UWORD AXIS_PTS_X 1 UWORD INDEX_INCR DIRECT /end RECORD_LAYOUT
/end MODULE
/end PROJECT
